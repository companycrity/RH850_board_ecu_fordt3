AUTOSAR XML (schema 4-0-3)
package /Ford/PortInterfaces
  sender receiver interface Ford_VehicleGGCCData: invalidation-policy{data-element=Ford_VehicleGGCCData, handle-invalid=DONT-INVALIDATE}
    data Ford_VehicleGGCCData: sw-calibration-access=READ-ONLY, type=Ford_VehicleGGCCData
package /Nexteer/Calibrations
  parameter interface u16p0_CalPortIf1
    parameter data prototype Val: sw-calibration-access=READ-WRITE, type=u16p0
package /Nexteer/PortInterfaces
  client server interface GetRefTmr100MicroSec32bit_PortIf1
    operation Oper
      arg RefTmr_Arg: type=uint32, direction=OUT, server-argument-impl-policy=USE-ARGUMENT-TYPE
  client server interface GetTiSpan100MicroSec32bit_PortIf1
    operation Oper
      arg RefTmr_Arg: type=uint32, direction=IN, server-argument-impl-policy=USE-ARGUMENT-TYPE
      arg TiSpan_Arg: type=uint32, direction=OUT, server-argument-impl-policy=USE-ARGUMENT-TYPE
  client server interface SetNtcSts_PortIf1
    operation Oper: possible-error=E_NOT_OK
      4 x arg, all with direction=IN, server-argument-impl-policy=USE-ARGUMENT-TYPE:
        NtcNr_Arg: type=NtcNr1
        NtcStInfo_Arg: type=uint8
        NtcSts_Arg: type=NtcSts1
        DebStep_Arg: type=uint16
    error E_NOT_OK: error-code=1
  sender receiver interface Ary1D_u08_17_PortIf1: invalidation-policy{data-element=Ary1D, handle-invalid=DONT-INVALIDATE}
    data Ary1D: sw-calibration-access=READ-ONLY, type=Ary1D_u08_17
  sender receiver interface float32_PortIf1: invalidation-policy{data-element=float32_PortIf1/Val, handle-invalid=DONT-INVALIDATE}
    data Val: sw-calibration-access=READ-ONLY, type=float32
  sender receiver interface uint8_PortIf1: invalidation-policy{data-element=uint8_PortIf1/Val, handle-invalid=DONT-INVALIDATE}
    data Val: sw-calibration-access=READ-ONLY, type=uint8
