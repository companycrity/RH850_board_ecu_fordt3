AUTOSAR XML (schema 4-0-3)
# COPYRIGHT
# Copyright(c) 2015 - 2017 Renesas Electronics Corporation
package /Renesas/EcucDefs_Spi
  bsw implementation Spi_Impl: programming-language=C, sw-version=2.0.0, vendor-id=59, ar-release-version=4.0.3, vendor-api-infix=Renesas, behavior=BswInternalBehavior_0
  bsw module description Spi: module-id=83
    bsw internal behavior BswInternalBehavior_0
      exclusive area SPI_RAM_DATA_PROTECTION
      64 x bsw interrupt entity, all with can-enter-exclusive-area=SPI_RAM_DATA_PROTECTION:
        BswInterruptEntity_0: implemented-entry=SPI_CSIH0_TIC_ISR, interrupt-category=CAT-1, interrupt-source=INTCSIH0TIC
        BswInterruptEntity_1: implemented-entry=SPI_CSIH0_TIC_CAT2_ISR, interrupt-category=CAT-2, interrupt-source=INTCSIH0TIC
        BswInterruptEntity_2: implemented-entry=SPI_CSIH0_TIJC_ISR, interrupt-category=CAT-1, interrupt-source=INTCSIH0TIJC
        BswInterruptEntity_3: implemented-entry=SPI_CSIH0_TIJC_CAT2_ISR, interrupt-category=CAT-2, interrupt-source=INTCSIH0TIJC
        BswInterruptEntity_4: implemented-entry=SPI_CSIH0_TIR_ISR, interrupt-category=CAT-1, interrupt-source=INTCSIH0TIR
        BswInterruptEntity_5: implemented-entry=SPI_CSIH0_TIR_CAT2_ISR, interrupt-category=CAT-2, interrupt-source=INTCSIH0TIR
        BswInterruptEntity_6: implemented-entry=SPI_CSIH0_TIRE_ISR, interrupt-category=CAT-1, interrupt-source=INTCSIH0TIRE
        BswInterruptEntity_7: implemented-entry=SPI_CSIH0_TIRE_CAT2_ISR, interrupt-category=CAT-2, interrupt-source=INTCSIH0TIRE
        BswInterruptEntity_8: implemented-entry=SPI_CSIH1_TIC_ISR, interrupt-category=CAT-1, interrupt-source=INTCSIH1TIC
        BswInterruptEntity_9: implemented-entry=SPI_CSIH1_TIC_CAT2_ISR, interrupt-category=CAT-2, interrupt-source=INTCSIH1TIC
        BswInterruptEntity_10: implemented-entry=SPI_CSIH1_TIJC_ISR, interrupt-category=CAT-1, interrupt-source=INTCSIH1TIJC
        BswInterruptEntity_11: implemented-entry=SPI_CSIH1_TIJC_CAT2_ISR, interrupt-category=CAT-2, interrupt-source=INTCSIH1TIJC
        BswInterruptEntity_12: implemented-entry=SPI_CSIH1_TIR_ISR, interrupt-category=CAT-1, interrupt-source=INTCSIH1TIR
        BswInterruptEntity_13: implemented-entry=SPI_CSIH1_TIR_CAT2_ISR, interrupt-category=CAT-2, interrupt-source=INTCSIH1TIR
        BswInterruptEntity_14: implemented-entry=SPI_CSIH1_TIRE_ISR, interrupt-category=CAT-1, interrupt-source=INTCSIH1TIRE
        BswInterruptEntity_15: implemented-entry=SPI_CSIH1_TIRE_CAT2_ISR, interrupt-category=CAT-2, interrupt-source=INTCSIH1TIRE
        BswInterruptEntity_16: implemented-entry=SPI_CSIH2_TIC_ISR, interrupt-category=CAT-1, interrupt-source=INTCSIH2TIC
        BswInterruptEntity_17: implemented-entry=SPI_CSIH2_TIC_CAT2_ISR, interrupt-category=CAT-2, interrupt-source=INTCSIH2TIC
        BswInterruptEntity_18: implemented-entry=SPI_CSIH2_TIJC_ISR, interrupt-category=CAT-1, interrupt-source=INTCSIH2TIJC
        BswInterruptEntity_19: implemented-entry=SPI_CSIH2_TIJC_CAT2_ISR, interrupt-category=CAT-2, interrupt-source=INTCSIH2TIJC
        BswInterruptEntity_20: implemented-entry=SPI_CSIH2_TIR_ISR, interrupt-category=CAT-1, interrupt-source=INTCSIH2TIR
        BswInterruptEntity_21: implemented-entry=SPI_CSIH2_TIR_CAT2_ISR, interrupt-category=CAT-2, interrupt-source=INTCSIH2TIR
        BswInterruptEntity_22: implemented-entry=SPI_CSIH2_TIRE_ISR, interrupt-category=CAT-1, interrupt-source=INTCSIH2TIRE
        BswInterruptEntity_23: implemented-entry=SPI_CSIH2_TIRE_CAT2_ISR, interrupt-category=CAT-2, interrupt-source=INTCSIH2TIRE
        BswInterruptEntity_24: implemented-entry=SPI_CSIH3_TIC_ISR, interrupt-category=CAT-1, interrupt-source=INTCSIH3TIC
        BswInterruptEntity_25: implemented-entry=SPI_CSIH3_TIC_CAT2_ISR, interrupt-category=CAT-2, interrupt-source=INTCSIH3TIC
        BswInterruptEntity_26: implemented-entry=SPI_CSIH3_TIJC_ISR, interrupt-category=CAT-1, interrupt-source=INTCSIH3TIJC
        BswInterruptEntity_27: implemented-entry=SPI_CSIH3_TIJC_CAT2_ISR, interrupt-category=CAT-2, interrupt-source=INTCSIH3TIJC
        BswInterruptEntity_28: implemented-entry=SPI_CSIH3_TIR_ISR, interrupt-category=CAT-1, interrupt-source=INTCSIH3TIR
        BswInterruptEntity_29: implemented-entry=SPI_CSIH3_TIR_CAT2_ISR, interrupt-category=CAT-2, interrupt-source=INTCSIH3TIR
        BswInterruptEntity_30: implemented-entry=SPI_CSIH3_TIRE_ISR, interrupt-category=CAT-1, interrupt-source=INTCSIH3TIRE
        BswInterruptEntity_31: implemented-entry=SPI_CSIH3_TIRE_CAT2_ISR, interrupt-category=CAT-2, interrupt-source=INTCSIH3TIRE
        BswInterruptEntity_32: implemented-entry=SPI_DMA00_ISR, interrupt-category=CAT-1, interrupt-source=ICDMA0
        BswInterruptEntity_33: implemented-entry=SPI_DMA00_CAT2_ISR, interrupt-category=CAT-2, interrupt-source=ICDMA0
        BswInterruptEntity_34: implemented-entry=SPI_DMA01_ISR, interrupt-category=CAT-1, interrupt-source=ICDMA1
        BswInterruptEntity_35: implemented-entry=SPI_DMA01_CAT2_ISR, interrupt-category=CAT-2, interrupt-source=ICDMA1
        BswInterruptEntity_36: implemented-entry=SPI_DMA02_ISR, interrupt-category=CAT-1, interrupt-source=ICDMA2
        BswInterruptEntity_37: implemented-entry=SPI_DMA02_CAT2_ISR, interrupt-category=CAT-2, interrupt-source=ICDMA2
        BswInterruptEntity_38: implemented-entry=SPI_DMA03_ISR, interrupt-category=CAT-1, interrupt-source=ICDMA3
        BswInterruptEntity_39: implemented-entry=SPI_DMA03_CAT2_ISR, interrupt-category=CAT-2, interrupt-source=ICDMA3
        BswInterruptEntity_40: implemented-entry=SPI_DMA04_ISR, interrupt-category=CAT-1, interrupt-source=ICDMA4
        BswInterruptEntity_41: implemented-entry=SPI_DMA04_CAT2_ISR, interrupt-category=CAT-2, interrupt-source=ICDMA4
        BswInterruptEntity_42: implemented-entry=SPI_DMA05_ISR, interrupt-category=CAT-1, interrupt-source=ICDMA5
        BswInterruptEntity_43: implemented-entry=SPI_DMA05_CAT2_ISR, interrupt-category=CAT-2, interrupt-source=ICDMA5
        BswInterruptEntity_44: implemented-entry=SPI_DMA06_ISR, interrupt-category=CAT-1, interrupt-source=ICDMA6
        BswInterruptEntity_45: implemented-entry=SPI_DMA06_CAT2_ISR, interrupt-category=CAT-2, interrupt-source=ICDMA6
        BswInterruptEntity_46: implemented-entry=SPI_DMA07_ISR, interrupt-category=CAT-1, interrupt-source=ICDMA7
        BswInterruptEntity_47: implemented-entry=SPI_DMA07_CAT2_ISR, interrupt-category=CAT-2, interrupt-source=ICDMA7
        BswInterruptEntity_48: implemented-entry=SPI_DMA08_ISR, interrupt-category=CAT-1, interrupt-source=ICDMA8
        BswInterruptEntity_49: implemented-entry=SPI_DMA08_CAT2_ISR, interrupt-category=CAT-2, interrupt-source=ICDMA8
        BswInterruptEntity_50: implemented-entry=SPI_DMA09_ISR, interrupt-category=CAT-1, interrupt-source=ICDMA9
        BswInterruptEntity_51: implemented-entry=SPI_DMA09_CAT2_ISR, interrupt-category=CAT-2, interrupt-source=ICDMA9
        BswInterruptEntity_52: implemented-entry=SPI_DMA10_ISR, interrupt-category=CAT-1, interrupt-source=ICDMA10
        BswInterruptEntity_53: implemented-entry=SPI_DMA10_CAT2_ISR, interrupt-category=CAT-2, interrupt-source=ICDMA10
        BswInterruptEntity_54: implemented-entry=SPI_DMA11_ISR, interrupt-category=CAT-1, interrupt-source=ICDMA11
        BswInterruptEntity_55: implemented-entry=SPI_DMA11_CAT2_ISR, interrupt-category=CAT-2, interrupt-source=ICDMA11
        BswInterruptEntity_56: implemented-entry=SPI_DMA12_ISR, interrupt-category=CAT-1, interrupt-source=ICDMA12
        BswInterruptEntity_57: implemented-entry=SPI_DMA12_CAT2_ISR, interrupt-category=CAT-2, interrupt-source=ICDMA12
        BswInterruptEntity_58: implemented-entry=SPI_DMA13_ISR, interrupt-category=CAT-1, interrupt-source=ICDMA13
        BswInterruptEntity_59: implemented-entry=SPI_DMA13_CAT2_ISR, interrupt-category=CAT-2, interrupt-source=ICDMA13
        BswInterruptEntity_60: implemented-entry=SPI_DMA14_ISR, interrupt-category=CAT-1, interrupt-source=ICDMA14
        BswInterruptEntity_61: implemented-entry=SPI_DMA14_CAT2_ISR, interrupt-category=CAT-2, interrupt-source=ICDMA14
        BswInterruptEntity_62: implemented-entry=SPI_DMA15_ISR, interrupt-category=CAT-1, interrupt-source=ICDMA15
        BswInterruptEntity_63: implemented-entry=SPI_DMA15_CAT2_ISR, interrupt-category=CAT-2, interrupt-source=ICDMA15
      16 x bsw called entity:
        BswCalledEntity_0: implemented-entry=Spi_Init
        BswCalledEntity_1: implemented-entry=Spi_DeInit
        BswCalledEntity_2: can-enter-exclusive-area=SPI_RAM_DATA_PROTECTION, implemented-entry=Spi_WriteIB
        BswCalledEntity_3: can-enter-exclusive-area=SPI_RAM_DATA_PROTECTION, implemented-entry=Spi_AsyncTransmit
        BswCalledEntity_4: implemented-entry=Spi_ReadIB
        BswCalledEntity_5: implemented-entry=Spi_SetupEB
        BswCalledEntity_6: implemented-entry=Spi_GetStatus
        BswCalledEntity_7: implemented-entry=Spi_GetJobResult
        BswCalledEntity_8: implemented-entry=Spi_GetSequenceResult
        BswCalledEntity_9: can-enter-exclusive-area=SPI_RAM_DATA_PROTECTION, implemented-entry=Spi_SyncTransmit
        BswCalledEntity_10: implemented-entry=Spi_GetHWUnitStatus
        BswCalledEntity_11: can-enter-exclusive-area=SPI_RAM_DATA_PROTECTION, implemented-entry=Spi_Cancel
        BswCalledEntity_12: implemented-entry=Spi_SetAsyncMode
        BswCalledEntity_13: implemented-entry=Spi_GetVersionInfo
        BswCalledEntity_14: implemented-entry=Spi_SelfTest
        BswCalledEntity_15: implemented-entry=Spi_GetErrorInfo
      bsw schedulable entity Spi_MainFunction_Handling: can-enter-exclusive-area=SPI_RAM_DATA_PROTECTION, minimum-start-interval=0.00000085, implemented-entry=Spi_MainFunction_Handling
  81 x bsw module entry, all with sw-service-impl-policy=STANDARD:
    SPI_CSIH0_TIC_ISR: is-reentrant=true, is-synchronous=false, call-type=INTERRUPT, execution-context=INTERRUPT-CAT-1
    SPI_CSIH0_TIC_CAT2_ISR: is-reentrant=true, is-synchronous=false, call-type=INTERRUPT, execution-context=INTERRUPT-CAT-2
    SPI_CSIH0_TIJC_ISR: is-reentrant=true, is-synchronous=false, call-type=INTERRUPT, execution-context=INTERRUPT-CAT-1
    SPI_CSIH0_TIJC_CAT2_ISR: is-reentrant=true, is-synchronous=false, call-type=INTERRUPT, execution-context=INTERRUPT-CAT-2
    SPI_CSIH0_TIRE_ISR: is-reentrant=true, is-synchronous=false, call-type=INTERRUPT, execution-context=INTERRUPT-CAT-1
    SPI_CSIH0_TIRE_CAT2_ISR: is-reentrant=true, is-synchronous=false, call-type=INTERRUPT, execution-context=INTERRUPT-CAT-2
    SPI_CSIH0_TIR_ISR: is-reentrant=true, is-synchronous=false, call-type=INTERRUPT, execution-context=INTERRUPT-CAT-1
    SPI_CSIH0_TIR_CAT2_ISR: is-reentrant=true, is-synchronous=false, call-type=INTERRUPT, execution-context=INTERRUPT-CAT-2
    SPI_CSIH1_TIC_ISR: is-reentrant=true, is-synchronous=false, call-type=INTERRUPT, execution-context=INTERRUPT-CAT-1
    SPI_CSIH1_TIC_CAT2_ISR: is-reentrant=true, is-synchronous=false, call-type=INTERRUPT, execution-context=INTERRUPT-CAT-2
    SPI_CSIH1_TIJC_ISR: is-reentrant=true, is-synchronous=false, call-type=INTERRUPT, execution-context=INTERRUPT-CAT-1
    SPI_CSIH1_TIJC_CAT2_ISR: is-reentrant=true, is-synchronous=false, call-type=INTERRUPT, execution-context=INTERRUPT-CAT-2
    SPI_CSIH1_TIRE_ISR: is-reentrant=true, is-synchronous=false, call-type=INTERRUPT, execution-context=INTERRUPT-CAT-1
    SPI_CSIH1_TIRE_CAT2_ISR: is-reentrant=true, is-synchronous=false, call-type=INTERRUPT, execution-context=INTERRUPT-CAT-2
    SPI_CSIH1_TIR_ISR: is-reentrant=true, is-synchronous=false, call-type=INTERRUPT, execution-context=INTERRUPT-CAT-1
    SPI_CSIH1_TIR_CAT2_ISR: is-reentrant=true, is-synchronous=false, call-type=INTERRUPT, execution-context=INTERRUPT-CAT-2
    SPI_CSIH2_TIC_ISR: is-reentrant=true, is-synchronous=false, call-type=INTERRUPT, execution-context=INTERRUPT-CAT-1
    SPI_CSIH2_TIC_CAT2_ISR: is-reentrant=true, is-synchronous=false, call-type=INTERRUPT, execution-context=INTERRUPT-CAT-2
    SPI_CSIH2_TIJC_ISR: is-reentrant=true, is-synchronous=false, call-type=INTERRUPT, execution-context=INTERRUPT-CAT-1
    SPI_CSIH2_TIJC_CAT2_ISR: is-reentrant=true, is-synchronous=false, call-type=INTERRUPT, execution-context=INTERRUPT-CAT-2
    SPI_CSIH2_TIRE_ISR: is-reentrant=true, is-synchronous=false, call-type=INTERRUPT, execution-context=INTERRUPT-CAT-1
    SPI_CSIH2_TIRE_CAT2_ISR: is-reentrant=true, is-synchronous=false, call-type=INTERRUPT, execution-context=INTERRUPT-CAT-2
    SPI_CSIH2_TIR_ISR: is-reentrant=true, is-synchronous=false, call-type=INTERRUPT, execution-context=INTERRUPT-CAT-1
    SPI_CSIH2_TIR_CAT2_ISR: is-reentrant=true, is-synchronous=false, call-type=INTERRUPT, execution-context=INTERRUPT-CAT-2
    SPI_CSIH3_TIC_ISR: is-reentrant=true, is-synchronous=false, call-type=INTERRUPT, execution-context=INTERRUPT-CAT-1
    SPI_CSIH3_TIC_CAT2_ISR: is-reentrant=true, is-synchronous=false, call-type=INTERRUPT, execution-context=INTERRUPT-CAT-2
    SPI_CSIH3_TIJC_ISR: is-reentrant=true, is-synchronous=false, call-type=INTERRUPT, execution-context=INTERRUPT-CAT-1
    SPI_CSIH3_TIJC_CAT2_ISR: is-reentrant=true, is-synchronous=false, call-type=INTERRUPT, execution-context=INTERRUPT-CAT-2
    SPI_CSIH3_TIRE_ISR: is-reentrant=true, is-synchronous=false, call-type=INTERRUPT, execution-context=INTERRUPT-CAT-1
    SPI_CSIH3_TIRE_CAT2_ISR: is-reentrant=true, is-synchronous=false, call-type=INTERRUPT, execution-context=INTERRUPT-CAT-2
    SPI_CSIH3_TIR_ISR: is-reentrant=true, is-synchronous=false, call-type=INTERRUPT, execution-context=INTERRUPT-CAT-1
    SPI_CSIH3_TIR_CAT2_ISR: is-reentrant=true, is-synchronous=false, call-type=INTERRUPT, execution-context=INTERRUPT-CAT-2
    SPI_DMA00_ISR: is-reentrant=true, is-synchronous=false, call-type=INTERRUPT, execution-context=INTERRUPT-CAT-1
    SPI_DMA00_CAT2_ISR: is-reentrant=true, is-synchronous=false, call-type=INTERRUPT, execution-context=INTERRUPT-CAT-2
    SPI_DMA01_ISR: is-reentrant=true, is-synchronous=false, call-type=INTERRUPT, execution-context=INTERRUPT-CAT-1
    SPI_DMA01_CAT2_ISR: is-reentrant=true, is-synchronous=false, call-type=INTERRUPT, execution-context=INTERRUPT-CAT-2
    SPI_DMA02_ISR: is-reentrant=true, is-synchronous=false, call-type=INTERRUPT, execution-context=INTERRUPT-CAT-1
    SPI_DMA02_CAT2_ISR: is-reentrant=true, is-synchronous=false, call-type=INTERRUPT, execution-context=INTERRUPT-CAT-2
    SPI_DMA03_ISR: is-reentrant=true, is-synchronous=false, call-type=INTERRUPT, execution-context=INTERRUPT-CAT-1
    SPI_DMA03_CAT2_ISR: is-reentrant=true, is-synchronous=false, call-type=INTERRUPT, execution-context=INTERRUPT-CAT-2
    SPI_DMA04_ISR: is-reentrant=true, is-synchronous=false, call-type=INTERRUPT, execution-context=INTERRUPT-CAT-1
    SPI_DMA04_CAT2_ISR: is-reentrant=true, is-synchronous=false, call-type=INTERRUPT, execution-context=INTERRUPT-CAT-2
    SPI_DMA05_ISR: is-reentrant=true, is-synchronous=false, call-type=INTERRUPT, execution-context=INTERRUPT-CAT-1
    SPI_DMA05_CAT2_ISR: is-reentrant=true, is-synchronous=false, call-type=INTERRUPT, execution-context=INTERRUPT-CAT-2
    SPI_DMA06_ISR: is-reentrant=true, is-synchronous=false, call-type=INTERRUPT, execution-context=INTERRUPT-CAT-1
    SPI_DMA06_CAT2_ISR: is-reentrant=true, is-synchronous=false, call-type=INTERRUPT, execution-context=INTERRUPT-CAT-2
    SPI_DMA07_ISR: is-reentrant=true, is-synchronous=false, call-type=INTERRUPT, execution-context=INTERRUPT-CAT-1
    SPI_DMA07_CAT2_ISR: is-reentrant=true, is-synchronous=false, call-type=INTERRUPT, execution-context=INTERRUPT-CAT-2
    SPI_DMA08_ISR: is-reentrant=true, is-synchronous=false, call-type=INTERRUPT, execution-context=INTERRUPT-CAT-1
    SPI_DMA08_CAT2_ISR: is-reentrant=true, is-synchronous=false, call-type=INTERRUPT, execution-context=INTERRUPT-CAT-2
    SPI_DMA09_ISR: is-reentrant=true, is-synchronous=false, call-type=INTERRUPT, execution-context=INTERRUPT-CAT-1
    SPI_DMA09_CAT2_ISR: is-reentrant=true, is-synchronous=false, call-type=INTERRUPT, execution-context=INTERRUPT-CAT-2
    SPI_DMA10_ISR: is-reentrant=true, is-synchronous=false, call-type=INTERRUPT, execution-context=INTERRUPT-CAT-1
    SPI_DMA10_CAT2_ISR: is-reentrant=true, is-synchronous=false, call-type=INTERRUPT, execution-context=INTERRUPT-CAT-2
    SPI_DMA11_ISR: is-reentrant=true, is-synchronous=false, call-type=INTERRUPT, execution-context=INTERRUPT-CAT-1
    SPI_DMA11_CAT2_ISR: is-reentrant=true, is-synchronous=false, call-type=INTERRUPT, execution-context=INTERRUPT-CAT-2
    SPI_DMA12_ISR: is-reentrant=true, is-synchronous=false, call-type=INTERRUPT, execution-context=INTERRUPT-CAT-1
    SPI_DMA12_CAT2_ISR: is-reentrant=true, is-synchronous=false, call-type=INTERRUPT, execution-context=INTERRUPT-CAT-2
    SPI_DMA13_ISR: is-reentrant=true, is-synchronous=false, call-type=INTERRUPT, execution-context=INTERRUPT-CAT-1
    SPI_DMA13_CAT2_ISR: is-reentrant=true, is-synchronous=false, call-type=INTERRUPT, execution-context=INTERRUPT-CAT-2
    SPI_DMA14_ISR: is-reentrant=true, is-synchronous=false, call-type=INTERRUPT, execution-context=INTERRUPT-CAT-1
    SPI_DMA14_CAT2_ISR: is-reentrant=true, is-synchronous=false, call-type=INTERRUPT, execution-context=INTERRUPT-CAT-2
    SPI_DMA15_ISR: is-reentrant=true, is-synchronous=false, call-type=INTERRUPT, execution-context=INTERRUPT-CAT-1
    SPI_DMA15_CAT2_ISR: is-reentrant=true, is-synchronous=false, call-type=INTERRUPT, execution-context=INTERRUPT-CAT-2
    Spi_Init: service-id=0, is-reentrant=false, is-synchronous=true, call-type=REGULAR, execution-context=TASK
    Spi_DeInit: service-id=1, is-reentrant=false, is-synchronous=true, call-type=REGULAR, execution-context=TASK
    Spi_WriteIB: service-id=2, is-reentrant=true, is-synchronous=true, call-type=REGULAR, execution-context=TASK
    Spi_AsyncTransmit: service-id=3, is-reentrant=true, is-synchronous=false, call-type=REGULAR, execution-context=TASK
    Spi_ReadIB: service-id=4, is-reentrant=true, is-synchronous=true, call-type=REGULAR, execution-context=TASK
    Spi_SetupEB: service-id=5, is-reentrant=true, is-synchronous=true, call-type=REGULAR, execution-context=TASK
    Spi_GetStatus: service-id=6, is-reentrant=true, is-synchronous=true, call-type=REGULAR, execution-context=TASK
    Spi_GetJobResult: service-id=7, is-reentrant=true, is-synchronous=true, call-type=REGULAR, execution-context=TASK
    Spi_GetSequenceResult: service-id=8, is-reentrant=true, is-synchronous=true, call-type=REGULAR, execution-context=TASK
    Spi_GetVersionInfo: service-id=9, is-reentrant=true, is-synchronous=true, call-type=REGULAR, execution-context=TASK
    Spi_SyncTransmit: service-id=10, is-reentrant=true, is-synchronous=false, call-type=REGULAR, execution-context=TASK
    Spi_GetHWUnitStatus: service-id=11, is-reentrant=true, is-synchronous=true, call-type=REGULAR, execution-context=TASK
    Spi_Cancel: service-id=12, is-reentrant=true, is-synchronous=false, call-type=REGULAR, execution-context=TASK
    Spi_SetAsyncMode: service-id=13, is-reentrant=false, is-synchronous=true, call-type=REGULAR, execution-context=TASK
    Spi_SelfTest: service-id=17, is-reentrant=false, is-synchronous=true, call-type=REGULAR, execution-context=TASK
    Spi_GetErrorInfo: service-id=18, is-reentrant=true, is-synchronous=true, call-type=REGULAR, execution-context=TASK
    Spi_MainFunction_Handling: service-id=16, is-reentrant=false, call-type=SCHEDULED, execution-context=TASK
