AUTOSAR XML (schema 4-0-3)
standard types defined: boolean, dtRef_const_VOID, dtRef_VOID, float32, float64, sint16, sint16_least, sint32, sint32_least, sint64, sint8, sint8_least, uint16, uint16_least, uint32, uint32_least, uint64, uint8, uint8_least, boolean_CompuMethod, boolean_DataConstr, float32_DataConstr, float64_DataConstr, sint16_DataConstr, sint16_least_DataConstr, sint32_DataConstr, sint32_least_DataConstr, sint64_DataConstr, sint8_DataConstr, sint8_least_DataConstr, uint16_DataConstr, uint16_least_DataConstr, uint32_DataConstr, uint32_least_DataConstr, uint64_DataConstr, uint8_DataConstr, uint8_least_DataConstr
package /Nexteer/DataTypes
  7 x impl type:
    Ary1D_BlkFltTblRec1_5: category=ARRAY, sw-calibration-access=READ-ONLY, type-emitter=RTE
      element Element: array-size=5, array-size-semantics=FIXED-SIZE, implementation-data-type=BlkFltTblRec1
    Ary1D_boolean_NvMProxy1: category=ARRAY, sw-calibration-access=READ-ONLY, type-emitter=Platform_Type
      element Element: array-size=65535, array-size-semantics=VARIABLE-SIZE, implementation-data-type=boolean
    Ary1D_CmdRtnBufRec1_NvMProxy1: category=ARRAY, sw-calibration-access=READ-ONLY, type-emitter=NvMProxy
      element Element: array-size=65535, array-size-semantics=VARIABLE-SIZE, implementation-data-type=CmdRtnBufRec1
    BlkFltTblRec1: category=STRUCTURE, sw-calibration-access=READ-ONLY, type-emitter=RTE
      element Sts: implementation-data-type=NtcSts1
      element Prm: implementation-data-type=ImplementationDataTypes/uint8
    CmdRtnBufRec1: category=STRUCTURE, sw-calibration-access=READ-ONLY, type-emitter=NvMProxy
      element StdRtn: implementation-data-type=ImplementationDataTypes/uint8
      element ReqPen: implementation-data-type=ImplementationDataTypes/uint8
      element ReqRes: implementation-data-type=ImplementationDataTypes/uint8
    NtcNr1: compu {1..511=NTCNR_0X001..NTCNR_0X1FF}, implementation-data-type=PlatformTypes/uint16, type-emitter=RTE
    NtcSts1: compu {0=NTCSTS_PASSD, 1=NTCSTS_FAILD, 2=NTCSTS_PREPASSD, 3=NTCSTS_PREFAILD}, implementation-data-type=PlatformTypes/uint8, type-emitter=RTE
package /Nexteer/NvMProxy_swc/DataTypes
  impl type NvM_RequestResultType: category=VALUE, base-type=NvM_RequestResultType, compu {0=NVM_REQ_OK, 1=NVM_REQ_NOT_OK, 2=NVM_REQ_PENDING, 3=NVM_REQ_INTEGRITY_FAILED, 4=NVM_REQ_BLOCK_SKIPPED, 5=NVM_REQ_NV_INVALIDATED, 6=NVM_REQ_CANCELED, 7=NVM_REQ_REDUNDANCY_FAILED, 8=NVM_REQ_RESTORED_FROM_ROM}
package /Nexteer/NvMProxy_swc/DataTypes/BaseTypes
  base type NvM_RequestResultType: category=FIXED_LENGTH, base-type-size=8, base-type-encoding=NONE, native-declaration=uint8
package /Nexteer/Units
  unit FixdPt: factor-si-to-unit=1, offset-si-to-unit=0
