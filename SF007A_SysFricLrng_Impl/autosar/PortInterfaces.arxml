AUTOSAR XML (schema 4-0-3)
package /Nexteer/Calibrations
  10 x parameter interface:
    Ary1D_boolean_4_CalPortIf1
      parameter data prototype Ary1D: sw-calibration-access=READ-WRITE, type=Ary1D_boolean_4
    Ary1D_f32_4_CalPortIf1
      parameter data prototype Ary1D: sw-calibration-access=READ-WRITE, type=Ary1D_f32_4
    Ary1D_u11p5_10_CalPortIf1
      parameter data prototype Ary1D: sw-calibration-access=READ-WRITE, type=Ary1D_u11p5_10
    Ary1D_u6p10_10_CalPortIf1
      parameter data prototype Ary1D: sw-calibration-access=READ-WRITE, type=Ary1D_u6p10_10
    Ary2D_f32_4_2_CalPortIf1
      parameter data prototype Ary2D: sw-calibration-access=READ-WRITE, type=Ary2D_f32_4_2
    Ary2D_f32_8_4_CalPortIf1
      parameter data prototype Ary2D: sw-calibration-access=READ-WRITE, type=Ary2D_f32_8_4
    Ary2D_u16_8_3_CalPortIf1
      parameter data prototype Ary2D: sw-calibration-access=READ-WRITE, type=Ary2D_u16_8_3
    float32_CalPortIf1
      parameter data prototype Val: sw-calibration-access=READ-WRITE, type=float32
    uint16_CalPortIf1
      parameter data prototype Val: sw-calibration-access=READ-WRITE, type=uint16
    uint32_CalPortIf1
      parameter data prototype Val: sw-calibration-access=READ-WRITE, type=uint32
package /Nexteer/NvMProxy_swc/Interfaces
  client server interface NvMService_AC3_SRBS_Defs: is-service=true
    7 x operation, all with possible-error=NvMService_AC3_SRBS_Defs/E_NOT_OK:
      EraseBlock
      GetErrorStatus
        arg ErrorStatus: type=NvM_RequestResultType, direction=OUT, server-argument-impl-policy=USE-ARGUMENT-TYPE
      InvalidateNvBlock
      ReadBlock
        arg DstPtr: type=dtRef_VOID, direction=IN, server-argument-impl-policy=USE-ARGUMENT-TYPE
      RestoreBlockDefaults
        arg DstPtr: type=dtRef_VOID, direction=IN, server-argument-impl-policy=USE-ARGUMENT-TYPE
      SetRamBlockStatus
        arg RamBlockStatus: type=Boolean, direction=IN, server-argument-impl-policy=USE-ARGUMENT-TYPE
      WriteBlock
        arg SrcPtr: type=dtRef_const_VOID, direction=IN, server-argument-impl-policy=USE-ARGUMENT-TYPE
    error E_NOT_OK: error-code=1
package /Nexteer/PortInterfaces
  13 x client server interface:
    ClrFricLrngOperMod_PortIf1
      operation Oper
    FltInj_f32_PortIf1
      operation Oper
        arg SigPah_Arg: type=float32, direction=INOUT, server-argument-impl-policy=USE-ARGUMENT-TYPE
        arg LocnKey_Arg: type=uint16, direction=IN, server-argument-impl-policy=USE-ARGUMENT-TYPE
    GetFricData_PortIf3
      operation Oper
        5 x arg, all with direction=OUT, server-argument-impl-policy=USE-ARGUMENT-TYPE:
          FricOffs_Arg: type=float32
          BasLineFric_Arg: type=Ary1D_f32_4
          VehLrndFric_Arg: type=Ary1D_f32_4
          Hys_Arg: type=Ary2D_f32_8_4
          RngCntr_Arg: type=Ary2D_u16_8_3
    GetFricLrngData_PortIf1
      operation Oper
        4 x arg, all with direction=OUT, server-argument-impl-policy=USE-ARGUMENT-TYPE:
          FricLrngEna_Arg: type=boolean
          FricLrngOffsOutpEna_Arg: type=boolean
          FricLrngOperMod_Arg: type=SysFricLrngOperMod1
          EolFric_Arg: type=float32
    GetFricOffsOutpDi_PortIf1
      operation Oper
        arg FricOffsOutpDi_Arg: type=boolean, direction=OUT, server-argument-impl-policy=USE-ARGUMENT-TYPE
    GetNtcQlfrSts_PortIf1
      operation Oper: possible-error=GetNtcQlfrSts_PortIf1/E_NOT_OK
        arg NtcNr_Arg: type=NtcNr1, direction=IN, server-argument-impl-policy=USE-ARGUMENT-TYPE
        arg NtcQlfr_Arg: type=SigQlfr1, direction=OUT, server-argument-impl-policy=USE-ARGUMENT-TYPE
      error E_NOT_OK: error-code=1
    GetRefTmr100MicroSec32bit_PortIf1
      operation Oper
        arg RefTmr_Arg: type=uint32, direction=OUT, server-argument-impl-policy=USE-ARGUMENT-TYPE
    GetTiSpan100MicroSec32bit_PortIf1
      operation Oper
        arg RefTmr_Arg: type=uint32, direction=IN, server-argument-impl-policy=USE-ARGUMENT-TYPE
        arg TiSpan_Arg: type=uint32, direction=OUT, server-argument-impl-policy=USE-ARGUMENT-TYPE
    InitFricLrngTbl_PortIf1
      operation Oper
    SetFricData_PortIf3
      operation Oper
        5 x arg, all with direction=IN, server-argument-impl-policy=USE-ARGUMENT-TYPE:
          FricOffs_Arg: type=float32
          BasLineFric_Arg: type=Ary1D_f32_4
          VehLrndFric_Arg: type=Ary1D_f32_4
          Hys_Arg: type=Ary2D_f32_8_4
          RngCntr_Arg: type=Ary2D_u16_8_3
    SetFricLrngData_PortIf1
      operation Oper
        4 x arg, all with direction=IN, server-argument-impl-policy=USE-ARGUMENT-TYPE:
          FricLrngEna_Arg: type=boolean
          FricLrngOffsOutpEna_Arg: type=boolean
          FricLrngOperMod_Arg: type=SysFricLrngOperMod1
          EolFric_Arg: type=float32
    SetFricOffsOutpDi_PortIf1
      operation Oper
        arg FricOffsOutpDi_Arg: type=boolean, direction=IN, server-argument-impl-policy=USE-ARGUMENT-TYPE
    SetNtcSts_PortIf1
      operation Oper: possible-error=SetNtcSts_PortIf1/E_NOT_OK
        4 x arg, all with direction=IN, server-argument-impl-policy=USE-ARGUMENT-TYPE:
          NtcNr_Arg: type=NtcNr1
          NtcStInfo_Arg: type=uint8
          NtcSts_Arg: type=NtcSts1
          DebStep_Arg: type=uint16
      error E_NOT_OK: error-code=1
  sender receiver interface boolean_PortIf1: invalidation-policy{data-element=Logl, handle-invalid=DONT-INVALIDATE}
    data Logl: sw-calibration-access=READ-ONLY, type=boolean
  sender receiver interface float32_PortIf1: invalidation-policy{data-element=Val, handle-invalid=DONT-INVALIDATE}
    data Val: sw-calibration-access=READ-ONLY, type=float32
