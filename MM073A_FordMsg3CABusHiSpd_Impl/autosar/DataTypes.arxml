AUTOSAR XML (schema 4-0-3)
standard types defined: boolean, float32, uint16, uint32, uint8, boolean_CompuMethod, boolean_DataConstr, float32_DataConstr, uint16_DataConstr, uint32_DataConstr, uint8_DataConstr
package /DataType/Unit
  unit U_1Ym: display-name=1/m, factor-si-to-unit=1, offset-si-to-unit=0
  unit U_mrad: display-name=mrad, factor-si-to-unit=1, offset-si-to-unit=0
  unit U_SED: display-name=SED, factor-si-to-unit=1, offset-si-to-unit=0
package /Ford/DataTypes
  6 x impl type, all with category=VALUE, sw-calibration-access=READ-ONLY:
    Ford_LaCurvature_No_Calc: base-type=DataType/uint16, compu {4095=CxFFF_Fault, phys=raw*5e-06-0.01024 for raw 0..4095; unit 1/m} "Source signal range: [0,4094]", range raw 0..4095
    Ford_LaRampType_B_Req: base-type=DataType/boolean, compu {phys=raw for raw 0..1, 0=Cx0_Smooth, 1=Cx1_Quick; unit SED}
    Ford_LaRefAng_No_Req: base-type=DataType/uint16, compu {4095=CxFFF_Fault, phys=raw*0.05-102.4 for raw 0..4095; unit mrad} "Source signal range: [0,4094]", range raw 0..4095
    Ford_LdwActvIntns_D_Req: base-type=DataType/uint8, compu {phys=raw for raw 0..3, 0=Cx0_None, 1=Cx1_Low, 2=Cx2_Medium, 3=Cx3_High; unit SED}, range raw 0..3
    Ford_LdwActvStats_D_Req: base-type=DataType/uint8, compu {phys=raw for raw 0..7, 0=Cx0_LDW_Idle, 1=Cx1_Not_Used1, 2=Cx2_LDW_Warning_Left, 3=Cx3_LDW_Suppress_Left, 4=Cx4_LDW_Warning_Right, 5=Cx5_LDW_Suppress_Right, 6=Cx6_Not_Used2, 7=Cx7_LDW_Suppress_Right_Left; unit SED}, range raw 0..7
    Ford_LkaActvStats_D2_Req: base-type=DataType/uint8, compu {phys=raw for raw 0..7, 0=Cx0_LkaNoInterv, 1=Cx1_LkaIncrIntervLeft, 2=Cx2_LkaStandIntervLeft, 3=Cx3_LkaSupprLeft, 4=Cx4_LkaStandIntervRight, 5=Cx5_LkaSupprRight, 6=Cx6_LkaIncrIntervRight, 7=Cx7_NotUsed; unit SED}, range raw 0..7
package /Nexteer/DataTypes
  impl type NtcNr1: compu {1..511=NTCNR_0X001..NTCNR_0X1FF}, implementation-data-type=uint16, type-emitter=RTE
  impl type NtcSts1: compu {0=NTCSTS_PASSD, 1=NTCSTS_FAILD, 2=NTCSTS_PREPASSD, 3=NTCSTS_PREFAILD}, implementation-data-type=uint8, type-emitter=RTE
