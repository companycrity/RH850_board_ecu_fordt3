AUTOSAR XML (schema 4-0-3)
# COPYRIGHT
# Copyright (c) 2016 by Vector Informatik GmbH. All rights reserved.
# This software is copyright protected and proprietary to Vector Informatik GmbH.
# Vector Informatik GmbH grants to you only those rights as set out in the license conditions.
package /MICROSAR  # WdgM Preconfiguration
  module config WdgM_Pre: definition=WdgM
  module config WdgM_Rec: definition=WdgM, implementation-config-variant=VARIANT-PRE-COMPILE
