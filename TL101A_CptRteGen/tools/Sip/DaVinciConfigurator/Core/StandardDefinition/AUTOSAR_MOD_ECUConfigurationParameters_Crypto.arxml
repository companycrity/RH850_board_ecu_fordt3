AUTOSAR XML (schema 4-0-3)
package /AUTOSAR/EcucDefs
  module definition Crypto [0..1]: category=STANDARDIZED_MODULE_DEFINITION, variants pre-compile  # Software Crypto Driver
    container CryptoGeneral  # Container for common configuration options.
      boolean CryptoDevErrorDetect: set at pre-compile, default-value=true  # Switches the development error detection and notification on or off.  true: detection and notification is enabled.  false: detection and notification is disabled. | True: Development error detection enabled. False: Development error detection disabled
      boolean CryptoVersionInfoApi: set at pre-compile, default-value=false  # Pre-processor switch to enable and disable availability of the API Crypto_GetVersionInfo(). - True: API Crypto_GetVersionInfo() is available - False: API Csm_GetVersionInfo() is not available.
    container CryptoDriverObjects  # Container for Crypto Driver Objects
      container CryptoDriverObject [0..*]  # Container for configuration of Crypto Driver Object. The container name serves as a symbolic name for the identifier of a Crypto Driver Object.
        integer CryptoDriverObjectId: 0..4294967295, set at pre-compile, symbolic-name-value=true, default-value=0  # Identifier of the Crypto Driver Object
        integer CryptoDriverObjectQueueSize: 0..255, set at pre-compile, default-value=1  # Indication of supported queue size. Or if possilbe, configurable
        reference CryptoPrimitiveRef [1..*]: set at pre-compile, destination=CryptoPrimitive  # Reference to the supported Crypto Primitive. Only used for evaluation.
    container CryptoKeys [0..1]  # Container for CRYPTO keys
      container CryptoKey [1..*]  # Container for configuration of CRYPTO key. The container name serves as a symbolic name for the identifier of a CRYPTO key.
        integer CryptoKeyId: 0..4294967295, set at pre-compile, symbolic-name-value=true, default-value=0  # Container for configuration of CRYPTO key. The container name serves as a symbolic name for the identifier of a CRYPTO key.
        reference CryptoKeyTypeRef: set at pre-compile, destination=CryptoKeyType  # Reference to the Crypto Key Type.
    container CryptoPrimitives  # Primitives which are provided by this specific Crypto Driver -> read only
      container CryptoPrimitive [0..*]  # Container for CSM queues
        enumeration CryptoPrimitiveAlgorithmFamily [1..*]: {CRYPTO_ALGOFAM_NOT_SET, CRYPTO_ALGOFAM_SHA1, CRYPTO_ALGOFAM_SHA2, CRYPTO_ALGOFAM_SHA3, CRYPTO_ALGOFAM_RIPEMD160, CRYPTO_ALGOFAM_BLAKE, CRYPTO_ALGOFAM_3DES, CRYPTO_ALGOFAM_AES, CRYPTO_ALGOFAM_CHACHA, CRYPTO_ALGOFAM_RSA, CRYPTO_ALGOFAM_ED25519, CRYPTO_ALGOFAM_BRAINPOOL, CRYPTO_ALGOFAM_ECCNIST, CRYPTO_ALGOFAM_SECURECOUNTER, CRYPTO_ALGOFAM_TRNG}, set at pre-compile  # Determines the algorithm family used for the crypto service
        integer CryptoPrimitiveAlgorithmKeyLength: 1..4294967295, set at pre-compile, default-value=1
        enumeration CryptoPrimitiveAlgorithmMode [1..*]: {CRYPTO_ALGOMODE_NOT_SET, CRYPTO_ALGOMODE_ECB, CRYPTO_ALGOMODE_CBC, CRYPTO_ALGOMODE_CFB, CRYPTO_ALGOMODE_OFB, CRYPTO_ALGOMODE_CTR, CRYPTO_ALGOMODE_GCM, CRYPTO_ALGOMODE_XTS, CRYPTO_ALGOMODE_RSAES_OAEP, CRYPTO_ALGOMODE_RSAES_PKCS1_v1_5, CRYPTO_ALGOMODE_RSASSA_PSS, CRYPTO_ALGOMODE_RSASSA_PKCS1_v1_5, CRYPTO_ALGOMODE_8ROUNDS, CRYPTO_ALGOMODE_12ROUNDS, CRYPTO_ALGOMODE_20ROUNDS, CRYPTO_ALGOMODE_HMAC, CRYPTO_ALGOMODE_CMAC, CRYPTO_ALGOMODE_GMAC, CRYPTO_ALGOMODE_CTRDRBG}, set at pre-compile  # Determines the algorithm mode used for the crypto service
        integer CryptoPrimitiveLength [0..1]: 1..4294967295, set at pre-compile
        enumeration CryptoPrimitiveService [1..*]: {MacGenerate, MacVerify, SignatureVerify, SignatureGenerate, Encrypt}, set at pre-compile
        enumeration CryptoPrimitiveSecondaryAlgorithmFamily [1..*]: {CRYPTO_ALGOFAM_NOT_SET, CRYPTO_ALGOFAM_SHA1, CRYPTO_ALGOFAM_SHA2, CRYPTO_ALGOFAM_SHA3, CRYPTO_ALGOFAM_RIPEMD160, CRYPTO_ALGOFAM_BLAKE, CRYPTO_ALGOFAM_3DES, CRYPTO_ALGOFAM_AES, CRYPTO_ALGOFAM_CHACHA, CRYPTO_ALGOFAM_RSA, CRYPTO_ALGOFAM_ED25519, CRYPTO_ALGOFAM_BRAINPOOL, CRYPTO_ALGOFAM_ECCNIST, CRYPTO_ALGOFAM_SECURECOUNTER, CRYPTO_ALGOFAM_TRNG}, set at pre-compile  # Determines the algorithm family used for the crypto service
    container CryptoKeyElements [0..1]  # Container for CRYPTO key elements
      container CryptoKeyElement [1..*]
        integer CryptoKeyElementId: 0..4294967295, set at pre-compile, symbolic-name-value=true  # Identifier of the CRYPTO key element
        integer CryptoKeyElementSize: 1..4294967295, set at pre-compile  # Size of a CRYPTO key element in bytes.
        string CryptoKeyElementInitValue [0..1]: set at pre-compile  # Value which is stored in the Key Element during initialization of the Crypto Driver
        enumeration CryptoKeyElementReadAccess: {RA_INTERNAL_COPY_ONLY, RA_EXTERNAL_READ, RA_NONE, ENCRYPTED}, set at pre-compile, default-value=RA_EXTERNAL_READ  # EXTERNAL_READ: Element can be read from csm via KeyElementGet() EXTERNAL_WRITE: Element can be read from csm via KeyElementSet() EXTERNAL_RW: Element can be read and written from csm via KeyElementSet() and KeyElementGet(). INTERNAL_COPY_ONLY: Element can only be copied internally in the Crypto driver. It can't be read or written from outsite. It can be only copied to an element with the same restriction.
        boolean CryptoKeyElementAllowPartialAccess: set at pre-compile, default-value=false  # If TRUE, data with a size smaller than the element size can be written to the element. When reading data from an element, only the written length is returned. If FALSE, only data with the same size as the element can be written to and read from the element.
        boolean CryptoKeyElementPersist: set at pre-compile, default-value=true  # If TRUE, the content of the key element is persisted (e.g. NvM, Keyslot in HSM or SHE) Otherwise, the data is stored in RAM. (This Parameter can be vendor specific)
        enumeration CryptoKeyElementWriteAccess: {WA_INTERNAL_COPY_ONLY, WA_EXTERNAL_WRITE, WA_NONE}, set at pre-compile, default-value=WA_EXTERNAL_WRITE  # EXTERNAL_READ: Element can be read from csm via KeyElementGet() EXTERNAL_WRITE: Element can be read from csm via KeyElementSet() EXTERNAL_RW: Element can be read and written from csm via KeyElementSet() and KeyElementGet(). INTERNAL_COPY_ONLY: Element can only be copied internally in the Crypto driver. It can't be read or written from outsite. It can be only copied to an element with the same restriction.
        reference CryptoKeyElementVirtualTargetRef [0..1]: set at pre-compile, destination=CryptoKeyElement  # Referenze to a other Key Element If this reference is configured, Key Element is handled as an virtual Key Element.
    container CryptoKeyTypes
      container CryptoKeyType [1..*]  # Container to declare a Key Type.
        reference CryptoKeyElementRef [1..*]: set at pre-compile, destination=CryptoKeyElement
