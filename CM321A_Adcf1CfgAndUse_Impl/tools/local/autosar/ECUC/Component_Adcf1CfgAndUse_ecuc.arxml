AUTOSAR XML (schema 4-0-3)
package /ActiveEcuC
  module config Adcf1CfgAndUse: implementation-config-variant=VARIANT-PRE-COMPILE
    Adcf1CfgAndUseGeneral:
      ADCF1VCR{00..20} = 0
      ADCF1SGVCSP2 = 0
      ADCF1SGVCSP3 = 0
      ADCF1SGVCEP2 = 0
      ADCF1SGVCEP3 = 0
