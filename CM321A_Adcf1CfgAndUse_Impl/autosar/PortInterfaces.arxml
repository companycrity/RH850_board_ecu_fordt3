AUTOSAR XML (schema 4-0-3)
package /Nexteer/Calibrations
  323 x parameter interface:
    A1
      parameter data prototype Val: sw-calibration-access=READ-WRITE, type=A1
    A2
      parameter data prototype Val: sw-calibration-access=READ-WRITE, type=A3
    A3
      parameter data prototype Val: sw-calibration-access=READ-WRITE, type=A4
    A4
      parameter data prototype Val: sw-calibration-access=READ-WRITE, type=A5
    Ag1
      parameter data prototype Val: sw-calibration-access=READ-WRITE, type=Ag1
    Ag2
      parameter data prototype Val: sw-calibration-access=READ-WRITE, type=Ag6
    Ag3
      parameter data prototype Val: sw-calibration-access=READ-WRITE, type=Ag11
    Ag4
      parameter data prototype Val: sw-calibration-access=READ-WRITE, type=Ag13
    Ag5
      parameter data prototype Val: sw-calibration-access=READ-WRITE, type=Ag16
    AgAry1D2
      parameter data prototype Ary1D: sw-calibration-access=READ-WRITE, type=AgAry1D4
    AgAry2D1
      parameter data prototype Ary2D: sw-calibration-access=READ-WRITE, type=AgAry2D1
    Ary1D_boolean_4_CalPortIf1
      parameter data prototype Ary1D: sw-calibration-access=READ-WRITE, type=Ary1D_boolean_4
    Ary1D_f32_2_CalPortIf1
      parameter data prototype Ary1D: sw-calibration-access=READ-WRITE, type=Ary1D_f32_2
    Ary1D_f32_4_CalPortIf1
      parameter data prototype Ary1D: sw-calibration-access=READ-WRITE, type=Ary1D_f32_4
    Ary1D_f32_5_CalPortIf1
      parameter data prototype Ary1D: sw-calibration-access=READ-WRITE, type=Ary1D_f32_5
    Ary1D_f32_8_CalPortIf1
      parameter data prototype Ary1D: sw-calibration-access=READ-WRITE, type=Ary1D_f32_8
    Ary1D_logl_2_CalPortIf1
      parameter data prototype Ary1D: sw-calibration-access=READ-WRITE, type=Ary1D_logl_2
    Ary1D_s10p5_8_CalPortIf1
      parameter data prototype Ary1D: sw-calibration-access=READ-WRITE, type=Ary1D_s10p5_8
    Ary1D_s11p4_11_CalPortIf1
      parameter data prototype Ary1D: sw-calibration-access=READ-WRITE, type=Ary1D_s11p4_11
    Ary1D_s11p4_14_CalPortIf1
      parameter data prototype Ary1D: sw-calibration-access=READ-WRITE, type=Ary1D_s11p4_14
    Ary1D_s11p4_5_CalPortIf1
      parameter data prototype Ary1D: sw-calibration-access=READ-WRITE, type=Ary1D_s11p4_5
    Ary1D_s14p1_8_CalPortIf1
      parameter data prototype Ary1D: sw-calibration-access=READ-WRITE, type=Ary1D_s14p1_8
    Ary1D_s15p0_4_CalPortIf1
      parameter data prototype Ary1D: sw-calibration-access=READ-WRITE, type=Ary1D_s15p0_4
    Ary1D_s4p11_12_CalPortIf1
      parameter data prototype Ary1D: sw-calibration-access=READ-WRITE, type=Ary1D_s4p11_12
    Ary1D_s4p11_20_CalPortIf1
      parameter data prototype Ary1D: sw-calibration-access=READ-WRITE, type=Ary1D_s4p11_20
    Ary1D_s4p11_4_CalPortIf1
      parameter data prototype Ary1D: sw-calibration-access=READ-WRITE, type=Ary1D_s4p11_4
    Ary1D_s4p11_5_CalPortIf1
      parameter data prototype Ary1D: sw-calibration-access=READ-WRITE, type=Ary1D_s4p11_5
    Ary1D_s7p8_20_CalPortIf1
      parameter data prototype Ary1D: sw-calibration-access=READ-WRITE, type=Ary1D_s7p8_20
    Ary1D_s8p7_12_CalPortIf1
      parameter data prototype Ary1D: sw-calibration-access=READ-WRITE, type=Ary1D_s8p7_12
    Ary1D_s8p7_14_CalPortIf1
      parameter data prototype Ary1D: sw-calibration-access=READ-WRITE, type=Ary1D_s8p7_14
    Ary1D_s8p7_3_CalPortIf1
      parameter data prototype Ary1D: sw-calibration-access=READ-WRITE, type=Ary1D_s8p7_3
    Ary1D_u0p16_10_CalPortIf1
      parameter data prototype Ary1D: sw-calibration-access=READ-WRITE, type=Ary1D_u0p16_10
    Ary1D_u0p16_3_CalPortIf1
      parameter data prototype Ary1D: sw-calibration-access=READ-WRITE, type=Ary1D_u0p16_3
    Ary1D_u10p6_10_CalPortIf1
      parameter data prototype Ary1D: sw-calibration-access=READ-WRITE, type=Ary1D_u10p6_10
    Ary1D_u10p6_13_CalPortIf1
      parameter data prototype Ary1D: sw-calibration-access=READ-WRITE, type=Ary1D_u10p6_13
    Ary1D_u10p6_2_CalPortIf1
      parameter data prototype Ary1D: sw-calibration-access=READ-WRITE, type=Ary1D_u10p6_2
    Ary1D_u10p6_3_CalPortIf1
      parameter data prototype Ary1D: sw-calibration-access=READ-WRITE, type=Ary1D_u10p6_3
    Ary1D_u10p6_4_CalPortIf1
      parameter data prototype Ary1D: sw-calibration-access=READ-WRITE, type=Ary1D_u10p6_4
    Ary1D_u10p6_5_CalPortIf1
      parameter data prototype Ary1D: sw-calibration-access=READ-WRITE, type=Ary1D_u10p6_5
    Ary1D_u10p6_7_CalPortIf1
      parameter data prototype Ary1D: sw-calibration-access=READ-WRITE, type=Ary1D_u10p6_7
    Ary1D_u10p6_8_CalPortIf1
      parameter data prototype Ary1D: sw-calibration-access=READ-WRITE, type=Ary1D_u10p6_8
    Ary1D_u11p5_10_CalPortIf1
      parameter data prototype Ary1D: sw-calibration-access=READ-WRITE, type=Ary1D_u11p5_10
    Ary1D_u11p5_11_CalPortIf1
      parameter data prototype Ary1D: sw-calibration-access=READ-WRITE, type=Ary1D_u11p5_11
    Ary1D_u11p5_12_CalPortIf1
      parameter data prototype Ary1D: sw-calibration-access=READ-WRITE, type=Ary1D_u11p5_12
    Ary1D_u11p5_13_CalPortIf1
      parameter data prototype Ary1D: sw-calibration-access=READ-WRITE, type=Ary1D_u11p5_13
    Ary1D_u11p5_4_CalPortIf1
      parameter data prototype Ary1D: sw-calibration-access=READ-WRITE, type=Ary1D_u11p5_4
    Ary1D_u11p5_6_CalPortIf1
      parameter data prototype Ary1D: sw-calibration-access=READ-WRITE, type=Ary1D_u11p5_6
    Ary1D_u11p5_8_CalPortIf1
      parameter data prototype Ary1D: sw-calibration-access=READ-WRITE, type=Ary1D_u11p5_8
    Ary1D_u11p5_9_CalPortIf1
      parameter data prototype Ary1D: sw-calibration-access=READ-WRITE, type=Ary1D_u11p5_9
    Ary1D_u12p4_12_CalPortIf1
      parameter data prototype Ary1D: sw-calibration-access=READ-WRITE, type=Ary1D_u12p4_12
    Ary1D_u12p4_2_CalPortIf1
      parameter data prototype Ary1D: sw-calibration-access=READ-WRITE, type=Ary1D_u12p4_2
    Ary1D_u12p4_7_CalPortIf1
      parameter data prototype Ary1D: sw-calibration-access=READ-WRITE, type=Ary1D_u12p4_7
    Ary1D_u12p4_9_CalPortIf1
      parameter data prototype Ary1D: sw-calibration-access=READ-WRITE, type=Ary1D_u12p4_9
    Ary1D_u13p3_2_CalPortIf1
      parameter data prototype Ary1D: sw-calibration-access=READ-WRITE, type=Ary1D_u13p3_2
    Ary1D_u13p3_6_CalPortIf1
      parameter data prototype Ary1D: sw-calibration-access=READ-WRITE, type=Ary1D_u13p3_6
    Ary1D_u15p1_12_CalPortIf1
      parameter data prototype Ary1D: sw-calibration-access=READ-WRITE, type=Ary1D_u15p1_12
    Ary1D_u16_512
      parameter data prototype Ary1D: sw-calibration-access=READ-WRITE, type=Ary1D_u16_512
    Ary1D_u16p0_2_CalPortIf1
      parameter data prototype Ary1D: sw-calibration-access=READ-WRITE, type=Ary1D_u16p0_2
    Ary1D_u16p0_20_CalPortIf1
      parameter data prototype Ary1D: sw-calibration-access=READ-WRITE, type=Ary1D_u16p0_20
    Ary1D_u16p0_8_CalPortIf1
      parameter data prototype Ary1D: sw-calibration-access=READ-WRITE, type=Ary1D_u16p0_8
    Ary1D_u1p15_10_CalPortIf1
      parameter data prototype Ary1D: sw-calibration-access=READ-WRITE, type=Ary1D_u1p15_10
    Ary1D_u1p15_11_CalPortIf1
      parameter data prototype Ary1D: sw-calibration-access=READ-WRITE, type=Ary1D_u1p15_11
    Ary1D_u1p15_12_CalPortIf1
      parameter data prototype Ary1D: sw-calibration-access=READ-WRITE, type=Ary1D_u1p15_12
    Ary1D_u1p15_2_CalPortIf1
      parameter data prototype Ary1D: sw-calibration-access=READ-WRITE, type=Ary1D_u1p15_2
    Ary1D_u1p15_5_CalPortIf1
      parameter data prototype Ary1D: sw-calibration-access=READ-WRITE, type=Ary1D_u1p15_5
    Ary1D_u1p15_6_CalPortIf1
      parameter data prototype Ary1D: sw-calibration-access=READ-WRITE, type=Ary1D_u1p15_6
    Ary1D_u1p15_9_CalPortIf1
      parameter data prototype Ary1D: sw-calibration-access=READ-WRITE, type=Ary1D_u1p15_9
    Ary1D_u2p14_10_CalPortIf1
      parameter data prototype Ary1D: sw-calibration-access=READ-WRITE, type=Ary1D_u2p14_10
    Ary1D_u2p14_12_CalPortIf1
      parameter data prototype Ary1D: sw-calibration-access=READ-WRITE, type=Ary1D_u2p14_12
    Ary1D_u2p14_2_CalPortIf1
      parameter data prototype Ary1D: sw-calibration-access=READ-WRITE, type=Ary1D_u2p14_2
    Ary1D_u2p14_3_CalPortIf1
      parameter data prototype Ary1D: sw-calibration-access=READ-WRITE, type=Ary1D_u2p14_3
    Ary1D_u2p14_4_CalPortIf1
      parameter data prototype Ary1D: sw-calibration-access=READ-WRITE, type=Ary1D_u2p14_4
    Ary1D_u2p14_5_CalPortIf1
      parameter data prototype Ary1D: sw-calibration-access=READ-WRITE, type=Ary1D_u2p14_5
    Ary1D_u2p14_6_CalPortIf1
      parameter data prototype Ary1D: sw-calibration-access=READ-WRITE, type=Ary1D_u2p14_6
    Ary1D_u2p14_8_CalPortIf1
      parameter data prototype Ary1D: sw-calibration-access=READ-WRITE, type=Ary1D_u2p14_8
    Ary1D_u2p14_9_CalPortIf1
      parameter data prototype Ary1D: sw-calibration-access=READ-WRITE, type=Ary1D_u2p14_9
    Ary1D_u32_512
      parameter data prototype Ary1D: sw-calibration-access=READ-WRITE, type=Ary1D_u32_512
    Ary1D_u3p13_10_CalPortIf1
      parameter data prototype Ary1D: sw-calibration-access=READ-WRITE, type=Ary1D_u3p13_10
    Ary1D_u3p13_5_CalPortIf1
      parameter data prototype Ary1D: sw-calibration-access=READ-WRITE, type=Ary1D_u3p13_5
    Ary1D_u4p12_10_CalPortIf1
      parameter data prototype Ary1D: sw-calibration-access=READ-WRITE, type=Ary1D_u4p12_10
    Ary1D_u4p12_11_CalPortIf1
      parameter data prototype Ary1D: sw-calibration-access=READ-WRITE, type=Ary1D_u4p12_11
    Ary1D_u4p12_12_CalPortIf1
      parameter data prototype Ary1D: sw-calibration-access=READ-WRITE, type=Ary1D_u4p12_12
    Ary1D_u4p12_14_CalPortIf1
      parameter data prototype Ary1D: sw-calibration-access=READ-WRITE, type=Ary1D_u4p12_14
    Ary1D_u4p12_2_CalPortIf1
      parameter data prototype Ary1D: sw-calibration-access=READ-WRITE, type=Ary1D_u4p12_2
    Ary1D_u4p12_4_CalPortIf1
      parameter data prototype Ary1D: sw-calibration-access=READ-WRITE, type=Ary1D_u4p12_4
    Ary1D_u4p12_5_CalPortIf1
      parameter data prototype Ary1D: sw-calibration-access=READ-WRITE, type=Ary1D_u4p12_5
    Ary1D_u4p12_6_CalPortIf1
      parameter data prototype Ary1D: sw-calibration-access=READ-WRITE, type=Ary1D_u4p12_6
    Ary1D_u4p12_8_CalPortIf1
      parameter data prototype Ary1D: sw-calibration-access=READ-WRITE, type=Ary1D_u4p12_8
    Ary1D_u5p11_10_CalPortIf1
      parameter data prototype Ary1D: sw-calibration-access=READ-WRITE, type=Ary1D_u5p11_10
    Ary1D_u5p11_11_CalPortIf1
      parameter data prototype Ary1D: sw-calibration-access=READ-WRITE, type=Ary1D_u5p11_11
    Ary1D_u5p11_14_CalPortIf1
      parameter data prototype Ary1D: sw-calibration-access=READ-WRITE, type=Ary1D_u5p11_14
    Ary1D_u5p11_17_CalPortIf1
      parameter data prototype Ary1D: sw-calibration-access=READ-WRITE, type=Ary1D_u5p11_17
    Ary1D_u5p11_5_CalPortIf1
      parameter data prototype Ary1D: sw-calibration-access=READ-WRITE, type=Ary1D_u5p11_5
    Ary1D_u5p11_6_CalPortIf1
      parameter data prototype Ary1D: sw-calibration-access=READ-WRITE, type=Ary1D_u5p11_6
    Ary1D_u5p11_8_CalPortIf1
      parameter data prototype Ary1D: sw-calibration-access=READ-WRITE, type=Ary1D_u5p11_8
    Ary1D_u6p10_10_CalPortIf1
      parameter data prototype Ary1D: sw-calibration-access=READ-WRITE, type=Ary1D_u6p10_10
    Ary1D_u6p10_17_CalPortIf1
      parameter data prototype Ary1D: sw-calibration-access=READ-WRITE, type=Ary1D_u6p10_17
    Ary1D_u6p10_6_CalPortIf1
      parameter data prototype Ary1D: sw-calibration-access=READ-WRITE, type=Ary1D_u6p10_6
    Ary1D_u7p9_12_CalPortIf1
      parameter data prototype Ary1D: sw-calibration-access=READ-WRITE, type=Ary1D_u7p9_12
    Ary1D_u7p9_3_CalPortIf1
      parameter data prototype Ary1D: sw-calibration-access=READ-WRITE, type=Ary1D_u7p9_3
    Ary1D_u7p9_6_CalPortIf1
      parameter data prototype Ary1D: sw-calibration-access=READ-WRITE, type=Ary1D_u7p9_6
    Ary1D_u8p8_10_CalPortIf1
      parameter data prototype Ary1D: sw-calibration-access=READ-WRITE, type=Ary1D_u8p8_10
    Ary1D_u8p8_11_CalPortIf1
      parameter data prototype Ary1D: sw-calibration-access=READ-WRITE, type=Ary1D_u8p8_11
    Ary1D_u8p8_12_CalPortIf1
      parameter data prototype Ary1D: sw-calibration-access=READ-WRITE, type=Ary1D_u8p8_12
    Ary1D_u8p8_2_CalPortIf1
      parameter data prototype Ary1D: sw-calibration-access=READ-WRITE, type=Ary1D_u8p8_2
    Ary1D_u8p8_20_CalPortIf1
      parameter data prototype Ary1D: sw-calibration-access=READ-WRITE, type=Ary1D_u8p8_20
    Ary1D_u8p8_3_CalPortIf1
      parameter data prototype Ary1D: sw-calibration-access=READ-WRITE, type=Ary1D_u8p8_3
    Ary1D_u8p8_4_CalPortIf1
      parameter data prototype Ary1D: sw-calibration-access=READ-WRITE, type=Ary1D_u8p8_4
    Ary1D_u8p8_5_CalPortIf1
      parameter data prototype Ary1D: sw-calibration-access=READ-WRITE, type=Ary1D_u8p8_5
    Ary1D_u8p8_6_CalPortIf1
      parameter data prototype Ary1D: sw-calibration-access=READ-WRITE, type=Ary1D_u8p8_6
    Ary1D_u8p8_7_CalPortIf1
      parameter data prototype Ary1D: sw-calibration-access=READ-WRITE, type=Ary1D_u8p8_7
    Ary1D_u8p8_8_CalPortIf1
      parameter data prototype Ary1D: sw-calibration-access=READ-WRITE, type=Ary1D_u8p8_8
    Ary1D_u8p8_9_CalPortIf1
      parameter data prototype Ary1D: sw-calibration-access=READ-WRITE, type=Ary1D_u8p8_9
    Ary1D_u9p7_10_CalPortIf1
      parameter data prototype Ary1D: sw-calibration-access=READ-WRITE, type=Ary1D_u9p7_10
    Ary1D_u9p7_11_CalPortIf1
      parameter data prototype Ary1D: sw-calibration-access=READ-WRITE, type=Ary1D_u9p7_11
    Ary1D_u9p7_12_CalPortIf1
      parameter data prototype Ary1D: sw-calibration-access=READ-WRITE, type=Ary1D_u9p7_12
    Ary1D_u9p7_2_CalPortIf1
      parameter data prototype Ary1D: sw-calibration-access=READ-WRITE, type=Ary1D_u9p7_2
    Ary1D_u9p7_3_CalPortIf1
      parameter data prototype Ary1D: sw-calibration-access=READ-WRITE, type=Ary1D_u9p7_3
    Ary1D_u9p7_4_CalPortIf1
      parameter data prototype Ary1D: sw-calibration-access=READ-WRITE, type=Ary1D_u9p7_4
    Ary1D_u9p7_5_CalPortIf1
      parameter data prototype Ary1D: sw-calibration-access=READ-WRITE, type=Ary1D_u9p7_5
    Ary1D_u9p7_6_CalPortIf1
      parameter data prototype Ary1D: sw-calibration-access=READ-WRITE, type=Ary1D_u9p7_6
    Ary1D_u9p7_8_CalPortIf1
      parameter data prototype Ary1D: sw-calibration-access=READ-WRITE, type=Ary1D_u9p7_8
    Ary1D_u9p7_9_CalPortIf1
      parameter data prototype Ary1D: sw-calibration-access=READ-WRITE, type=Ary1D_u9p7_9
    Ary2D_f32_4_2_CalPortIf1
      parameter data prototype Ary2D: sw-calibration-access=READ-WRITE, type=Ary2D_f32_4_2
    Ary2D_f32_4_5_CalPortIf1
      parameter data prototype Ary2D: sw-calibration-access=READ-WRITE, type=Ary2D_f32_4_5
    Ary2D_f32_5_4_CalPortIf1
      parameter data prototype Ary2D: sw-calibration-access=READ-WRITE, type=Ary2D_f32_5_4
    Ary2D_f32_5_5_CalPortIf1
      parameter data prototype Ary2D: sw-calibration-access=READ-WRITE, type=Ary2D_f32_5_5
    Ary2D_f32_8_4_CalPortIf1
      parameter data prototype Ary2D: sw-calibration-access=READ-WRITE, type=Ary2D_f32_8_4
    Ary2D_s1p14_10_12_CalPortIf1
      parameter data prototype Ary2D: sw-calibration-access=READ-WRITE, type=Ary2D_s1p14_10_12
    Ary2D_s4p11_11_8_CalPortIf1
      parameter data prototype Ary2D: sw-calibration-access=READ-WRITE, type=Ary2D_s4p11_11_8
    Ary2D_s4p11_12_11_CalPortIf1
      parameter data prototype Ary2D: sw-calibration-access=READ-WRITE, type=Ary2D_s4p11_12_11
    Ary2D_s4p11_12_20_CalPortIf1
      parameter data prototype Ary2D: sw-calibration-access=READ-WRITE, type=Ary2D_s4p11_12_20
    Ary2D_s4p11_8_11_CalPortIf1
      parameter data prototype Ary2D: sw-calibration-access=READ-WRITE, type=Ary2D_s4p11_8_11
    Ary2D_s7p8_11_12_CalPortIf1
      parameter data prototype Ary2D: sw-calibration-access=READ-WRITE, type=Ary2D_s7p8_11_12
    Ary2D_s7p8_12_11_CalPortIf1
      parameter data prototype Ary2D: sw-calibration-access=READ-WRITE, type=Ary2D_s7p8_12_11
    Ary2D_s7p8_3_5_CalPortIf1
      parameter data prototype Ary2D: sw-calibration-access=READ-WRITE, type=Ary2D_s7p8_3_5
    Ary2D_s7p8_3_6_CalPortIf1
      parameter data prototype Ary2D: sw-calibration-access=READ-WRITE, type=Ary2D_s7p8_3_6
    Ary2D_s7p8_4_5_CalPortIf1
      parameter data prototype Ary2D: sw-calibration-access=READ-WRITE, type=Ary2D_s7p8_4_5
    Ary2D_s7p8_9_5_CalPortIf1
      parameter data prototype Ary2D: sw-calibration-access=READ-WRITE, type=Ary2D_s7p8_9_5
    Ary2D_s7p8_9_6_CalPortIf1
      parameter data prototype Ary2D: sw-calibration-access=READ-WRITE, type=Ary2D_s7p8_9_6
    Ary2D_u0p16_20_8_CalPortIf1
      parameter data prototype Ary2D: sw-calibration-access=READ-WRITE, type=Ary2D_u0p16_20_8
    Ary2D_u0p16_4_2_CalPortIf1
      parameter data prototype Ary2D: sw-calibration-access=READ-WRITE, type=Ary2D_u0p16_4_2
    Ary2D_u10p6_3_7_CalPortIf1
      parameter data prototype Ary2D: sw-calibration-access=READ-WRITE, type=Ary2D_u10p6_3_7
    Ary2D_u10p6_8_12_CalPortIf1
      parameter data prototype Ary2D: sw-calibration-access=READ-WRITE, type=Ary2D_u10p6_8_12
    Ary2D_u10p6_8_9_CalPortIf1
      parameter data prototype Ary2D: sw-calibration-access=READ-WRITE, type=Ary2D_u10p6_8_9
    Ary2D_u12p4_12_13_CalPortIf1
      parameter data prototype Ary2D: sw-calibration-access=READ-WRITE, type=Ary2D_u12p4_12_13
    Ary2D_u12p4_4_2_CalPortIf1
      parameter data prototype Ary2D: sw-calibration-access=READ-WRITE, type=Ary2D_u12p4_4_2
    Ary2D_u12p4_5_4_CalPortIf1
      parameter data prototype Ary2D: sw-calibration-access=READ-WRITE, type=Ary2D_u12p4_5_4
    Ary2D_u12p4_8_12_CalPortIf1
      parameter data prototype Ary2D: sw-calibration-access=READ-WRITE, type=Ary2D_u12p4_8_12
    Ary2D_u16_8_3_CalPortIf1
      parameter data prototype Ary2D: sw-calibration-access=READ-WRITE, type=Ary2D_u16_8_3
    Ary2D_u1p15_12_5_CalPortIf1
      parameter data prototype Ary2D: sw-calibration-access=READ-WRITE, type=Ary2D_u1p15_12_5
    Ary2D_u1p15_5_4_CalPortIf1
      parameter data prototype Ary2D: sw-calibration-access=READ-WRITE, type=Ary2D_u1p15_5_4
    Ary2D_u1p15_8_4_CalPortIf1
      parameter data prototype Ary2D: sw-calibration-access=READ-WRITE, type=Ary2D_u1p15_8_4
    Ary2D_u2p14_12_5_CalPortIf1
      parameter data prototype Ary2D: sw-calibration-access=READ-WRITE, type=Ary2D_u2p14_12_5
    Ary2D_u2p14_5_10_CalPortIf1
      parameter data prototype Ary2D: sw-calibration-access=READ-WRITE, type=Ary2D_u2p14_5_10
    Ary2D_u2p14_5_8_CalPortIf1
      parameter data prototype Ary2D: sw-calibration-access=READ-WRITE, type=Ary2D_u2p14_5_8
    Ary2D_u2p14_6_5_CalPortIf1
      parameter data prototype Ary2D: sw-calibration-access=READ-WRITE, type=Ary2D_u2p14_6_5
    Ary2D_u2p14_6_7_PortIf1
      parameter data prototype Ary2D: sw-calibration-access=READ-WRITE, type=Ary2D_u2p14_6_7
    Ary2D_u2p14_7_8_CalPortIf1
      parameter data prototype Ary2D: sw-calibration-access=READ-WRITE, type=Ary2D_u2p14_7_8
    Ary2D_u3p13_12_13_CalPortIf1
      parameter data prototype Ary2D: sw-calibration-access=READ-WRITE, type=Ary2D_u3p13_12_13
    Ary2D_u3p13_20_8_CalPortIf1
      parameter data prototype Ary2D: sw-calibration-access=READ-WRITE, type=Ary2D_u3p13_20_8
    Ary2D_u4p12_12_20_CalPortIf1
      parameter data prototype Ary2D: sw-calibration-access=READ-WRITE, type=Ary2D_u4p12_12_20
    Ary2D_u4p12_12_5_CalPortIf1
      parameter data prototype Ary2D: sw-calibration-access=READ-WRITE, type=Ary2D_u4p12_12_5
    Ary2D_u4p12_12_8_CalPortIf1
      parameter data prototype Ary2D: sw-calibration-access=READ-WRITE, type=Ary2D_u4p12_12_8
    Ary2D_u4p12_13_3_CalPortIf1
      parameter data prototype Ary2D: sw-calibration-access=READ-WRITE, type=Ary2D_u4p12_13_3
    Ary2D_u4p12_3_13_CalPortIf1
      parameter data prototype Ary2D: sw-calibration-access=READ-WRITE, type=Ary2D_u4p12_3_13
    Ary2D_u5p11_12_13_CalPortIf1
      parameter data prototype Ary2D: sw-calibration-access=READ-WRITE, type=Ary2D_u5p11_12_13
    Ary2D_u5p11_12_5_CalPortIf1
      parameter data prototype Ary2D: sw-calibration-access=READ-WRITE, type=Ary2D_u5p11_12_5
    Ary2D_u6p10_5_9_CalPortIf1
      parameter data prototype Ary2D: sw-calibration-access=READ-WRITE, type=Ary2D_u6p10_5_9
    Ary2D_u6p10_8_9_CalPortIf1
      parameter data prototype Ary2D: sw-calibration-access=READ-WRITE, type=Ary2D_u6p10_8_9
    Ary2D_u8p8_12_20_CalPortIf1
      parameter data prototype Ary2D: sw-calibration-access=READ-WRITE, type=Ary2D_u8p8_12_20
    Ary2D_u8p8_3_5_CalPortIf1
      parameter data prototype Ary2D: sw-calibration-access=READ-WRITE, type=Ary2D_u8p8_3_5
    Ary2D_u8p8_3_6_CalPortIf1
      parameter data prototype Ary2D: sw-calibration-access=READ-WRITE, type=Ary2D_u8p8_3_6
    Ary2D_u8p8_5_10_CalPortIf1
      parameter data prototype Ary2D: sw-calibration-access=READ-WRITE, type=Ary2D_u8p8_5_10
    Ary2D_u8p8_5_8_CalPortIf1
      parameter data prototype Ary2D: sw-calibration-access=READ-WRITE, type=Ary2D_u8p8_5_8
    Ary2D_u8p8_6_5_CalPortIf1
      parameter data prototype Ary2D: sw-calibration-access=READ-WRITE, type=Ary2D_u8p8_6_5
    Ary2D_u8p8_9_5_CalPortIf1
      parameter data prototype Ary2D: sw-calibration-access=READ-WRITE, type=Ary2D_u8p8_9_5
    Ary2D_u8p8_9_6_CalPortIf1
      parameter data prototype Ary2D: sw-calibration-access=READ-WRITE, type=Ary2D_u8p8_9_6
    boolean_CalPortIf1
      parameter data prototype Logl: sw-calibration-access=READ-WRITE, type=boolean
    Cnt1
      parameter data prototype Val: sw-calibration-access=READ-WRITE, type=Cnt5
    Cnt10
      parameter data prototype Val: sw-calibration-access=READ-WRITE, type=Cnt16
    Cnt11
      parameter data prototype Val: sw-calibration-access=READ-WRITE, type=Cnt30
    Cnt2
      parameter data prototype Val: sw-calibration-access=READ-WRITE, type=uint16
    Cnt3
      parameter data prototype Val: sw-calibration-access=READ-WRITE, type=uint8
    Cnt4
      parameter data prototype Val: sw-calibration-access=READ-WRITE, type=Cnt9
    Cnt5
      parameter data prototype Val: sw-calibration-access=READ-WRITE, type=Cnt10
    Cnt6
      parameter data prototype Val: sw-calibration-access=READ-WRITE, type=Cnt14
    Cnt7
      parameter data prototype Val: sw-calibration-access=READ-WRITE, type=Cnt28
    Cnt8
      parameter data prototype Val: sw-calibration-access=READ-WRITE, type=Cnt29
    Cnt9
      parameter data prototype Val: sw-calibration-access=READ-WRITE, type=Cnt15
    CntAry1D1
      parameter data prototype Ary1D: sw-calibration-access=READ-WRITE, type=CntAry1D1
    CntAry1D2
      parameter data prototype Ary1D: sw-calibration-access=READ-WRITE, type=CntAry1D4
    CntAry1D3
      parameter data prototype Ary1D: sw-calibration-access=READ-WRITE, type=CntAry1D5
    CntAry1D4
      parameter data prototype Ary1D: sw-calibration-access=READ-WRITE, type=CntAry1D6
    Curr1
      parameter data prototype Val: sw-calibration-access=READ-WRITE, type=Curr2
    Curr2
      parameter data prototype Val: sw-calibration-access=READ-WRITE, type=Curr3
    Curr3
      parameter data prototype Val: sw-calibration-access=READ-WRITE, type=Curr9
    CurrAry1D1
      parameter data prototype Ary1D: sw-calibration-access=READ-WRITE, type=CurrAry1D1
    CurrAry1D2
      parameter data prototype Ary1D: sw-calibration-access=READ-WRITE, type=CurrAry1D2
    CurrAry1D3
      parameter data prototype Ary1D: sw-calibration-access=READ-WRITE, type=CurrAry1D3
    FilNotchGainRec1_CalPortIf1
      parameter data prototype Rec: sw-calibration-access=READ-WRITE, type=FilNotchGainRec1
    float32_CalPortIf1
      parameter data prototype Val: sw-calibration-access=READ-WRITE, type=float32
    Frq1
      parameter data prototype Val: sw-calibration-access=READ-WRITE, type=Frq1
    Frq2
      parameter data prototype Val: sw-calibration-access=READ-WRITE, type=Frq2
    Frq3
      parameter data prototype Val: sw-calibration-access=READ-WRITE, type=Frq7
    Frq4
      parameter data prototype Val: sw-calibration-access=READ-WRITE, type=Frq8
    Frq5
      parameter data prototype Val: sw-calibration-access=READ-WRITE, type=Frq9
    Frq6
      parameter data prototype Val: sw-calibration-access=READ-WRITE, type=Frq10
    FrqAry1D1
      parameter data prototype Ary1D: sw-calibration-access=READ-WRITE, type=FrqAry1D1
    FrqAry1D2
      parameter data prototype Ary1D: sw-calibration-access=READ-WRITE, type=FrqAry1D2
    FrqAry1D3
      parameter data prototype Ary1D: sw-calibration-access=READ-WRITE, type=FrqAry1D3
    FrqAry1D4
      parameter data prototype Ary1D: sw-calibration-access=READ-WRITE, type=FrqAry1D4
    Gain1
      parameter data prototype Val: sw-calibration-access=READ-WRITE, type=Gain1
    Gain2
      parameter data prototype Val: sw-calibration-access=READ-WRITE, type=Gain2
    Gain3
      parameter data prototype Val: sw-calibration-access=READ-WRITE, type=Gain3
    Gain4
      parameter data prototype Val: sw-calibration-access=READ-WRITE, type=Gain5
    Gain5
      parameter data prototype Val: sw-calibration-access=READ-WRITE, type=Gain6
    Gain6
      parameter data prototype Val: sw-calibration-access=READ-WRITE, type=Gain7
    Gain7
      parameter data prototype Val: sw-calibration-access=READ-WRITE, type=Gain8
    Indu1
      parameter data prototype Val: sw-calibration-access=READ-WRITE, type=Indu1
    Logl1
      parameter data prototype Logl: sw-calibration-access=READ-WRITE, type=Logl1
    MotCon1
      parameter data prototype Val: sw-calibration-access=READ-WRITE, type=MotCon1
    R1
      parameter data prototype Val: sw-calibration-access=READ-WRITE, type=R1
    R2
      parameter data prototype Val: sw-calibration-access=READ-WRITE, type=R6
    R3
      parameter data prototype Val: sw-calibration-access=READ-WRITE, type=R8
    Rate1
      parameter data prototype Val: sw-calibration-access=READ-WRITE, type=Rate3
    Rate2
      parameter data prototype Val: sw-calibration-access=READ-WRITE, type=Rate4
    Rate3
      parameter data prototype Val: sw-calibration-access=READ-WRITE, type=Rate5
    Rate4
      parameter data prototype Val: sw-calibration-access=READ-WRITE, type=Rate6
    Rate5
      parameter data prototype Val: sw-calibration-access=READ-WRITE, type=Rate7
    Rate6
      parameter data prototype Val: sw-calibration-access=READ-WRITE, type=Rate8
    Rate7
      parameter data prototype Val: sw-calibration-access=READ-WRITE, type=Rate9
    Rate8
      parameter data prototype Val: sw-calibration-access=READ-WRITE, type=Rate10
    sint16_CalPortIf1
      parameter data prototype Val: sw-calibration-access=READ-WRITE, type=sint16
    Spd1  # OBSOLETE
      parameter data prototype Element: sw-calibration-access=READ-WRITE, type=Spd1
    Spd2
      parameter data prototype Val: sw-calibration-access=READ-WRITE, type=Spd3
    Spd3
      parameter data prototype Val: sw-calibration-access=READ-WRITE, type=Spd4
    Spd4
      parameter data prototype Val: sw-calibration-access=READ-WRITE, type=Spd1
    SpdAry1D1
      parameter data prototype Ary1D: sw-calibration-access=READ-WRITE, type=SpdAry1D1
    SpdAry1D2
      parameter data prototype Ary1D: sw-calibration-access=READ-WRITE, type=SpdAry1D2
    T1
      parameter data prototype Val: sw-calibration-access=READ-WRITE, type=T1
    T2
      parameter data prototype Val: sw-calibration-access=READ-WRITE, type=T2
    T3
      parameter data prototype Val: sw-calibration-access=READ-WRITE, type=T4
    T4
      parameter data prototype Val: sw-calibration-access=READ-WRITE, type=T5
    TAry1D1  # OBSOLETE
      parameter data prototype Ary1D1: sw-calibration-access=READ-WRITE, type=TAry1D1
    TAry1D2
      parameter data prototype Ary1D: sw-calibration-access=READ-WRITE, type=TAry1D2
    TAry1D3
      parameter data prototype Ary1D: sw-calibration-access=READ-WRITE, type=TAry1D1
    Ti1
      parameter data prototype Val: sw-calibration-access=READ-WRITE, type=Ti1
    Ti2
      parameter data prototype Val: sw-calibration-access=READ-WRITE, type=Ti2
    Ti3
      parameter data prototype Val: sw-calibration-access=READ-WRITE, type=Ti3
    Ti4
      parameter data prototype Val: sw-calibration-access=READ-WRITE, type=Ti4
    Ti5
      parameter data prototype Val: sw-calibration-access=READ-WRITE, type=Ti5
    Ti6
      parameter data prototype Val: sw-calibration-access=READ-WRITE, type=Ti6
    Ti7
      parameter data prototype Val: sw-calibration-access=READ-WRITE, type=Ti10
    Ti8
      parameter data prototype Val: sw-calibration-access=READ-WRITE, type=Ti11
    Ti9
      parameter data prototype Val: sw-calibration-access=READ-WRITE, type=Ti12
    Tq1
      parameter data prototype Val: sw-calibration-access=READ-WRITE, type=Tq3
    Tq2
      parameter data prototype Val: sw-calibration-access=READ-WRITE, type=Tq10
    Tq3
      parameter data prototype Val: sw-calibration-access=READ-WRITE, type=Tq15
    Tq4
      parameter data prototype Val: sw-calibration-access=READ-WRITE, type=Tq1
    Tq5
      parameter data prototype Val: sw-calibration-access=READ-WRITE, type=Tq16
    Tq6
      parameter data prototype Val: sw-calibration-access=READ-WRITE, type=Tq18
    TqAry1D1
      parameter data prototype Ary1D: sw-calibration-access=READ-WRITE, type=TqAry1D6
    TqAry1D2
      parameter data prototype Ary1D: sw-calibration-access=READ-WRITE, type=TqAry1D9
    TqAry1D3
      parameter data prototype Ary1D: sw-calibration-access=READ-WRITE, type=TqAry1D10
    TqAry2D1
      parameter data prototype Ary2D: sw-calibration-access=READ-WRITE, type=TqAry2D1
    TqAry2D2
      parameter data prototype Ary2D: sw-calibration-access=READ-WRITE, type=TqAry2D2
    TqAry2D3
      parameter data prototype Ary2D: sw-calibration-access=READ-WRITE, type=TqAry2D3
    TqAry2D4
      parameter data prototype Ary2D: sw-calibration-access=READ-WRITE, type=TqAry2D4
    TqAry2D5
      parameter data prototype Ary2D: sw-calibration-access=READ-WRITE, type=TqAry2D5
    TqAry2D6
      parameter data prototype Ary2D: sw-calibration-access=READ-WRITE, type=TqAry2D6
    TqAry2D7
      parameter data prototype Ary2D: sw-calibration-access=READ-WRITE, type=TqAry2D7
    TqAry2D8
      parameter data prototype Ary2D: sw-calibration-access=READ-WRITE, type=TqAry2D8
    u0p16_CalPortIf1
      parameter data prototype Val: sw-calibration-access=READ-WRITE, type=u0p16
    u10p6_CalPortIf1
      parameter data prototype Val: sw-calibration-access=READ-WRITE, type=u10p6
    u16p0_CalPortIf1
      parameter data prototype Val: sw-calibration-access=READ-WRITE, type=u16p0
    u2p14_CalPortIf1
      parameter data prototype Val: sw-calibration-access=READ-WRITE, type=u2p14
    u9p7_CalPortIf1
      parameter data prototype Val: sw-calibration-access=READ-WRITE, type=u9p7
    uint16_CalPortIf1
      parameter data prototype Val: sw-calibration-access=READ-WRITE, type=uint16
    uint32_CalPortIf1
      parameter data prototype Val: sw-calibration-access=READ-WRITE, type=uint32
    uint8_CalPortIf1
      parameter data prototype Val: sw-calibration-access=READ-WRITE, type=uint8
    Uls1
      parameter data prototype Val: sw-calibration-access=READ-WRITE, type=Uls1
    Uls2
      parameter data prototype Val: sw-calibration-access=READ-WRITE, type=Uls7
    Uls3
      parameter data prototype Val: sw-calibration-access=READ-WRITE, type=Uls9
    Uls4
      parameter data prototype Val: sw-calibration-access=READ-WRITE, type=Uls2
    Uls5
      parameter data prototype Val: sw-calibration-access=READ-WRITE, type=Uls10
    Uls6
      parameter data prototype Val: sw-calibration-access=READ-WRITE, type=Uls14
    Uls7
      parameter data prototype Val: sw-calibration-access=READ-WRITE, type=Uls21
    UlsAry1D1
      parameter data prototype Ary1D: sw-calibration-access=READ-WRITE, type=UlsAry1D2
    UlsAry1D10
      parameter data prototype Ary1D: sw-calibration-access=READ-WRITE, type=UlsAry1D15
    UlsAry1D2
      parameter data prototype Ary1D: sw-calibration-access=READ-WRITE, type=UlsAry1D3
    UlsAry1D3
      parameter data prototype Ary1D: sw-calibration-access=READ-WRITE, type=UlsAry1D5
    UlsAry1D4
      parameter data prototype Ary1D: sw-calibration-access=READ-WRITE, type=UlsAry1D7
    UlsAry1D5
      parameter data prototype Ary1D: sw-calibration-access=READ-WRITE, type=UlsAry1D8
    UlsAry1D6
      parameter data prototype Ary1D: sw-calibration-access=READ-WRITE, type=UlsAry1D11
    UlsAry1D7
      parameter data prototype Ary1D: sw-calibration-access=READ-WRITE, type=UlsAry1D12
    UlsAry1D8
      parameter data prototype Ary1D: sw-calibration-access=READ-WRITE, type=UlsAry1D13
    UlsAry1D9
      parameter data prototype Ary1D: sw-calibration-access=READ-WRITE, type=UlsAry1D14
    UlsAry2D1
      parameter data prototype Ary2D: sw-calibration-access=READ-WRITE, type=UlsAry2D1
    UlsAry2D2
      parameter data prototype Ary2D: sw-calibration-access=READ-WRITE, type=UlsAry2D2
    UlsAry2D3
      parameter data prototype Ary2D: sw-calibration-access=READ-WRITE, type=UlsAry2D3
    UlsAry2D4
      parameter data prototype Ary2D: sw-calibration-access=READ-WRITE, type=UlsAry2D4
    Vel1
      parameter data prototype Val: sw-calibration-access=READ-WRITE, type=Vel2
    Vel2
      parameter data prototype Val: sw-calibration-access=READ-WRITE, type=Vel5
    Vel3
      parameter data prototype Val: sw-calibration-access=READ-WRITE, type=Vel8
    VelAry1D1
      parameter data prototype Ary1D: sw-calibration-access=READ-WRITE, type=VelAry1D1
    VelAry1D2
      parameter data prototype Ary1D: sw-calibration-access=READ-WRITE, type=VelAry1D2
    VelAry1D3
      parameter data prototype Ary1D: sw-calibration-access=READ-WRITE, type=VelAry1D3
    VelAry2D1
      parameter data prototype Ary2D: sw-calibration-access=READ-WRITE, type=VelAry2D1
    VelAry2D2
      parameter data prototype Ary2D: sw-calibration-access=READ-WRITE, type=VelAry2D2
    VelAry2D3
      parameter data prototype Ary2D: sw-calibration-access=READ-WRITE, type=VelAry2D3
    Volt1
      parameter data prototype Val: sw-calibration-access=READ-WRITE, type=Volt1
    Volt10
      parameter data prototype Val: sw-calibration-access=READ-WRITE, type=Volt16
    Volt2
      parameter data prototype Val: sw-calibration-access=READ-WRITE, type=Volt3
    Volt3
      parameter data prototype Val: sw-calibration-access=READ-WRITE, type=Volt4
    Volt4
      parameter data prototype Val: sw-calibration-access=READ-WRITE, type=Volt8
    Volt5
      parameter data prototype Val: sw-calibration-access=READ-WRITE, type=Volt10
    Volt6
      parameter data prototype Val: sw-calibration-access=READ-WRITE, type=Volt9
    Volt7
      parameter data prototype Val: sw-calibration-access=READ-WRITE, type=Volt11
    Volt8
      parameter data prototype Val: sw-calibration-access=READ-WRITE, type=Volt12
    Volt9
      parameter data prototype Val: sw-calibration-access=READ-WRITE, type=Volt13
    VoltAry1D1
      parameter data prototype Ary1D: sw-calibration-access=READ-WRITE, type=VoltAry1D1
    VoltTi1
      parameter data prototype Val: sw-calibration-access=READ-WRITE, type=VoltTi2
package /Nexteer/PortInterfaces
  277 x client server interface:
    Adc1CfgAndUseAdc1EnaCnvn_PortIf1
      operation Oper
    Adc1CfgAndUseAdc1EnaCnvn1  # OBSOLETE
      operation Oper
    Adcf1EnaCnvn_PortIf1
      operation Oper
    AdcScanGroupCfg_PortIf1
      operation Oper
        arg StrtPtr_Arg: type=uint8, direction=IN, server-argument-impl-policy=USE-ARGUMENT-TYPE
        arg EndPtr_Arg: type=uint8, direction=IN, server-argument-impl-policy=USE-ARGUMENT-TYPE
    Calc16BitCrc_u08_PortIf1
      operation Oper: possible-error=Calc16BitCrc_u08_PortIf1/E_NOT_OK
        5 x arg, all with server-argument-impl-policy=USE-ARGUMENT-TYPE:
          DataPtr_Arg: type=uint8, direction=INOUT
          Len_Arg: type=uint32, direction=IN
          StrtVal_Arg: type=uint16, direction=IN
          FirstCall_Arg: type=boolean, direction=IN
          CalcCrcRes_Arg: type=uint16, direction=OUT
      error E_NOT_OK: error-code=1
    Calc16BitCrc_u16_PortIf1
      operation Oper: possible-error=Calc16BitCrc_u16_PortIf1/E_NOT_OK
        5 x arg, all with server-argument-impl-policy=USE-ARGUMENT-TYPE:
          DataPtr_Arg: type=uint16, direction=INOUT
          Len_Arg: type=uint32, direction=IN
          StrtVal_Arg: type=uint16, direction=IN
          FirstCall_Arg: type=boolean, direction=IN
          CalcCrcRes_Arg: type=uint16, direction=OUT
      error E_NOT_OK: error-code=1
    Calc32BitCrc_u08_PortIf1
      operation Oper: possible-error=Calc32BitCrc_u08_PortIf1/E_NOT_OK
        5 x arg, all with server-argument-impl-policy=USE-ARGUMENT-TYPE:
          DataPtr_Arg: type=uint8, direction=INOUT
          Len_Arg: type=uint32, direction=IN
          StrtVal_Arg: type=uint32, direction=IN
          FirstCall_Arg: type=boolean, direction=IN
          CalcCrcRes_Arg: type=uint32, direction=OUT
      error E_NOT_OK: error-code=1
    Calc32BitCrc_u16_PortIf1
      operation Oper: possible-error=Calc32BitCrc_u16_PortIf1/E_NOT_OK
        5 x arg, all with server-argument-impl-policy=USE-ARGUMENT-TYPE:
          DataPtr_Arg: type=uint16, direction=INOUT
          Len_Arg: type=uint32, direction=IN
          StrtVal_Arg: type=uint32, direction=IN
          FirstCall_Arg: type=boolean, direction=IN
          CalcCrcRes_Arg: type=uint32, direction=OUT
      error E_NOT_OK: error-code=1
    Calc32BitCrc_u32_PortIf1
      operation Oper: possible-error=Calc32BitCrc_u32_PortIf1/E_NOT_OK
        5 x arg, all with server-argument-impl-policy=USE-ARGUMENT-TYPE:
          DataPtr_Arg: type=uint32, direction=INOUT
          Len_Arg: type=uint32, direction=IN
          StrtVal_Arg: type=uint32, direction=IN
          FirstCall_Arg: type=boolean, direction=IN
          CalcCrcRes_Arg: type=uint32, direction=OUT
      error E_NOT_OK: error-code=1
    Calc8BitCrc_PortIf1
      operation Oper: possible-error=Calc8BitCrc_PortIf1/E_NOT_OK
        5 x arg, all with server-argument-impl-policy=USE-ARGUMENT-TYPE:
          DataPtr_Arg: type=uint8, direction=INOUT
          Len_Arg: type=uint32, direction=IN
          StrtVal_Arg: type=uint8, direction=IN
          FirstCall_Arg: type=boolean, direction=IN
          CalcCrcRes_Arg: type=uint8, direction=OUT
      error E_NOT_OK: error-code=1
    ChkForStrtUpTest_PortIf1
      operation Oper
        arg ExecStrtUpTest_Arg: type=boolean, direction=OUT, server-argument-impl-policy=USE-ARGUMENT-TYPE
    ClrAllDiagc_PortIf1
      operation Oper
    ClrErrInjReg_PortIf1
      operation Oper
    ClrFricLrngOperMod_PortIf1
      operation Oper
    ClrHwAgTrimVal_PortIf1
      operation Oper
    ClrLtchCntrData_PortIf1
      operation Oper
    ClrSigStcHlthData_PortIf1
      operation Oper
        arg ClrTar_Arg: type=boolean, direction=IN, server-argument-impl-policy=USE-ARGUMENT-TYPE
    ClrSnpshtData_PortIf1
      operation Oper
    CnvSnpshtData_f32_PortIf1
      operation Oper
        arg SnpshtDataCnvd_Arg: type=uint32, direction=OUT, server-argument-impl-policy=USE-ARGUMENT-TYPE
        arg SnpshtData_Arg: type=float32, direction=IN, server-argument-impl-policy=USE-ARGUMENT-TYPE
    CnvSnpshtData_logl_PortIf1
      operation Oper
        arg SnpshtDataCnvd_Arg: type=uint32, direction=OUT, server-argument-impl-policy=USE-ARGUMENT-TYPE
        arg SnpshtData_Arg: type=boolean, direction=IN, server-argument-impl-policy=USE-ARGUMENT-TYPE
    CnvSnpshtData_s08_PortIf1
      operation Oper
        arg SnpshtDataCnvd_Arg: type=uint32, direction=OUT, server-argument-impl-policy=USE-ARGUMENT-TYPE
        arg SnpshtData_Arg: type=sint8, direction=IN, server-argument-impl-policy=USE-ARGUMENT-TYPE
    CnvSnpshtData_s16_PortIf1
      operation Oper
        arg SnpshtDataCnvd_Arg: type=uint32, direction=OUT, server-argument-impl-policy=USE-ARGUMENT-TYPE
        arg SnpshtData_Arg: type=sint16, direction=IN, server-argument-impl-policy=USE-ARGUMENT-TYPE
    CnvSnpshtData_s32_PortIf1
      operation Oper
        arg SnpshtDataCnvd_Arg: type=uint32, direction=OUT, server-argument-impl-policy=USE-ARGUMENT-TYPE
        arg SnpshtData_Arg: type=sint32, direction=IN, server-argument-impl-policy=USE-ARGUMENT-TYPE
    CnvSnpshtData_u08_PortIf1
      operation Oper
        arg SnpshtDataCnvd_Arg: type=uint32, direction=OUT, server-argument-impl-policy=USE-ARGUMENT-TYPE
        arg SnpshtData_Arg: type=uint8, direction=IN, server-argument-impl-policy=USE-ARGUMENT-TYPE
    CnvSnpshtData_u16_PortIf1
      operation Oper
        arg SnpshtDataCnvd_Arg: type=uint32, direction=OUT, server-argument-impl-policy=USE-ARGUMENT-TYPE
        arg SnpshtData_Arg: type=uint16, direction=IN, server-argument-impl-policy=USE-ARGUMENT-TYPE
    CopyCalPageReq_PortIf1
      operation Oper: possible-error=CopyCalPageReq_PortIf1/E_NOT_OK
        arg Seg_Arg: type=uint8, direction=IN, server-argument-impl-policy=USE-ARGUMENT-TYPE
      error E_NOT_OK: error-code=1
    CtrlErrOut_PortIf1
      operation Oper
        arg PinSt_Arg: type=boolean, direction=IN, server-argument-impl-policy=USE-ARGUMENT-TYPE
        arg TrigReg_Arg: type=TrigReg1, direction=IN, server-argument-impl-policy=USE-ARGUMENT-TYPE
    CurrMeasEolGainReq_PortIf1
      operation Oper
    CurrMeasEolGainReq1
      operation Oper: possible-error=CurrMeasEolGainReq1/E_NOT_OK
      error E_NOT_OK: error-code=1
    CurrMeasEolGainStReq_PortIf1
      operation Oper
        arg CurrMeasEolGainSt_Arg: type=uint8, direction=OUT, server-argument-impl-policy=USE-ARGUMENT-TYPE
    CurrMeasEolGainStReq1
      operation Oper: possible-error=CurrMeasEolGainStReq1/E_NOT_OK
        arg CurrMeasEolGainSt: type=Cnt12, direction=OUT, server-argument-impl-policy=USE-ARGUMENT-TYPE
      error E_NOT_OK: error-code=1
    CurrMeasEolOffsReq_PortIf1
      operation Oper
    CurrMeasEolOffsReq1
      operation Oper: possible-error=CurrMeasEolOffsReq1/E_NOT_OK
      error E_NOT_OK: error-code=1
    CurrMeasEolOffsStReq_PortIf1
      operation Oper
        arg CurrMeasEolOffsSt_Arg: type=uint8, direction=OUT, server-argument-impl-policy=USE-ARGUMENT-TYPE
    CurrMeasEolOffsStReq1
      operation Oper: possible-error=CurrMeasEolOffsStReq1/E_NOT_OK
        arg CurrMeasEolOffsSt: type=Cnt12, direction=OUT, server-argument-impl-policy=USE-ARGUMENT-TYPE
      error E_NOT_OK: error-code=1
    CurrMeasGainReadReq_PortIf1
      operation Oper
        6 x arg, all with type=float32, direction=OUT, server-argument-impl-policy=USE-ARGUMENT-TYPE:
          CurrMeasMotCurrGainA_Arg
          CurrMeasMotCurrGainB_Arg
          CurrMeasMotCurrGainC_Arg
          CurrMeasMotCurrGainD_Arg
          CurrMeasMotCurrGainE_Arg
          CurrMeasMotCurrGainF_Arg
    CurrMeasGainReadReq_PortIf2
      operation Oper
        arg CurrMeasMotCurrGainA_Arg: type=float32, direction=OUT, server-argument-impl-policy=USE-ARGUMENT-TYPE
        arg CurrMeasMotCurrGainB_Arg: type=float32, direction=OUT, server-argument-impl-policy=USE-ARGUMENT-TYPE
        arg CurrMeasMotCurrGainC_Arg: type=float32, direction=OUT, server-argument-impl-policy=USE-ARGUMENT-TYPE
    CurrMeasGainReadReqSngIvtr_PortIf1
      operation Oper
        arg CurrMeasMotCurrGainA_Arg: type=float32, direction=OUT, server-argument-impl-policy=USE-ARGUMENT-TYPE
        arg CurrMeasMotCurrGainB_Arg: type=float32, direction=OUT, server-argument-impl-policy=USE-ARGUMENT-TYPE
        arg CurrMeasMotCurrGainC_Arg: type=float32, direction=OUT, server-argument-impl-policy=USE-ARGUMENT-TYPE
    CurrMeasGainWrReq_PortIf1  # OBSELETE
      operation Oper
        6 x arg, all with type=float32, direction=IN, server-argument-impl-policy=USE-ARGUMENT-TYPE:
          CurrMeasMotCurrGainA_Arg
          CurrMeasMotCurrGainB_Arg
          CurrMeasMotCurrGainC_Arg
          CurrMeasMotCurrGainD_Arg
          CurrMeasMotCurrGainE_Arg
          CurrMeasMotCurrGainF_Arg
    CurrMeasGainWrReq_PortIf2
      operation Oper
        7 x arg, all with server-argument-impl-policy=USE-ARGUMENT-TYPE:
          CurrMeasMotCurrGainA_Arg: type=float32, direction=IN
          CurrMeasMotCurrGainB_Arg: type=float32, direction=IN
          CurrMeasMotCurrGainC_Arg: type=float32, direction=IN
          CurrMeasMotCurrGainD_Arg: type=float32, direction=IN
          CurrMeasMotCurrGainE_Arg: type=float32, direction=IN
          CurrMeasMotCurrGainF_Arg: type=float32, direction=IN
          CurrMeasGainWrReqSts_Arg: type=uint8, direction=OUT
    CurrMeasGainWrReq_PortIf3
      operation Oper
        4 x arg, all with server-argument-impl-policy=USE-ARGUMENT-TYPE:
          CurrMeasMotCurrGainA_Arg: type=float32, direction=IN
          CurrMeasMotCurrGainB_Arg: type=float32, direction=IN
          CurrMeasMotCurrGainC_Arg: type=float32, direction=IN
          CurrMeasGainWrReqSts_Arg: type=uint8, direction=OUT
    CurrMeasGainWrReqSngIvtr_PortIf1
      operation Oper
        4 x arg, all with server-argument-impl-policy=USE-ARGUMENT-TYPE:
          CurrMeasMotCurrGainA_Arg: type=float32, direction=IN
          CurrMeasMotCurrGainB_Arg: type=float32, direction=IN
          CurrMeasMotCurrGainC_Arg: type=float32, direction=IN
          CurrMeasGainWrReqSts_Arg: type=uint8, direction=OUT
    CurrMeasOffsReadReq_PortIf1  # OBSELETE
      operation Oper
        13 x arg, all with type=float32, direction=OUT, server-argument-impl-policy=USE-ARGUMENT-TYPE:
          CurrMeasEolOffsHiBrdgVltg
          CurrMeasMotCurrOffsDifA
          CurrMeasMotCurrOffsDifB
          CurrMeasMotCurrOffsDifC
          CurrMeasMotCurrOffsDifD
          CurrMeasMotCurrOffsDifE
          CurrMeasMotCurrOffsDifF
          CurrMeasMotCurrOffsLoAvrgA
          CurrMeasMotCurrOffsLoAvrgB
          CurrMeasMotCurrOffsLoAvrgC
          CurrMeasMotCurrOffsLoAvrgD
          CurrMeasMotCurrOffsLoAvrgE
          CurrMeasMotCurrOffsLoAvrgF
    CurrMeasOffsReadReq_PortIf2
      operation Oper
        13 x arg, all with type=float32, direction=OUT, server-argument-impl-policy=USE-ARGUMENT-TYPE:
          CurrMeasEolOffsHiBrdgVltg_Arg
          CurrMeasMotCurrOffsDifA_Arg
          CurrMeasMotCurrOffsDifB_Arg
          CurrMeasMotCurrOffsDifC_Arg
          CurrMeasMotCurrOffsDifD_Arg
          CurrMeasMotCurrOffsDifE_Arg
          CurrMeasMotCurrOffsDifF_Arg
          CurrMeasMotCurrOffsLoAvrgA_Arg
          CurrMeasMotCurrOffsLoAvrgB_Arg
          CurrMeasMotCurrOffsLoAvrgC_Arg
          CurrMeasMotCurrOffsLoAvrgD_Arg
          CurrMeasMotCurrOffsLoAvrgE_Arg
          CurrMeasMotCurrOffsLoAvrgF_Arg
    CurrMeasOffsReadReq_PortIf3
      operation Oper
        arg MotCurrOffsZeroAvrgA_Arg: type=float32, direction=OUT, server-argument-impl-policy=USE-ARGUMENT-TYPE
        arg MotCurrOffsZeroAvrgB_Arg: type=float32, direction=OUT, server-argument-impl-policy=USE-ARGUMENT-TYPE
        arg MotCurrOffsZeroAvrgC_Arg: type=float32, direction=OUT, server-argument-impl-policy=USE-ARGUMENT-TYPE
    CurrMeasOffsReadReqSngIvtr_PortIf1
      operation Oper
        7 x arg, all with type=float32, direction=OUT, server-argument-impl-policy=USE-ARGUMENT-TYPE:
          CurrMeasEolOffsHiBrdgVltg_Arg
          CurrMeasMotCurrOffsDifA_Arg
          CurrMeasMotCurrOffsDifB_Arg
          CurrMeasMotCurrOffsDifC_Arg
          CurrMeasMotCurrOffsLoAvrgA_Arg
          CurrMeasMotCurrOffsLoAvrgB_Arg
          CurrMeasMotCurrOffsLoAvrgC_Arg
    CurrMeasOffsWrReq_PortIf1  # OBSELETE
      operation Oper
        13 x arg, all with type=float32, direction=IN, server-argument-impl-policy=USE-ARGUMENT-TYPE:
          CurrMeasEolOffsHiBrdgVltg
          CurrMeasMotCurrOffsDifA
          CurrMeasMotCurrOffsDifB
          CurrMeasMotCurrOffsDifC
          CurrMeasMotCurrOffsDifD
          CurrMeasMotCurrOffsDifE
          CurrMeasMotCurrOffsDifF
          CurrMeasMotCurrOffsLoAvrgA
          CurrMeasMotCurrOffsLoAvrgB
          CurrMeasMotCurrOffsLoAvrgC
          CurrMeasMotCurrOffsLoAvrgD
          CurrMeasMotCurrOffsLoAvrgE
          CurrMeasMotCurrOffsLoAvrgF
    CurrMeasOffsWrReq_PortIf2  # OBSELETE
      operation Oper
        13 x arg, all with type=float32, direction=IN, server-argument-impl-policy=USE-ARGUMENT-TYPE:
          CurrMeasEolOffsHiBrdgVltg_Arg
          CurrMeasMotCurrOffsDifA_Arg
          CurrMeasMotCurrOffsDifB_Arg
          CurrMeasMotCurrOffsDifC_Arg
          CurrMeasMotCurrOffsDifD_Arg
          CurrMeasMotCurrOffsDifE_Arg
          CurrMeasMotCurrOffsDifF_Arg
          CurrMeasMotCurrOffsLoAvrgA_Arg
          CurrMeasMotCurrOffsLoAvrgB_Arg
          CurrMeasMotCurrOffsLoAvrgC_Arg
          CurrMeasMotCurrOffsLoAvrgD_Arg
          CurrMeasMotCurrOffsLoAvrgE_Arg
          CurrMeasMotCurrOffsLoAvrgF_Arg
    CurrMeasOffsWrReq_PortIf3
      operation Oper
        14 x arg, all with server-argument-impl-policy=USE-ARGUMENT-TYPE:
          CurrMeasEolOffsHiBrdgVltg_Arg: type=float32, direction=IN
          CurrMeasMotCurrOffsDifA_Arg: type=float32, direction=IN
          CurrMeasMotCurrOffsDifB_Arg: type=float32, direction=IN
          CurrMeasMotCurrOffsDifC_Arg: type=float32, direction=IN
          CurrMeasMotCurrOffsDifD_Arg: type=float32, direction=IN
          CurrMeasMotCurrOffsDifE_Arg: type=float32, direction=IN
          CurrMeasMotCurrOffsDifF_Arg: type=float32, direction=IN
          CurrMeasMotCurrOffsLoAvrgA_Arg: type=float32, direction=IN
          CurrMeasMotCurrOffsLoAvrgB_Arg: type=float32, direction=IN
          CurrMeasMotCurrOffsLoAvrgC_Arg: type=float32, direction=IN
          CurrMeasMotCurrOffsLoAvrgD_Arg: type=float32, direction=IN
          CurrMeasMotCurrOffsLoAvrgE_Arg: type=float32, direction=IN
          CurrMeasMotCurrOffsLoAvrgF_Arg: type=float32, direction=IN
          CurrMeasOffsWrReqSts_Arg: type=uint8, direction=OUT
    CurrMeasOffsWrReq_PortIf4
      operation Oper
        arg MotCurrOffsZeroAvrgA_Arg: type=float32, direction=IN, server-argument-impl-policy=USE-ARGUMENT-TYPE
        arg MotCurrOffsZeroAvrgB_Arg: type=float32, direction=IN, server-argument-impl-policy=USE-ARGUMENT-TYPE
        arg MotCurrOffsZeroAvrgC_Arg: type=float32, direction=IN, server-argument-impl-policy=USE-ARGUMENT-TYPE
    CurrMeasOffsWrReqSngIvtr_PortIf1
      operation Oper
        8 x arg, all with server-argument-impl-policy=USE-ARGUMENT-TYPE:
          CurrMeasEolOffsHiBrdgVltg_Arg: type=float32, direction=IN
          CurrMeasMotCurrOffsDifA_Arg: type=float32, direction=IN
          CurrMeasMotCurrOffsDifB_Arg: type=float32, direction=IN
          CurrMeasMotCurrOffsDifC_Arg: type=float32, direction=IN
          CurrMeasMotCurrOffsLoAvrgA_Arg: type=float32, direction=IN
          CurrMeasMotCurrOffsLoAvrgB_Arg: type=float32, direction=IN
          CurrMeasMotCurrOffsLoAvrgC_Arg: type=float32, direction=IN
          CurrMeasOffsWrReqSts_Arg: type=uint8, direction=OUT
    DmaEna2MilliSecToMotCtrlTrf_PortIf1
      operation Oper
    DmaEna2MilliSecToMotCtrlTrf1  # OBSOLETE
      operation Oper
    DmaEna2msToMotCtrlTrf
      operation Oper
    DmaWaitForMotCtrlTo2MilliSecTrf_PortIf1
      operation Oper: possible-error=DmaWaitForMotCtrlTo2MilliSecTrf_PortIf1/E_NOT_OK
      error E_NOT_OK: error-code=1
    DmaWaitForMotCtrlTo2MilliSecTrf1  # OBSOLETE
      operation Oper: possible-error=DmaWaitForMotCtrlTo2MilliSecTrf1/E_NOT_OK
      error E_NOT_OK: error-code=1
    DmaWaitForMotCtrlTo2msTrf
      operation Oper: possible-error=DmaWaitForMotCtrlTo2msTrf/E_NOT_OK
      error E_NOT_OK: error-code=1
    FltInj_f32_PortIf1
      operation Oper
        arg SigPah_Arg: type=float32, direction=INOUT, server-argument-impl-policy=USE-ARGUMENT-TYPE
        arg LocnKey_Arg: type=uint16, direction=IN, server-argument-impl-policy=USE-ARGUMENT-TYPE
    FltInj_logl_PortIf1
      operation Oper
        arg SigPah_Arg: type=boolean, direction=INOUT, server-argument-impl-policy=USE-ARGUMENT-TYPE
        arg LocnKey_Arg: type=uint16, direction=IN, server-argument-impl-policy=USE-ARGUMENT-TYPE
    FltInj_u08_PortIf1
      operation Oper
        arg SigPah_Arg: type=uint8, direction=INOUT, server-argument-impl-policy=USE-ARGUMENT-TYPE
        arg LocnKey_Arg: type=uint16, direction=IN, server-argument-impl-policy=USE-ARGUMENT-TYPE
    FltInj_u0p16_PortIf1
      operation Oper
        arg SigPah_Arg: type=u0p16, direction=INOUT, server-argument-impl-policy=USE-ARGUMENT-TYPE
        arg LocnKey_Arg: type=uint16, direction=IN, server-argument-impl-policy=USE-ARGUMENT-TYPE
    FltInj1  # OBSOLETE
      operation Oper: possible-error=FltInj1/E_NOT_OK
        arg SigPah: type=Uls5, direction=INOUT, server-argument-impl-policy=USE-ARGUMENT-TYPE
        arg LocnKey: type=Cnt16, direction=IN, server-argument-impl-policy=USE-ARGUMENT-TYPE
      error E_NOT_OK: error-code=1
    FltInj2
      operation Oper
        arg SigPah_Arg: type=Uls5, direction=INOUT, server-argument-impl-policy=USE-ARGUMENT-TYPE
        arg LocnKey_Arg: type=Cnt16, direction=IN, server-argument-impl-policy=USE-ARGUMENT-TYPE
    FltInj3
      operation Oper
        arg SigPah_Arg: type=Uls24, direction=INOUT, server-argument-impl-policy=USE-ARGUMENT-TYPE
        arg LocnKey_Arg: type=Cnt16, direction=IN, server-argument-impl-policy=USE-ARGUMENT-TYPE
    FSnsrlsHwCentr_PortIf1
      operation Oper
    GetCalPageReq_PortIf1
      operation Oper
        4 x arg, all with type=uint8, server-argument-impl-policy=USE-ARGUMENT-TYPE:
          Seg_Arg: direction=IN
          Mod_Arg: direction=IN
          Page_Arg: direction=INOUT
          Rtn_Arg: direction=OUT
    GetCtrlPrm_PortIf1
      operation Oper
        7 x arg, all with type=float32, direction=OUT, server-argument-impl-policy=USE-ARGUMENT-TYPE:
          MotVelCtrlPropGain_Arg
          MotVelCtrlIntgtrGain_Arg
          MotVelCtrlDerivtvGain_Arg
          MotVelCtrlAntiWdupLim_Arg
          MotVelCtrlAntiWdupGain_Arg
          MotVelCtrlDerivtvLpFilTiCon_Arg
          MotVelCtrlTqCmdLim_Arg
    GetFricData_PortIf1  # OBSELETE
      operation Oper
        5 x arg, all with direction=OUT, server-argument-impl-policy=USE-ARGUMENT-TYPE:
          FricOffs_Arg: type=float32
          BasLineFric_Arg: type=float32
          VehLrndFric_Arg: type=float32
          Hys_Arg: type=float32
          RngCntr_Arg: type=uint16
    GetFricData_PortIf2  # OBSELETE
      operation Oper
        5 x arg, all with direction=OUT, server-argument-impl-policy=USE-ARGUMENT-TYPE:
          FricOffs_Arg: type=float32
          BasLineFric_Arg: type=Ary1D_f32_4
          VehLrndFric_Arg: type=Ary1D_f32_4
          Hys_Arg: type=Ary2D_f32_4_8
          RngCntr_Arg: type=Ary2D_u16_3_8
    GetFricData_PortIf3
      operation Oper
        5 x arg, all with direction=OUT, server-argument-impl-policy=USE-ARGUMENT-TYPE:
          FricOffs_Arg: type=float32
          BasLineFric_Arg: type=Ary1D_f32_4
          VehLrndFric_Arg: type=Ary1D_f32_4
          Hys_Arg: type=Ary2D_f32_8_4
          RngCntr_Arg: type=Ary2D_u16_8_3
    GetFricLrngData_PortIf1
      operation Oper
        4 x arg, all with direction=OUT, server-argument-impl-policy=USE-ARGUMENT-TYPE:
          FricLrngEna_Arg: type=boolean
          FricLrngOffsOutpEna_Arg: type=boolean
          FricLrngOperMod_Arg: type=SysFricLrngOperMod1
          EolFric_Arg: type=float32
    GetFricOffsOutpDi_PortIf1
      operation Oper
        arg FricOffsOutpDi_Arg: type=boolean, direction=OUT, server-argument-impl-policy=USE-ARGUMENT-TYPE
    GetGmLoaIgnCntr_PortIf1
      operation Oper
        arg GmLoaIgnCntr_Arg: type=uint16, direction=OUT, server-argument-impl-policy=USE-ARGUMENT-TYPE
    GetGpio_PortIf1
      operation Oper: possible-error=GetGpio_PortIf1/E_NOT_OK
        arg PinSt_Arg: type=boolean, direction=OUT, server-argument-impl-policy=USE-ARGUMENT-TYPE
      error E_NOT_OK: error-code=1
    GetGpio1
      operation Oper: possible-error=GetGpio1/E_NOT_OK
        arg PinSt: type=Logl1, direction=OUT, server-argument-impl-policy=USE-ARGUMENT-TYPE
      error E_NOT_OK: error-code=1
    GetHwAgOffs_PortIf1
      operation Oper
        arg HwAgOffs_Arg: type=float32, direction=OUT, server-argument-impl-policy=USE-ARGUMENT-TYPE
        arg HwAgLrngStRst_Arg: type=boolean, direction=OUT, server-argument-impl-policy=USE-ARGUMENT-TYPE
    GetHwAgOverTrvlCnt_PortIf1  # OBSELETE
      operation Oper
        arg HwAgOverTrvlCntValRet_Arg: type=uint8, direction=OUT, server-argument-impl-policy=USE-ARGUMENT-TYPE
    GetHwAgOverTrvlCnt_PortIf2
      operation Oper
        arg HwAgOverTrvlCnt_Arg: type=uint8, direction=OUT, server-argument-impl-policy=USE-ARGUMENT-TYPE
    GetHwAgTrimVal_PortIf1  # OBSELETE
      operation Oper
        arg HwAgTrimVal_Arg: type=float32, direction=OUT, server-argument-impl-policy=USE-ARGUMENT-TYPE
    GetHwAgTrimVal_PortIf2
      operation Oper
        arg HwAgTrimVal_Arg: type=float32, direction=OUT, server-argument-impl-policy=USE-ARGUMENT-TYPE
        arg HwAgTrimPrfmd_Arg: type=boolean, direction=OUT, server-argument-impl-policy=USE-ARGUMENT-TYPE
    GetHwTqOffs_PortIf1
      operation Oper
        arg HwTqOffs_Arg: type=float32, direction=OUT, server-argument-impl-policy=USE-ARGUMENT-TYPE
        arg HwTqLrngStRst_Arg: type=boolean, direction=OUT, server-argument-impl-policy=USE-ARGUMENT-TYPE
    GetMcuDiagcSpplData_PortIf1
      operation Oper
        arg McuDiagcData1_Arg: type=uint32, direction=OUT, server-argument-impl-policy=USE-ARGUMENT-TYPE
    GetMotAgMecl_PortIf1
      operation Oper
        arg MotAgMecl_Arg: type=u0p16, direction=OUT, server-argument-impl-policy=USE-ARGUMENT-TYPE
    GetMotCoggCmdPrm_PortIf1
      operation Oper
        arg MotCoggCmdY_Arg: type=Ary1D_s1p14_128, direction=OUT, server-argument-impl-policy=USE-ARGUMENT-TYPE
        arg Idx_Arg: type=uint8, direction=IN, server-argument-impl-policy=USE-ARGUMENT-TYPE
    GetMotPrmNomEol1  # OBSELETE
      operation Oper: possible-error=GetMotPrmNomEol1/E_NOT_OK
        arg MotKeNom: type=MotCon1, direction=OUT, server-argument-impl-policy=USE-ARGUMENT-TYPE
        arg MotRNom: type=R6, direction=OUT, server-argument-impl-policy=USE-ARGUMENT-TYPE
      error E_NOT_OK: error-code=1
    GetMotPrmNomEol2
      operation Oper: possible-error=GetMotPrmNomEol2/E_NOT_OK
        arg MotBackEmfConNom_Arg: type=MotCon1, direction=OUT, server-argument-impl-policy=USE-ARGUMENT-TYPE
        arg MotRNom_Arg: type=R6, direction=OUT, server-argument-impl-policy=USE-ARGUMENT-TYPE
      error E_NOT_OK: error-code=1
    GetMotRplCoggPrm_PortIf1
      operation Oper
        9 x arg, all with direction=OUT, server-argument-impl-policy=USE-ARGUMENT-TYPE:
          CoggOrder1_Arg: type=uint16
          CoggOrder1X_Arg: type=s1p14
          CoggOrder1Y_Arg: type=s1p14
          CoggOrder2_Arg: type=uint16
          CoggOrder2X_Arg: type=s1p14
          CoggOrder2Y_Arg: type=s1p14
          CoggOrder3_Arg: type=uint16
          CoggOrder3X_Arg: type=s1p14
          CoggOrder3Y_Arg: type=s1p14
    GetMotTqCmdSca_PortIf1
      operation Oper
        arg MotTqCmdSca_Arg: type=float32, direction=OUT, server-argument-impl-policy=USE-ARGUMENT-TYPE
    GetNtcActv1
      operation Oper: possible-error=GetNtcActv1/E_NOT_OK
        arg NtcNr: type=NtcNr1, direction=IN, server-argument-impl-policy=USE-ARGUMENT-TYPE
        arg NtcActv: type=boolean, direction=OUT, server-argument-impl-policy=USE-ARGUMENT-TYPE
      error E_NOT_OK: error-code=1
    GetNtcQlfrSts_PortIf1
      operation Oper: possible-error=GetNtcQlfrSts_PortIf1/E_NOT_OK
        arg NtcNr_Arg: type=NtcNr1, direction=IN, server-argument-impl-policy=USE-ARGUMENT-TYPE
        arg NtcQlfr_Arg: type=SigQlfr1, direction=OUT, server-argument-impl-policy=USE-ARGUMENT-TYPE
      error E_NOT_OK: error-code=1
    GetNtcQlfrSts1
      operation Oper: possible-error=GetNtcQlfrSts1/E_NOT_OK
        arg NtcNr: type=NtcNr1, direction=IN, server-argument-impl-policy=USE-ARGUMENT-TYPE
        arg NtcQlfr: type=SigQlfr1, direction=OUT, server-argument-impl-policy=USE-ARGUMENT-TYPE
      error E_NOT_OK: error-code=1
    GetNtcSts1
      operation Oper: possible-error=GetNtcSts1/E_NOT_OK
        arg NtcNr: type=NtcNr1, direction=IN, server-argument-impl-policy=USE-ARGUMENT-TYPE
        arg NtcInfoSts: type=uint8, direction=OUT, server-argument-impl-policy=USE-ARGUMENT-TYPE
      error E_NOT_OK: error-code=1
    GetPullCmpPrm_PortIf1
      operation Oper
        4 x arg, all with direction=OUT, server-argument-impl-policy=USE-ARGUMENT-TYPE:
          PullCmpCmdTot_Arg: type=float32
          PullCmpShoTerm_Arg: type=float32
          PullCmpLongTerm_Arg: type=float32
          LrngEnad_Arg: type=boolean
    GetRefTmr100MicroSec32bit_PortIf1
      operation Oper
        arg RefTmr_Arg: type=uint32, direction=OUT, server-argument-impl-policy=USE-ARGUMENT-TYPE
    GetRefTmr100MicroSec32bit1
      operation Oper
        arg RefTmr: type=uint32, direction=OUT, server-argument-impl-policy=USE-ARGUMENT-TYPE
    GetRefTmr1MicroSec32bit_PortIf1
      operation Oper
        arg RefTmr_Arg: type=uint32, direction=OUT, server-argument-impl-policy=USE-ARGUMENT-TYPE
    GetRefTmr1MicroSec32bit1
      operation Oper
        arg RefTmr: type=uint32, direction=OUT, server-argument-impl-policy=USE-ARGUMENT-TYPE
    GetSegInfoReq_PortIf2
      operation Oper
        7 x arg, all with server-argument-impl-policy=USE-ARGUMENT-TYPE:
          Mod_Arg: type=GetSegMod1, direction=IN
          Seg_Arg: type=uint8, direction=IN
          SegInfo_Arg: type=uint8, direction=IN
          MpgIdx_Arg: type=uint8, direction=IN
          Resp_Arg: type=uint8, direction=INOUT
          RespLen_Arg: type=uint8, direction=INOUT
          Rtn_Arg: type=uint8, direction=OUT
    GetSigImcData_f32_PortIf1
      operation Oper: possible-error=GetSigImcData_f32_PortIf1/E_NOT_OK
        arg SigId_Arg: type=uint16, direction=IN, server-argument-impl-policy=USE-ARGUMENT-TYPE
        arg Data_Arg: type=float32, direction=OUT, server-argument-impl-policy=USE-ARGUMENT-TYPE
        arg Sts_Arg: type=ImcArbnRxSts1, direction=OUT, server-argument-impl-policy=USE-ARGUMENT-TYPE
      error E_NOT_OK: error-code=1
    GetSigImcData_logl_PortIf1
      operation Oper: possible-error=GetSigImcData_logl_PortIf1/E_NOT_OK
        arg SigId_Arg: type=uint16, direction=IN, server-argument-impl-policy=USE-ARGUMENT-TYPE
        arg Data_Arg: type=boolean, direction=OUT, server-argument-impl-policy=USE-ARGUMENT-TYPE
        arg Sts_Arg: type=ImcArbnRxSts1, direction=OUT, server-argument-impl-policy=USE-ARGUMENT-TYPE
      error E_NOT_OK: error-code=1
    GetSigImcData_s08_PortIf1
      operation Oper: possible-error=GetSigImcData_s08_PortIf1/E_NOT_OK
        arg SigId_Arg: type=uint16, direction=IN, server-argument-impl-policy=USE-ARGUMENT-TYPE
        arg Data_Arg: type=sint8, direction=OUT, server-argument-impl-policy=USE-ARGUMENT-TYPE
        arg Sts_Arg: type=ImcArbnRxSts1, direction=OUT, server-argument-impl-policy=USE-ARGUMENT-TYPE
      error E_NOT_OK: error-code=1
    GetSigImcData_s16_PortIf1
      operation Oper: possible-error=GetSigImcData_s16_PortIf1/E_NOT_OK
        arg SigId_Arg: type=uint16, direction=IN, server-argument-impl-policy=USE-ARGUMENT-TYPE
        arg Data_Arg: type=sint16, direction=OUT, server-argument-impl-policy=USE-ARGUMENT-TYPE
        arg Sts_Arg: type=ImcArbnRxSts1, direction=OUT, server-argument-impl-policy=USE-ARGUMENT-TYPE
      error E_NOT_OK: error-code=1
    GetSigImcData_s32_PortIf1
      operation Oper: possible-error=GetSigImcData_s32_PortIf1/E_NOT_OK
        arg SigId_Arg: type=uint16, direction=IN, server-argument-impl-policy=USE-ARGUMENT-TYPE
        arg Data_Arg: type=sint32, direction=OUT, server-argument-impl-policy=USE-ARGUMENT-TYPE
        arg Sts_Arg: type=ImcArbnRxSts1, direction=OUT, server-argument-impl-policy=USE-ARGUMENT-TYPE
      error E_NOT_OK: error-code=1
    GetSigImcData_u08_PortIf1
      operation Oper: possible-error=GetSigImcData_u08_PortIf1/E_NOT_OK
        arg SigId_Arg: type=uint16, direction=IN, server-argument-impl-policy=USE-ARGUMENT-TYPE
        arg Data_Arg: type=uint8, direction=OUT, server-argument-impl-policy=USE-ARGUMENT-TYPE
        arg Sts_Arg: type=ImcArbnRxSts1, direction=OUT, server-argument-impl-policy=USE-ARGUMENT-TYPE
      error E_NOT_OK: error-code=1
    GetSigImcData_u16_PortIf1
      operation Oper: possible-error=GetSigImcData_u16_PortIf1/E_NOT_OK
        arg SigId_Arg: type=uint16, direction=IN, server-argument-impl-policy=USE-ARGUMENT-TYPE
        arg Data_Arg: type=uint16, direction=OUT, server-argument-impl-policy=USE-ARGUMENT-TYPE
        arg Sts_Arg: type=ImcArbnRxSts1, direction=OUT, server-argument-impl-policy=USE-ARGUMENT-TYPE
      error E_NOT_OK: error-code=1
    GetSigImcData_u32_PortIf1
      operation Oper: possible-error=GetSigImcData_u32_PortIf1/E_NOT_OK
        arg SigId_Arg: type=uint16, direction=IN, server-argument-impl-policy=USE-ARGUMENT-TYPE
        arg Data_Arg: type=uint32, direction=OUT, server-argument-impl-policy=USE-ARGUMENT-TYPE
        arg Sts_Arg: type=ImcArbnRxSts1, direction=OUT, server-argument-impl-policy=USE-ARGUMENT-TYPE
      error E_NOT_OK: error-code=1
    GetSigImcDataExtdSts_f32_PortIf1
      operation Oper: possible-error=GetSigImcDataExtdSts_f32_PortIf1/E_NOT_OK
        4 x arg, all with server-argument-impl-policy=USE-ARGUMENT-TYPE:
          SigId_Arg: type=uint16, direction=IN
          Data_Arg: type=float32, direction=OUT
          Sts_Arg: type=ImcArbnRxExtdSts1, direction=OUT
          DataSrc_Arg: type=ImcArbnRxDataSrc1, direction=OUT
      error E_NOT_OK: error-code=1
    GetSigImcDataExtdSts_logl_PortIf1
      operation Oper: possible-error=GetSigImcDataExtdSts_logl_PortIf1/E_NOT_OK
        4 x arg, all with server-argument-impl-policy=USE-ARGUMENT-TYPE:
          SigId_Arg: type=uint16, direction=IN
          Data_Arg: type=boolean, direction=OUT
          Sts_Arg: type=ImcArbnRxExtdSts1, direction=OUT
          DataSrc_Arg: type=ImcArbnRxDataSrc1, direction=OUT
      error E_NOT_OK: error-code=1
    GetSigImcDataExtdSts_s08_PortIf1
      operation Oper: possible-error=GetSigImcDataExtdSts_s08_PortIf1/E_NOT_OK
        4 x arg, all with server-argument-impl-policy=USE-ARGUMENT-TYPE:
          SigId_Arg: type=uint16, direction=IN
          Data_Arg: type=sint8, direction=OUT
          Sts_Arg: type=ImcArbnRxExtdSts1, direction=OUT
          DataSrc_Arg: type=ImcArbnRxDataSrc1, direction=OUT
      error E_NOT_OK: error-code=1
    GetSigImcDataExtdSts_s16_PortIf1
      operation Oper: possible-error=GetSigImcDataExtdSts_s16_PortIf1/E_NOT_OK
        4 x arg, all with server-argument-impl-policy=USE-ARGUMENT-TYPE:
          SigId_Arg: type=uint16, direction=IN
          Data_Arg: type=sint16, direction=OUT
          Sts_Arg: type=ImcArbnRxExtdSts1, direction=OUT
          DataSrc_Arg: type=ImcArbnRxDataSrc1, direction=OUT
      error E_NOT_OK: error-code=1
    GetSigImcDataExtdSts_s32_PortIf1
      operation Oper: possible-error=GetSigImcDataExtdSts_s32_PortIf1/E_NOT_OK
        4 x arg, all with server-argument-impl-policy=USE-ARGUMENT-TYPE:
          SigId_Arg: type=uint16, direction=IN
          Data_Arg: type=sint32, direction=OUT
          Sts_Arg: type=ImcArbnRxExtdSts1, direction=OUT
          DataSrc_Arg: type=ImcArbnRxDataSrc1, direction=OUT
      error E_NOT_OK: error-code=1
    GetSigImcDataExtdSts_u08_PortIf1
      operation Oper: possible-error=GetSigImcDataExtdSts_u08_PortIf1/E_NOT_OK
        4 x arg, all with server-argument-impl-policy=USE-ARGUMENT-TYPE:
          SigId_Arg: type=uint16, direction=IN
          Data_Arg: type=uint8, direction=OUT
          Sts_Arg: type=ImcArbnRxExtdSts1, direction=OUT
          DataSrc_Arg: type=ImcArbnRxDataSrc1, direction=OUT
      error E_NOT_OK: error-code=1
    GetSigImcDataExtdSts_u16_PortIf1
      operation Oper: possible-error=GetSigImcDataExtdSts_u16_PortIf1/E_NOT_OK
        4 x arg, all with server-argument-impl-policy=USE-ARGUMENT-TYPE:
          SigId_Arg: type=uint16, direction=IN
          Data_Arg: type=uint16, direction=OUT
          Sts_Arg: type=ImcArbnRxExtdSts1, direction=OUT
          DataSrc_Arg: type=ImcArbnRxDataSrc1, direction=OUT
      error E_NOT_OK: error-code=1
    GetSigImcDataExtdSts_u32_PortIf1
      operation Oper: possible-error=GetSigImcDataExtdSts_u32_PortIf1/E_NOT_OK
        4 x arg, all with server-argument-impl-policy=USE-ARGUMENT-TYPE:
          SigId_Arg: type=uint16, direction=IN
          Data_Arg: type=uint32, direction=OUT
          Sts_Arg: type=ImcArbnRxExtdSts1, direction=OUT
          DataSrc_Arg: type=ImcArbnRxDataSrc1, direction=OUT
      error E_NOT_OK: error-code=1
    GetSigStcHlthData_PortIf1
      operation Oper: possible-error=GetSigStcHlthData_PortIf1/E_NOT_OK
        arg SigId_Arg: type=StHlthMonSig1, direction=IN, server-argument-impl-policy=USE-ARGUMENT-TYPE
        arg BufPtr_Arg: type=uint32, direction=OUT, server-argument-impl-policy=USE-ARGUMENT-TYPE
      error E_NOT_OK: error-code=1
    GetSigStcHlthData_PortIf2
      operation Oper: possible-error=GetSigStcHlthData_PortIf2/E_NOT_OK
        arg SigId_Arg: type=StHlthMonSig2, direction=IN, server-argument-impl-policy=USE-ARGUMENT-TYPE
        arg BufPtr_Arg: type=uint32, direction=OUT, server-argument-impl-policy=USE-ARGUMENT-TYPE
      error E_NOT_OK: error-code=1
    GetSigStcHlthData_PortIf3
      operation Oper: possible-error=GetSigStcHlthData_PortIf3/E_NOT_OK
        arg SigId_Arg: type=StHlthMonSig3, direction=IN, server-argument-impl-policy=USE-ARGUMENT-TYPE
        arg BufPtr_Arg: type=uint32, direction=OUT, server-argument-impl-policy=USE-ARGUMENT-TYPE
      error E_NOT_OK: error-code=1
    GetTiSpan100MicroSec32bit_PortIf1
      operation Oper
        arg RefTmr_Arg: type=uint32, direction=IN, server-argument-impl-policy=USE-ARGUMENT-TYPE
        arg TiSpan_Arg: type=uint32, direction=OUT, server-argument-impl-policy=USE-ARGUMENT-TYPE
    GetTiSpan100MicroSec32bit1
      operation Oper
        arg RefTmr: type=uint32, direction=IN, server-argument-impl-policy=USE-ARGUMENT-TYPE
        arg TiSpan: type=uint32, direction=OUT, server-argument-impl-policy=USE-ARGUMENT-TYPE
    GetTiSpan1MicroSec32bit_PortIf1
      operation Oper
        arg RefTmr_Arg: type=uint32, direction=IN, server-argument-impl-policy=USE-ARGUMENT-TYPE
        arg TiSpan_Arg: type=uint32, direction=OUT, server-argument-impl-policy=USE-ARGUMENT-TYPE
    GetTiSpan1MicroSec32bit1
      operation Oper
        arg RefTmr: type=uint32, direction=IN, server-argument-impl-policy=USE-ARGUMENT-TYPE
        arg TiSpan: type=uint32, direction=OUT, server-argument-impl-policy=USE-ARGUMENT-TYPE
    GetTxRateGroup_PortIf1
      operation Oper: possible-error=GetTxRateGroup_PortIf1/E_NOT_OK
        arg RateGroup_Arg: type=uint8, direction=IN, server-argument-impl-policy=USE-ARGUMENT-TYPE
        arg Buf_Arg: type=uint8, direction=OUT, server-argument-impl-policy=USE-ARGUMENT-TYPE
      error E_NOT_OK: error-code=1
    GetTxSigGroup_PortIf1
      operation Oper: possible-error=GetTxSigGroup_PortIf1/E_NOT_OK
        arg SigGroupId_Arg: type=uint8, direction=IN, server-argument-impl-policy=USE-ARGUMENT-TYPE
        arg Buf_Arg: type=uint8, direction=OUT, server-argument-impl-policy=USE-ARGUMENT-TYPE
      error E_NOT_OK: error-code=1
    GetYawRateOffs_PortIf1
      operation Oper
        arg VehYawRateOffs_Arg: type=float32, direction=OUT, server-argument-impl-policy=USE-ARGUMENT-TYPE
        arg VehYawRateLrngStRst_Arg: type=boolean, direction=OUT, server-argument-impl-policy=USE-ARGUMENT-TYPE
    GmFctDiReq_PortIf1
      operation Oper
    HwAg0ClrLtch_PortIf1
      operation Oper
    HwAg0MeasHwAg0AutoTrim1  # OBSOLETE
      operation Oper
    HwAg0MeasHwAg0ClrTrim1  # OBSOLETE
      operation Oper
    HwAg0MeasHwAg0ReadTrim1  # OBSELETE
      operation Oper
        arg HwAg0MeasHwAg0WrOffsTrimData: type=Ag19, direction=IN, server-argument-impl-policy=USE-ARGUMENT-TYPE
    HwAg0MeasHwAg0ReadTrim2  # OBSOLETE
      operation Oper
        arg HwAg0MeasHwAg0WrOffsTrimData: type=Ag19, direction=OUT, server-argument-impl-policy=USE-ARGUMENT-TYPE
    HwAg0MeasHwAg0TrimPrfmdSts1  # OBSELETE
      operation Oper
        arg HwAg0MeasHwAg0OffsTrimPrfmdStsData: type=Logl1, direction=IN, server-argument-impl-policy=USE-ARGUMENT-TYPE
    HwAg0MeasHwAg0TrimPrfmdSts2  # OBSOLETE
      operation Oper
        arg HwAg0MeasHwAg0OffsTrimPrfmdStsData: type=Logl1, direction=OUT, server-argument-impl-policy=USE-ARGUMENT-TYPE
    HwAg0MeasHwAg0WrTrim1  # OBSELETE
      operation Oper
    HwAg0MeasHwAg0WrTrim2  # OBSOLETE
      operation Oper
        arg HwAg0MeasHwAg0WrTrimData: type=Ag19, direction=IN, server-argument-impl-policy=USE-ARGUMENT-TYPE
    HwAg1ClrLtch_PortIf1
      operation Oper
    HwAg1MeasHwAg1AutoTrim1  # OBSOLETE
      operation Oper
    HwAg1MeasHwAg1ClrTrim1  # OBSOLETE
      operation Oper
    HwAg1MeasHwAg1ReadTrim1  # OBSELETE
      operation Oper
        arg HwAg1MeasHwAg1WrOffsTrimData: type=Ag19, direction=IN, server-argument-impl-policy=USE-ARGUMENT-TYPE
    HwAg1MeasHwAg1ReadTrim2  # OBSOLETE
      operation Oper
        arg HwAg1MeasHwAg1WrOffsTrimData: type=Ag19, direction=OUT, server-argument-impl-policy=USE-ARGUMENT-TYPE
    HwAg1MeasHwAg1TrimPrfmdSts1  # OBSELETE
      operation Oper
        arg HwAg1MeasHwAg1OffsTrimPrfmdStsData: type=Logl1, direction=IN, server-argument-impl-policy=USE-ARGUMENT-TYPE
    HwAg1MeasHwAg1TrimPrfmdSts2  # OBSOLETE
      operation Oper
        arg HwAg1MeasHwAg1OffsTrimPrfmdStsData: type=Logl1, direction=OUT, server-argument-impl-policy=USE-ARGUMENT-TYPE
    HwAg1MeasHwAg1WrTrim1  # OBSELETE
      operation Oper
    HwAg1MeasHwAg1WrTrim2  # OBSOLETE
      operation Oper
        arg HwAg1MeasHwAg1WrTrimData: type=Ag19, direction=IN, server-argument-impl-policy=USE-ARGUMENT-TYPE
    HwAgMeasHwAgAutTrim1
      operation Oper
    HwAgMeasHwAgClrTrim1
      operation Oper
    HwAgMeasHwAgReadTrim1
      operation Oper
        arg HwAgReadTrimData_Arg: type=Ag19, direction=OUT, server-argument-impl-policy=USE-ARGUMENT-TYPE
    HwAgMeasHwAgTrimPrfmdSts1
      operation Oper
        arg HwAgOffsTrimPrfmdStsData_Arg: type=Logl1, direction=OUT, server-argument-impl-policy=USE-ARGUMENT-TYPE
    HwAgMeasHwAgWrTrim1
      operation Oper
        arg HwAgWrOffsTrimData_Arg: type=Ag19, direction=IN, server-argument-impl-policy=USE-ARGUMENT-TYPE
    HwTq0MeasHwTq0AutTrim_PortIf1  # OBSOLETE
      operation Oper
    HwTq0MeasHwTq0ClrTrim_PortIf1  # OBSOLETE
      operation Oper
    HwTq0MeasHwTq0ReadTrim_PortIf1  # OBSOLETE
      operation Oper
        arg HwTq0MeasHwTq0ReadTrimData_Arg: type=float32, direction=OUT, server-argument-impl-policy=USE-ARGUMENT-TYPE
    HwTq0MeasHwTq0TrimPrfmdSts_PortIf1  # OBSOLETE
      operation Oper
        arg HwTq0MeasHwTq0OffsTrimPrfmdStsData_Arg: type=boolean, direction=OUT, server-argument-impl-policy=USE-ARGUMENT-TYPE
    HwTq0MeasHwTq0WrTrim_PortIf1  # OBSOLETE
      operation Oper
        arg HwTq0MeasHwTq0WrOffsTrimData_Arg: type=float32, direction=IN, server-argument-impl-policy=USE-ARGUMENT-TYPE
    HwTq1MeasHwTq1AutTrim_PortIf1  # OBSOLETE
      operation Oper
    HwTq1MeasHwTq1ClrTrim_PortIf1  # OBSOLETE
      operation Oper
    HwTq1MeasHwTq1ReadTrim_PortIf1  # OBSOLETE
      operation Oper
        arg HwTq1MeasHwTq1ReadTrimData_Arg: type=float32, direction=OUT, server-argument-impl-policy=USE-ARGUMENT-TYPE
    HwTq1MeasHwTq1TrimPrfmdSts_PortIf1  # OBSOLETE
      operation Oper
        arg HwTq1MeasHwTq1OffsTrimPrfmdStsData_Arg: type=boolean, direction=OUT, server-argument-impl-policy=USE-ARGUMENT-TYPE
    HwTq1MeasHwTq1WrTrim_PortIf1  # OBSOLETE
      operation Oper
        arg HwTq1MeasHwTq1WrOffsTrimData_Arg: type=float32, direction=IN, server-argument-impl-policy=USE-ARGUMENT-TYPE
    HwTq2MeasHwTq2AutTrim_PortIf1  # OBSOLETE
      operation Oper
    HwTq2MeasHwTq2ClrTrim_PortIf1  # OBSOLETE
      operation Oper
    HwTq2MeasHwTq2ReadTrim_PortIf1  # OBSOLETE
      operation Oper
        arg HwTq2MeasHwTq2ReadTrimData_Arg: type=float32, direction=OUT, server-argument-impl-policy=USE-ARGUMENT-TYPE
    HwTq2MeasHwTq2TrimPrfmdSts_PortIf1  # OBSOLETE
      operation Oper
        arg HwTq2MeasHwTq2OffsTrimPrfmdStsData_Arg: type=boolean, direction=OUT, server-argument-impl-policy=USE-ARGUMENT-TYPE
    HwTq2MeasHwTq2WrTrim_PortIf1  # OBSOLETE
      operation Oper
        arg HwTq2MeasHwTq2WrOffsTrimData_Arg: type=float32, direction=IN, server-argument-impl-policy=USE-ARGUMENT-TYPE
    HwTq3MeasHwTq3AutTrim_PortIf1  # OBSOLETE
      operation Oper
    HwTq3MeasHwTq3ClrTrim_PortIf1  # OBSOLETE
      operation Oper
    HwTq3MeasHwTq3ReadTrim_PortIf1  # OBSOLETE
      operation Oper
        arg HwTq3MeasHwTq3ReadTrimData_Arg: type=float32, direction=OUT, server-argument-impl-policy=USE-ARGUMENT-TYPE
    HwTq3MeasHwTq3TrimPrfmdSts_PortIf1  # OBSOLETE
      operation Oper
        arg HwTq3MeasHwTq3OffsTrimPrfmdStsData_Arg: type=boolean, direction=OUT, server-argument-impl-policy=USE-ARGUMENT-TYPE
    HwTq3MeasHwTq3WrTrim_PortIf1  # OBSOLETE
      operation Oper
        arg HwTq3MeasHwTq3WrOffsTrimData_Arg: type=float32, direction=IN, server-argument-impl-policy=USE-ARGUMENT-TYPE
    HwTqClrSnsrSca_PortIf1
      operation Oper
    HwTqMeasHwTqAutTrim_PortIf1
      operation Oper
    HwTqMeasHwTqClrTrim_PortIf1
      operation Oper
    HwTqMeasHwTqReadTrim_PortIf1
      operation Oper
        arg HwTqReadTrimData_Arg: type=float32, direction=OUT, server-argument-impl-policy=USE-ARGUMENT-TYPE
    HwTqMeasHwTqTrimPrfmdSts_PortIf1
      operation Oper
        arg HwTqOffsTrimPrfmdStsData_Arg: type=boolean, direction=OUT, server-argument-impl-policy=USE-ARGUMENT-TYPE
    HwTqMeasHwTqWrTrim_PortIf1
      operation Oper
        arg HwTqWrOffsTrimData_Arg: type=float32, direction=IN, server-argument-impl-policy=USE-ARGUMENT-TYPE
    HwTqReadSnsrSca_PortIf1  # OBSELETE
      operation Oper
        arg HwTqReadScaData_Arg: type=float32, direction=OUT, server-argument-impl-policy=USE-ARGUMENT-TYPE
        arg HwTqScaPrfmdStsData_Arg: type=boolean, direction=OUT, server-argument-impl-policy=USE-ARGUMENT-TYPE
    HwTqReadSnsrSca_PortIf2
      operation Oper
        arg HwTqReadScaData_Arg: type=float32, direction=OUT, server-argument-impl-policy=USE-ARGUMENT-TYPE
    HwTqSetSnsrSca_PortIf1  # OBSELETE
      operation Oper
        arg HwTqScaVal_Arg: type=float32, direction=IN, server-argument-impl-policy=USE-ARGUMENT-TYPE
    HwTqSnsrScaPrfmdSts_PortIf1
      operation Oper
        arg HwTqScaPrfmdStsData_Arg: type=boolean, direction=OUT, server-argument-impl-policy=USE-ARGUMENT-TYPE
    HwTqWrSnsrSca_PortIf1
      operation Oper
        arg HwTqScaVal_Arg: type=float32, direction=IN, server-argument-impl-policy=USE-ARGUMENT-TYPE
    InitFricLrngTbl_PortIf1
      operation Oper
    MCalReadVrfyFailFltInfo_PortIf1
      operation Oper
        arg PrphlId_Arg: type=uint8, direction=IN, server-argument-impl-policy=USE-ARGUMENT-TYPE
        arg ErrId_Arg: type=uint16, direction=IN, server-argument-impl-policy=USE-ARGUMENT-TYPE
    MeasTrgStrt_PortIf1  # OBSELETE
      operation Oper
    MeasTrigStrt_PortIf1
      operation Oper
    MotAg0MeasMotAg0CorrnTblClr1  # OBSELETE
      operation Oper
    MotAg0MeasMotAg0CorrnTblRead1  # OBSELETE
      operation Oper
        arg MotAg0MeasMotAg0CorrnTblCrc: type=Cnt16, direction=OUT, server-argument-impl-policy=USE-ARGUMENT-TYPE
    MotAg0MeasMotAg0CorrnTblSegRead1  # OBSELETE
      operation Oper
        arg MotAg0MeasMotAg0CorrnTblSegReadData: type=CntAry1D3, direction=OUT, server-argument-impl-policy=USE-ARGUMENT-TYPE
        arg MotAg0MeasMotAg0CorrnTblSegRead: type=Cnt13, direction=IN, server-argument-impl-policy=USE-ARGUMENT-TYPE
    MotAg0MeasMotAg0CorrnTblSegUpd1  # OBSELETE
      operation Oper
        arg MotAg0MeasMotAg0CorrnTblSegWrData: type=CntAry1D3, direction=IN, server-argument-impl-policy=USE-ARGUMENT-TYPE
        arg MotAg0MeasMotAg0CorrnTblSegWr: type=Cnt13, direction=IN, server-argument-impl-policy=USE-ARGUMENT-TYPE
        arg MotAg0MeasMotAg0CorrnTblSegUpdResp: type=Cnt25, direction=OUT, server-argument-impl-policy=USE-ARGUMENT-TYPE
    MotAg0MeasMotAg0CorrnTblWr1  # OBSELETE
      operation Oper
        arg MotAg0MeasMotAg0CorrnTblCrc: type=Cnt16, direction=IN, server-argument-impl-policy=USE-ARGUMENT-TYPE
        arg MotAg0MeasMotAg0CorrnTblWrResp: type=Cnt25, direction=OUT, server-argument-impl-policy=USE-ARGUMENT-TYPE
    MotAg0SnsrCfgDmaStrt_PortIf1  # OBSELETE
      operation Oper
      error E_NOT_OK: error-code=1
    MotAg0SnsrCfgDmaStrt_PortIf2
      operation Oper: possible-error=MotAg0SnsrCfgDmaStrt_PortIf2/E_NOT_OK
      error E_NOT_OK: error-code=1
    MotAg1MeasMotAg1CorrnTblClr1  # OBSELETE
      operation Oper
    MotAg1MeasMotAg1CorrnTblRead1  # OBSELETE
      operation Oper
        arg MotAg1MeasMotAg1CorrnTblCrc: type=Cnt16, direction=OUT, server-argument-impl-policy=USE-ARGUMENT-TYPE
    MotAg1MeasMotAg1CorrnTblSegRead1  # OBSELETE
      operation Oper
        arg MotAg1MeasMotAg1CorrnTblSegReadData: type=CntAry1D3, direction=OUT, server-argument-impl-policy=USE-ARGUMENT-TYPE
        arg MotAg1MeasMotAg1CorrnTblSegRead: type=Cnt13, direction=IN, server-argument-impl-policy=USE-ARGUMENT-TYPE
    MotAg1MeasMotAg1CorrnTblSegUpd1  # OBSELETE
      operation Oper
        arg MotAg1MeasMotAg1CorrnTblSegWrData: type=CntAry1D3, direction=IN, server-argument-impl-policy=USE-ARGUMENT-TYPE
        arg MotAg1MeasMotAg1CorrnTblSegWr: type=Cnt13, direction=IN, server-argument-impl-policy=USE-ARGUMENT-TYPE
        arg MotAg1MeasMotAg1CorrnTblSegUpdResp: type=Cnt25, direction=OUT, server-argument-impl-policy=USE-ARGUMENT-TYPE
    MotAg1MeasMotAg1CorrnTblWr1  # OBSELETE
      operation Oper
        arg MotAg1MeasMotAg1CorrnTblCrc: type=Cnt16, direction=IN, server-argument-impl-policy=USE-ARGUMENT-TYPE
        arg MotAg1MeasMotAg1CorrnTblWrResp: type=Cnt25, direction=OUT, server-argument-impl-policy=USE-ARGUMENT-TYPE
    MotAgCmpBackEmfRead1  # OBSELETE
      operation Oper: possible-error=MotAgCmpBackEmfRead1/E_NOT_OK
        arg MotAgBackEmfRead: type=Ag9, direction=OUT, server-argument-impl-policy=USE-ARGUMENT-TYPE
      error E_NOT_OK: error-code=1
    MotAgCmpBackEmfRead2  # OBSELETE
      operation Oper
        arg MotAgBackEmfRead: type=Ag9, direction=OUT, server-argument-impl-policy=USE-ARGUMENT-TYPE
    MotAgCmpBackEmfWr1
      operation Oper: possible-error=MotAgCmpBackEmfWr1/E_NOT_OK
        arg MotAgCmpBackEmfWrData: type=Ag9, direction=IN, server-argument-impl-policy=USE-ARGUMENT-TYPE
      error E_NOT_OK: error-code=1
    MotAgMeasEolPrmRead_PortIf1
      operation Oper
        arg MotAgEolPrmReadCrc_Arg: type=uint16, direction=OUT, server-argument-impl-policy=USE-ARGUMENT-TYPE
        arg MotAgEolPrmRead_Arg: type=MotAgMeasEolPrmRec1, direction=OUT, server-argument-impl-policy=USE-ARGUMENT-TYPE
    MotAgMeasEolPrmRead_PortIf2
      operation Oper
        arg MotAgEolPrmRead_Arg: type=MotAgMeasEolPrmRec1, direction=OUT, server-argument-impl-policy=USE-ARGUMENT-TYPE
    MotAgMeasEolPrmWr_PortIf1
      operation Oper
        arg MotAgSinCosEolCalData_Arg: type=MotAgMeasEolPrmRec1, direction=IN, server-argument-impl-policy=USE-ARGUMENT-TYPE
        arg MotAgSinCosEolCalDataCrc_Arg: type=uint16, direction=IN, server-argument-impl-policy=USE-ARGUMENT-TYPE
        arg MotAgSinCosWrResp_Arg: type=uint8, direction=OUT, server-argument-impl-policy=USE-ARGUMENT-TYPE
    MotAgMeasEolPrmWr_PortIf2
      operation Oper
        arg MotAgSinCosEolCalData_Arg: type=MotAgMeasEolPrmRec1, direction=IN, server-argument-impl-policy=USE-ARGUMENT-TYPE
    MotAgMeasMotAgCoeffTblRead_PortIf1
      operation Oper
        arg MotAgCoeffTbl_Arg: type=Ary1D_f32_26, direction=OUT, server-argument-impl-policy=USE-ARGUMENT-TYPE
    MotAgMeasMotAgCoeffTblWr_PortIf1
      operation Oper
        arg MotAgCoeffTbl_Arg: type=Ary1D_f32_26, direction=IN, server-argument-impl-policy=USE-ARGUMENT-TYPE
    OnlineTunRamAdrMpg_PortIf1
      operation Oper: possible-error=OnlineTunRamAdrMpg_PortIf1/E_NOT_OK
        arg ReqAdr_Arg: type=uint32, direction=IN, server-argument-impl-policy=USE-ARGUMENT-TYPE
        arg CorrdAdr_Arg: type=uint32, direction=INOUT, server-argument-impl-policy=USE-ARGUMENT-TYPE
        arg ReqTyp_Arg: type=AdrMpgReqTyp1, direction=IN, server-argument-impl-policy=USE-ARGUMENT-TYPE
      error E_NOT_OK: error-code=1
    PolarityCfgRead_PortIf1
      operation Oper
        arg PolarityCfgSaved_Arg: type=uint32, direction=OUT, server-argument-impl-policy=USE-ARGUMENT-TYPE
    PolarityCfgRead1
      operation Oper: possible-error=PolarityCfgRead1/E_NOT_OK
        arg PolarityCfgSaved: type=Cnt15, direction=OUT, server-argument-impl-policy=USE-ARGUMENT-TYPE
      error E_NOT_OK: error-code=1
    PolarityCfgWr_PortIf1
      operation Oper
        arg PolarityCfgSaved_Arg: type=uint32, direction=IN, server-argument-impl-policy=USE-ARGUMENT-TYPE
    PolarityCfgWr1
      operation Oper: possible-error=PolarityCfgWr1/E_NOT_OK
        arg PolarityCfgSaved: type=Cnt15, direction=IN, server-argument-impl-policy=USE-ARGUMENT-TYPE
      error E_NOT_OK: error-code=1
    PrphlVltgMonrStrtUpTestFlt_PortIf1
      operation Oper
    PwrTurnOffCtrl_PortIf1
      operation Oper
        arg PinSt_Arg: type=boolean, direction=IN, server-argument-impl-policy=USE-ARGUMENT-TYPE
    ReadErrInjReg_PortIf1
      operation Oper
        arg ErrId_Arg: type=uint32, direction=OUT, server-argument-impl-policy=USE-ARGUMENT-TYPE
    ReadLtchCntrData_PortIf1
      operation Oper
        arg ReadLtchCntrAry_Arg: type=Ary1D_u08_20, direction=OUT, server-argument-impl-policy=USE-ARGUMENT-TYPE
    ReadNtcFltAry_PortIf1
      operation Oper
        arg DiagcMgrReadFltInfo_Arg: type=Ary1D_ReadFltInfoRec1_20, direction=OUT, server-argument-impl-policy=USE-ARGUMENT-TYPE
    ReadNtcFltAry1  # OBSOLETE
      operation Oper: possible-error=ReadNtcFltAry1/E_NOT_OK  # OBSOLETE
        arg DiagcMgrNtcFltAry: type=NtcFltInfoRec1, direction=OUT, server-argument-impl-policy=USE-ARGUMENT-TYPE
      error E_NOT_OK: error-code=1
    ReadNtcInfoAndDebCntr_PortIf1
      operation Oper
        arg NtcNr_Arg: type=NtcNr1, direction=IN, server-argument-impl-policy=USE-ARGUMENT-TYPE
        arg NtcInfo_Arg: type=NtcInfoRec4, direction=OUT, server-argument-impl-policy=USE-ARGUMENT-TYPE
        arg DebCntr_Arg: type=sint16, direction=OUT, server-argument-impl-policy=USE-ARGUMENT-TYPE
    ReadSnpshtData_PortIf1  # OBSOLETE
      operation Oper  # OBSOLETE
        arg ReadSnpshtDataAry_Arg: type=Ary1D_SnpshtDataRec1_8, direction=OUT, server-argument-impl-policy=USE-ARGUMENT-TYPE
    ReadSnpshtData_PortIf2
      operation Oper
        arg ReadSnpshtDataAry_Arg: type=Ary1D_SnpshtDataRec2_8, direction=OUT, server-argument-impl-policy=USE-ARGUMENT-TYPE
    ResvCrcHwUnit_PortIf1
      operation Oper: possible-error=ResvCrcHwUnit_PortIf1/E_NOT_OK
        6 x arg, all with server-argument-impl-policy=USE-ARGUMENT-TYPE:
          Mod_Arg: type=CrcHwResvMod1, direction=IN
          CrcCfg_Arg: type=CrcHwResvCfg1, direction=IN
          CrcHwInRegAdr_Arg: type=uint32, direction=OUT
          CrcHwOutRegAdr_Arg: type=uint32, direction=OUT
          StrtVal_Arg: type=uint32, direction=IN
          ResvKey_Arg: type=uint16, direction=INOUT
      error E_NOT_OK: error-code=1
    RstHwAgOverTrvlCnt_PortIf1
      operation Oper
    RstHwTq_PortIf1
      operation Oper
    RstMaxHwAgCwAndCcw_PortIf1
      operation Oper
    RstPullCmp_PortIf1
      operation Oper
    RstSnsrlsHwCentr_PortIf1
      operation Oper
    RstYawAndAg_PortIf1
      operation Oper
    RtCalChgReq
      operation Oper: possible-error=RtCalChgReq/E_NOT_OK
      error E_NOT_OK: error-code=1
    RtCalChgReq_PortIf1
      operation Oper: possible-error=RtCalChgReq_PortIf1/E_NOT_OK
      error E_NOT_OK: error-code=1
    RtnMaxHwAgCwAndCcw_PortIf1
      operation Oper
        arg HwAgCcwMax_Arg: type=float32, direction=OUT, server-argument-impl-policy=USE-ARGUMENT-TYPE
        arg HwAgCwMax_Arg: type=float32, direction=OUT, server-argument-impl-policy=USE-ARGUMENT-TYPE
    SerlComRstEot_PortIf1
      operation Oper
    SetCalPageReq_PortIf1
      operation Oper
        arg Seg_Arg: type=uint8, direction=IN, server-argument-impl-policy=USE-ARGUMENT-TYPE
        arg Mod_Arg: type=uint8, direction=IN, server-argument-impl-policy=USE-ARGUMENT-TYPE
        arg Page_Arg: type=uint8, direction=IN, server-argument-impl-policy=USE-ARGUMENT-TYPE
    SetCtrlPrm_PortIf1
      operation Oper
        7 x arg, all with type=float32, direction=IN, server-argument-impl-policy=USE-ARGUMENT-TYPE:
          MotVelCtrlPropGain_Arg
          MotVelCtrlIntgtrGain_Arg
          MotVelCtrlDerivtvGain_Arg
          MotVelCtrlAntiWdupLim_Arg
          MotVelCtrlAntiWdupGain_Arg
          MotVelCtrlDerivtvLpFilTiCon_Arg
          MotVelCtrlTqCmdLim_Arg
    SetEolFric_PortIf1  # OBSOLETE
      operation Oper
        arg EolFric_Arg: type=float32, direction=IN, server-argument-impl-policy=USE-ARGUMENT-TYPE
    SetFctGpio_PortIf1
      operation Oper: possible-error=SetFctGpio_PortIf1/E_NOT_OK
      error E_NOT_OK: error-code=1
    SetFctGpio1
      operation Oper: possible-error=SetFctGpio1/E_NOT_OK
      error E_NOT_OK: error-code=1
    SetFctPeriph_PortIf1
      operation Oper: possible-error=SetFctPeriph_PortIf1/E_NOT_OK
      error E_NOT_OK: error-code=1
    SetFctPeriph1
      operation Oper: possible-error=SetFctPeriph1/E_NOT_OK
      error E_NOT_OK: error-code=1
    SetFricData_PortIf1  # OBSELETE
      operation Oper
        5 x arg, all with direction=IN, server-argument-impl-policy=USE-ARGUMENT-TYPE:
          FricOffs_Arg: type=float32
          BasLineFric_Arg: type=float32
          VehLrndFric_Arg: type=float32
          Hys_Arg: type=float32
          RngCntr_Arg: type=uint16
    SetFricData_PortIf2  # OBSELETE
      operation Oper
        5 x arg, all with direction=IN, server-argument-impl-policy=USE-ARGUMENT-TYPE:
          FricOffs_Arg: type=float32
          BasLineFric_Arg: type=Ary1D_f32_4
          VehLrndFric_Arg: type=Ary1D_f32_4
          Hys_Arg: type=Ary2D_f32_4_8
          RngCntr_Arg: type=Ary2D_u16_3_8
    SetFricData_PortIf3
      operation Oper
        5 x arg, all with direction=IN, server-argument-impl-policy=USE-ARGUMENT-TYPE:
          FricOffs_Arg: type=float32
          BasLineFric_Arg: type=Ary1D_f32_4
          VehLrndFric_Arg: type=Ary1D_f32_4
          Hys_Arg: type=Ary2D_f32_8_4
          RngCntr_Arg: type=Ary2D_u16_8_3
    SetFricLrngData_PortIf1
      operation Oper
        4 x arg, all with direction=IN, server-argument-impl-policy=USE-ARGUMENT-TYPE:
          FricLrngEna_Arg: type=boolean
          FricLrngOffsOutpEna_Arg: type=boolean
          FricLrngOperMod_Arg: type=SysFricLrngOperMod1
          EolFric_Arg: type=float32
    SetFricLrngOperMod_PortIf1  # OBSELETE
      operation Oper
        arg FricLrngEna_Arg: type=boolean, direction=IN, server-argument-impl-policy=USE-ARGUMENT-TYPE
        arg FricLrngOffsOutpEna_Arg: type=boolean, direction=IN, server-argument-impl-policy=USE-ARGUMENT-TYPE
        arg FricLrngOperMod_Arg: type=SysFricLrngOperMod1, direction=IN, server-argument-impl-policy=USE-ARGUMENT-TYPE
    SetFricOffsOutpDi_PortIf1
      operation Oper
        arg FricOffsOutpDi_Arg: type=boolean, direction=IN, server-argument-impl-policy=USE-ARGUMENT-TYPE
    SetGmLoaIgnCntr_PortIf1
      operation Oper
        arg GmLoaIgnCntr_Arg: type=uint16, direction=IN, server-argument-impl-policy=USE-ARGUMENT-TYPE
    SetGpio_PortIf1
      operation Oper: possible-error=SetGpio_PortIf1/E_NOT_OK
        arg PinSt_Arg: type=boolean, direction=IN, server-argument-impl-policy=USE-ARGUMENT-TYPE
      error E_NOT_OK: error-code=1
    SetGpio1
      operation Oper: possible-error=SetGpio1/E_NOT_OK
        arg PinSt: type=boolean, direction=IN, server-argument-impl-policy=USE-ARGUMENT-TYPE
      error E_NOT_OK: error-code=1
    SetHwAgOffs_PortIf1
      operation Oper
        arg HwAgOffs_Arg: type=float32, direction=IN, server-argument-impl-policy=USE-ARGUMENT-TYPE
        arg HwAgLrngStRst_Arg: type=boolean, direction=IN, server-argument-impl-policy=USE-ARGUMENT-TYPE
    SetHwAgOverTrvlCnt_PortIf1  # OBSELETE
      operation Oper
        arg HwAgOverTrvlCntValSet_Arg: type=uint8, direction=IN, server-argument-impl-policy=USE-ARGUMENT-TYPE
    SetHwAgOverTrvlCnt_PortIf2
      operation Oper
        arg HwAgOverTrvlCnt_Arg: type=uint8, direction=IN, server-argument-impl-policy=USE-ARGUMENT-TYPE
    SetHwAgTrimVal_PortIf1  # OBSELETE
      operation Oper
        arg HwAgTrimVal_Arg: type=float32, direction=IN, server-argument-impl-policy=USE-ARGUMENT-TYPE
    SetHwAgTrimVal_PortIf2
      operation Oper
        arg HwAgTrimVal_Arg: type=float32, direction=IN, server-argument-impl-policy=USE-ARGUMENT-TYPE
        arg HwAgTrimPrfmd_Arg: type=boolean, direction=IN, server-argument-impl-policy=USE-ARGUMENT-TYPE
    SetHwTqOffs_PortIf1
      operation Oper
        arg HwTqOffs_Arg: type=float32, direction=IN, server-argument-impl-policy=USE-ARGUMENT-TYPE
        arg HwTqLrngStRst_Arg: type=boolean, direction=IN, server-argument-impl-policy=USE-ARGUMENT-TYPE
    SetManTqCmd1
      operation Oper: possible-error=SetManTqCmd1/E_NOT_OK
        arg ManTqCmd: type=Tq1, direction=IN, server-argument-impl-policy=USE-ARGUMENT-TYPE
        arg ManTqCmdEna: type=boolean, direction=IN, server-argument-impl-policy=USE-ARGUMENT-TYPE
      error E_NOT_OK: error-code=1
    SetMotCoggCmdPrm_PortIf1
      operation Oper
        arg MotCoggCmdY_Arg: type=Ary1D_s1p14_128, direction=IN, server-argument-impl-policy=USE-ARGUMENT-TYPE
        arg Idx_Arg: type=uint8, direction=IN, server-argument-impl-policy=USE-ARGUMENT-TYPE
    SetMotPrmNomEol1  # OBSELETE
      operation Oper: possible-error=SetMotPrmNomEol1/E_NOT_OK
        arg MotKeNom: type=MotCon1, direction=IN, server-argument-impl-policy=USE-ARGUMENT-TYPE
        arg MotRNom: type=R6, direction=IN, server-argument-impl-policy=USE-ARGUMENT-TYPE
      error E_NOT_OK: error-code=1
    SetMotPrmNomEol2
      operation Oper: possible-error=SetMotPrmNomEol2/E_NOT_OK
        arg MotBackEmfConNom_Arg: type=MotCon1, direction=IN, server-argument-impl-policy=USE-ARGUMENT-TYPE
        arg MotRNom_Arg: type=R6, direction=IN, server-argument-impl-policy=USE-ARGUMENT-TYPE
      error E_NOT_OK: error-code=1
    SetMotRplCoggPrm_PortIf1
      operation Oper
        9 x arg, all with direction=IN, server-argument-impl-policy=USE-ARGUMENT-TYPE:
          CoggOrder1_Arg: type=uint16
          CoggOrder1X_Arg: type=s1p14
          CoggOrder1Y_Arg: type=s1p14
          CoggOrder2_Arg: type=uint16
          CoggOrder2X_Arg: type=s1p14
          CoggOrder2Y_Arg: type=s1p14
          CoggOrder3_Arg: type=uint16
          CoggOrder3X_Arg: type=s1p14
          CoggOrder3Y_Arg: type=s1p14
    SetMotTqCmdSca_PortIf1
      operation Oper
        arg MotTqCmdSca_Arg: type=float32, direction=IN, server-argument-impl-policy=USE-ARGUMENT-TYPE
    SetNerrStDiOutp1
      operation Oper: possible-error=SetNerrStDiOutp1/E_NOT_OK
        arg NerrSt: type=Logl1, direction=IN, server-argument-impl-policy=USE-ARGUMENT-TYPE
      error E_NOT_OK: error-code=1
    SetNtcSts_PortIf1
      operation Oper: possible-error=SetNtcSts_PortIf1/E_NOT_OK
        4 x arg, all with direction=IN, server-argument-impl-policy=USE-ARGUMENT-TYPE:
          NtcNr_Arg: type=NtcNr1
          NtcStInfo_Arg: type=uint8
          NtcSts_Arg: type=NtcSts1
          DebStep_Arg: type=uint16
      error E_NOT_OK: error-code=1
    SetNtcSts1
      operation Oper: possible-error=SetNtcSts1/E_NOT_OK
        4 x arg, all with direction=IN, server-argument-impl-policy=USE-ARGUMENT-TYPE:
          NtcNr: type=NtcNr1
          NtcStInfo: type=uint8
          NtcSts: type=NtcSts1
          DebStep: type=uint16
      error E_NOT_OK: error-code=1
    SetNtcStsAndSnpshtData_PortIf1
      operation Oper: possible-error=SetNtcStsAndSnpshtData_PortIf1/E_NOT_OK
        7 x arg, all with direction=IN, server-argument-impl-policy=USE-ARGUMENT-TYPE:
          NtcNr_Arg: type=NtcNr1
          NtcStInfo_Arg: type=uint8
          NtcSts_Arg: type=NtcSts1
          DebStep_Arg: type=uint16
          SpclSnpshtData{0..2}_Arg: type=uint32
      error E_NOT_OK: error-code=1
    SetPullCmpLongTerm_PortIf1
      operation Oper
        arg PullCmpLongTerm_Arg: type=float32, direction=IN, server-argument-impl-policy=USE-ARGUMENT-TYPE
    SetPullCmpShoTerm_PortIf1
      operation Oper
        arg PullCmpShoTerm_Arg: type=float32, direction=IN, server-argument-impl-policy=USE-ARGUMENT-TYPE
    SetRxSigGroup_PortIf1
      operation Oper: possible-error=SetRxSigGroup_PortIf1/E_NOT_OK
        arg SigGroup_Arg: type=uint8, direction=IN, server-argument-impl-policy=USE-ARGUMENT-TYPE
        arg DataSrc_Arg: type=ImcArbnRxDataSrc1, direction=IN, server-argument-impl-policy=USE-ARGUMENT-TYPE
        arg Buf_Arg: type=Ary1D_u8_8, direction=IN, server-argument-impl-policy=USE-ARGUMENT-TYPE
      error E_NOT_OK: error-code=1
    SetTrajTarPrm_PortIf1
      operation Oper
        arg HwAgTrajGennHwAgTar_Arg: type=float32, direction=IN, server-argument-impl-policy=USE-ARGUMENT-TYPE
        arg HwAgTrajGennHwVelTar_Arg: type=float32, direction=IN, server-argument-impl-policy=USE-ARGUMENT-TYPE
        arg HwAgTrajGennHwATar_Arg: type=float32, direction=IN, server-argument-impl-policy=USE-ARGUMENT-TYPE
    SetYawRateOffs_PortIf1
      operation Oper
        arg VehYawRateOffs_Arg: type=float32, direction=IN, server-argument-impl-policy=USE-ARGUMENT-TYPE
        arg VehYawRateLrngStRst_Arg: type=boolean, direction=IN, server-argument-impl-policy=USE-ARGUMENT-TYPE
    StHlthStcPwrDwn_PortIf1
      operation Oper
    StopCtrl_PortIf1
      operation Oper
        arg MotVelCtrlVelSlewRate_Arg: type=float32, direction=IN, server-argument-impl-policy=USE-ARGUMENT-TYPE
    StrtCtrl_PortIf1
      operation Oper
        arg MotVelCtrlMotVelTar_Arg: type=float32, direction=IN, server-argument-impl-policy=USE-ARGUMENT-TYPE
        arg MotVelCtrlVelSlewRate_Arg: type=float32, direction=IN, server-argument-impl-policy=USE-ARGUMENT-TYPE
    StrtErrInjCntr_PortIf1
      operation Oper
    UpdErrInjReg_PortIf1
      operation Oper
        arg NtcNr_Arg: type=uint16, direction=IN, server-argument-impl-policy=USE-ARGUMENT-TYPE
        arg NtcStInfo_Arg: type=uint8, direction=IN, server-argument-impl-policy=USE-ARGUMENT-TYPE
        arg ErrInjNr_Arg: type=uint8, direction=IN, server-argument-impl-policy=USE-ARGUMENT-TYPE
    UpdHwAgTrimVal_PortIf1
      operation Oper
        arg UpdHwAgTrimValSrvResp_Arg: type=uint8, direction=OUT, server-argument-impl-policy=USE-ARGUMENT-TYPE
    UpdRawSig_PortIf1
      operation Oper
        arg SigId_Arg: type=StHlthMonSig1, direction=IN, server-argument-impl-policy=USE-ARGUMENT-TYPE
    UpdRawSig_PortIf2
      operation Oper
        arg SigId_Arg: type=StHlthMonSig2, direction=IN, server-argument-impl-policy=USE-ARGUMENT-TYPE
    UpdRawSig_PortIf3
      operation Oper
        arg SigId_Arg: type=StHlthMonSig3, direction=IN, server-argument-impl-policy=USE-ARGUMENT-TYPE
    UpdStHlthStcData_PortIf1
      operation Oper
        arg TaskId_Arg: type=uint8, direction=IN, server-argument-impl-policy=USE-ARGUMENT-TYPE
    XcpCalChgReq
      operation Oper: possible-error=XcpCalChgReq/E_NOT_OK
      error E_NOT_OK: error-code=1
  120 x sender receiver interface:
    A1: invalidation-policy{data-element=A1/Val, handle-invalid=DONT-INVALIDATE}
      data Val: sw-calibration-access=READ-ONLY, type=A1
    A2: invalidation-policy{data-element=A2/Val, handle-invalid=DONT-INVALIDATE}
      data Val: sw-calibration-access=READ-ONLY, type=A2
    A3: invalidation-policy{data-element=A3/Val, handle-invalid=DONT-INVALIDATE}
      data Val: sw-calibration-access=READ-ONLY, type=A3
    ActvGroup_PortIf1: invalidation-policy{data-element=ActvGroup_PortIf1/Val, handle-invalid=DONT-INVALIDATE}
      data Val: type=uint8
    Ag1: invalidation-policy{data-element=Ag1/Val, handle-invalid=DONT-INVALIDATE}
      data Val: sw-calibration-access=READ-ONLY, type=Ag2
    Ag2: invalidation-policy{data-element=Ag2/Val, handle-invalid=DONT-INVALIDATE}
      data Val: sw-calibration-access=READ-ONLY, type=Ag5
    Ag3: invalidation-policy{data-element=Ag3/Val, handle-invalid=DONT-INVALIDATE}
      data Val: sw-calibration-access=READ-ONLY, type=Ag7
    Ag4: invalidation-policy{data-element=Ag4/Val, handle-invalid=DONT-INVALIDATE}
      data Val: sw-calibration-access=READ-ONLY, type=Ag8
    Ag5: invalidation-policy{data-element=Ag5/Val, handle-invalid=DONT-INVALIDATE}
      data Val: sw-calibration-access=READ-ONLY, type=Ag12
    Ag6: invalidation-policy{data-element=Ag6/Val, handle-invalid=DONT-INVALIDATE}
      data Val: sw-calibration-access=READ-ONLY, type=Ag10
    Ag7: invalidation-policy{data-element=Ag7/Val, handle-invalid=DONT-INVALIDATE}
      data Val: sw-calibration-access=READ-ONLY, type=Ag15
    Ag8: invalidation-policy{data-element=Ag8/Val, handle-invalid=DONT-INVALIDATE}
      data Val: sw-calibration-access=READ-ONLY, type=Ag16
    Ag9: invalidation-policy{data-element=Ag9/Val, handle-invalid=DONT-INVALIDATE}
      data Val: sw-calibration-access=READ-ONLY, type=Ag19
    AgAry1D1: invalidation-policy{data-element=AgAry1D1/Ary1D, handle-invalid=DONT-INVALIDATE}
      data Ary1D: sw-calibration-access=READ-ONLY, type=AgAry1D2
    Ary1D_f32_8_PortIf1: invalidation-policy{data-element=Ary1D_f32_8_PortIf1/Ary1D, handle-invalid=DONT-INVALIDATE}
      data Ary1D: sw-calibration-access=READ-ONLY, type=Ary1D_f32_8
    Ary1D_u32_4_PortIf1: invalidation-policy{data-element=Ary1D_u32_4_PortIf1/Ary1D, handle-invalid=DONT-INVALIDATE}
      data Ary1D: sw-calibration-access=READ-ONLY, type=Ary1D_u32_4
    BattSwdVltgCorrlnSts1: invalidation-policy{data-element=BattSwdVltgCorrlnSts1/Val, handle-invalid=DONT-INVALIDATE}
      data Val: sw-calibration-access=READ-ONLY, type=BattSwdVltgCorrlnSts1
    BattSwdVltgCorrlnSts1_PortIf1: invalidation-policy{data-element=BattSwdVltgCorrlnSts1_PortIf1/Val, handle-invalid=DONT-INVALIDATE}
      data Val: sw-calibration-access=READ-ONLY, type=BattSwdVltgCorrlnSts1
    BattVltgSt1_PortIf1: invalidation-policy{data-element=BattVltgSt1_PortIf1/Val, handle-invalid=DONT-INVALIDATE}
      data Val: sw-calibration-access=READ-ONLY, type=BattVltgSt1
    boolean_PortIf1: invalidation-policy{data-element=boolean_PortIf1/Logl, handle-invalid=DONT-INVALIDATE}
      data Logl: sw-calibration-access=READ-ONLY, type=boolean
    CalCopySts_PortIf1: invalidation-policy{data-element=CalCopySts_PortIf1/Val, handle-invalid=DONT-INVALIDATE}
      data Val: type=CalCopySts1
    Cnt1: invalidation-policy{data-element=Cnt1/Val, handle-invalid=DONT-INVALIDATE}
      data Val: sw-calibration-access=READ-ONLY, type=Cnt1
    Cnt10: invalidation-policy{data-element=Cnt10/Val, handle-invalid=DONT-INVALIDATE}
      data Val: sw-calibration-access=READ-ONLY, type=Cnt16
    Cnt11: invalidation-policy{data-element=Cnt11/Val, handle-invalid=DONT-INVALIDATE}
      data Val: sw-calibration-access=READ-ONLY, type=Cnt17
    Cnt12: invalidation-policy{data-element=Cnt12/Val, handle-invalid=DONT-INVALIDATE}
      data Val: sw-calibration-access=READ-ONLY, type=Cnt22
    Cnt13: invalidation-policy{data-element=Cnt13/Val, handle-invalid=DONT-INVALIDATE}
      data Val: sw-calibration-access=READ-ONLY, type=Cnt13
    Cnt14: invalidation-policy{data-element=Cnt14/Val, handle-invalid=DONT-INVALIDATE}
      data Val: sw-calibration-access=READ-ONLY, type=Cnt19
    Cnt2: invalidation-policy{data-element=Cnt2/Val, handle-invalid=DONT-INVALIDATE}
      data Val: sw-calibration-access=READ-ONLY, type=Cnt2
    Cnt3: invalidation-policy{data-element=Cnt3/Val, handle-invalid=DONT-INVALIDATE}
      data Val: sw-calibration-access=READ-ONLY, type=Cnt3
    Cnt4: invalidation-policy{data-element=Cnt4/Val, handle-invalid=DONT-INVALIDATE}
      data Val: sw-calibration-access=READ-ONLY, data-constr=p0pt0_p31pt0, type=Cnt4
    Cnt5: invalidation-policy{data-element=Cnt5/Val, handle-invalid=DONT-INVALIDATE}
      data Val: sw-calibration-access=READ-ONLY, type=Cnt5
    Cnt6: invalidation-policy{data-element=Cnt6/Val, handle-invalid=DONT-INVALIDATE}
      data Val: sw-calibration-access=READ-ONLY, type=uint8
    Cnt7: invalidation-policy{data-element=Cnt7/Val, handle-invalid=DONT-INVALIDATE}
      data Val: sw-calibration-access=READ-ONLY, type=Cnt6
    Cnt8: invalidation-policy{data-element=Cnt8/Val, handle-invalid=DONT-INVALIDATE}
      data Val: sw-calibration-access=READ-ONLY, type=Cnt7
    Cnt9: invalidation-policy{data-element=Cnt9/Val, handle-invalid=DONT-INVALIDATE}
      data Val: sw-calibration-access=READ-ONLY, type=uint32
    CntAry1D1: invalidation-policy{data-element=CntAry1D1/Ary1D, handle-invalid=DONT-INVALIDATE}
      data Ary1D: sw-calibration-access=READ-ONLY, type=CntAry1D2
    Curr1: invalidation-policy{data-element=Curr1/Val, handle-invalid=DONT-INVALIDATE}
      data Val: sw-calibration-access=READ-ONLY, type=Curr1
    Curr2: invalidation-policy{data-element=Curr2/Val, handle-invalid=DONT-INVALIDATE}
      data Val: sw-calibration-access=READ-ONLY, type=Curr6
    Curr3: invalidation-policy{data-element=Curr3/Val, handle-invalid=DONT-INVALIDATE}
      data Val: sw-calibration-access=READ-ONLY, type=Curr7
    EgyModSt1_PortIf1: invalidation-policy{data-element=EgyModSt1_PortIf1/Val, handle-invalid=DONT-INVALIDATE}
      data Val: sw-calibration-access=READ-ONLY, type=EgyModSt1
    float32_PortIf1: invalidation-policy{data-element=float32_PortIf1/Val, handle-invalid=DONT-INVALIDATE}
      data Val: sw-calibration-access=READ-ONLY, type=float32
    Frq1: invalidation-policy{data-element=Frq1/Val, handle-invalid=DONT-INVALIDATE}
      data Val: sw-calibration-access=READ-ONLY, type=Frq1
    GmAutnmsDrvgIfFltRespDi_PortIf1: invalidation-policy{data-element=GmAutnmsDrvgIfFltRespDi_PortIf1/Val, handle-invalid=DONT-INVALIDATE}
      data Val: sw-calibration-access=READ-ONLY, type=GmAutnmsDrvgIfFltRespDi1
    GmAutnmsSteerCmdSts_PortIf1: invalidation-policy{data-element=GmAutnmsSteerCmdSts_PortIf1/Val, handle-invalid=DONT-INVALIDATE}
      data Val: sw-calibration-access=READ-ONLY, type=GmAutnmsSteerCmdSts1
    GmDrvrIntvDetnSt_PortIf1: invalidation-policy{data-element=GmDrvrIntvDetnSt_PortIf1/Val, handle-invalid=DONT-INVALIDATE}
      data Val: sw-calibration-access=READ-ONLY, type=GmDrvrIntvDetnSt1
    GmDualEcuOperSts_PortIf1: invalidation-policy{data-element=GmDualEcuOperSts_PortIf1/Val, handle-invalid=DONT-INVALIDATE}
      data Val: sw-calibration-access=READ-ONLY, type=GmDualEcuOperSts1
    GmFctDiArbnSts_PortIf1: invalidation-policy{data-element=GmFctDiArbnSts_PortIf1/Val, handle-invalid=DONT-INVALIDATE}
      data Val: sw-calibration-access=READ-ONLY, type=GmFctDiArbnSts1
    GmOvrlStMgrApaSt1_PortIf1: invalidation-policy{data-element=GmOvrlStMgrApaSt1_PortIf1/Val, handle-invalid=DONT-INVALIDATE}
      data Val: sw-calibration-access=READ-ONLY, type=GmOvrlStMgrApaSt1
    GmOvrlStMgrHaptcSt1_PortIf1: invalidation-policy{data-element=GmOvrlStMgrHaptcSt1_PortIf1/Val, handle-invalid=DONT-INVALIDATE}
      data Val: sw-calibration-access=READ-ONLY, type=GmOvrlStMgrHaptcSt1
    GmSteerCmdLimrSt_PortIf1: invalidation-policy{data-element=GmSteerCmdLimrSt_PortIf1/Val, handle-invalid=DONT-INVALIDATE}
      data Val: sw-calibration-access=READ-ONLY, type=GmSteerCmdLimrSt1
    GmSteerCmdMsgSrc1_PortIf1: invalidation-policy{data-element=GmSteerCmdMsgSrc1_PortIf1/Val, handle-invalid=DONT-INVALIDATE}
      data Val: sw-calibration-access=READ-ONLY, type=GmSteerCmdMsgSrc1
    GmSteerCmdMsgSts_PortIf1: invalidation-policy{data-element=GmSteerCmdMsgSts_PortIf1/Val, handle-invalid=DONT-INVALIDATE}
      data Val: sw-calibration-access=READ-ONLY, type=GmSteerCmdMsgSts1
    GmSysPwrMod1_PortIf1: invalidation-policy{data-element=GmSysPwrMod1_PortIf1/Val, handle-invalid=DONT-INVALIDATE}
      data Val: sw-calibration-access=READ-ONLY, type=GmSysPwrMod1
    GmTqArbnEscSt1_PortIf1: invalidation-policy{data-element=GmTqArbnEscSt1_PortIf1/Val, handle-invalid=DONT-INVALIDATE}
      data Val: sw-calibration-access=READ-ONLY, type=GmTqArbnEscSt1
    GmTqArbnLkaSt1_PortIf1: invalidation-policy{data-element=GmTqArbnLkaSt1_PortIf1/Val, handle-invalid=DONT-INVALIDATE}
      data Val: sw-calibration-access=READ-ONLY, type=GmTqArbnLkaSt1
    GmVehHlthMgrSt1_PortIf1: invalidation-policy{data-element=GmVehHlthMgrSt1_PortIf1/Val, handle-invalid=DONT-INVALIDATE}
      data Val: sw-calibration-access=READ-ONLY, type=GmVehHlthMgrSt1
    GmVehModMgrSt_PortIf1: invalidation-policy{data-element=GmVehModMgrSt_PortIf1/Val, handle-invalid=DONT-INVALIDATE}
      data Val: sw-calibration-access=READ-ONLY, type=GmVehModMgrSt1
    ImcArbnRxSts1_PortIf1: invalidation-policy{data-element=ImcArbnRxSts1_PortIf1/Val, handle-invalid=DONT-INVALIDATE}
      data Val: sw-calibration-access=READ-ONLY, type=ImcArbnRxSts1
    Indu1: invalidation-policy{data-element=Indu1, handle-invalid=DONT-INVALIDATE}  # OBSOLETE
      data Indu1: sw-calibration-access=READ-ONLY, type=Indu1
    Indu2: invalidation-policy{data-element=Indu2/Val, handle-invalid=DONT-INVALIDATE}
      data Val: sw-calibration-access=READ-ONLY, type=Indu1
    LoaSt1_PortIf1: invalidation-policy{data-element=LoaSt1_PortIf1/Val, handle-invalid=DONT-INVALIDATE}
      data Val: sw-calibration-access=READ-ONLY, type=LoaSt1
    Logl1: invalidation-policy{data-element=Logl1/Logl, handle-invalid=DONT-INVALIDATE}
      data Logl: sw-calibration-access=READ-ONLY, type=boolean
    Logl2: invalidation-policy{data-element=Logl2/Logl, handle-invalid=DONT-INVALIDATE}
      data Logl: sw-calibration-access=READ-ONLY, type=Logl1
    MfgEnaSt1_PortIf1: invalidation-policy{data-element=MfgEnaSt1_PortIf1/Val, handle-invalid=DONT-INVALIDATE}
      data Val: type=MfgEnaSt1
    MotCon1: invalidation-policy{data-element=MotCon1/Val, handle-invalid=DONT-INVALIDATE}
      data Val: sw-calibration-access=READ-ONLY, type=MotCon1
    MotCurrEolCalSt_PortIf1: invalidation-policy{data-element=MotCurrEolCalSt_PortIf1/Val, handle-invalid=DONT-INVALIDATE}
      data Val: sw-calibration-access=READ-ONLY, type=MotCurrEolCalSt2
    MotCurrEolCalSt1: invalidation-policy{data-element=MotCurrEolCalSt1/Val, handle-invalid=DONT-INVALIDATE}
      data Val: sw-calibration-access=READ-ONLY, type=MotCurrEolCalSt1
    MotCurrEolCalSt2: invalidation-policy{data-element=MotCurrEolCalSt2/Val, handle-invalid=DONT-INVALIDATE}
      data Val: sw-calibration-access=READ-ONLY, type=MotCurrEolCalSt2
    MotQuad1: invalidation-policy{data-element=MotQuad1/Val, handle-invalid=DONT-INVALIDATE}
      data Val: sw-calibration-access=READ-ONLY, type=MotQuad1
    R1: invalidation-policy{data-element=R1/Val, handle-invalid=DONT-INVALIDATE}
      data Val: sw-calibration-access=READ-ONLY, type=R2
    R2: invalidation-policy{data-element=R2/Val, handle-invalid=DONT-INVALIDATE}
      data Val: sw-calibration-access=READ-ONLY, type=R3
    R3: invalidation-policy{data-element=R3/Val, handle-invalid=DONT-INVALIDATE}
      data Val: sw-calibration-access=READ-ONLY, type=R4
    R4: invalidation-policy{data-element=R4/Val, handle-invalid=DONT-INVALIDATE}
      data Val: sw-calibration-access=READ-ONLY, type=R5
    R5: invalidation-policy{data-element=R5/Val, handle-invalid=DONT-INVALIDATE}
      data Val: sw-calibration-access=READ-ONLY, type=R7
    R6: invalidation-policy{data-element=R6/Val, handle-invalid=DONT-INVALIDATE}
      data Val: sw-calibration-access=READ-ONLY, type=R6
    Rate1: invalidation-policy{data-element=Rate1/Val, handle-invalid=DONT-INVALIDATE}
      data Val: sw-calibration-access=READ-ONLY, type=Rate1
    Rate2: invalidation-policy{data-element=Rate2/Val, handle-invalid=DONT-INVALIDATE}
      data Val: sw-calibration-access=READ-ONLY, type=Rate5
    s18p13_PortIf1: invalidation-policy{data-element=s18p13_PortIf1/Val, handle-invalid=DONT-INVALIDATE}
      data Val: sw-calibration-access=READ-ONLY, type=s18p13
    SelnCaseSt1: invalidation-policy{data-element=SelnCaseSt1/Val, handle-invalid=DONT-INVALIDATE}
      data Val: sw-calibration-access=READ-ONLY, type=SelnCaseSt1
    SigQlfr_PortIf1: invalidation-policy{data-element=SigQlfr_PortIf1/Val, handle-invalid=DONT-INVALIDATE}
      data Val: sw-calibration-access=READ-ONLY, type=SigQlfr1
    SigQlfr1: invalidation-policy{data-element=SigQlfr1/Val, handle-invalid=DONT-INVALIDATE}
      data Val: sw-calibration-access=READ-ONLY, type=SigQlfr1
    sint16_PortIf1: invalidation-policy{data-element=sint16_PortIf1/Val, handle-invalid=DONT-INVALIDATE}
      data Val: sw-calibration-access=READ-ONLY, type=sint16
    sint32_PortIf1: invalidation-policy{data-element=sint32_PortIf1/Val, handle-invalid=DONT-INVALIDATE}
      data Val: sw-calibration-access=READ-ONLY, type=sint32
    sint8_PortIf1: invalidation-policy{data-element=sint8_PortIf1/Val, handle-invalid=DONT-INVALIDATE}
      data Val: sw-calibration-access=READ-ONLY, type=sint8
    Spd1: invalidation-policy{data-element=Spd1/Val, handle-invalid=DONT-INVALIDATE}
      data Val: sw-calibration-access=READ-ONLY, type=Spd1
    Spd2: invalidation-policy{data-element=Spd2/Val, handle-invalid=DONT-INVALIDATE}
      data Val: sw-calibration-access=READ-ONLY, type=Spd2
    SteerMod1_PortIf1: invalidation-policy{data-element=SteerMod1_PortIf1/Val, handle-invalid=DONT-INVALIDATE}
      data Val: sw-calibration-access=READ-ONLY, type=SteerMod1
    StrtUpSt1: invalidation-policy{data-element=StrtUpSt1/Val, handle-invalid=DONT-INVALIDATE}
      data Val: sw-calibration-access=READ-ONLY, type=StrtUpSt1
    SysSt1: invalidation-policy{data-element=SysSt1/Val, handle-invalid=DONT-INVALIDATE}
      data Val: sw-calibration-access=READ-ONLY, type=SysSt1
    SysSt1_PortIf1: invalidation-policy{data-element=SysSt1_PortIf1/Val, handle-invalid=DONT-INVALIDATE}
      data Val: sw-calibration-access=READ-ONLY, type=SysSt1
    T1: invalidation-policy{data-element=T1/Val, handle-invalid=DONT-INVALIDATE}
      data Val: sw-calibration-access=READ-ONLY, type=T1
    T2: invalidation-policy{data-element=T2, handle-invalid=DONT-INVALIDATE}  # OBSOLETE
      data T2: sw-calibration-access=READ-ONLY, type=T2
    T3: invalidation-policy{data-element=T3, handle-invalid=DONT-INVALIDATE}  # OBSOLETE
      data T3: sw-calibration-access=READ-ONLY, type=T3
    T4: invalidation-policy{data-element=Element, handle-invalid=DONT-INVALIDATE}
      data Element: sw-calibration-access=READ-ONLY, type=T4
    T5: invalidation-policy{data-element=T5/Val, handle-invalid=DONT-INVALIDATE}
      data Val: sw-calibration-access=READ-ONLY, type=T2
    T6: invalidation-policy{data-element=T6/Val, handle-invalid=DONT-INVALIDATE}
      data Val: sw-calibration-access=READ-ONLY, type=T3
    Ti1: invalidation-policy{data-element=Ti1/Val, handle-invalid=DONT-INVALIDATE}
      data Val: sw-calibration-access=READ-ONLY, type=Ti1
    Ti3: invalidation-policy{data-element=Ti3/Val, handle-invalid=DONT-INVALIDATE}
      data Val: sw-calibration-access=READ-ONLY, type=Ti3
    Tq1: invalidation-policy{data-element=Tq1/Val, handle-invalid=DONT-INVALIDATE}
      data Val: sw-calibration-access=READ-ONLY, type=Tq1
    Tq2: invalidation-policy{data-element=Tq2/Val, handle-invalid=DONT-INVALIDATE}
      data Val: sw-calibration-access=READ-ONLY, type=Tq2
    Tq3: invalidation-policy{data-element=Tq3/Val, handle-invalid=DONT-INVALIDATE}
      data Val: sw-calibration-access=READ-ONLY, type=Tq3
    Tq4: invalidation-policy{data-element=Tq4/Val, handle-invalid=DONT-INVALIDATE}
      data Val: sw-calibration-access=READ-ONLY, type=Tq4
    Tq5: invalidation-policy{data-element=Tq5/Val, handle-invalid=DONT-INVALIDATE}
      data Val: sw-calibration-access=READ-ONLY, type=Tq8
    Tq6: invalidation-policy{data-element=Tq6/Val, handle-invalid=DONT-INVALIDATE}
      data Val: sw-calibration-access=READ-ONLY, type=Tq9
    Tq7: invalidation-policy{data-element=Tq7/Val, handle-invalid=DONT-INVALIDATE}
      data Val: sw-calibration-access=READ-ONLY, type=Tq10
    u0p16_PortIf1: invalidation-policy{data-element=u0p16_PortIf1/Val, handle-invalid=DONT-INVALIDATE}
      data Val: sw-calibration-access=READ-ONLY, type=u0p16
    uint16_PortIf1: invalidation-policy{data-element=uint16_PortIf1/Val, handle-invalid=DONT-INVALIDATE}
      data Val: sw-calibration-access=READ-ONLY, type=uint16
    uint32_PortIf1: invalidation-policy{data-element=uint32_PortIf1/Val, handle-invalid=DONT-INVALIDATE}
      data Val: sw-calibration-access=READ-ONLY, type=uint32
    uint8_PortIf1: invalidation-policy{data-element=uint8_PortIf1/Val, handle-invalid=DONT-INVALIDATE}
      data Val: sw-calibration-access=READ-ONLY, type=uint8
    Uls2: invalidation-policy{data-element=Uls2/Val, handle-invalid=DONT-INVALIDATE}
      data Val: sw-calibration-access=READ-ONLY, type=Uls2
    Uls3: invalidation-policy{data-element=Uls3/Val, handle-invalid=DONT-INVALIDATE}
      data Val: sw-calibration-access=READ-ONLY, type=Uls3
    Uls4: invalidation-policy{data-element=Uls4/Val, handle-invalid=DONT-INVALIDATE}
      data Val: sw-calibration-access=READ-ONLY, type=Uls6
    Vel1: invalidation-policy{data-element=Vel1/Val, handle-invalid=DONT-INVALIDATE}
      data Val: sw-calibration-access=READ-ONLY, type=Vel1
    Vel2: invalidation-policy{data-element=Vel2/Val, handle-invalid=DONT-INVALIDATE}
      data Val: sw-calibration-access=READ-ONLY, type=Vel3
    Volt1: invalidation-policy{data-element=Volt1/Val, handle-invalid=DONT-INVALIDATE}
      data Val: sw-calibration-access=READ-ONLY, type=Volt1
    Volt2: invalidation-policy{data-element=Volt2/Val, handle-invalid=DONT-INVALIDATE}
      data Val: sw-calibration-access=READ-ONLY, type=Volt2
    Volt3: invalidation-policy{data-element=Volt3/Val, handle-invalid=DONT-INVALIDATE}
      data Val: sw-calibration-access=READ-ONLY, type=Volt3
    Volt4: invalidation-policy{data-element=Volt4/Val, handle-invalid=DONT-INVALIDATE}
      data Val: sw-calibration-access=READ-ONLY, type=Volt6
    Volt5: invalidation-policy{data-element=Volt5/Val, handle-invalid=DONT-INVALIDATE}
      data Val: sw-calibration-access=READ-ONLY, type=Volt7
    Volt6: invalidation-policy{data-element=Volt6/Val, handle-invalid=DONT-INVALIDATE}
      data Val: sw-calibration-access=READ-ONLY, type=Volt17
