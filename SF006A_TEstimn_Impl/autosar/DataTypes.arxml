AUTOSAR XML (schema 4-0-3)
standard types defined: boolean, float32, uint32, uint8, boolean_CompuMethod, boolean_DataConstr, float32_DataConstr, uint32_DataConstr, uint8_DataConstr, Boolean, dtRef_const_VOID, dtRef_VOID
package /Nexteer/DataTypes
  4 x impl type, all with sw-calibration-access=READ-ONLY:
    Ary1D_f32_3: category=ARRAY, type-emitter=RTE
      element Element: array-size=3, array-size-semantics=FIXED-SIZE, implementation-data-type=ImplementationDataTypes/float32
    Ary1D_logl_3: category=ARRAY, type-emitter=RTE
      element Element: array-size=3, array-size-semantics=FIXED-SIZE, implementation-data-type=ImplementationDataTypes/boolean
    FilLpRec1: category=STRUCTURE, type-emitter=NxtrFil
      element FilSt: implementation-data-type=ImplementationDataTypes/float32
      element FilGain: implementation-data-type=ImplementationDataTypes/float32
      symbol props FilLpRec1
    TFilStValRec1: category=STRUCTURE, type-emitter=RTE
      8 x element, all with category=TYPE_REFERENCE, implementation-data-type=ImplementationDataTypes/float32:
        FilSiLpStVal
        FilMagLpStVal
        FilCuLpStVal
        FilAssisMechLpStVal
        FilSiLLStVal
        FilMagLLStVal
        FilCuLLStVal
        FilAssisMechLLStVal
package /Nexteer/NvMProxy_swc/DataTypes
  impl type NvM_RequestResultType: category=VALUE, base-type=NvM_RequestResultType, compu {0=NVM_REQ_OK, 1=NVM_REQ_NOT_OK, 2=NVM_REQ_PENDING, 3=NVM_REQ_INTEGRITY_FAILED, 4=NVM_REQ_BLOCK_SKIPPED, 5=NVM_REQ_NV_INVALIDATED, 6=NVM_REQ_CANCELED, 7=NVM_REQ_REDUNDANCY_FAILED, 8=NVM_REQ_RESTORED_FROM_ROM}
package /Nexteer/NvMProxy_swc/DataTypes/BaseTypes
  base type NvM_RequestResultType: category=FIXED_LENGTH, base-type-size=8, base-type-encoding=NONE, native-declaration=uint8
