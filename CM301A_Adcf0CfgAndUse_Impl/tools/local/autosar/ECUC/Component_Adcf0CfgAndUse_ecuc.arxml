AUTOSAR XML (schema 4-0-3)
package /ActiveEcuC
  module config Adcf0CfgAndUse: implementation-config-variant=VARIANT-PRE-COMPILE
    Adcf0CfgAndUseGeneral:
      ADCF0VCR{00..20} = 0
      ADCF0SGVCSP2 = 8
      ADCF0SGVCSP3 = 0
      ADCF0SGVCEP2 = 18
      ADCF0SGVCEP3 = 7
