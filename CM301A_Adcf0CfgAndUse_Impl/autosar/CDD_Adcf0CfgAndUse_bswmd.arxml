AUTOSAR XML (schema 4-0-3)
package /Nexteer
  module definition Adcf0CfgAndUse [0..1]: variants pre-compile  # Configuration of the ADC0.
    container Adcf0CfgAndUseGeneral  # This container contains the configuration (parameters) of the Adcf0CfgAndUse.
      integer ADCF0VCR{00..20}: 0..262143, set at pre-compile, origin=Nexteer  # .
      integer ADCF0SGVCSP2: 0..63, set at pre-compile, origin=Nexteer  # .
      integer ADCF0SGVCSP3: 0..63, set at pre-compile, origin=Nexteer  # .
      integer ADCF0SGVCEP2: 0..63, set at pre-compile, origin=Nexteer  # .
      integer ADCF0SGVCEP3: 0..63, set at pre-compile, origin=Nexteer  # .
