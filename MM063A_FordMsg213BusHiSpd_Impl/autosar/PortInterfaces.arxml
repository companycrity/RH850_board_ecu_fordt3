AUTOSAR XML (schema 4-0-3)
package /Ford/PortInterfaces
  4 x sender receiver interface:
    Ford_AbsActv_B_Actl: invalidation-policy{data-element=Ford_AbsActv_B_Actl, handle-invalid=DONT-INVALIDATE}
      data Ford_AbsActv_B_Actl: sw-calibration-access=READ-ONLY, type=Ford_AbsActv_B_Actl
    Ford_CmbbBrkDis_B_Actl: invalidation-policy{data-element=Ford_CmbbBrkDis_B_Actl, handle-invalid=DONT-INVALIDATE}
      data Ford_CmbbBrkDis_B_Actl: sw-calibration-access=READ-ONLY, type=Ford_CmbbBrkDis_B_Actl
    Ford_CmbbDeny_B_ActlBrk: invalidation-policy{data-element=Ford_CmbbDeny_B_ActlBrk, handle-invalid=DONT-INVALIDATE}
      data Ford_CmbbDeny_B_ActlBrk: sw-calibration-access=READ-ONLY, type=Ford_CmbbDeny_B_ActlBrk
    Ford_StabCtlBrkActv_B_Actl: invalidation-policy{data-element=Ford_StabCtlBrkActv_B_Actl, handle-invalid=DONT-INVALIDATE}
      data Ford_StabCtlBrkActv_B_Actl: sw-calibration-access=READ-ONLY, type=Ford_StabCtlBrkActv_B_Actl
package /Nexteer/Calibrations
  parameter interface uint16_CalPortIf1
    parameter data prototype Val: sw-calibration-access=READ-WRITE, type=uint16
package /Nexteer/PortInterfaces
  client server interface GetRefTmr100MicroSec32bit_PortIf1
    operation Oper
      arg RefTmr_Arg: type=uint32, direction=OUT, server-argument-impl-policy=USE-ARGUMENT-TYPE
  client server interface GetTiSpan100MicroSec32bit_PortIf1
    operation Oper
      arg RefTmr_Arg: type=uint32, direction=IN, server-argument-impl-policy=USE-ARGUMENT-TYPE
      arg TiSpan_Arg: type=uint32, direction=OUT, server-argument-impl-policy=USE-ARGUMENT-TYPE
  client server interface SetNtcSts_PortIf1
    operation Oper: possible-error=E_NOT_OK
      4 x arg, all with direction=IN, server-argument-impl-policy=USE-ARGUMENT-TYPE:
        NtcNr_Arg: type=NtcNr1
        NtcStInfo_Arg: type=uint8
        NtcSts_Arg: type=NtcSts1
        DebStep_Arg: type=uint16
    error E_NOT_OK: error-code=1
  sender receiver interface boolean_PortIf1: invalidation-policy{data-element=Logl, handle-invalid=DONT-INVALIDATE}
    data Logl: sw-calibration-access=READ-ONLY, type=boolean
  sender receiver interface uint8_PortIf1: invalidation-policy{data-element=Val, handle-invalid=DONT-INVALIDATE}
    data Val: sw-calibration-access=READ-ONLY, type=uint8
