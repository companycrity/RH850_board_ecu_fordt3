AUTOSAR XML (schema 4-0-3)
standard types defined: boolean, uint8, boolean_CompuMethod, boolean_DataConstr, uint8_DataConstr
package /Nexteer/DataTypes
  impl type TrigReg1: compu {85=TRIGREG_MST, 170=TRIGREG_CHKR, 255=TRIGREG_MSTANDCHKR}, implementation-data-type=uint8, type-emitter=EcmOutpAndDiagc
