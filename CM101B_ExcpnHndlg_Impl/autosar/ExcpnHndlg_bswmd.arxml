AUTOSAR XML (schema 4-0-3)
package /Nexteer
  module definition ExcpnHndlg [0..1]: variants pre-compile
    container ExcpnHndlgCfg  # This is the container for ExcpnHndlg Configurations
      string WdgMCfgStr: origin=NEXTEER, default-value=NULL_PTR  # WdgMConfig structure name For OS Gen 7 or later, set this to WdgMConfig_Mode0_Core(n). Otherwise Set it to WdgMConfig_Mode0 Name to be given by integrator based on the definition in WdgM_PBcfg.h file from Vector. It should be an externed variable of WdgM_ConfigType in that file.
