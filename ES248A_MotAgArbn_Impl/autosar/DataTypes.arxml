AUTOSAR XML (schema 4-0-3)
standard types defined: boolean, boolean_CompuMethod, boolean_DataConstr, uint8_DataConstr, uint8
