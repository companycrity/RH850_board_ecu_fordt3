AUTOSAR XML (schema 4-0-3)
package /ActiveEcuC
  module config HwTq1Meas: implementation-config-variant=VARIANT-PRE-COMPILE
    HwTq1MeasGeneral: HwTq1PrtclNtcNr=NTCNR_0X075, HwTq1MfgNtcNr=NTCNR_0X1E1
