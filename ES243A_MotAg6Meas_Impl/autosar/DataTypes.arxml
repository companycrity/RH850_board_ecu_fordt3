AUTOSAR XML (schema 4-0-3)
standard types defined: boolean, dtRef_const_VOID, dtRef_VOID, float32, float64, sint16, sint16_least, sint32, sint32_least, sint64, sint8, sint8_least, uint16, uint16_least, uint32, uint32_least, uint64, uint8, uint8_least, boolean_CompuMethod, boolean_DataConstr, float32_DataConstr, float64_DataConstr, sint16_DataConstr, sint16_least_DataConstr, sint32_DataConstr, sint32_least_DataConstr, sint64_DataConstr, sint8_DataConstr, sint8_least_DataConstr, uint16_DataConstr, uint16_least_DataConstr, uint32_DataConstr, uint32_least_DataConstr, uint64_DataConstr, uint8_DataConstr, uint8_least_DataConstr, Boolean
package /Nexteer/DataTypes
  13 x impl type:
    Ary1D_sm6p13_144: category=ARRAY, sw-calibration-access=READ-ONLY, type-emitter=RTE
      element Element: array-size=144, array-size-semantics=FIXED-SIZE, implementation-data-type=sm6p13
    FilLpRec1: category=STRUCTURE, sw-calibration-access=READ-ONLY, type-emitter=NxtrFil
      element FilSt: implementation-data-type=float32
      element FilGain: implementation-data-type=float32
      symbol props FilLpRec1
    MotAgEolPrmRec1: category=STRUCTURE, sw-calibration-access=READ-ONLY, type-emitter=RTE
      12 x element, all with category=TYPE_REFERENCE:
        SinOffs: implementation-data-type=u3p13
        CosOffs: implementation-data-type=u3p13
        SinAmpRecpr: implementation-data-type=u3p13
        CosAmpRecpr: implementation-data-type=u3p13
        SinDelta: implementation-data-type=s2p13
        SinHrmncTbl: implementation-data-type=Ary1D_sm6p13_144
        CosHrmncTbl: implementation-data-type=Ary1D_sm6p13_144
        SinGainCorrd: implementation-data-type=u1p15
        CosGainCorrd: implementation-data-type=u1p15
        SinOffsCorrd: implementation-data-type=s2p13
        CosOffsCorrd: implementation-data-type=s2p13
        CosDeltaRecpr: implementation-data-type=u3p13
    MotAgRtPrmRec1: category=STRUCTURE, sw-calibration-access=READ-ONLY, type-emitter=RTE
      14 x element, all with category=TYPE_REFERENCE, implementation-data-type=float32:
        SinRtOffs
        SinRtAmpRecpr
        CosRtOffs
        CosRtAmpRecpr
        SinGainCorrd
        CosGainCorrd
        SinOffsCorrd
        CosOffsCorrd
        CosSinNomRatio
        SinCosNomRatio
        RtToNomRatioLoLim
        RtToNomRatioHiLim
        PrevSinRtOffs
        PrevCosRtOffs
    MotAgStVariRec1: category=STRUCTURE, sw-calibration-access=READ-ONLY, type-emitter=RTE
      4 x element, all with category=TYPE_REFERENCE, implementation-data-type=float32:
        MotAgSinMax
        MotAgSinMin
        MotAgCosMax
        MotAgCosMin
    NtcNr1: compu {1..511=NTCNR_0X001..NTCNR_0X1FF}, implementation-data-type=uint16, type-emitter=RTE
    NtcSts1: compu {0=NTCSTS_PASSD, 1=NTCSTS_FAILD, 2=NTCSTS_PREPASSD, 3=NTCSTS_PREFAILD}, implementation-data-type=uint8, type-emitter=RTE
    s2p13: implementation-data-type=sint16, type-emitter=RTE
    SigQlfr1: compu {0=SIGQLFR_NORES, 1=SIGQLFR_PASSD, 2=SIGQLFR_FAILD}, implementation-data-type=uint8, type-emitter=RTE
    sm6p13: implementation-data-type=sint8, type-emitter=RTE
    u0p16: implementation-data-type=uint16, type-emitter=RTE
    u1p15: implementation-data-type=uint16, type-emitter=RTE
    u3p13: implementation-data-type=uint16, type-emitter=RTE
package /Nexteer/NvMProxy_swc/DataTypes
  impl type NvM_RequestResultType: category=VALUE, base-type=NvM_RequestResultType, compu {0=NVM_REQ_OK, 1=NVM_REQ_NOT_OK, 2=NVM_REQ_PENDING, 3=NVM_REQ_INTEGRITY_FAILED, 4=NVM_REQ_BLOCK_SKIPPED, 5=NVM_REQ_NV_INVALIDATED, 6=NVM_REQ_CANCELED, 7=NVM_REQ_REDUNDANCY_FAILED, 8=NVM_REQ_RESTORED_FROM_ROM}
package /Nexteer/NvMProxy_swc/DataTypes/BaseTypes
  base type NvM_RequestResultType: category=FIXED_LENGTH, base-type-size=8, base-type-encoding=NONE, native-declaration=uint8
