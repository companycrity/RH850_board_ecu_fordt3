AUTOSAR XML (schema 4-0-3)
package /ActiveEcuC
  module config MotAg6Meas: implementation-config-variant=VARIANT-PRE-COMPILE
    MotAg6MeasGeneral: MotAg6PrtclFlt=NTCNR_0X085
