AUTOSAR XML (schema 4-0-3)
standard types defined: boolean, float32, uint16, uint32, uint8, boolean_CompuMethod, boolean_DataConstr, float32_DataConstr, uint16_DataConstr, uint32_DataConstr, uint8_DataConstr
package /DataType/Unit
  28 x unit, all with factor-si-to-unit=1, offset-si-to-unit=0:
    U_1Ym: display-name=1/m
    U_1Ymeter: display-name=1/meter
    U_Amps: display-name=Amps
    U_deg: display-name=deg
    U_degrees: display-name=degrees
    U_Degrees: display-name=Degrees
    U_Degrees_C: display-name=Degrees C
    U_degreesYsecond: display-name=degrees/second
    U_degYs: display-name=deg/s
    U_km: display-name=km
    U_kmYh: display-name=km/h
    U_kph: display-name=kph
    U_meter: display-name=meter
    U_metersYsec: display-name=meters/sec
    U_mrad: display-name=mrad
    U_mYsX2: display-name=m/s^2
    U_Nm: display-name=Nm
    U_p: display-name=%
    U_radians: display-name=radians
    U_radiansYsecond: display-name=radians/second
    U_radYs: display-name=rad/s
    U_rpm: display-name=rpm
    U_second: display-name=second
    U_SED: display-name=SED
    U_volt: display-name=volt
    U_Volts: display-name=Volts
    unitless: display-name=unitless
    Unitless: display-name=Unitless
package /Ford/DataTypes
  168 x impl type, all with sw-calibration-access=READ-ONLY:
    Ford_AbsActv_B_Actl: category=VALUE, base-type=DataType/boolean, compu {phys=raw for raw 0..1, 0=Cx0_No, 1=Cx1_Yes; unit SED}
    Ford_ApaSys_D_Stat: category=VALUE, base-type=DataType/uint8, compu {phys=raw for raw 0..7, 0=Cx0_Null, 1=Cx1_Off, 2=Cx2_On, 3=Cx3_Overspeed, 4=Cx4_ApaCancelled, 5=Cx5_NotAccessible, 6=Cx6_Finished, 7=Cx7_Faulty; unit SED}, range raw 0..7
    Ford_ApedPos_Pc_ActlArb: category=VALUE, base-type=DataType/uint16, compu {phys=raw*0.1 for raw 0..1022; unit %}, range raw 0..1023
    Ford_ApedPosPcActl_D_Qf: category=VALUE, base-type=DataType/uint8, compu {phys=raw for raw 0..3, 0=Cx0_Faulty, 1=Cx1_No_Data_Exists, 2=Cx2_Not_Within_Specifications, 3=Cx3_OK; unit SED}, range raw 0..3
    Ford_BattULo_U_Actl: category=VALUE, base-type=DataType/uint8, compu {255=CxFF_Fault, phys=raw*0.0625 for raw 0..255; unit volt} "Source signal range: [0,254]"
    Ford_BpedDrvAppl_D_Actl: category=VALUE, base-type=DataType/uint8, compu {phys=raw for raw 0..3, 0=Cx0_Not_Allowed, 1=Cx1_Driver_Not_Braking, 2=Cx2_Driver_Braking, 3=Cx3_Not_Allowed; unit SED}, range raw 0..3
    Ford_BPedDrvAppl_D_QF: category=VALUE, base-type=DataType/uint8, compu {phys=raw for raw 0..3, 0=Cx0_Faulty, 1=Cx1_No_Data_Exists, 2=Cx2_Not_Within_Specifications, 3=Cx3_OK; unit SED}, range raw 0..3
    Ford_BrkTot_Tq_Actl: category=VALUE, base-type=DataType/uint16, compu {8190=Cx1FFE_Unknown, 8191=Cx1FFF_Fault, phys=raw*4 for raw 0..8191; unit Nm} "Source signal range: [0,8189]", range raw 0..8191
    Ford_CmbbBrkDis_B_Actl: category=VALUE, base-type=DataType/boolean, compu {phys=raw for raw 0..1, 0=Cx0_No, 1=Cx1_Yes; unit SED}
    Ford_CmbbDeny_B_ActlBrk: category=VALUE, base-type=DataType/boolean, compu {phys=raw for raw 0..1, 0=Cx0_No, 1=Cx1_Yes; unit SED}
    Ford_CmbbObjClass_D_Stat: category=VALUE, base-type=DataType/uint8, compu {phys=raw for raw 0..15, 0=Cx0_Undetermined, 1=Cx1_Vehicle, 2=Cx2_Motorcycle, 3=Cx3_Truck, 4=Cx4_Pedestrian, 5=Cx5_Bicycle, 6=Cx6_Unclassified_Vehicle, 7=Cx7_NotUsed_1, 8=Cx8_NotUsed_2, 9=Cx9_NotUsed_3, 10=CxA_NotUsed_4, 11=CxB_NotUsed_5, 12=CxC_NotUsed_6, 13=CxD_NotUsed_7, 14=CxE_NotUsed_8, 15=CxF_NotUsed_9; unit SED}, range raw 0..15
    Ford_CmbbObjColl_T_Actl: category=VALUE, base-type=DataType/uint8, compu {126=Cx7E_NoDataExists, 127=Cx7F_Faulty, phys=raw*0.05 for raw 0..127; unit second} "Source signal range: [0,125]", range raw 0..127
    Ford_CmbbObjConfdnc_D_Stat: category=VALUE, base-type=DataType/uint8, compu {phys=raw for raw 0..3, 0=Cx0_NotDetermined, 1=Cx1_Low, 2=Cx2_Medium, 3=Cx3_High; unit SED}, range raw 0..3
    Ford_CmbbObjDistLat_L_Actl: category=VALUE, base-type=DataType/uint16, compu {510=Cx1FE_NoDataExists, 511=Cx1FF_Faulty, phys=raw*0.1-25.5 for raw 0..511; unit meter} "Source signal range: [0,509]", range raw 0..511
    Ford_CmbbObjDistLong_L_Actl: category=VALUE, base-type=DataType/uint16, compu {1022=Cx3FE_NoDataExists, 1023=Cx3FF_Faulty, phys=raw*0.1 for raw 0..1023; unit meter} "Source signal range: [0,1021]", range raw 0..1023
    Ford_CmbbObjRelLat_V_Actl: category=VALUE, base-type=DataType/uint16, compu {510=Cx1FE_NoDataExists, 511=Cx1FF_Faulty, phys=raw*0.1-25.5 for raw 0..511; unit meters/sec} "Source signal range: [0,509]", range raw 0..511
    Ford_CmbbObjRelLong_V_Actl: category=VALUE, base-type=DataType/uint16, compu {1022=Cx3FE_NoDataExists, 1023=Cx3FF_Faulty, phys=raw*0.1-102.1 for raw 0..1023; unit meters/sec} "Source signal range: [0,1021]", range raw 0..1023
    Ford_DeliveryIdle: category=VALUE, base-type=DataType/uint16
    Ford_DeliveryNumber: category=VALUE, base-type=DataType/uint8
    Ford_DeliverySipNumber: category=VALUE, base-type=DataType/uint32, range raw 0..16777215
    Ford_DeliverySubProjectNumber: category=VALUE, base-type=DataType/uint32
    Ford_DrvSte_D_Stat:
      category=VALUE
      base-type=DataType/uint8
      compu {phys=raw for raw 0..15, 0=Cx0_DSR_Deactivated, 1=Cx1_DSR_Request_Not_Applicable, 2=Cx2_EPAS_Comm_Disturbed, 3=Cx3_DSR_in_Normal_Idle_Mode, 4=Cx4_Ignition_Off, 5=Cx5_Request_Active, 6=Cx6_NotUsed1, 7=Cx7_NotUsed2, 8=Cx8_NotUsed3, 9=Cx9_NotUsed4, 10=CxA_NotUsed5, 11=CxB_NotUsed6, 12=CxC_NotUsed7, 13=CxD_NotUsed8, 14=CxE_NotUsed9, 15=CxF_NotUsed10; unit SED}
      range raw 0..15
    Ford_DrvSte_Tq_Actl: category=VALUE, base-type=DataType/uint8, compu {254=CxFE_Unknown, 255=CxFF_Invalid, phys=raw*0.0625-8 for raw 0..255; unit Nm} "Source signal range: [0,253]"
    Ford_DrvSte_Tq_Rq: category=VALUE, base-type=DataType/uint8, compu {254=CxFE_Unknown, 255=CxFF_Invalid, phys=raw*0.0625-8 for raw 0..255; unit Nm} "Source signal range: [0,253]"
    Ford_DrvSteActv_B_Stat: category=VALUE, base-type=DataType/boolean, compu {phys=raw for raw 0..1, 0=Cx0_Inactive, 1=Cx1_Active; unit SED}
    Ford_ElPw_D_Stat: category=VALUE, base-type=DataType/uint8, compu {phys=raw for raw 0..7, 0=Cx0_Not_Supported, 1=Cx1_Supported, 2=Cx2_Not_Supported_Imminent, 3=Cx3_LV_Event_In_Progress, 4=Cx4_Fault_Limited, 5=Cx5_NotUsed_1, 6=Cx6_NotUsed_2, 7=Cx7_NotUsed_3; unit SED}, range raw 0..7
    Ford_ElPw_D_StatStrtStop:
      category=VALUE
      base-type=DataType/uint8
      compu {phys=raw for raw 0..15, 0=Cx0_Not_Supported, 1=Cx1_Supported_All, 2=Cx2_Not_Supported_Imminent, 3=Cx3_LV_Event_in_Progress, 4=Cx4_Fault_Limited, 5=Cx5_Limited_Support, 6=Cx6_Supported_Level_1, 7=Cx7_Supported_Level_2, 8=Cx8_Supported_Level_3, 9=Cx9_Supported_Level_4, 10=CxA_NotUsed1, 11=CxB_NotUsed2, 12=CxC_NotUsed3, 13=CxD_NotUsed4, 14=CxE_NotUsed5, 15=CxF_NotUsed6; unit SED}
      range raw 0..15
    Ford_EngAout_N_Actl: category=VALUE, base-type=DataType/uint16, compu {phys=raw*2 for raw 0..8191; unit rpm}, range raw 0..8191
    Ford_EPAS_Failure: category=VALUE, base-type=DataType/uint8, compu {phys=raw for raw 0..3, 0=Cx0_EPAS_OK_NO_MESSAGE, 1=Cx1_POWER_STRG_ASSIST_FAULT, 2=Cx2_SERVICE_POWER_STEERING, 3=Cx3_SERVICE_POWER_STEERING_NOW; unit SED}, range raw 0..3
    Ford_EPASExtAngleStatReq: category=VALUE, base-type=DataType/boolean, compu {phys=raw for raw 0..1, 0=Cx0_NoRequest, 1=Cx1_Request; unit SED}
    Ford_EsaEnbl_D2_Rq: category=VALUE, base-type=DataType/uint8, compu {phys=raw for raw 0..3, 0=Cx0_Disabled, 1=Cx1_Pending, 2=Cx2_Enabled, 3=Cx3_NotConfigured; unit SED}, range raw 0..3
    Ford_EsaOn_B_Rq: category=VALUE, base-type=DataType/boolean, compu {phys=raw for raw 0..1, 0=Cx0_Off, 1=Cx1_On; unit SED}
    Ford_EsaOn_B_Stat: category=VALUE, base-type=DataType/boolean, compu {phys=raw for raw 0..1, 0=Cx0_Off, 1=Cx1_On; unit SED}
    Ford_ExtSteeringAngleReq2: category=VALUE, base-type=DataType/uint16, compu {32766=Cx7FFE_Unknown, 32767=Cx7FFF_Invalid, phys=raw*0.1-1000 for raw 0..32767; unit Degrees} "Source signal range: [0,32765]", range raw 0..32767
    Ford_FileVersionDay: category=VALUE, base-type=DataType/uint8
    Ford_FileVersionMonth: category=VALUE, base-type=DataType/uint8
    Ford_FileVersionNumber: category=VALUE, base-type=DataType/uint8
    Ford_FileVersionYear: category=VALUE, base-type=DataType/uint8
    Ford_GearLvrPos_D_Actl: category=VALUE, base-type=DataType/uint8, compu {phys=raw for raw 0..15, 0=Cx0_Park, 1=Cx1_Reverse, 2=Cx2_Neutral, 3=Cx3_Drive, 4=Cx4_Sport_DriveSport, 5=Cx5_Low, 6=Cx6_first, 7=Cx7_second, 8=Cx8_third, 9=Cx9_fourth, 10=CxA_fifth, 11=CxB_sixth, 12=CxC_Undefined_Treat_as_Fault, 13=CxD_Undefined_Treat_as_Fault (Undefined_Treat_as__Fault), 14=CxE_Unknown_Position, 15=CxF_Fault; unit SED}, range raw 0..15
    Ford_GearPos_D_Actl: category=VALUE, base-type=DataType/uint8, compu {phys=raw for raw 0..15, 0=Cx0_Neutral, 1=Cx1_First, 2=Cx2_Second, 3=Cx3_Third, 4=Cx4_Fourth, 5=Cx5_Fifth, 6=Cx6_Sixth, 7=Cx7_Seventh, 8=Cx8_Eighth, 9=Cx9_Ninth, 10=CxA_Tenth, 11=CxB_Undefined_3, 12=CxC_Undefined_4, 13=CxD_Undefined_5, 14=CxE_Reverse, 15=CxF_Unknown; unit SED}, range raw 0..15
    Ford_GearRvrse_D_Actl: category=VALUE, base-type=DataType/uint8, compu {phys=raw for raw 0..7, 0=Cx0_Inactive_not_confirmed, 1=Cx1_Inactive_confirmed, 2=Cx2_Active_not_confirmed, 3=Cx3_Active_confirmed, 4=Cx4_NotUsed_1, 5=Cx5_NotUsed_2, 6=Cx6_NotUsed_3, 7=Cx7_Fault; unit SED}, range raw 0..7
    Ford_HandsOffCnfm_B_Rq: category=VALUE, base-type=DataType/boolean, compu {phys=raw for raw 0..1, 0=Cx0_Inactive, 1=Cx1_Active; unit SED}
    Ford_HitchToTrlrAxle_L_Calc: category=VALUE, base-type=DataType/uint16, compu {phys=raw*0.0254 for raw 0..511; unit meter}, range raw 0..511
    Ford_HitchToVehAxle_L_Calc: category=VALUE, base-type=DataType/uint8, compu {255=CxFF_Faulty, phys=raw*0.0127-0.508 for raw 0..255; unit meter} "Source signal range: [0,254]"
    Ford_Ignition_Status: category=VALUE, base-type=DataType/uint8, compu {phys=raw for raw 0..15, 0=Cx0_Unknown, 1=Cx1_Off, 2=Cx2_Accessory, 4=Cx4_Run, 8=Cx8_Start, 15=CxF_Invalid; unit SED}, range raw 0..15
    Ford_LaActAvail_D_Actl: category=VALUE, base-type=DataType/uint8, compu {phys=raw for raw 0..3, 0=Cx0_LCA_LKA_LDW_Suppress, 1=Cx1_LCA_LKA_Suppress_LDW_Avail, 2=Cx2_LCA_LKA_Avail_LDW_Suppress, 3=Cx3_LKA_LCA_LDW_Avail; unit SED}, range raw 0..3
    Ford_LaActDeny_B_Actl: category=VALUE, base-type=DataType/boolean, compu {phys=raw for raw 0..1, 0=Cx0_LA_Not_Denied, 1=Cx1_LA_Denied; unit SED}
    Ford_LaCurvature_No_Calc: category=VALUE, base-type=DataType/uint16, compu {4095=CxFFF_Fault, phys=raw*5e-06-0.01024 for raw 0..4095; unit 1/m} "Source signal range: [0,4094]", range raw 0..4095
    Ford_LaHandsOff_B_Actl: category=VALUE, base-type=DataType/boolean, compu {phys=raw for raw 0..1, 0=Cx0_Hands_On, 1=Cx1_Hands_Off; unit SED}
    Ford_LaRampType_B_Req: category=VALUE, base-type=DataType/boolean, compu {phys=raw for raw 0..1, 0=Cx0_Smooth, 1=Cx1_Quick; unit SED}
    Ford_LaRefAng_No_Req: category=VALUE, base-type=DataType/uint16, compu {4095=CxFFF_Fault, phys=raw*0.05-102.4 for raw 0..4095; unit mrad} "Source signal range: [0,4094]", range raw 0..4095
    Ford_LatCtl_D_Rq: category=VALUE, base-type=DataType/uint8, compu {phys=raw for raw 0..7, 0=Cx0_NoLateralControl, 1=Cx1_ContinuousPathFollowing, 2=Cx2_InterventionLeft, 3=Cx3_InterventionRight, 4=Cx4_NotUsed1, 5=Cx5_NotUsed2, 6=Cx6_NotUsed3, 7=Cx7_NotUsed4; unit SED}, range raw 0..7
    Ford_LatCtlCurv_No_Actl: category=VALUE, base-type=DataType/uint16, compu {phys=raw*2e-05-0.02 for raw 0..2047; unit 1/meter}, range raw 0..2047
    Ford_LatCtlCurv_NoRate_Actl: category=VALUE, base-type=DataType/uint16, compu {phys=raw/4000000-0.001024 for raw 0..8191; unit 1/meter}, range raw 0..8191
    Ford_LatCtlLim_D_Stat: category=VALUE, base-type=DataType/uint8, compu {phys=raw for raw 0..3, 0=Cx0_LimitNotReached, 1=Cx1_LimitClose, 2=Cx2_LimitReached, 3=Cx3_LimitWithDriverActive; unit SED}, range raw 0..3
    Ford_LatCtlPath_An_Actl: category=VALUE, base-type=DataType/uint16, compu {phys=raw*0.0005-0.5 for raw 0..2046; unit radians}, range raw 0..2047
    Ford_LatCtlPathOffst_L_Actl: category=VALUE, base-type=DataType/uint16, compu {phys=raw*0.01-5.12 for raw 0..1023; unit meter}, range raw 0..1023
    Ford_LatCtlPrecision_D_Rq: category=VALUE, base-type=DataType/uint8, compu {phys=raw for raw 0..3, 0=Cx0_Comfortable, 1=Cx1_Precise, 2=Cx2_NotUsed1, 3=Cx3_NotUsed2; unit SED}, range raw 0..3
    Ford_LatCtlRampType_D_Rq: category=VALUE, base-type=DataType/uint8, compu {phys=raw for raw 0..3, 0=Cx0_Slow, 1=Cx1_Medium, 2=Cx2_Fast, 3=Cx3_Immediately; unit SED}, range raw 0..3
    Ford_LatCtlRng_L_Max: category=VALUE, base-type=DataType/uint8, compu {phys=raw*2 for raw 0..63; unit meter}, range raw 0..63
    Ford_LatCtlSte_D_Stat: category=VALUE, base-type=DataType/uint8, compu {phys=raw for raw 0..7, 0=Cx0_Unavailable, 1=Cx1_Available, 2=Cx2_ContLatControlInProgress, 3=Cx3_RampOut, 4=Cx4_Denied, 5=Cx5_NotUsed1, 6=Cx6_NotUsed2, 7=Cx7_NotUsed3; unit SED}, range raw 0..7
    Ford_LdwActvIntns_D_Req: category=VALUE, base-type=DataType/uint8, compu {phys=raw for raw 0..3, 0=Cx0_None, 1=Cx1_Low, 2=Cx2_Medium, 3=Cx3_High; unit SED}, range raw 0..3
    Ford_LdwActvStats_D_Req: category=VALUE, base-type=DataType/uint8, compu {phys=raw for raw 0..7, 0=Cx0_LDW_Idle, 1=Cx1_Not_Used1, 2=Cx2_LDW_Warning_Left, 3=Cx3_LDW_Suppress_Left, 4=Cx4_LDW_Warning_Right, 5=Cx5_LDW_Suppress_Right, 6=Cx6_Not_Used2, 7=Cx7_LDW_Suppress_Right_Left; unit SED}, range raw 0..7
    Ford_LifeCycMde_D_Actl: category=VALUE, base-type=DataType/uint8, compu {phys=raw for raw 0..15, 0=Cx0_Normal, 1=Cx1_Factory, 2=Cx2_NotUsed, 3=Cx3_Transport; unit SED}, range raw 0..15
    Ford_LkaActvStats_D2_Req: category=VALUE, base-type=DataType/uint8, compu {phys=raw for raw 0..7, 0=Cx0_LkaNoInterv, 1=Cx1_LkaIncrIntervLeft, 2=Cx2_LkaStandIntervLeft, 3=Cx3_LkaSupprLeft, 4=Cx4_LkaStandIntervRight, 5=Cx5_LkaSupprRight, 6=Cx6_LkaIncrIntervRight, 7=Cx7_NotUsed; unit SED}, range raw 0..7
    Ford_LkaDrvOvrrd_D_Rq: category=VALUE, base-type=DataType/uint8, compu {phys=raw for raw 0..3, 0=Cx0_Level_0, 1=Cx1_Level_1, 2=Cx2_Level_2, 3=Cx3_Level_3; unit SED}, range raw 0..3
    Ford_LsmcBrk_Tq_Rq: category=VALUE, base-type=DataType/uint16, compu {phys=raw*4 for raw 0..8191; unit Nm}, range raw 0..8191
    Ford_LsmcBrkDecel_D_Stat: category=VALUE, base-type=DataType/uint8, compu {phys=raw for raw 0..7, 0=Cx0_Off, 1=Cx1_On, 2=Cx2_FaultExt, 3=Cx3_FaultDegraded, 4=Cx4_Denied, 5=Cx5_NotUsed_1, 6=Cx6_NotUsed_2, 7=Cx7_NotUsed_3; unit SED}, range raw 0..7
    Ford_LsmcBrkDecelEnbl_D_Rq: category=VALUE, base-type=DataType/uint8, compu {phys=raw for raw 0..3, 0=Cx0_Off, 1=Cx1_On, 2=Cx2_NotUsed1, 3=Cx3_NotUsed2; unit SED}, range raw 0..3
    Ford_OdometerMasterValue: category=VALUE, base-type=DataType/uint32, compu {phys=raw for raw 0..16777215, 16777215=CxFFFFFF_Invalid; unit km} "Source signal range: [0,16777214]", range raw 0..16777215
    Ford_Outside_Air_Temp_Stat: category=VALUE, base-type=DataType/uint8, compu {254=CxFE_Unknown, 255=CxFF_Invalid, phys=raw*0.5-40 for raw 0..255; unit Degrees C} "Source signal range: [0,253]"
    Ford_PrplWhlTot2_Tq_Actl: category=VALUE, base-type=DataType/uint16, compu {65534=CxFFFE_NoDataExists, 65535=CxFFFF_Fault, phys=raw*4-131072 for raw 0..65535; unit Nm} "Source signal range: [0,65533]"
    Ford_PwPckTq_D_Stat: category=VALUE, base-type=DataType/uint8, compu {phys=raw for raw 0..3, 0=Cx0_PwPckOff_TqNotAvailable, 1=Cx1_PwPckOn_TqNotAvailable, 2=Cx2_StartInPrgrss_TqNotAvail, 3=Cx3_PwPckOn_TqAvailable; unit SED}, range raw 0..3
    Ford_SAPPAngleControlStat1: category=VALUE, base-type=DataType/uint8, compu {phys=raw for raw 0..3, 0=Cx0_Closed, 1=Cx1_Open, 2=Cx2_Active, 3=Cx3_Fault; unit SED}, range raw 0..3
    Ford_SAPPAngleControlStat2: category=VALUE, base-type=DataType/boolean, compu {phys=raw for raw 0..1, 0=Cx0_NoRel_ExtSteeringAngleReqx, 1=Cx1_Rel_ExtSteeringAngleReqx; unit SED}
    Ford_SAPPAngleControlStat3: category=VALUE, base-type=DataType/boolean, compu {phys=raw for raw 0..1, 0=Cx0_ExternalSigContentOKforEAC, 1=Cx1_EARactiveNoReverseEngage; unit SED}
    Ford_SAPPAngleControlStat4: category=VALUE, base-type=DataType/boolean, compu {phys=raw for raw 0..1, 0=Cx0_ExternalSigContentOKforEAC, 1=Cx1_SpeedLimitExceededEAROn; unit SED}
    Ford_SAPPAngleControlStat5: category=VALUE, base-type=DataType/boolean, compu {phys=raw for raw 0..1, 0=Cx0_ExternalSigContentOKforEAC, 1=Cx1_StrgColTorqueExceed_EAROn; unit SED}
    Ford_SAPPAngleControlStat6: category=VALUE, base-type=DataType/boolean, compu {phys=raw for raw 0..1, 0=Cx0_RequestedAngleCanBeReached, 1=Cx1_RequestedAngleNotReached; unit SED}
    Ford_SelDrvMdeChassis2_D_Rq:
      category=VALUE
      base-type=DataType/uint8
      compu {phys=raw for raw 0..31, 0=Cx00_NormalMode, 1=Cx01_NormalAdaptiveMode, 2=Cx02_EconomyMode, 3=Cx03_SportMode, 4=Cx04_SportAdaptiveMode, 5=Cx05_ComfortMode, 6=Cx06_ComfortAdaptiveMode, 7=Cx07_LowMuMode, 8=Cx08_MudAndRutsMode, 9=Cx09_SandMode, 10=Cx0A_RockCrawlMode, 11=Cx0B_TowHaulMode, 12=Cx0C_HighSpeedDesertMode, 13=Cx0D_TrackMode, 14=Cx0E_RoughRoadMode, 15=Cx0F_NotUsed2, 16=Cx10_NotUsed3, 17=Cx11_NotUsed4, 18=Cx12_NotUsed5, 19=Cx13_NotUsed6, 20=Cx14_NotUsed7, 21=Cx15_NotUsed8, 22=Cx16_NotUsed9, 23=Cx17_NotUsed10, 24=Cx18_NotUsed11, 25=Cx19_NotUsed12, 26=Cx1A_NotUsed13, 27=Cx1B_NotUsed14, 28=Cx1C_NotUsed15, 29=Cx1D_NotUsed16, 30=Cx1E_NotUsed17, 31=Cx1F_Faulty; unit SED}
      range raw 0..31
    Ford_SelDrvMdeSte_D_Stat: category=VALUE, base-type=DataType/uint8, compu {phys=raw for raw 0..3, 0=Cx0_NotAvailable, 1=Cx1_Available, 2=Cx2_TemporarilyNotAvailable, 3=Cx3_Faulty; unit SED}, range raw 0..3
    Ford_StabCtlBrkActv_B_Actl: category=VALUE, base-type=DataType/boolean, compu {phys=raw for raw 0..1, 0=Cx0_No, 1=Cx1_Yes; unit SED}
    Ford_SteeringColumnTorque: category=VALUE, base-type=DataType/uint8, compu {254=CxFE_Unknown, 255=CxFF_Invalid, phys=raw*0.0625-8 for raw 0..255; unit Nm} "Source signal range: [0,253]"
    Ford_SteMdule_D_Stat: category=VALUE, base-type=DataType/uint8, compu {phys=raw for raw 0..7, 0=Cx0_EPAS_Initialization, 1=Cx1_Normal_Op_Limited_Assist, 2=Cx2_Normal_Op_Full_Assist, 3=Cx3_EPAS_Shutdown, 4=Cx4_System_Failure, 5=Cx5_EPAS_Failure2, 6=Cx6_EPAS_Failure3, 7=Cx7_NotUsed; unit SED}, range raw 0..7
    Ford_SteMdule_I_Est: category=VALUE, base-type=DataType/uint16, compu {4095=CxFFF_Invalid, phys=raw*0.05-64 for raw 0..4095; unit Amps} "Source signal range: [0,4094]", range raw 0..4095
    Ford_SteMdule_U_Meas: category=VALUE, base-type=DataType/uint8, compu {255=CxFF_Invalid, phys=raw*0.05+6 for raw 0..255; unit Volts} "Source signal range: [0,254]"
    Ford_StePinAn_No_Cnt: category=VALUE, base-type=DataType/uint8, compu {phys=raw for raw 0..15; unit unitless}, range raw 0..15
    Ford_StePinAn_No_Cs: category=VALUE, base-type=DataType/uint8, compu {phys=raw for raw 0..255; unit Unitless}
    Ford_StePinComp_An_Est: category=VALUE, base-type=DataType/uint16, compu {phys=raw*0.1-1600 for raw 0..32766; unit degrees}, range raw 0..32767
    Ford_StePinCompAnEst_D_Qf: category=VALUE, base-type=DataType/uint8, compu {phys=raw for raw 0..3, 0=Cx0_Faulty, 1=Cx1_No_Data_Exists, 2=Cx2_Degraded, 3=Cx3_OK; unit SED}, range raw 0..3
    Ford_StePinOffst_An_Est: category=VALUE, base-type=DataType/uint16, compu {65534=CxFFFE_NoDataExists, 65535=CxFFFF_Faulty, phys=raw*0.1-3200 for raw 0..65535; unit degrees} "Source signal range: [0,65533]"
    Ford_StePinOffst_D_Stat: category=VALUE, base-type=DataType/uint8, compu {phys=raw for raw 0..3, 0=Cx0_OffsetNotCalculated, 1=Cx1_StoredOffset, 2=Cx2_CoarseOffset, 3=Cx3_FineOffset; unit SED}, range raw 0..3
    Ford_StePinOffst_No_Cnt: category=VALUE, base-type=DataType/uint8, compu {phys=raw for raw 0..15; unit unitless}, range raw 0..15
    Ford_StePinOffst_No_Cs: category=VALUE, base-type=DataType/uint8, compu {phys=raw for raw 0..255; unit Unitless}
    Ford_StePinRelInit_An_Sns: category=VALUE, base-type=DataType/uint16, compu {65534=CxFFFE_NoDataExists, 65535=CxFFFF_Faulty, phys=raw*0.1-3200 for raw 0..65535; unit degrees} "Source signal range: [0,65533]"
    Ford_StePw_B_Rq: category=VALUE, base-type=DataType/boolean, compu {phys=raw for raw 0..1, 0=Cx0_No, 1=Cx1_Yes; unit SED}
    Ford_SteWhlRelCalib_An_Sns: category=VALUE, base-type=DataType/uint16, compu {32766=Cx7FFE_NoDataExists, 32767=Cx7FFF_Fault, phys=raw*0.1-1600 for raw 0..32767; unit deg} "Source signal range: [0,32765]", range raw 0..32767
    Ford_TjaHandsOnCnfdnc_B_Est: category=VALUE, base-type=DataType/boolean, compu {phys=raw for raw 0..1, 0=Cx0_Low_Confidence, 1=Cx1_High_Confidence; unit SED}
    Ford_TrlrAid_An3_Actl: category=VALUE, base-type=DataType/uint16, compu {2047=Cx7FF_Faulty, phys=raw*0.125-90 for raw 0..2047; unit degrees} "Source signal range: [0,2046]", range raw 0..2047
    Ford_TrlrAid_AnRate2_Actl: category=VALUE, base-type=DataType/uint16, compu {1023=Cx3FF_Faulty, phys=raw*0.125-50 for raw 0..1023; unit degrees/second} "Source signal range: [0,1022]", range raw 0..1023
    Ford_TrlrAid_D2_Stat:
      category=VALUE
      base-type=DataType/uint8
      compu {phys=raw for raw 0..15, 0=Cx0_NotTracking, 1=Cx1_Initializing, 2=Cx2_DriveStraighRequested, 3=Cx3_TurnRequested, 4=Cx4_TrackingLowConfidence, 5=Cx5_TrackingMediumConfidence, 6=Cx6_TrackingHighConfidence, 7=Cx7_TrackingUnknownConfidence, 8=Cx8_TrackingLost, 9=Cx9_IncorrectLighting, 10=CxA_DirtyCamera, 11=CxB_NotUsed_1, 12=CxC_NotUsed_2, 13=CxD_NotUsed_3, 14=CxE_NotUsed_4, 15=CxF_Faulty; unit SED}
      range raw 0..15
    Ford_TrlrAidCancl_B_Rq: category=VALUE, base-type=DataType/boolean, compu {phys=raw for raw 0..1, 0=Cx0_Null, 1=Cx1_Cancel; unit SED}
    Ford_TrlrAidCtl_U_RqDrv: category=VALUE, base-type=DataType/uint16, compu {4094=CxFFE_NoDataExists, 4095=CxFFF_Faulty, phys=raw/800 for raw 0..4095; unit volt} "Source signal range: [0,4093]", range raw 0..4095
    Ford_TrlrAidEnbl_D2_Rq: category=VALUE, base-type=DataType/uint8, compu {phys=raw for raw 0..7, 0=Cx0_Inactive, 1=Cx1_ActivateTba, 2=Cx2_ActivateTrg, 3=Cx3_Deactivate, 4=Cx4_NotUsed_1, 5=Cx5_NotUsed_2, 6=Cx6_NotUsed_3, 7=Cx7_NotUsed_4; unit SED}, range raw 0..7
    Ford_TrlrAidEnbl_D2_Stat: category=VALUE, base-type=DataType/uint8, compu {phys=raw for raw 0..7, 0=Cx0_Inactive, 1=Cx1_TbaActive, 2=Cx2_TbaSetup, 3=Cx3_TbaOffTrgSetup, 4=Cx4_TbaOffTrgActive, 5=Cx5_TbaActiveExpertAvail, 6=Cx6_TbaActiveExpertActive, 7=Cx7_NotUsed_1; unit SED}, range raw 0..7
    Ford_TrlrAidMde_D_Rq: category=VALUE, base-type=DataType/uint8, compu {phys=raw for raw 0..3, 0=Cx0_NoRequest, 1=Cx1_Mode_1, 2=Cx2_Mode_2, 3=Cx3_Mode_3; unit SED}, range raw 0..3
    Ford_TrlrAidMsgTxt_D2_Rq:
      category=VALUE
      base-type=DataType/uint8
      compu {phys=raw for raw 0..63, 0=Cx00_NoMessage, 1=Cx01_Message1, 2=Cx02_Message2, 3=Cx03_Message3, 4=Cx04_Message4, 5=Cx05_Message5, 6=Cx06_Message6, 7=Cx07_Message7, 8=Cx08_Message8, 9=Cx09_Message9, 10=Cx0A_Message10, 11=Cx0B_Message11, 12=Cx0C_Message12, 13=Cx0D_Message13, 14=Cx0E_Message14, 15=Cx0F_Message15, 16=Cx10_Message16, 17=Cx11_Message17, 18=Cx12_Message18, 19=Cx13_Message19, 20=Cx14_Message20, 21=Cx15_Message21, 22=Cx16_Message22, 23=Cx17_Message23, 24=Cx18_Message24, 25=Cx19_Message25, 26=Cx1A_Message26, 27=Cx1B_Message27, 28=Cx1C_Message28, 29=Cx1D_Message29, 30=Cx1E_Message30, 31=Cx1F_Message31, 35=Cx23_Message35, 40=Cx28_Message40, 45=Cx2D_Message45, 50=Cx32_Message50, 55=Cx37_Message55, 60=Cx3C_Message60, 61=Cx3D_Message61, 62=Cx3E_Message62, 63=Cx3F_Message63; unit SED}
      range raw 0..63
    Ford_TrlrAidSetup_D2_Rq: category=VALUE, base-type=DataType/uint8, compu {phys=raw for raw 0..15, 0=Cx0_Inactive, 1=Cx1_BeginSetup, 2=Cx2_EndSetup, 3=Cx3_ConfirmSetup, 4=Cx4_StickerNotCircled, 5=Cx5_ReturnToSetup, 6=Cx6_CompleteSetup, 7=Cx7_NotUsed_1, 8=Cx8_NotUsed_2, 9=Cx9_NotUsed_3, 10=CxA_NotUsed_4, 11=CxB_NotUsed_5, 12=CxC_NotUsed_6, 13=CxD_NotUsed_7, 14=CxE_NotUsed_8, 15=CxF_NotUsed_9; unit SED}, range raw 0..15
    Ford_TrlrAidSetup_D2_Stat: category=VALUE, base-type=DataType/uint8, compu {phys=raw for raw 0..7, 0=Cx0_Null, 1=Cx1_TbaActive, 2=Cx2_SetupPrepForAcquisition, 3=Cx3_SetupStartAcquisition, 4=Cx4_TbaTadMonitor, 5=Cx5_SetupAcquisitionSuccess, 6=Cx6_NotUsed_1, 7=Cx7_NotUsed_2; unit SED}, range raw 0..7
    Ford_TrlrAidSwtch_D_RqDrv: category=VALUE, base-type=DataType/uint8, compu {phys=raw for raw 0..3, 0=Cx0_Not_Pressed, 1=Cx1_Pressed, 2=Cx2_NotUsed, 3=Cx3_Faulty; unit SED}, range raw 0..3
    Ford_TrlrAidTrgtId_No_Actl: category=VALUE, base-type=DataType/uint8, compu {phys=raw for raw 0..31; unit unitless}, range raw 0..31
    Ford_TrlrAidTrgtId_No_Rq: category=VALUE, base-type=DataType/uint8, compu {phys=raw for raw 0..31; unit unitless}, range raw 0..31
    Ford_TrlrAidTrlrId_No_Rq: category=VALUE, base-type=DataType/uint8, compu {phys=raw for raw 0..15; unit unitless}, range raw 0..15
    Ford_TrlrAn_An_MxCalc: category=VALUE, base-type=DataType/uint8, compu {phys=raw for raw 0..127; unit degrees}, range raw 0..127
    Ford_TrlrAn_An_TrgtCalc: category=VALUE, base-type=DataType/uint8, compu {phys=raw-128 for raw 0..255; unit degrees}
    Ford_TrlrAn_An_WarnCalc: category=VALUE, base-type=DataType/uint8, compu {phys=raw for raw 0..31; unit degrees}, range raw 0..31
    Ford_TrlrAnOffst_An2_Calc: category=VALUE, base-type=DataType/uint8, compu {phys=raw*0.5-64 for raw 0..255; unit degrees}
    Ford_TrlrAnOffstDir_D_Mem: category=VALUE, base-type=DataType/uint8, compu {phys=raw for raw 0..3, 0=Cx0_Null, 1=Cx1_Left_or_Center, 2=Cx2_Right, 3=Cx3_NotUSed; unit SED}, range raw 0..3
    Ford_TrlrAxleToBmpr_L_Actl: category=VALUE, base-type=DataType/uint16, compu {phys=raw*0.0254 for raw 0..511; unit meter}, range raw 0..511
    Ford_TrlrBrkActCnnct_B_Actl: category=VALUE, base-type=DataType/boolean, compu {phys=raw for raw 0..1, 0=Cx0_No, 1=Cx1_Yes; unit SED}
    Ford_TrlrHitchLamp_D_Rqst: category=VALUE, base-type=DataType/boolean, compu {phys=raw for raw 0..1, 0=Cx0_Off, 1=Cx1_On; unit SED}
    Ford_TrlrHitchYaw_An_Actl: category=VALUE, base-type=DataType/uint16, compu {4094=CxFFE_NoDataExists, 4095=CxFFF_Faulty, phys=raw*0.1-90 for raw 0..4095; unit degrees} "Source signal range: [0,4093]", range raw 0..4095
    Ford_TrlrHitchYaw_D_Stat:
      category=VALUE
      base-type=DataType/uint8
      compu {phys=raw for raw 0..15, 0=Cx0_NoConnectionWithYrsu, 1=Cx1_TadNotWithinSpecification, 2=Cx2_TadTrlrDataOutOfRange, 3=Cx3_InitInputs, 4=Cx4_InitNoTadAngle, 5=Cx5_LowConfdAngleMem, 6=Cx6_HiConfdAngleMem, 7=Cx7_LowConfdLrndAngle, 8=Cx8_HiConfdLrndAngle, 9=Cx9_FaultyYrsu, 10=CxA_FaultyYrsuConnection, 11=CxB_NotUsed_1, 12=CxC_NotUsed_2, 13=CxD_NotUsed_3, 14=CxE_NotUsed_4, 15=CxF_Faulty; unit SED}
      range raw 0..15
    Ford_TrlrHitYaw_AnRate_Actl: category=VALUE, base-type=DataType/uint16, compu {4094=CxFFE_NoDataExists, 4095=CxFFF_Fault, phys=raw*0.1-50 for raw 0..4095; unit degrees/second} "Source signal range: [0,4093]", range raw 0..4095
    Ford_TrlrId_No_Actl: category=VALUE, base-type=DataType/uint8, compu {phys=raw for raw 0..15; unit unitless}, range raw 0..15
    Ford_TrlrIdType_D_Stat: category=VALUE, base-type=DataType/uint8, compu {phys=raw for raw 0..3, 0=Cx0_Null, 1=Cx1_Conventional, 2=Cx2_FifthWheel, 3=Cx3_Gooseneck; unit SED}, range raw 0..3
    Ford_TrlrLampCnnct_B_Actl: category=VALUE, base-type=DataType/boolean, compu {phys=raw for raw 0..1, 0=Cx0_No, 1=Cx1_Yes; unit SED}
    Ford_TrlrRvrse_D_Stat: category=VALUE, base-type=DataType/uint8, compu {phys=raw for raw 0..3, 0=Cx0_Off, 1=Cx1_On, 2=Cx2_TrailerReverseGuidanceLite, 3=Cx3_Faulty; unit SED}, range raw 0..3
    Ford_TrlrRvrseCancl_B_Rq: category=VALUE, base-type=DataType/boolean, compu {phys=raw for raw 0..1, 0=Cx0_Null, 1=Cx1_Cancel; unit SED}
    Ford_TrlrRvrseEnbl_D2_Stat: category=VALUE, base-type=DataType/uint8, compu {phys=raw for raw 0..7, 0=Cx0_Inactive, 1=Cx1_TbaActive, 2=Cx2_TbaSetup, 3=Cx3_TbaOffTrgSetup, 4=Cx4_TbaOffTrgActive, 5=Cx5_TbaActiveExpertAvail, 6=Cx6_TbaActiveExpertActive, 7=Cx7_NotUsed; unit SED}, range raw 0..7
    Ford_TrlrRvrseMsgTxt_D2_Rq:
      category=VALUE
      base-type=DataType/uint8
      compu {phys=raw for raw 0..63, 0=Cx00_NoMessage, 1=Cx01_Message1, 2=Cx02_Message2, 3=Cx03_Message3, 4=Cx04_Message4, 5=Cx05_Message5, 6=Cx06_Message6, 7=Cx07_Message7, 8=Cx08_Message8, 9=Cx09_Message9, 10=Cx0A_Message10, 11=Cx0B_Message11, 12=Cx0C_Message12, 13=Cx0D_Message13, 14=Cx0E_Message14, 15=Cx0F_Message15, 16=Cx10_Message16, 17=Cx11_Message17, 18=Cx12_Message18, 19=Cx13_Message19, 20=Cx14_Message20, 21=Cx15_Message21, 22=Cx16_Message22, 23=Cx17_Message23, 24=Cx18_Message24, 25=Cx19_Message25, 26=Cx1A_Message26, 27=Cx1B_Message27, 28=Cx1C_Message28, 29=Cx1D_Message29, 30=Cx1E_Message30, 31=Cx1F_Message31; unit SED}
      range raw 0..63
    Ford_TrlrSnsId_No_Actl: category=ARRAY
      element Element: array-size=6, array-size-semantics=FIXED-SIZE, implementation-data-type=uint8
    Ford_TrlrTrgtAcquire_D_Stat: category=VALUE, base-type=DataType/uint8, compu {phys=raw for raw 0..7, 0=Cx0_Null, 1=Cx1_TargetAcquired, 2=Cx2_TargetNotAcquired, 3=Cx3_Processing, 4=Cx4_RVCforTBA_Activated, 5=Cx5_NotUsed_1, 6=Cx6_NotUsed_2, 7=Cx7_Faulty; unit SED}, range raw 0..7
    Ford_TrlrYaw_W_Actl: category=VALUE, base-type=DataType/uint16, compu {65534=CxFFFE_NoDataExists, 65535=CxFFFF_Faulty, phys=raw*0.0002-6.5 for raw 0..65535; unit radians/second} "Source signal range: [0,65533]"
    Ford_TrlrYawWActl_D_Qf: category=VALUE, base-type=DataType/uint8, compu {phys=raw for raw 0..3, 0=Cx0_Faulty, 1=Cx1_No_Data_Exists, 2=Cx2_Not_Within_Specifications, 3=Cx3_OK; unit SED}, range raw 0..3
    Ford_TrnRng_D_Rq: category=VALUE, base-type=DataType/uint8, compu {phys=raw for raw 0..15, 0=Cx0_Park, 1=Cx1_Reverse, 2=Cx2_Neutral, 3=Cx3_Drive, 4=Cx4_Sport_DriveSport_Mposition, 5=Cx5_Low, 6=Cx6_Range1_M1_L1, 7=Cx7_Range2_M2_L2, 8=Cx8_Range3_M3_L3, 9=Cx9_Range4, 10=CxA_Range5, 11=CxB_Range6, 12=CxC_NotUsed_1, 13=CxD_NotUsed_2, 14=CxE_Unknown_Position, 15=CxF_Fault; unit SED}, range raw 0..15
    Ford_TurnLghtSwtch_D_Stat: category=VALUE, base-type=DataType/uint8, compu {phys=raw for raw 0..3, 0=Cx0_Off, 1=Cx1_Left, 2=Cx2_Right, 3=Cx3_Unused_Treat_As_Off; unit SED}, range raw 0..3
    Ford_Veh_V_ActlBrk: category=VALUE, base-type=DataType/uint16, compu {phys=raw*0.01 for raw 0..65535; unit kph}
    Ford_Veh_V_ActlEng: category=VALUE, base-type=DataType/uint16, compu {phys=raw*0.01 for raw 0..65535; unit kph}
    Ford_Veh_V_RqMxTrlrAid: category=VALUE, base-type=DataType/uint8, compu {phys=raw*0.1 for raw 0..255; unit km/h}
    Ford_VehicleGGCCData: category=ARRAY
      element Element: array-size=8, array-size-semantics=FIXED-SIZE, implementation-data-type=uint8
    Ford_VehLatComp_A_Actl: category=VALUE, base-type=DataType/uint16, compu {1022=Cx3FE_NoDataExists, 1023=Cx3FF_Fault, phys=raw*0.035-17.9 for raw 0..1023; unit m/s^2} "Source signal range: [0,1021]", range raw 0..1023
    Ford_VehLongComp_A_Actl: category=VALUE, base-type=DataType/uint16, compu {1022=Cx3FE_NoDataExists, 1023=Cx3FF_Fault, phys=raw*0.035-17.9 for raw 0..1023; unit m/s^2} "Source signal range: [0,1021]", range raw 0..1023
    Ford_VehOverGnd_V_Est: category=VALUE, base-type=DataType/uint16, compu {65534=CxFFFE_Unknown, 65535=CxFFFF_Invalid, phys=raw*0.01 for raw 0..65535; unit kph} "Source signal range: [0,65533]"
    Ford_VehVActlBrk_D_Qf: category=VALUE, base-type=DataType/uint8, compu {phys=raw for raw 0..3, 0=Cx0_Faulty, 1=Cx1_No_Data_Exists, 2=Cx2_Not_Within_Specifications, 3=Cx3_OK; unit SED}, range raw 0..3
    Ford_VehVActlBrk_No_Cnt: category=VALUE, base-type=DataType/uint8, compu {phys=raw for raw 0..15; unit Unitless}, range raw 0..15
    Ford_VehVActlBrk_No_Cs: category=VALUE, base-type=DataType/uint8, compu {phys=raw for raw 0..255; unit Unitless}
    Ford_VehVActlEng_D_Qf: category=VALUE, base-type=DataType/uint8, compu {phys=raw for raw 0..3, 0=Cx0_Faulty, 1=Cx1_No_Data_Exists, 2=Cx2_Not_Within_Specifications, 3=Cx3_OK; unit SED}, range raw 0..3
    Ford_VehVActlEng_No_Cnt: category=VALUE, base-type=DataType/uint8, compu {phys=raw for raw 0..15; unit Unitless}, range raw 0..15
    Ford_VehVActlEng_No_Cs: category=VALUE, base-type=DataType/uint8, compu {phys=raw for raw 0..255; unit Unitless}
    Ford_VehVertComp_A_Actl: category=VALUE, base-type=DataType/uint16, compu {1022=Cx3FE_NoDataExists, 1023=Cx3FF_Fault, phys=raw*0.035-17.9 for raw 0..1023; unit m/s^2} "Source signal range: [0,1021]", range raw 0..1023
    Ford_VehVTrlrAid_B_Avail: category=VALUE, base-type=DataType/boolean, compu {phys=raw for raw 0..1, 0=Cx0_No, 1=Cx1_Yes; unit SED}
    Ford_VehVTrlrAid_B_Rq: category=VALUE, base-type=DataType/boolean, compu {phys=raw for raw 0..1, 0=Cx0_NoRequest, 1=Cx1_Request; unit SED}
    Ford_VehYaw_W_Actl: category=VALUE, base-type=DataType/uint16, compu {65534=CxFFFE_NoDataExists, 65535=CxFFFF_Faulty, phys=raw*0.0002-6.5 for raw 0..65535; unit rad/s} "Source signal range: [0,65533]"
    Ford_VehYawComp_W_Actl: category=VALUE, base-type=DataType/uint16, compu {4094=CxFFE_NoDataExists, 4095=CxFFF_Fault, phys=raw*0.03663-75 for raw 0..4095; unit deg/s} "Source signal range: [0,4093]", range raw 0..4095
    Ford_WhlDirFl_D_Actl: category=VALUE, base-type=DataType/uint8, compu {phys=raw for raw 0..3, 0=Cx0_Forward, 1=Cx1_Backward, 2=Cx2_Unknown, 3=Cx3_Failed; unit SED}, range raw 0..3
    Ford_WhlDirFr_D_Actl: category=VALUE, base-type=DataType/uint8, compu {phys=raw for raw 0..3, 0=Cx0_Forward, 1=Cx1_Backward, 2=Cx2_Unknown, 3=Cx3_Failed; unit SED}, range raw 0..3
    Ford_WhlDirRl_D_Actl: category=VALUE, base-type=DataType/uint8, compu {phys=raw for raw 0..3, 0=Cx0_Forward, 1=Cx1_Backward, 2=Cx2_Unknown, 3=Cx3_Failed; unit SED}, range raw 0..3
    Ford_WhlDirRr_D_Actl: category=VALUE, base-type=DataType/uint8, compu {phys=raw for raw 0..3, 0=Cx0_Forward, 1=Cx1_Backward, 2=Cx2_Unknown, 3=Cx3_Failed; unit SED}, range raw 0..3
    Ford_WhlFl_W_Meas: category=VALUE, base-type=DataType/uint16, compu {32766=Cx7FFE_Unknown, 32767=Cx7FFF_Fault, phys=raw*0.01 for raw 0..32767; unit rad/s} "Source signal range: [0,32765]", range raw 0..32767
    Ford_WhlFr_W_Meas: category=VALUE, base-type=DataType/uint16, compu {32766=Cx7FFE_Unknown, 32767=Cx7FFF_Fault, phys=raw*0.01 for raw 0..32767; unit rad/s} "Source signal range: [0,32765]", range raw 0..32767
    Ford_WhlRl_W_Meas: category=VALUE, base-type=DataType/uint16, compu {32766=Cx7FFE_Unknown, 32767=Cx7FFF_Fault, phys=raw*0.01 for raw 0..32767; unit rad/s} "Source signal range: [0,32765]", range raw 0..32767
    Ford_WhlRotatFl_No_Cnt: category=VALUE, base-type=DataType/uint8, compu {phys=raw for raw 0..255; unit Unitless}
    Ford_WhlRotatFr_No_Cnt: category=VALUE, base-type=DataType/uint8, compu {phys=raw for raw 0..255; unit Unitless}
    Ford_WhlRotatRl_No_Cnt: category=VALUE, base-type=DataType/uint8, compu {phys=raw for raw 0..255; unit Unitless}
    Ford_WhlRotatRr_No_Cnt: category=VALUE, base-type=DataType/uint8, compu {phys=raw for raw 0..255; unit Unitless}
    Ford_WhlRr_W_Meas: category=VALUE, base-type=DataType/uint16, compu {32766=Cx7FFE_Unknown, 32767=Cx7FFF_Fault, phys=raw*0.01 for raw 0..32767; unit rad/s} "Source signal range: [0,32765]", range raw 0..32767
    Ford_YawStabilityIndex: category=VALUE, base-type=DataType/uint16, compu {510=Cx1FE_NoDataExists, 511=Cx1FF_Fault, phys=raw-256 for raw 0..511; unit %}, range raw 0..511
package /Nexteer/DataTypes
  impl type NtcNr1: compu {1..511=NTCNR_0X001..NTCNR_0X1FF}, implementation-data-type=uint16, type-emitter=RTE
  impl type NtcSts1: compu {0=NTCSTS_PASSD, 1=NTCSTS_FAILD, 2=NTCSTS_PREPASSD, 3=NTCSTS_PREFAILD}, implementation-data-type=uint8, type-emitter=RTE
