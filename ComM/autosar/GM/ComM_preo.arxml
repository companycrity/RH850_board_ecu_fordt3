AUTOSAR XML (schema 4-0-3)
# COPYRIGHT
# Copyright (c) 2016 by Vector Informatik GmbH. All rights reserved.
# This software is copyright protected and proprietary to Vector Informatik GmbH.
# Vector Informatik GmbH grants to you only those rights as set out in the license conditions.
package /MICROSAR  # ComM Preconfiguration
  module config ComM_Pre: definition=ComM
  module config ComM_Rec: definition=ComM, implementation-config-variant=VARIANT-PRE-COMPILE
    ComMConfigSet
    ComMGeneral: ComMDevErrorDetect=0, ComMPncPrepareSleepTimer=5, ComMPncSupport=1, ComMVersionInfoApi=1
  module config ComM_Rec_Class1: definition=ComM
    ComMConfigSet
      ComMChannel: ComMNoWakeup=0
        ComMNetworkManagement: ComMNmLightTimeout=0
