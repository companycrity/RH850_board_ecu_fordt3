AUTOSAR XML (schema 4-0-3)
package /Constants
  6 x constant specification:
    CNVMILLISECTOCNT_CNTPERMILLISEC_U16: value-spec=10  # One count of elapsed timer is equal to 100 microseconds. The count value is multiplied by this constant to convert millisecond to count.
    DEBSTEP_CNT_U16: value-spec=65535  # Constant use to indicate debounce stepsize as 65535
    DIAGENA_CNT_U08: value-spec=0  # To check whether the diagnostic is enabled using CAN DTC Inhibit signal FordMissMsgDiagcInhb,MfgDiagcInhb,FordInvldMsgDiagcInhbl
    FEATACTV_CNT_U08: value-spec=1  # To check whether the feature is active so that diagnostics can be performed
    FIXDVAL_MILLISEC_U16: value-spec=5000  # Pass constant value 5000 if EpsLifeCycMod is one
    MODSEL_CNT_U08: value-spec=1  # Mode select constant is used to select the appropriate threshold based on the EPSLifeCycMod
