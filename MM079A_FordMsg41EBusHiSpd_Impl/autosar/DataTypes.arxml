AUTOSAR XML (schema 4-0-3)
standard types defined: boolean, uint16, uint32, uint8, boolean_CompuMethod, boolean_DataConstr, uint16_DataConstr, uint32_DataConstr, uint8_DataConstr
package /DataType/Unit
  unit U_SED: display-name=SED, factor-si-to-unit=1, offset-si-to-unit=0
package /Ford/DataTypes
  impl type Ford_SelDrvMdeChassis2_D_Rq:
    category=VALUE
    base-type=DataType/uint8
    sw-calibration-access=READ-ONLY
    compu {phys=raw for raw 0..31, 0=Cx00_NormalMode, 1=Cx01_NormalAdaptiveMode, 2=Cx02_EconomyMode, 3=Cx03_SportMode, 4=Cx04_SportAdaptiveMode, 5=Cx05_ComfortMode, 6=Cx06_ComfortAdaptiveMode, 7=Cx07_LowMuMode, 8=Cx08_MudAndRutsMode, 9=Cx09_SandMode, 10=Cx0A_RockCrawlMode, 11=Cx0B_TowHaulMode, 12=Cx0C_HighSpeedDesertMode, 13=Cx0D_TrackMode, 14=Cx0E_RoughRoadMode, 15=Cx0F_NotUsed2, 16=Cx10_NotUsed3, 17=Cx11_NotUsed4, 18=Cx12_NotUsed5, 19=Cx13_NotUsed6, 20=Cx14_NotUsed7, 21=Cx15_NotUsed8, 22=Cx16_NotUsed9, 23=Cx17_NotUsed10, 24=Cx18_NotUsed11, 25=Cx19_NotUsed12, 26=Cx1A_NotUsed13, 27=Cx1B_NotUsed14, 28=Cx1C_NotUsed15, 29=Cx1D_NotUsed16, 30=Cx1E_NotUsed17, 31=Cx1F_Faulty; unit SED}
    range raw 0..31
package /Nexteer/DataTypes
  4 x impl type, all with type-emitter=RTE:
    Ary1D_u16_32: category=ARRAY, sw-calibration-access=READ-ONLY
      element Element: array-size=32, array-size-semantics=FIXED-SIZE, implementation-data-type=uint16
    NtcNr1: compu {1..511=NTCNR_0X001..NTCNR_0X1FF}, implementation-data-type=uint16
    NtcSts1: compu {0=NTCSTS_PASSD, 1=NTCSTS_FAILD, 2=NTCSTS_PREPASSD, 3=NTCSTS_PREFAILD}, implementation-data-type=uint8
    u16p0: implementation-data-type=uint16
