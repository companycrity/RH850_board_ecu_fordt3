AUTOSAR XML (schema 4-0-3)
package /Nexteer/Calibrations
  9 x parameter interface:
    Ary1D_u16p0_20_CalPortIf1
      parameter data prototype Ary1D: sw-calibration-access=READ-WRITE, type=Ary1D_u16p0_20
    Ary1D_u5p11_8_CalPortIf1
      parameter data prototype Ary1D: sw-calibration-access=READ-WRITE, type=Ary1D_u5p11_8
    Ary1D_u9p7_10_CalPortIf1
      parameter data prototype Ary1D: sw-calibration-access=READ-WRITE, type=Ary1D_u9p7_10
    Ary1D_u9p7_12_CalPortIf1
      parameter data prototype Ary1D: sw-calibration-access=READ-WRITE, type=Ary1D_u9p7_12
    Ary2D_s1p14_10_12_CalPortIf1
      parameter data prototype Ary2D: sw-calibration-access=READ-WRITE, type=Ary2D_s1p14_10_12
    Ary2D_u0p16_20_8_CalPortIf1
      parameter data prototype Ary2D: sw-calibration-access=READ-WRITE, type=Ary2D_u0p16_20_8
    Ary2D_u3p13_20_8_CalPortIf1
      parameter data prototype Ary2D: sw-calibration-access=READ-WRITE, type=Ary2D_u3p13_20_8
    float32_CalPortIf1
      parameter data prototype Val: sw-calibration-access=READ-WRITE, type=float32
    uint8_CalPortIf1
      parameter data prototype Val: sw-calibration-access=READ-WRITE, type=uint8
package /Nexteer/NvMProxy_swc/Interfaces
  client server interface NvMService_AC3_SRBS: is-service=true
    6 x operation, all with possible-error=E_NOT_OK:
      EraseBlock
      GetErrorStatus
        arg ErrorStatus: type=NvM_RequestResultType, direction=OUT
      InvalidateNvBlock
      ReadBlock
        arg DstPtr: type=dtRef_VOID, direction=IN
      SetRamBlockStatus
        arg RamBlockStatus: type=Boolean, direction=IN
      WriteBlock
        arg SrcPtr: type=dtRef_const_VOID, direction=IN
    error E_NOT_OK: error-code=1
package /Nexteer/PortInterfaces
  client server interface GetMotRplCoggPrm_PortIf1
    operation Oper
      9 x arg, all with direction=OUT:
        CoggOrder1_Arg: type=uint16
        CoggOrder1X_Arg: type=s1p14
        CoggOrder1Y_Arg: type=s1p14
        CoggOrder2_Arg: type=uint16
        CoggOrder2X_Arg: type=s1p14
        CoggOrder2Y_Arg: type=s1p14
        CoggOrder3_Arg: type=uint16
        CoggOrder3X_Arg: type=s1p14
        CoggOrder3Y_Arg: type=s1p14
  client server interface SetMotRplCoggPrm_PortIf1
    operation Oper
      9 x arg, all with direction=IN:
        CoggOrder1_Arg: type=uint16
        CoggOrder1X_Arg: type=s1p14
        CoggOrder1Y_Arg: type=s1p14
        CoggOrder2_Arg: type=uint16
        CoggOrder2X_Arg: type=s1p14
        CoggOrder2Y_Arg: type=s1p14
        CoggOrder3_Arg: type=uint16
        CoggOrder3X_Arg: type=s1p14
        CoggOrder3Y_Arg: type=s1p14
  sender receiver interface float32_PortIf1: invalidation-policy{data-element=Val, handle-invalid=DONT-INVALIDATE}
    data Val: sw-calibration-access=READ-ONLY, type=float32
