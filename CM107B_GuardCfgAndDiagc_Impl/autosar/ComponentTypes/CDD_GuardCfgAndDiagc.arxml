AUTOSAR XML (schema 4-0-3)
package /ComponentTypes
  complex device driver sw component type CDD_GuardCfgAndDiagc
    behavior CDD_GuardCfgAndDiagc_InternalBehavior
      timing event CDD_GuardCfgAndDiagc_InitEvent: start-on-event=GuardCfgAndDiagcInit2, period=0
      runnable GuardCfgAndDiagcInit2
  swc implementation CDD_GuardCfgAndDiagc_Implementation: behavior=CDD_GuardCfgAndDiagc_InternalBehavior
    code-descriptors:
      code Default: artifact-descriptors=autosar-engineering-object={short-label=Default, category=SWSRC}
