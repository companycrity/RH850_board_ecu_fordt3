AUTOSAR XML (schema 4-0-3)
standard types defined: boolean, dtRef_const_VOID, dtRef_VOID, float32, float64, sint16, sint16_least, sint32, sint32_least, sint64, sint8, sint8_least, uint16, uint16_least, uint32, uint32_least, uint64, uint8, uint8_least, boolean_CompuMethod, boolean_DataConstr, float32_DataConstr, float64_DataConstr, sint16_DataConstr, sint16_least_DataConstr, sint32_DataConstr, sint32_least_DataConstr, sint64_DataConstr, sint8_DataConstr, sint8_least_DataConstr, uint16_DataConstr, uint16_least_DataConstr, uint32_DataConstr, uint32_least_DataConstr, uint64_DataConstr, uint8_DataConstr, uint8_least_DataConstr
package /Nexteer/DataTypes
  5 x impl type, all with type-emitter=RTE:
    Ary1D_u16_12: category=ARRAY, sw-calibration-access=READ-ONLY
      element Element: array-size=12, array-size-semantics=FIXED-SIZE, implementation-data-type=uint16
    Ary1D_u3p13_50: category=ARRAY, sw-calibration-access=READ-ONLY
      element Element: array-size=50, array-size-semantics=FIXED-SIZE, implementation-data-type=u3p13
    u0p16: implementation-data-type=uint16
    u16p16: implementation-data-type=uint32
    u3p13: implementation-data-type=uint16
