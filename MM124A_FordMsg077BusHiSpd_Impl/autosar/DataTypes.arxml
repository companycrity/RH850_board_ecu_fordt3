AUTOSAR XML (schema 4-0-3)
standard types defined: boolean, float32, uint16, uint32, uint8, boolean_CompuMethod, boolean_DataConstr, float32_DataConstr, uint16_DataConstr, uint32_DataConstr, uint8_DataConstr
package /DataType/Unit
  unit U_degYs: display-name=deg/s, factor-si-to-unit=1, offset-si-to-unit=0
  unit U_kph: display-name=kph, factor-si-to-unit=1, offset-si-to-unit=0
  unit U_mYsX2: display-name=m/s^2, factor-si-to-unit=1, offset-si-to-unit=0
package /Ford/DataTypes
  4 x impl type, all with category=VALUE, base-type=DataType/uint16, sw-calibration-access=READ-ONLY:
    Ford_VehLatComp_A_Actl: compu {1022=Cx3FE_NoDataExists, 1023=Cx3FF_Fault, phys=raw*0.035-17.9 for raw 0..1023; unit m/s^2} "Source signal range: [0,1021]", range raw 0..1023
    Ford_VehLongComp_A_Actl: compu {1022=Cx3FE_NoDataExists, 1023=Cx3FF_Fault, phys=raw*0.035-17.9 for raw 0..1023; unit m/s^2} "Source signal range: [0,1021]", range raw 0..1023
    Ford_VehOverGnd_V_Est: compu {65534=CxFFFE_Unknown, 65535=CxFFFF_Invalid, phys=raw*0.01 for raw 0..65535; unit kph} "Source signal range: [0,65533]"
    Ford_VehYawComp_W_Actl: compu {4094=CxFFE_NoDataExists, 4095=CxFFF_Fault, phys=raw*0.03663-75 for raw 0..4095; unit deg/s} "Source signal range: [0,4093]", range raw 0..4095
package /Nexteer/DataTypes
  impl type NtcNr1: compu {1..511=NTCNR_0X001..NTCNR_0X1FF}, implementation-data-type=ImplementationDataTypes/uint16, type-emitter=RTE
  impl type NtcSts1: compu {0=NTCSTS_PASSD, 1=NTCSTS_FAILD, 2=NTCSTS_PREPASSD, 3=NTCSTS_PREFAILD}, implementation-data-type=uint8, type-emitter=RTE
  impl type u16p0: implementation-data-type=ImplementationDataTypes/uint16, type-emitter=RTE
