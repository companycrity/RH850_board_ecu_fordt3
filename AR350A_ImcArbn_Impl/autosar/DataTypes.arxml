AUTOSAR XML (schema 4-0-3)
standard types defined: float32_DataConstr, float64_DataConstr, sint16_DataConstr, sint32_DataConstr, sint8_DataConstr, uint16_DataConstr, uint32_DataConstr, uint8_DataConstr, boolean, float32, float64, sint16, sint32, sint8, uint16, uint32, uint8
package /Nexteer/DataTypes
  19 x impl type:
    Ary1D_ImcArbnRxDataSrc2_ImcArbnA: category=ARRAY, sw-calibration-access=READ-ONLY, type-emitter=ImcArbrn
      element Element: array-size=65535, array-size-semantics=VARIABLE-SIZE, implementation-data-type=ImcArbnRxDataSrc2
    Ary1D_ImcArbnRxDataSrc2_ImcArbnB: category=ARRAY, sw-calibration-access=READ-ONLY, type-emitter=ImcArbn
      element Element: array-size=65535, array-size-semantics=VARIABLE-SIZE, implementation-data-type=ImcArbnRxDataSrc2
    Ary1D_ImrArbnRxExtdSts2_ImcArbnA: category=ARRAY, sw-calibration-access=READ-ONLY, type-emitter=ImcArbn
      element Element: array-size=65535, array-size-semantics=VARIABLE-SIZE, implementation-data-type=ImcArbnRxExtdSts2
    Ary1D_logl_ImcArbnA: category=ARRAY, sw-calibration-access=READ-ONLY, type-emitter=ImcArbn
      element Element: array-size=65535, array-size-semantics=VARIABLE-SIZE, implementation-data-type=boolean
    Ary1D_u32_ImcArbnA: category=ARRAY, sw-calibration-access=READ-ONLY, type-emitter=ImcArbn
      element Element: array-size=65535, array-size-semantics=VARIABLE-SIZE, implementation-data-type=uint32
    Ary1D_u8_2: category=ARRAY, sw-calibration-access=READ-ONLY, type-emitter=RTE
      element Element: array-size=2, array-size-semantics=FIXED-SIZE, implementation-data-type=uint8
    Ary1D_u8_3: category=ARRAY, sw-calibration-access=READ-ONLY, type-emitter=RTE
      element Element: array-size=3, array-size-semantics=FIXED-SIZE, implementation-data-type=uint8
    Ary1D_u8_8: category=ARRAY, sw-calibration-access=READ-ONLY, type-emitter=RTE
      element Element: array-size=8, array-size-semantics=FIXED-SIZE, implementation-data-type=uint8
    Ary1D_u8_ImcArbnA: category=ARRAY, sw-calibration-access=READ-ONLY, type-emitter=ImcArbn
      element Element: array-size=8, array-size-semantics=FIXED-SIZE, implementation-data-type=uint8
    Ary1D_u8_ImcArbnB: category=ARRAY, sw-calibration-access=READ-ONLY, type-emitter=ImcArbn
      element Element: array-size=65535, array-size-semantics=VARIABLE-SIZE, implementation-data-type=uint8
    Ary2D_u8_2_2: category=ARRAY, sw-calibration-access=READ-ONLY, type-emitter=RTE
      element Element: array-size=2, array-size-semantics=FIXED-SIZE, implementation-data-type=Ary1D_u8_2
    Ary2D_u8_ImcArbnA: category=ARRAY, sw-calibration-access=READ-ONLY, type-emitter=ImcArbr
      element Element: array-size=65535, array-size-semantics=VARIABLE-SIZE, implementation-data-type=Ary1D_u8_ImcArbnA
    ImcArbnRxDataSrc1: implementation-data-type=ImcArbnRxDataSrc2, type-emitter=RTE
    ImcArbnRxDataSrc2: implementation-data-type=uint8, type-emitter=ImcArbn
    ImcArbnRxExtdSts1: implementation-data-type=ImcArbnRxExtdSts2, type-emitter=RTE
    ImcArbnRxExtdSts2: implementation-data-type=uint8, type-emitter=ImcArbn
    ImcArbnRxSts1: compu {0=IMCARBNRXSTS_NODATA, 1=IMCARBNRXSTS_VLD, 2=IMCARBNRXSTS_INVLD}, implementation-data-type=uint8, type-emitter=RTE
    NtcNr1: compu {1..511=NTCNR_0X001..NTCNR_0X1FF}, implementation-data-type=uint16, type-emitter=RTE
    NtcSts1: compu {0=NTCSTS_PASSD, 1=NTCSTS_FAILD, 2=NTCSTS_PREPASSD, 3=NTCSTS_PREFAILD}, implementation-data-type=uint8, type-emitter=RTE
