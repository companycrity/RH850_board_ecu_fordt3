AUTOSAR XML (schema 4-0-3)
standard types defined: boolean, float32, uint16, boolean_CompuMethod, boolean_DataConstr, float32_DataConstr, uint16_DataConstr, float64_DataConstr, sint16_DataConstr, sint32_DataConstr, sint8_DataConstr, uint32_DataConstr, uint8_DataConstr, float64, sint16, sint32, sint8, uint32, uint8
package /Nexteer/DataTypes
  17 x impl type:
    Ary1D_u0p16_2: category=ARRAY, sw-calibration-access=READ-ONLY, type-emitter=RTE
      element Element: array-size=2, array-size-semantics=FIXED-SIZE, implementation-data-type=u0p16
    Ary1D_u12p4_2: category=ARRAY, sw-calibration-access=READ-ONLY, type-emitter=RTE
      element Element: array-size=2, array-size-semantics=FIXED-SIZE, implementation-data-type=u12p4
    Ary1D_u12p4_4: category=ARRAY, sw-calibration-access=READ-ONLY, type-emitter=RTE
      element Element: array-size=4, array-size-semantics=FIXED-SIZE, implementation-data-type=u12p4
    Ary1D_u1p15_4: category=ARRAY, sw-calibration-access=READ-ONLY, type-emitter=RTE
      element Element: array-size=4, array-size-semantics=FIXED-SIZE, implementation-data-type=u1p15
    Ary1D_u4p12_2: category=ARRAY, sw-calibration-access=READ-ONLY, type-emitter=RTE
      element Element: array-size=2, array-size-semantics=FIXED-SIZE, implementation-data-type=u4p12
    Ary1D_u9p7_4: category=ARRAY, sw-calibration-access=READ-ONLY, type-emitter=RTE
      element Element: array-size=4, array-size-semantics=FIXED-SIZE, implementation-data-type=u9p7
    Ary1D_u9p7_5: category=ARRAY, sw-calibration-access=READ-ONLY, type-emitter=RTE
      element Element: array-size=5, array-size-semantics=FIXED-SIZE, implementation-data-type=u9p7
    Ary2D_u0p16_4_2: category=ARRAY, sw-calibration-access=READ-ONLY, type-emitter=RTE
      element Element: array-size=4, array-size-semantics=FIXED-SIZE, implementation-data-type=Ary1D_u0p16_2
    Ary2D_u12p4_4_2: category=ARRAY, sw-calibration-access=READ-ONLY, type-emitter=RTE
      element Element: array-size=4, array-size-semantics=FIXED-SIZE, implementation-data-type=Ary1D_u12p4_2
    Ary2D_u12p4_5_4: category=ARRAY, sw-calibration-access=READ-ONLY, type-emitter=RTE
      element Element: array-size=5, array-size-semantics=FIXED-SIZE, implementation-data-type=Ary1D_u12p4_4
    Ary2D_u1p15_5_4: category=ARRAY, sw-calibration-access=READ-ONLY, type-emitter=RTE
      element Element: array-size=5, array-size-semantics=FIXED-SIZE, implementation-data-type=Ary1D_u1p15_4
    FilLpRec1: category=STRUCTURE, sw-calibration-access=READ-ONLY, type-emitter=NxtrFil
      element FilSt: implementation-data-type=ImplementationDataTypes/float32
      element FilGain: implementation-data-type=ImplementationDataTypes/float32
      symbol props FilLpRec1
    u0p16: implementation-data-type=ImplementationDataTypes/uint16, type-emitter=RTE
    u12p4: implementation-data-type=ImplementationDataTypes/uint16, type-emitter=RTE
    u1p15: implementation-data-type=ImplementationDataTypes/uint16, type-emitter=RTE
    u4p12: implementation-data-type=ImplementationDataTypes/uint16, type-emitter=RTE
    u9p7: implementation-data-type=ImplementationDataTypes/uint16, type-emitter=RTE
