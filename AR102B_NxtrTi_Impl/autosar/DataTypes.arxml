AUTOSAR XML (schema 4-0-3)
standard types defined: uint16, uint32, uint8, uint16_DataConstr, uint32_DataConstr, uint8_DataConstr, float32_DataConstr, float64_DataConstr, sint16_DataConstr, sint32_DataConstr, sint8_DataConstr, boolean, float32, float64, sint16, sint32, sint8
package /Nexteer/DataTypeMappingSets
  data type mapping set Nexteer
    data-type-maps:
      application-data-type=Cnt1, implementation-data-type=PlatformTypes/uint8
      application-data-type=Cnt2, implementation-data-type=sint8
      application-data-type=Cnt{3..5}, implementation-data-type=PlatformTypes/uint16
      application-data-type=Cnt6, implementation-data-type=PlatformTypes/uint8
      application-data-type=Cnt7, implementation-data-type=PlatformTypes/uint8
      application-data-type=Curr1, implementation-data-type=float32
      application-data-type=Curr2, implementation-data-type=float32
      application-data-type=Frq1, implementation-data-type=float32
      application-data-type=Gain1, implementation-data-type=float32
      application-data-type=T{1..4}, implementation-data-type=float32
      application-data-type=Ti{1..3}, implementation-data-type=PlatformTypes/uint32
      application-data-type=Tq1, implementation-data-type=float32
      application-data-type=Tq2, implementation-data-type=float32
      application-data-type=Volt{1..3}, implementation-data-type=float32
package /Nexteer/DataTypes
  23 x app type, all with category=VALUE, sw-calibration-access=READ-ONLY:
    Cnt1: range phys 1..4, unit=Cnt
    Cnt2: range phys -1..1, unit=Cnt
    Cnt3: range phys 0..1, unit=Cnt
    Cnt4: range phys 0..31, unit=Cnt
    Cnt5: range phys 0..32767, unit=Cnt
    Cnt6: range phys 0..63, unit=Cnt
    Cnt7: range phys 20..160, unit=Cnt
    Curr1: range phys -145..145, unit=Amp
    Curr2: range phys 0..50, unit=Amp
    Frq1: range phys 0.1..10, unit=Hz
    Gain1: range phys 0..200, unit=degC/V
    T1: range phys -50..150, unit=degC
    T2: range phys -50..200, unit=degC
    T3: range phys -50..300, unit=degC
    T4: range phys -100..150, unit=degC
    Ti1: range phys 0..25000, unit=nS
    Ti2: range phys 1..1000, unit=nS
    Ti3: range phys 0..71429, unit=nS
    Tq1: range phys -8.8..8.8, unit=MotNm
    Tq2: range phys -10..10, unit=HwNm
    Volt1: range phys 6..26.5, unit=Volt
    Volt2: range phys 6..16, unit=Volt
    Volt3: range phys 0..5, unit=Volt
  impl type NtcNr1: compu {1..511=NTCNR_0X001..NTCNR_0X1FF}, implementation-data-type=ImplementationDataTypes/uint16, type-emitter=RTE
  impl type NtcSts1: compu {0=NTCSTS_PASSD, 1=NTCSTS_FAILD, 2=NTCSTS_PREPASSD, 3=NTCSTS_PREFAILD}, implementation-data-type=ImplementationDataTypes/uint8, type-emitter=RTE
package /Nexteer/Units
  9 x unit, all with factor-si-to-unit=1, offset-si-to-unit=0:
    Ampr: display-name=Amp
    Cnt: display-name=Cnt
    DegCgrd: display-name=degC
    DegCgrdPerVolt: display-name=degC/V
    HwNwtMtr: display-name=HwNm
    Hz: display-name=Hz
    MotNwtMtr: display-name=MotNm
    NanoSec: display-name=nS
    Volt: display-name=Volt
