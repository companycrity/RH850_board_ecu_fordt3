AUTOSAR XML (schema 4-0-3)
standard types defined: boolean, float32, sint16, uint16, uint32, uint8, boolean_CompuMethod, boolean_DataConstr, float32_DataConstr, sint16_DataConstr, uint16_DataConstr, uint32_DataConstr, uint8_DataConstr, float64_DataConstr, sint32_DataConstr, sint8_DataConstr, Boolean, dtRef_const_VOID, dtRef_VOID
package /Nexteer/DataTypes
  18 x impl type:
    Ary1D_s15p0_4: category=ARRAY, sw-calibration-access=READ-ONLY, type-emitter=RTE
      element Element: array-size=4, array-size-semantics=FIXED-SIZE, implementation-data-type=s15p0
    Ary1D_s15p0_5: category=ARRAY, sw-calibration-access=READ-ONLY, type-emitter=RTE
      element Element: array-size=5, array-size-semantics=FIXED-SIZE, implementation-data-type=s15p0
    Ary1D_u16p0_8: category=ARRAY, sw-calibration-access=READ-ONLY, type-emitter=RTE
      element Element: array-size=8, array-size-semantics=FIXED-SIZE, implementation-data-type=u16p0
    Ary1D_u3p13_5: category=ARRAY, sw-calibration-access=READ-ONLY, type-emitter=RTE
      element Element: array-size=5, array-size-semantics=FIXED-SIZE, implementation-data-type=u3p13
    Ary1D_u9p7_4: category=ARRAY, sw-calibration-access=READ-ONLY, type-emitter=RTE
      element Element: array-size=4, array-size-semantics=FIXED-SIZE, implementation-data-type=u9p7
    Ary1D_u9p7_5: category=ARRAY, sw-calibration-access=READ-ONLY, type-emitter=RTE
      element Element: array-size=5, array-size-semantics=FIXED-SIZE, implementation-data-type=u9p7
    Ary1D_u9p7_8: category=ARRAY, sw-calibration-access=READ-ONLY, type-emitter=RTE
      element Element: array-size=8, array-size-semantics=FIXED-SIZE, implementation-data-type=u9p7
    Ary2D_u16p0_2_8: category=ARRAY, sw-calibration-access=READ-ONLY, type-emitter=RTE
      element Element: array-size=2, array-size-semantics=FIXED-SIZE, implementation-data-type=Ary1D_u16p0_8
    Ary2D_u9p7_2_5: category=ARRAY, sw-calibration-access=READ-ONLY, type-emitter=RTE
      element Element: array-size=2, array-size-semantics=FIXED-SIZE, implementation-data-type=Ary1D_u9p7_5
    Ary2D_u9p7_2_8: category=ARRAY, sw-calibration-access=READ-ONLY, type-emitter=RTE
      element Element: array-size=2, array-size-semantics=FIXED-SIZE, implementation-data-type=Ary1D_u9p7_8
    DutyCycThermProtnFilStValRec1: category=STRUCTURE, sw-calibration-access=READ-ONLY, type-emitter=RTE
      4 x element, all with category=TYPE_REFERENCE, implementation-data-type=ImplementationDataTypes/uint8:
        Fil{3..6}StVal
      symbol props DutyCycThermProtnFilStValRec1
    FilLpRec1: category=STRUCTURE, sw-calibration-access=READ-ONLY, type-emitter=NxtrFil
      element FilSt: implementation-data-type=ImplementationDataTypes/float32
      element FilGain: implementation-data-type=ImplementationDataTypes/float32
      symbol props FilLpRec1
    NtcNr1: compu {1..511=NTCNR_0X001..NTCNR_0X1FF}, implementation-data-type=uint16, type-emitter=RTE
    NtcSts1: compu {0=NTCSTS_PASSD, 1=NTCSTS_FAILD, 2=NTCSTS_PREPASSD, 3=NTCSTS_PREFAILD}, implementation-data-type=ImplementationDataTypes/uint8, type-emitter=RTE
    s15p0: implementation-data-type=sint16, type-emitter=RTE
    u16p0: implementation-data-type=uint16, type-emitter=RTE
    u3p13: implementation-data-type=uint16, type-emitter=RTE
    u9p7: implementation-data-type=uint16, type-emitter=RTE
package /Nexteer/NvMProxy_swc/DataTypes
  impl type NvM_RequestResultType: category=VALUE, base-type=NvM_RequestResultType, compu {0=NVM_REQ_OK, 1=NVM_REQ_NOT_OK, 2=NVM_REQ_PENDING, 3=NVM_REQ_INTEGRITY_FAILED, 4=NVM_REQ_BLOCK_SKIPPED, 5=NVM_REQ_NV_INVALIDATED, 6=NVM_REQ_CANCELED, 7=NVM_REQ_REDUNDANCY_FAILED, 8=NVM_REQ_RESTORED_FROM_ROM}
package /Nexteer/NvMProxy_swc/DataTypes/BaseTypes
  base type NvM_RequestResultType: category=FIXED_LENGTH, base-type-size=8, base-type-encoding=NONE, native-declaration=uint8
package /Nexteer/NvMProxy_swc/DataTypes/DataConstrs
  range NvM_BlockIdType_Constr: raw 1..32767
  range UInt8_Constr: raw 0..255
