AUTOSAR XML (schema 4-0-3)
standard types defined: boolean, dtRef_const_VOID, dtRef_VOID, float32, float64, sint16, sint16_least, sint32, sint32_least, sint64, sint8, sint8_least, uint16, uint16_least, uint32, uint32_least, uint64, uint8, uint8_least, boolean_CompuMethod, boolean_DataConstr, float32_DataConstr, float64_DataConstr, sint16_DataConstr, sint16_least_DataConstr, sint32_DataConstr, sint32_least_DataConstr, sint64_DataConstr, sint8_DataConstr, sint8_least_DataConstr, uint16_DataConstr, uint16_least_DataConstr, uint32_DataConstr, uint32_least_DataConstr, uint64_DataConstr, uint8_DataConstr, uint8_least_DataConstr, Boolean, UInt8
package /Nexteer/DataTypes
  16 x impl type, all with type-emitter=RTE:
    Ary1D_s4p11_20: category=ARRAY, sw-calibration-access=READ-ONLY
      element Element: array-size=20, array-size-semantics=FIXED-SIZE, implementation-data-type=s4p11
    Ary1D_u08_128: category=ARRAY, sw-calibration-access=READ-ONLY
      element Element: array-size=128, array-size-semantics=FIXED-SIZE, implementation-data-type=uint8
    Ary1D_u08_256: category=ARRAY, sw-calibration-access=READ-ONLY
      element Element: array-size=256, array-size-semantics=FIXED-SIZE, implementation-data-type=uint8
    Ary1D_u08_512: category=ARRAY, sw-calibration-access=READ-ONLY
      element Element: array-size=512, array-size-semantics=FIXED-SIZE, implementation-data-type=uint8
    Ary1D_u8p8_20: category=ARRAY, sw-calibration-access=READ-ONLY
      element Element: array-size=20, array-size-semantics=FIXED-SIZE, implementation-data-type=u8p8
    Ary1D_u9p7_12: category=ARRAY, sw-calibration-access=READ-ONLY
      element Element: array-size=12, array-size-semantics=FIXED-SIZE, implementation-data-type=u9p7
    Ary2D_s4p11_12_20: category=ARRAY, sw-calibration-access=READ-ONLY
      element Element: array-size=12, array-size-semantics=FIXED-SIZE, implementation-data-type=Ary1D_s4p11_20
    Ary2D_u8p8_12_20: category=ARRAY, sw-calibration-access=READ-ONLY
      element Element: array-size=12, array-size-semantics=FIXED-SIZE, implementation-data-type=Ary1D_u8p8_20
    Ford_LatCtlLim_D_Stat: compu {0=Cx0_LimitNotReached, 1=Cx1_LimitClose, 2=Cx2_LimitReached, 3=Cx3_LimitWithDriverActive}, implementation-data-type=uint8
    Ford_LatCtlSte_D_Stat: compu {0=Cx0_Unavailable, 1=Cx1_Available, 2=Cx2_ContLatControlInProgress, 3=Cx3_RampOut, 4=Cx4_Denied, 5=Cx5_NotUsed1, 6=Cx6_NotUsed2, 7=Cx7_NotUsed3}, implementation-data-type=uint8
    FordArbnCmd1: compu {0=Cx0_PASSIVE, 3=Cx3_ACTIVE, 5=Cx5_LOCKED, 99=Cx99_DONT_CARE}, implementation-data-type=uint8
    FordFeatSt1: compu {0=Cx0_PASSIVE, 1=Cx1_ACTIVATION_REQUEST, 2=Cx2_RAMP_IN_REQUEST, 3=Cx3_ACTIVE, 4=Cx4_RAMP_OUT_REQUEST, 5=Cx5_LOCKED}, implementation-data-type=uint8
    s4p11: implementation-data-type=sint16
    s8p7: implementation-data-type=sint16
    u8p8: implementation-data-type=uint16
    u9p7: implementation-data-type=uint16
package /Nexteer/NvMProxy_swc/DataTypes
  impl type NvM_RequestResultType: category=VALUE, base-type=NvM_RequestResultType, compu {0=NVM_REQ_OK, 1=NVM_REQ_NOT_OK, 2=NVM_REQ_PENDING, 3=NVM_REQ_INTEGRITY_FAILED, 4=NVM_REQ_BLOCK_SKIPPED, 5=NVM_REQ_NV_INVALIDATED, 6=NVM_REQ_CANCELED, 7=NVM_REQ_REDUNDANCY_FAILED, 8=NVM_REQ_RESTORED_FROM_ROM}
package /Nexteer/NvMProxy_swc/DataTypes/BaseTypes
  base type NvM_BlockIdType: category=FIXED_LENGTH, base-type-size=16, base-type-encoding=NONE, native-declaration=uint16
  base type NvM_RequestResultType: category=FIXED_LENGTH, base-type-size=8, base-type-encoding=NONE, native-declaration=uint8
