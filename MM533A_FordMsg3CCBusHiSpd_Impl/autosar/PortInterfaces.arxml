AUTOSAR XML (schema 4-0-3)
package /Ford/PortInterfaces
  7 x sender receiver interface:
    Ford_LaActAvail_D_Actl_PortIf1: invalidation-policy{data-element=Ford_LaActAvail_D_Actl, handle-invalid=DONT-INVALIDATE}
      data Ford_LaActAvail_D_Actl: sw-calibration-access=READ-ONLY, type=Ford_LaActAvail_D_Actl
    Ford_LaActDeny_B_Actl_PortIf1: invalidation-policy{data-element=Ford_LaActDeny_B_Actl, handle-invalid=DONT-INVALIDATE}
      data Ford_LaActDeny_B_Actl: sw-calibration-access=READ-ONLY, type=Ford_LaActDeny_B_Actl
    Ford_LaHandsOff_B_Actl_PortIf1: invalidation-policy{data-element=Ford_LaHandsOff_B_Actl, handle-invalid=DONT-INVALIDATE}
      data Ford_LaHandsOff_B_Actl: sw-calibration-access=READ-ONLY, type=Ford_LaHandsOff_B_Actl
    Ford_LsmcBrk_Tq_Rq_PortIf1: invalidation-policy{data-element=Ford_LsmcBrk_Tq_Rq, handle-invalid=DONT-INVALIDATE}
      data Ford_LsmcBrk_Tq_Rq: sw-calibration-access=READ-ONLY, type=Ford_LsmcBrk_Tq_Rq
    Ford_LsmcBrkDecelEnbl_D_Rq_PortIf1: invalidation-policy{data-element=Ford_LsmcBrkDecelEnbl_D_Rq, handle-invalid=DONT-INVALIDATE}
      data Ford_LsmcBrkDecelEnbl_D_Rq: sw-calibration-access=READ-ONLY, type=Ford_LsmcBrkDecelEnbl_D_Rq
    Ford_TjaHandsOnCnfdnc_B_Est_PortIf1: invalidation-policy{data-element=Ford_TjaHandsOnCnfdnc_B_Est, handle-invalid=DONT-INVALIDATE}
      data Ford_TjaHandsOnCnfdnc_B_Est: sw-calibration-access=READ-ONLY, type=Ford_TjaHandsOnCnfdnc_B_Est
    Ford_TrlrAn_An_TrgtCalc_PortIf1: invalidation-policy{data-element=Ford_TrlrAn_An_TrgtCalc, handle-invalid=DONT-INVALIDATE}
      data Ford_TrlrAn_An_TrgtCalc: sw-calibration-access=READ-ONLY, type=Ford_TrlrAn_An_TrgtCalc
package /Nexteer/PortInterfaces
  sender receiver interface float32_PortIf1: invalidation-policy{data-element=float32_PortIf1/Val, handle-invalid=DONT-INVALIDATE}
    data Val: sw-calibration-access=READ-ONLY, type=float32
  sender receiver interface uint8_PortIf1: invalidation-policy{data-element=uint8_PortIf1/Val, handle-invalid=DONT-INVALIDATE}
    data Val: sw-calibration-access=READ-ONLY, type=uint8
