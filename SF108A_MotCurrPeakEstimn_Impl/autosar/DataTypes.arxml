AUTOSAR XML (schema 4-0-3)
standard types defined: boolean, float32, uint8, boolean_CompuMethod, boolean_DataConstr, float32_DataConstr, uint8_DataConstr, float64_DataConstr, sint16_DataConstr, sint32_DataConstr, sint8_DataConstr, uint16_DataConstr, uint32_DataConstr, float64, sint16, sint32, sint8, uint16, uint32
package /Nexteer/DataTypes
  impl type FilLpRec1: category=STRUCTURE, sw-calibration-access=READ-ONLY, type-emitter=NxtrFil
    element FilSt: implementation-data-type=ImplementationDataTypes/float32
    element FilGain: implementation-data-type=ImplementationDataTypes/float32
    symbol props FilLpRec1
