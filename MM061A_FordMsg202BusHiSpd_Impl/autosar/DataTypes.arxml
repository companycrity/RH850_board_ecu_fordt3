AUTOSAR XML (schema 4-0-3)
standard types defined: boolean, float32, uint16, uint32, uint8, boolean_CompuMethod, boolean_DataConstr, float32_DataConstr, uint16_DataConstr, uint32_DataConstr, uint8_DataConstr
package /DataType/Unit
  unit U_kph: display-name=kph, factor-si-to-unit=1, offset-si-to-unit=0
  unit U_SED: display-name=SED, factor-si-to-unit=1, offset-si-to-unit=0
  unit Unitless: display-name=Unitless, factor-si-to-unit=1, offset-si-to-unit=0
package /Ford/DataTypes
  6 x impl type, all with category=VALUE, sw-calibration-access=READ-ONLY:
    Ford_GearRvrse_D_Actl: base-type=DataType/uint8, compu {phys=raw for raw 0..7, 0=Cx0_Inactive_not_confirmed, 1=Cx1_Inactive_confirmed, 2=Cx2_Active_not_confirmed, 3=Cx3_Active_confirmed, 4=Cx4_NotUsed_1, 5=Cx5_NotUsed_2, 6=Cx6_NotUsed_3, 7=Cx7_Fault; unit SED}, range raw 0..7
    Ford_Veh_V_ActlEng: base-type=DataType/uint16, compu {phys=raw*0.01 for raw 0..65535; unit kph}
    Ford_VehVActlEng_D_Qf: base-type=DataType/uint8, compu {phys=raw for raw 0..3, 0=Cx0_Faulty, 1=Cx1_No_Data_Exists, 2=Cx2_Not_Within_Specifications, 3=Cx3_OK; unit SED}, range raw 0..3
    Ford_VehVActlEng_No_Cnt: base-type=DataType/uint8, compu {phys=raw for raw 0..15; unit Unitless}, range raw 0..15
    Ford_VehVActlEng_No_Cs: base-type=DataType/uint8, compu {phys=raw for raw 0..255; unit Unitless}
    Ford_VehVTrlrAid_B_Avail: base-type=DataType/boolean, compu {phys=raw for raw 0..1, 0=Cx0_No, 1=Cx1_Yes; unit SED}
package /Nexteer/DataTypes
  impl type NtcNr1: compu {1..511=NTCNR_0X001..NTCNR_0X1FF}, implementation-data-type=uint16, type-emitter=RTE
  impl type NtcSts1: compu {0=NTCSTS_PASSD, 1=NTCSTS_FAILD, 2=NTCSTS_PREPASSD, 3=NTCSTS_PREFAILD}, implementation-data-type=uint8, type-emitter=RTE
