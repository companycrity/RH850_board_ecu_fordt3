AUTOSAR XML (schema 4-0-3)
standard types defined: float32_DataConstr, float64_DataConstr, sint16_DataConstr, sint32_DataConstr, sint8_DataConstr, uint16_DataConstr, uint32_DataConstr, uint8_DataConstr, boolean, float32, float64, sint16, sint32, sint8, uint16, uint32, uint8
package /DataDictionary/Units
  35 x unit, all with factor-si-to-unit=1, offset-si-to-unit=0:
    Ampr: display-name=Ampr
    AmprPerVolt: display-name=AmprPerVolt
    Cnt: display-name=Cnt
    DegCgrd: display-name=DegCgrd
    DegCgrdPerVolt: display-name=DegCgrdPerVolt
    FixdPt: display-name=FixdPt
    Henry: display-name=Henry
    HwDeg: display-name=HwDeg
    HwDegPerSec: display-name=HwDegPerSec
    HwNwtMtr: display-name=HwNwtMtr
    HwNwtMtrPerHwDeg: display-name=HwNwtMtrPerHwDeg
    HwNwtMtrPerMotNwtMtr: display-name=HwNwtMtrPerMotNwtMtr
    Hz: display-name=Hz
    Kph: display-name=Kph
    KphPerSec: display-name=KphPerSec
    KphPerSecSqd: display-name=KphPerSecSqd
    MotDeg: display-name=MotDeg
    MotDegPerHwDeg: display-name=MotDegPerHwDeg
    MotNwtMtr: display-name=MotNwtMtr
    MotNwtMtrPerMotRadPerSec: display-name=MotNwtMtrPerMotRadPerSec
    MotRad: display-name=MotRad
    MotRadPerSec: display-name=MotRadPerSec
    MtrPerSecSqd: display-name=MtrPerSecSqd
    NanoSec: display-name=NanoSec
    Ohm: display-name=Ohm
    OhmPerDegCgrd: display-name=OhmPerDegCgrd
    Sec: display-name=Sec
    Uls: display-name=Uls
    UlsPerSec: display-name=UlsPerSec
    VehDegPerSec: display-name=VehDegPerSec
    VehDegPerSecSqd: display-name=VehDegPerSecSqd
    Volt: display-name=Volt
    VoltNanoSec: display-name=VoltNanoSec
    VoltPerMotRadPerSec: display-name=VoltPerMotRadPerSec
    VoltPerMotRadPerSecPerDegCgrd: display-name=VoltPerMotRadPerSecPerDegCgrd
package /Nexteer/DataTypes
  4 x impl type, all with category=TYPE_REFERENCE, implementation-data-type=uint8, type-emitter=RTE:
    AdrMpgReqTyp1: compu {phys=raw for raw 0, phys=raw for raw 1}
    CalCopySts1: compu {0=CALCOPYSTS_NOTRDY, 1=CALCOPYSTS_COPYPNDING, 2=CALCOPYSTS_COPYCMPL, 3=CALCOPYSTS_PROCERR}
    GetSegMod1: compu {0=GETSEGMOD_ADRINFO, 1=GETSEGMOD_STDINFO, 2=GETSEGMOD_ADRMPG}
    MfgEnaSt1: compu {0=MFGENAST_PRDNMOD, 1=MFGENAST_MFGMOD, 2=MFGENAST_TESTMOD}
