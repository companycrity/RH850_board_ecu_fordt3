AUTOSAR XML (schema 4-0-3)
# COPYRIGHT
# Copyright(c) 2015-2016 Renesas Electronics Corporation
# 5. Copyright Information is updated.
package /Renesas/EcucDefs_Mcu
  bsw implementation Mcu_Impl: programming-language=C, sw-version=1.1.0, vendor-id=59, ar-release-version=4.0.3, vendor-api-infix=Renesas, behavior=BswInternalBehavior_0, preconfigured-configuration=Mcu_Preconfiguration
  module config Mcu_Preconfiguration: definition=Mcu, implementation-config-variant=VARIANT-PRE-COMPILE
    McuResetReason_0 (McuRstRsnConfPowOnRst): McuResetReason=0
    McuResetReason_1 (McuRstRsnConfTerminalRst): McuResetReason=1
    McuResetReason_2 (McuRstRsnConfCvmRst): McuResetReason=2
    McuResetReason_3 (McuRstRsnConfSwSysRst): McuResetReason=3
    McuResetReason_4 (McuRstRsnConfWdtRst): McuResetReason=4
    McuResetReason_5 (McuRstRsnConfLockStepCoreRst): McuResetReason=5
    McuResetReason_6 (McuRstRsnConfPbusFssRst): McuResetReason=6
    McuResetReason_7 (McuRstRsnConfBusBridgeErrorRst): McuResetReason=7
    McuResetReason_8 (McuRstRsnConfSafetyMechCompRst): McuResetReason=8
    McuResetReason_9 (McuRstRsnConfTempSensorRst): McuResetReason=9
    McuResetReason_10 (McuRstRsnConfClma0Rst): McuResetReason=10
    McuResetReason_11 (McuRstRsnConfClma1Rst): McuResetReason=11
    McuResetReason_12 (McuRstRsnConfClma2Rst): McuResetReason=12
    McuResetReason_13 (McuRstRsnConfClma3Rst): McuResetReason=13
    McuResetReason_14 (McuRstRsnConfClma5Rst): McuResetReason=14
    McuResetReason_15 (McuRstRsnConfLRamEccDedRst): McuResetReason=15
    McuResetReason_16 (McuRstRsnConfGRamEccDedRst): McuResetReason=16
    McuResetReason_17 (McuRstRsnConfCacheRamEdcRst): McuResetReason=17
    McuResetReason_18 (McuRstRsnConfCodeFlsEccDedRst): McuResetReason=18
    McuResetReason_19 (McuRstRsnConfDataFlsEccDedRst): McuResetReason=19
    McuResetReason_20 (McuRstRsnConfCsihRamEccDedRst): McuResetReason=20
    McuResetReason_21 (McuRstRsnConfCanRamEccDedRst): McuResetReason=21
    McuResetReason_22 (McuRstRsnConfEthRamDedRst): McuResetReason=22
    McuResetReason_23 (McuRstRsnConfFrRamEccDedRst): McuResetReason=23
    McuResetReason_24 (McuRstRsnConfGtmRamEccDedRst): McuResetReason=24
    McuResetReason_25 (McuRstRsnConfBusEccDedRst): McuResetReason=25
    McuResetReason_26 (McuRstRsnConfBusEccSedRst): McuResetReason=26
    McuResetReason_27 (McuRstRsnConfLRamAddrOvfRst): McuResetReason=27
    McuResetReason_28 (McuRstRsnConfGRamAddrOvfRst): McuResetReason=28
    McuResetReason_29 (McuRstRsnConfCodeFlsAddrOvfRst): McuResetReason=29
    McuResetReason_30 (McuRstRsnConfDataFlsAddrOvfRst): McuResetReason=30
    McuResetReason_31 (McuRstRsnConfPeriRamEccAddrOvfRst): McuResetReason=31
    McuResetReason_32 (McuRstRsnConfDtsRamEccDedRst): McuResetReason=32
    McuResetReason_33 (McuRstRsnConfDtsRamEccSedRst): McuResetReason=33
    McuResetReason_34 (McuRstRsnConfLRamEccSedRst): McuResetReason=34
    McuResetReason_35 (McuRstRsnConfGRamEccSedRst): McuResetReason=35
    McuResetReason_36 (McuRstRsnConfCodeFlsEccSedRst): McuResetReason=36
    McuResetReason_37 (McuRstRsnConfDataFlsEccSedRst): McuResetReason=37
    McuResetReason_38 (McuRstRsnConfCsihRamEccSedRst): McuResetReason=38
    McuResetReason_39 (McuRstRsnConfCanRamEccSedRst): McuResetReason=39
    McuResetReason_40 (McuRstRsnConfEthRamEccSedRst): McuResetReason=40
    McuResetReason_41 (McuRstRsnConfFrRamEccSedRst): McuResetReason=41
    McuResetReason_42 (McuRstRsnConfGtmRamEccSedRst): McuResetReason=42
    McuResetReason_43 (McuRstRsnConfPEGuardRst): McuResetReason=43
    McuResetReason_44 (McuRstRsnConfGramGuardRst): McuResetReason=44
    McuResetReason_45 (McuRstRsnConfMemcGuardRst): McuResetReason=45
    McuResetReason_46 (McuRstRsnConfSlaveGuardRst): McuResetReason=46
    McuResetReason_47 (McuRstRsnConfCodeFlsPEUnmapAccessRst): McuResetReason=47
    McuResetReason_48 (McuRstRsnConfGramPEUnmapAccessRst): McuResetReason=48
    McuResetReason_49 (McuRstRsnConfLpbPEUnmapAccessRst): McuResetReason=49
    McuResetReason_50 (McuRstRsnConfPBusUnmapAccessRst): McuResetReason=50
    McuResetReason_51 (McuRstRsnConfHBusUnmapAccessRst): McuResetReason=51
    McuResetReason_52 (McuRstRsnConfCodeFlsGvciUnmapAccessRst): McuResetReason=52
    McuResetReason_53 (McuRstRsnConfGramFlsGvciUnmapAccessRst): McuResetReason=53
    McuResetReason_54 (McuRstRsnConfResHbusUnmapAccessRst): McuResetReason=54
    McuResetReason_55 (McuRstRsnConfDmaTransferRst): McuResetReason=55
    McuResetReason_56 (McuRstRsnConfDmaUnmappedRst): McuResetReason=56
    McuResetReason_57 (McuRstRsnConfFlsSequenceRst): McuResetReason=57
    McuResetReason_58 (McuRstRsnConfFlsFaciRst): McuResetReason=58
    McuResetReason_59 (McuRstRsnConfAdcParityRst): McuResetReason=59
    McuResetReason_60 (McuRstRsnConfPEUnintenEnableDisableRst): McuResetReason=60
    McuResetReason_61 (McuRstRsnConfUnintenDeactUserRst): McuResetReason=61
    McuResetReason_62 (McuRstRsnConfUnintenActCfpModeRst): McuResetReason=62
    McuResetReason_63 (McuRstRsnConfUnintenDebugEnableDetectRst): McuResetReason=63
    McuResetReason_64 (McuRstRsnConfUnintenActTestModeRst): McuResetReason=64
    McuResetReason_65 (McuRstRsnConfEcmCompRst): McuResetReason=65
    McuResetReason_66 (McuRstRsnConfDebuggerRst): McuResetReason=66
    McuResetReason_67 (McuRstRsnConfSwApplRst): McuResetReason=67
    McuResetReason_68 (McuRstRsnConfBistRst): McuResetReason=68
    McuResetReason_69 (McuRstRsnConfRstUndefined): McuResetReason=69
    McuResetReason_70 (McuRstRsnConfRstUnknown): McuResetReason=70
  bsw module description Mcu: module-id=101
    bsw internal behavior BswInternalBehavior_0
      exclusive area MCU_PWR_MODE_PSC_PROTECTION
      exclusive area MCU_REGISTER_PROTECTION
      exclusive area MCU_VARIABLE_PROTECTION
      4 x bsw interrupt entity:
        BswInterruptEntity_0: implemented-entry=MCU_FEINT_ISR, interrupt-category=CAT-1, interrupt-source=INTECMnNMI
        BswInterruptEntity_1: implemented-entry=MCU_FEINT_CAT2_ISR, interrupt-category=CAT-2, interrupt-source=INTECMnNMI
        BswInterruptEntity_2: implemented-entry=MCU_ECM_EIC_ISR, interrupt-category=CAT-1, interrupt-source=INTECMnMI
        BswInterruptEntity_3: implemented-entry=MCU_ECM_EIC_CAT2_ISR, interrupt-category=CAT-2, interrupt-source=INTECMnMI
      11 x bsw called entity:
        BswCalledEntity_0: can-enter-exclusive-area=MCU_REGISTER_PROTECTION, implemented-entry=Mcu_Init
        BswCalledEntity_1: can-enter-exclusive-area=MCU_REGISTER_PROTECTION, implemented-entry=Mcu_InitRamSection
        BswCalledEntity_2: implemented-entry=Mcu_InitClock
        BswCalledEntity_3: implemented-entry=Mcu_DistributePllClock
        BswCalledEntity_4: implemented-entry=Mcu_GetPllStatus
        BswCalledEntity_5: implemented-entry=Mcu_GetResetReason
        BswCalledEntity_6: implemented-entry=Mcu_GetResetRawValue
        BswCalledEntity_7: implemented-entry=Mcu_PerformReset
        BswCalledEntity_8: can-enter-exclusive-area=MCU_PWR_MODE_PSC_PROTECTION, implemented-entry=Mcu_SetMode
        BswCalledEntity_9: can-enter-exclusive-area=MCU_VARIABLE_PROTECTION, implemented-entry=Mcu_GetRamState
        BswCalledEntity_10: implemented-entry=Mcu_GetVersionInfo
  15 x bsw module entry, all with sw-service-impl-policy=STANDARD:
    MCU_FEINT_ISR: is-reentrant=true, is-synchronous=false, call-type=INTERRUPT, execution-context=INTERRUPT-CAT-1
    MCU_FEINT_CAT2_ISR: is-reentrant=true, is-synchronous=false, call-type=INTERRUPT, execution-context=INTERRUPT-CAT-2
    MCU_ECM_EIC_ISR: is-reentrant=true, is-synchronous=false, call-type=INTERRUPT, execution-context=INTERRUPT-CAT-1
    MCU_ECM_EIC_CAT2_ISR: is-reentrant=true, is-synchronous=false, call-type=INTERRUPT, execution-context=INTERRUPT-CAT-2
    Mcu_Init: is-reentrant=false, is-synchronous=true, call-type=REGULAR, execution-context=TASK, service-id=0
    Mcu_InitRamSection: is-reentrant=false, is-synchronous=true, call-type=REGULAR, execution-context=TASK, service-id=1
    Mcu_InitClock: is-reentrant=false, is-synchronous=true, call-type=REGULAR, execution-context=TASK, service-id=2
    Mcu_DistributePllClock: is-reentrant=false, is-synchronous=true, call-type=REGULAR, execution-context=TASK, service-id=3
    Mcu_GetPllStatus: is-reentrant=true, is-synchronous=true, call-type=REGULAR, execution-context=TASK, service-id=4
    Mcu_GetResetReason: is-reentrant=true, is-synchronous=true, call-type=REGULAR, execution-context=TASK, service-id=5
    Mcu_GetResetRawValue: is-reentrant=true, is-synchronous=true, call-type=REGULAR, execution-context=TASK, service-id=6
    Mcu_PerformReset: is-reentrant=false, is-synchronous=true, call-type=REGULAR, execution-context=TASK, service-id=7
    Mcu_SetMode: is-reentrant=false, is-synchronous=true, call-type=REGULAR, execution-context=TASK, service-id=8
    Mcu_GetRamState: is-reentrant=false, is-synchronous=true, call-type=REGULAR, execution-context=TASK, service-id=10
    Mcu_GetVersionInfo: is-reentrant=true, is-synchronous=true, call-type=REGULAR, execution-context=TASK, service-id=9
