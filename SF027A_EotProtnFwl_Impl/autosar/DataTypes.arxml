AUTOSAR XML (schema 4-0-3)
standard types defined: float32_DataConstr, float64_DataConstr, sint16_DataConstr, sint32_DataConstr, sint8_DataConstr, uint16_DataConstr, uint32_DataConstr, uint8_DataConstr, boolean, float32, float64, sint16, sint32, sint8, uint16, uint32, uint8
package /Nexteer/DataTypes
  15 x impl type, all with type-emitter=RTE:
    Ary1D_s11p4_5: category=ARRAY, sw-calibration-access=READ-ONLY
      element Element: array-size=5, array-size-semantics=FIXED-SIZE, implementation-data-type=s11p4
    Ary1D_s4p11_5: category=ARRAY, sw-calibration-access=READ-ONLY
      element Element: array-size=5, array-size-semantics=FIXED-SIZE, implementation-data-type=s4p11
    Ary1D_s7p8_5: category=ARRAY, sw-calibration-access=READ-ONLY
      element Element: array-size=5, array-size-semantics=FIXED-SIZE, implementation-data-type=s7p8
    Ary1D_u12p4_2: category=ARRAY, sw-calibration-access=READ-ONLY
      element Element: array-size=2, array-size-semantics=FIXED-SIZE, implementation-data-type=u12p4
    Ary1D_u9p7_4: category=ARRAY, sw-calibration-access=READ-ONLY
      element Element: array-size=4, array-size-semantics=FIXED-SIZE, implementation-data-type=u9p7
    Ary2D_s7p8_4_5: category=ARRAY, sw-calibration-access=READ-ONLY
      element Element: array-size=4, array-size-semantics=FIXED-SIZE, implementation-data-type=Ary1D_s7p8_5
    Ary2D_u12p4_4_2: category=ARRAY, sw-calibration-access=READ-ONLY
      element Element: array-size=4, array-size-semantics=FIXED-SIZE, implementation-data-type=Ary1D_u12p4_2
    MfgEnaSt1: compu {0=MFGENAST_PRDNMOD, 1=MFGENAST_MFGMOD, 2=MFGENAST_TESTMOD}, implementation-data-type=uint8
    NtcNr1: compu {1..511=NTCNR_0X001..NTCNR_0X1FF}, implementation-data-type=uint16
    NtcSts1: compu {0=NTCSTS_PASSD, 1=NTCSTS_FAILD, 2=NTCSTS_PREPASSD, 3=NTCSTS_PREFAILD}, implementation-data-type=uint8
    s11p4: implementation-data-type=sint16
    s4p11: implementation-data-type=sint16
    s7p8: implementation-data-type=sint16
    u12p4: implementation-data-type=uint16
    u9p7: implementation-data-type=uint16
