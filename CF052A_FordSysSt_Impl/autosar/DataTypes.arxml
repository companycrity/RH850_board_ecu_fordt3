AUTOSAR XML (schema 4-0-3)
standard types defined: boolean, float32, uint16, uint8, boolean_CompuMethod, boolean_DataConstr, float32_DataConstr, uint16_DataConstr, uint8_DataConstr
package /DataType/Unit
  unit U_SED: display-name=SED, factor-si-to-unit=1, offset-si-to-unit=0
package /Ford/DataTypes
  impl type Ford_EPAS_Failure: category=VALUE, base-type=DataType/uint8, sw-calibration-access=READ-ONLY, compu {phys=raw for raw 0..3, 0=Cx0_EPAS_OK_NO_MESSAGE, 1=Cx1_POWER_STRG_ASSIST_FAULT, 2=Cx2_SERVICE_POWER_STEERING, 3=Cx3_SERVICE_POWER_STEERING_NOW; unit SED}, range raw 0..3
  impl type Ford_PwPckTq_D_Stat: category=VALUE, base-type=DataType/uint8, sw-calibration-access=READ-ONLY, compu {phys=raw for raw 0..3, 0=Cx0_PwPckOff_TqNotAvailable, 1=Cx1_PwPckOn_TqNotAvailable, 2=Cx2_StartInPrgrss_TqNotAvail, 3=Cx3_PwPckOn_TqAvailable; unit SED}, range raw 0..3
  impl type Ford_SteMdule_D_Stat: category=VALUE, base-type=DataType/uint8, sw-calibration-access=READ-ONLY, compu {phys=raw for raw 0..7, 0=Cx0_EPAS_Initialization, 1=Cx1_Normal_Op_Limited_Assist, 2=Cx2_Normal_Op_Full_Assist, 3=Cx3_EPAS_Shutdown, 4=Cx4_System_Failure, 5=Cx5_EPAS_Failure2, 6=Cx6_EPAS_Failure3, 7=Cx7_NotUsed; unit SED}, range raw 0..7
package /Nexteer/DataTypes
  6 x impl type, all with category=TYPE_REFERENCE, type-emitter=RTE:
    FordEpsSysSt1: compu {0=FORDEPSSYSST_EPS_ININ, 1=FORDEPSSYSST_EPS_NORM_OP_LIMD_ASSI, 2=FORDEPSSYSST_EPS_NORM_OP_FULL_ASSI, 3=FORDEPSSYSST_EPS_SYST_FAILR_LIMPHOME, 4=FORDEPSSYSST_EPS_SYST_FAILR_LIMPASIDE, 5=FORDEPSSYSST_EPS_SYST_FAILR_RAMPOUT, 6=FORDEPSSYSST_EPS_SYST_FAILR_ASSISTOFF, 7=FORDEPSSYSST_EPS_SHTDWN, 8=FORDEPSSYSST_EPS_PWRDWN}, implementation-data-type=uint8
    FordVltgOperSt1: compu {0=FORDVLTGOPERST_NORMVLTGOP, 1=FORDVLTGOPERST_LOVLTGOP_MONR, 2=FORDVLTGOPERST_LOVLTGOP_HICURR, 3=FORDVLTGOPERST_LOVLTGOP_TQSCAG, 4=FORDVLTGOPERST_LOVLTGOP_NOASSI, 5=FORDVLTGOPERST_HIVLTGOP, 6=FORDVLTGOPERST_HIVLTG_NOASSI}, implementation-data-type=uint8
    LoaSt1: compu {0=LOAST_NORM, 1=LOAST_LIMD, 2=LOAST_SWBASDMTGTN, 3=LOAST_FADEOUT, 4=LOAST_CTRLDSHTDWNREQD, 5=LOAST_IMDTSHTDWNREQD}, implementation-data-type=uint8
    NtcNr1: compu {1..511=NTCNR_0X001..NTCNR_0X1FF}, implementation-data-type=uint16
    SigQlfr1: compu {0=SIGQLFR_NORES, 1=SIGQLFR_PASSD, 2=SIGQLFR_FAILD}, implementation-data-type=uint8
    SysSt1: compu {0=SYSST_DI, 1=SYSST_OFF, 2=SYSST_ENA, 3=SYSST_WRMININ}, implementation-data-type=uint8
