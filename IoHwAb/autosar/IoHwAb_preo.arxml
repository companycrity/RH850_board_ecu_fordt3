AUTOSAR XML (schema 4-0-3)
# COPYRIGHT
# Copyright (c) 2013 by Vector Informatik GmbH. All rights reserved.
# This software is copyright protected and proprietary to Vector Informatik GmbH.
# Vector Informatik GmbH grants to you only those rights as set out in the license conditions.
package /MICROSAR  # IoHwAb Preconfiguration
  module config IoHwAb_Pre: definition=IoHwAb, implementation-config-variant=VARIANT-PRE-COMPILE
  module config IoHwAb_Rec: definition=IoHwAb
