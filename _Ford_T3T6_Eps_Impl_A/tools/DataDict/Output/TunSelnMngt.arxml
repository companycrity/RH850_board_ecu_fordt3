AUTOSAR XML (schema 4.0)
package /ActiveEcuC
  module config TunSelnMngt: implementation-config-variant=VARIANT-PRE-COMPILE
    TunSelnMngtCommon: OnlineCalibrationRamSize=4096
    CalibrationConfiguration
      6 x RuntimeSelectableCalibrationConfiguration:
        RtIdx00: RuntimeIndex=0, RuntimeComponentReference=CalRegn01Rt00, RuntimeComponentReference=CalRegn02Rt00GroupA, RuntimeComponentReference=CalRegn02Rt00GroupB
        RtIdx01: RuntimeIndex=1, RuntimeComponentReference=CalRegn01Rt01, RuntimeComponentReference=CalRegn02Rt01GroupA, RuntimeComponentReference=CalRegn02Rt01GroupB
        RtIdx02: RuntimeIndex=2, RuntimeComponentReference=CalRegn01Rt02, RuntimeComponentReference=CalRegn02Rt02GroupA, RuntimeComponentReference=CalRegn02Rt02GroupB
        RtIdx03: RuntimeIndex=3, RuntimeComponentReference=CalRegn01Rt03, RuntimeComponentReference=CalRegn02Rt03GroupA, RuntimeComponentReference=CalRegn02Rt03GroupB
        RtIdx04: RuntimeIndex=4, RuntimeComponentReference=CalRegn01Rt04, RuntimeComponentReference=CalRegn02Rt04GroupA, RuntimeComponentReference=CalRegn02Rt04GroupB
        RtIdx05: RuntimeIndex=5, RuntimeComponentReference=CalRegn01Rt05, RuntimeComponentReference=CalRegn02Rt05GroupA, RuntimeComponentReference=CalRegn02Rt05GroupB
      IninIdx00 (InitializationCalibrationConfiguration):
        InitializationIndex = 0
        InitializationComponentReference = CalRegn01Inin00
        InitializationComponentReference = CalRegn01Inin00GroupA
        InitializationComponentReference = CalRegn01Inin00GroupB
        InitializationComponentReference = CalRegn01Inin00GroupD
        InitializationComponentReference = CalRegn02Inin00
        InitializationComponentReference = CalRegn02Inin00GroupA
        InitializationComponentReference = CalRegn02Inin00GroupB
    3 x CalRegions:
      CalRegn00
      CalRegn01
        6 x RuntimeComponent:
          CalRegn01Rt00: ComponentPartOfIntegration=true
          CalRegn01Rt{01..05}: ComponentPartOfIntegration=false, RuntimeComponentReference=CalRegn01Rt00
        4 x InitializationComponent, all with ComponentPartOfIntegration=true:
          CalRegn01Inin00
          CalRegn01Inin00GroupA
          CalRegn01Inin00GroupB
          CalRegn01Inin00GroupD
        CalRegn01Cmn (CommonComponent): ComponentPartOfIntegration=true
        CalRegn01CmnGroupA (CommonComponent): ComponentPartOfIntegration=true
      CalRegn02
        12 x RuntimeComponent:
          CalRegn02Rt00GroupA: ComponentPartOfIntegration=true
          CalRegn02Rt{01..05}GroupA: ComponentPartOfIntegration=false, RuntimeComponentReference=CalRegn02Rt00GroupA
          CalRegn02Rt00GroupB: ComponentPartOfIntegration=true
          CalRegn02Rt{01..05}GroupB: ComponentPartOfIntegration=false, RuntimeComponentReference=CalRegn02Rt00GroupB
        3 x InitializationComponent, all with ComponentPartOfIntegration=true:
          CalRegn02Inin00
          CalRegn02Inin00GroupA
          CalRegn02Inin00GroupB
        3 x CommonComponent, all with ComponentPartOfIntegration=true:
          CalRegn02Cmn
          CalRegn02CmnGroupA
          CalRegn02CmnGroupB
    3 x OnlineCalibrationGroup:
      GroupA: GroupIndex=0, InitializationComponentReference=CalRegn01Inin00GroupA, CommonComponentReference=CalRegn01CmnGroupA, RuntimeComponentReference=CalRegn02Rt00GroupA, RuntimeComponentReference=CalRegn02Rt01GroupA, RuntimeComponentReference=CalRegn02Rt02GroupA, RuntimeComponentReference=CalRegn02Rt03GroupA, RuntimeComponentReference=CalRegn02Rt04GroupA, RuntimeComponentReference=CalRegn02Rt05GroupA, InitializationComponentReference=CalRegn02Inin00GroupA, CommonComponentReference=CalRegn02CmnGroupA
      GroupB: GroupIndex=1, InitializationComponentReference=CalRegn01Inin00GroupB, RuntimeComponentReference=CalRegn02Rt00GroupB, RuntimeComponentReference=CalRegn02Rt01GroupB, RuntimeComponentReference=CalRegn02Rt02GroupB, RuntimeComponentReference=CalRegn02Rt03GroupB, RuntimeComponentReference=CalRegn02Rt04GroupB, RuntimeComponentReference=CalRegn02Rt05GroupB, InitializationComponentReference=CalRegn02Inin00GroupB, CommonComponentReference=CalRegn02CmnGroupB
      GroupD: GroupIndex=2, InitializationComponentReference=CalRegn01Inin00GroupD
