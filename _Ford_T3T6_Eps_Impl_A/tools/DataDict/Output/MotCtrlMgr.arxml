AUTOSAR XML (schema 4.0)
package /ActiveEcuC
  module config MotCtrlMgr: implementation-config-variant=VARIANT-PRE-COMPILE
    MotCtrlMgrConfigSet
      SignalManagement
        144 x Signal:
          MotCurrQaxCoggCmd: WrittenInMotCtrlRunnable=true, ReadInMotCtrlRunnable=true, WrittenIn2msRunnable=false, ReadIn2msRunnable=false, ImplementationDataType=float32, Size=1, InitialValue=0.0F, Min=-6, Max=6, Units=Ampr
          MotCurrQaxRplCmd: WrittenInMotCtrlRunnable=true, ReadInMotCtrlRunnable=true, WrittenIn2msRunnable=false, ReadIn2msRunnable=false, ImplementationDataType=float32, Size=1, InitialValue=0.0F, Min=-29, Max=29, Units=Ampr
          MotAgElecDlyRpl: WrittenInMotCtrlRunnable=false, ReadInMotCtrlRunnable=true, WrittenIn2msRunnable=true, ReadIn2msRunnable=false, ImplementationDataType=float32, Size=1, InitialValue=0.0F, Min=-1.62, Max=1.62, Units=MotRad
          MotCurrQaxToMotTqGain: WrittenInMotCtrlRunnable=false, ReadInMotCtrlRunnable=true, WrittenIn2msRunnable=true, ReadIn2msRunnable=false, ImplementationDataType=float32, Size=1, InitialValue=0.021651F, Min=0.021651, Max=0.406952, Units=VoltPerMotRadPerSec
          MotTqRplCoggOrder1Mgn: WrittenInMotCtrlRunnable=false, ReadInMotCtrlRunnable=true, WrittenIn2msRunnable=true, ReadIn2msRunnable=false, ImplementationDataType=float32, Size=1, InitialValue=0.0F, Min=0, Max=0.5, Units=MotNwtMtr
          MotTqRplCoggOrder1Pha: WrittenInMotCtrlRunnable=false, ReadInMotCtrlRunnable=true, WrittenIn2msRunnable=true, ReadIn2msRunnable=false, ImplementationDataType=float32, Size=1, InitialValue=0.0F, Min=0, Max=6.2831853, Units=MotRad
          MotTqRplCoggOrder2Mgn: WrittenInMotCtrlRunnable=false, ReadInMotCtrlRunnable=true, WrittenIn2msRunnable=true, ReadIn2msRunnable=false, ImplementationDataType=float32, Size=1, InitialValue=0.0F, Min=0, Max=0.5, Units=MotNwtMtr
          MotTqRplCoggOrder2Pha: WrittenInMotCtrlRunnable=false, ReadInMotCtrlRunnable=true, WrittenIn2msRunnable=true, ReadIn2msRunnable=false, ImplementationDataType=float32, Size=1, InitialValue=0.0F, Min=0, Max=6.2831853, Units=MotRad
          MotTqRplCoggOrder3Mgn: WrittenInMotCtrlRunnable=false, ReadInMotCtrlRunnable=true, WrittenIn2msRunnable=true, ReadIn2msRunnable=false, ImplementationDataType=float32, Size=1, InitialValue=0.0F, Min=0, Max=0.5, Units=MotNwtMtr
          MotTqRplCoggOrder3Pha: WrittenInMotCtrlRunnable=false, ReadInMotCtrlRunnable=true, WrittenIn2msRunnable=true, ReadIn2msRunnable=false, ImplementationDataType=float32, Size=1, InitialValue=0.0F, Min=0, Max=6.2831853, Units=MotRad
          MotCurrQaxCmdFinal: WrittenInMotCtrlRunnable=true, ReadInMotCtrlRunnable=false, WrittenIn2msRunnable=false, ReadIn2msRunnable=false, ImplementationDataType=float32, Size=1, InitialValue=0.0F, Min=-200, Max=200, Units=Ampr
          MotModlnIdx: WrittenInMotCtrlRunnable=true, ReadInMotCtrlRunnable=true, WrittenIn2msRunnable=false, ReadIn2msRunnable=false, ImplementationDataType=float32, Size=1, InitialValue=0.0F, Min=0, Max=1, Units=Uls
          MotPhaAdv: WrittenInMotCtrlRunnable=true, ReadInMotCtrlRunnable=true, WrittenIn2msRunnable=false, ReadIn2msRunnable=false, ImplementationDataType=uint16, Size=1, InitialValue=0U, Min=0, Max=0.9999847412, Units=MotRev
          MotVltgDax: WrittenInMotCtrlRunnable=true, ReadInMotCtrlRunnable=false, WrittenIn2msRunnable=false, ReadIn2msRunnable=true, ImplementationDataType=float32, Size=1, InitialValue=0.0F, Min=-26.5, Max=26.5, Units=Volt
          MotVltgQax: WrittenInMotCtrlRunnable=true, ReadInMotCtrlRunnable=false, WrittenIn2msRunnable=false, ReadIn2msRunnable=true, ImplementationDataType=float32, Size=1, InitialValue=0.0F, Min=-26.5, Max=26.5, Units=Volt
          MotAgElecDly: WrittenInMotCtrlRunnable=false, ReadInMotCtrlRunnable=true, WrittenIn2msRunnable=true, ReadIn2msRunnable=false, ImplementationDataType=float32, Size=1, InitialValue=0.0F, Min=-1.5, Max=1.5, Units=MotRad
          MotDampgDax: WrittenInMotCtrlRunnable=false, ReadInMotCtrlRunnable=true, WrittenIn2msRunnable=true, ReadIn2msRunnable=false, ImplementationDataType=float32, Size=1, InitialValue=0.0F, Min=-0.11, Max=5.5, Units=Ohm
          MotDampgQax: WrittenInMotCtrlRunnable=false, ReadInMotCtrlRunnable=true, WrittenIn2msRunnable=true, ReadIn2msRunnable=false, ImplementationDataType=float32, Size=1, InitialValue=0.0F, Min=-0.11, Max=5.5, Units=Ohm
          MotIntglGainDax: WrittenInMotCtrlRunnable=false, ReadInMotCtrlRunnable=true, WrittenIn2msRunnable=true, ReadIn2msRunnable=false, ImplementationDataType=float32, Size=1, InitialValue=0.0F, Min=0, Max=0.6, Units=Ohm
          MotIntglGainQax: WrittenInMotCtrlRunnable=false, ReadInMotCtrlRunnable=true, WrittenIn2msRunnable=true, ReadIn2msRunnable=false, ImplementationDataType=float32, Size=1, InitialValue=0.0F, Min=0, Max=0.6, Units=Ohm
          MotPropGainDax: WrittenInMotCtrlRunnable=false, ReadInMotCtrlRunnable=true, WrittenIn2msRunnable=true, ReadIn2msRunnable=false, ImplementationDataType=float32, Size=1, InitialValue=0.0F, Min=0, Max=2.25, Units=Ohm
          MotPropGainQax: WrittenInMotCtrlRunnable=false, ReadInMotCtrlRunnable=true, WrittenIn2msRunnable=true, ReadIn2msRunnable=false, ImplementationDataType=float32, Size=1, InitialValue=0.0F, Min=0, Max=2.25, Units=Ohm
          MotBackEmfVltg: WrittenInMotCtrlRunnable=false, ReadInMotCtrlRunnable=true, WrittenIn2msRunnable=true, ReadIn2msRunnable=false, ImplementationDataType=float32, Size=1, InitialValue=0.0F, Min=-101.25, Max=101.25, Units=Volt
          MotCurrDaxCmd: WrittenInMotCtrlRunnable=false, ReadInMotCtrlRunnable=true, WrittenIn2msRunnable=true, ReadIn2msRunnable=true, ImplementationDataType=float32, Size=1, InitialValue=0.0F, Min=0, Max=220, Units=Ampr
          MotCurrDaxMax: WrittenInMotCtrlRunnable=false, ReadInMotCtrlRunnable=true, WrittenIn2msRunnable=true, ReadIn2msRunnable=false, ImplementationDataType=float32, Size=1, InitialValue=0.0F, Min=0, Max=220, Units=Ampr
          MotCurrQaxCmd: WrittenInMotCtrlRunnable=false, ReadInMotCtrlRunnable=true, WrittenIn2msRunnable=true, ReadIn2msRunnable=true, ImplementationDataType=float32, Size=1, InitialValue=0.0F, Min=-220, Max=220, Units=Ampr
          MotReacncDax: WrittenInMotCtrlRunnable=false, ReadInMotCtrlRunnable=true, WrittenIn2msRunnable=true, ReadIn2msRunnable=false, ImplementationDataType=float32, Size=1, InitialValue=0.0F, Min=-2.87607, Max=2.87607, Units=Ohm
          MotReacncQax: WrittenInMotCtrlRunnable=false, ReadInMotCtrlRunnable=true, WrittenIn2msRunnable=true, ReadIn2msRunnable=false, ImplementationDataType=float32, Size=1, InitialValue=0.0F, Min=-2.87607, Max=2.87607, Units=Ohm
          MotVltgDaxFf: WrittenInMotCtrlRunnable=false, ReadInMotCtrlRunnable=true, WrittenIn2msRunnable=true, ReadIn2msRunnable=false, ImplementationDataType=float32, Size=1, InitialValue=0.0F, Min=-26.5, Max=26.5, Units=Volt
          MotVltgQaxFf: WrittenInMotCtrlRunnable=false, ReadInMotCtrlRunnable=true, WrittenIn2msRunnable=true, ReadIn2msRunnable=false, ImplementationDataType=float32, Size=1, InitialValue=0.0F, Min=-101.25, Max=101.25, Units=Volt
          MotInduDaxEstimdIvs: WrittenInMotCtrlRunnable=false, ReadInMotCtrlRunnable=true, WrittenIn2msRunnable=true, ReadIn2msRunnable=false, ImplementationDataType=float32, Size=1, InitialValue=8412.0F, Min=2440, Max=33334, Units=IvsHenry
          MotInduQaxEstimdIvs: WrittenInMotCtrlRunnable=false, ReadInMotCtrlRunnable=true, WrittenIn2msRunnable=true, ReadIn2msRunnable=false, ImplementationDataType=float32, Size=1, InitialValue=8412.0F, Min=2440, Max=33334, Units=IvsHenry
          MotREstimd: WrittenInMotCtrlRunnable=false, ReadInMotCtrlRunnable=true, WrittenIn2msRunnable=true, ReadIn2msRunnable=true, ImplementationDataType=float32, Size=1, InitialValue=0.005F, Min=0.005, Max=0.12565, Units=Ohm
          DualEcuMotCtrlMtgtnEna: WrittenInMotCtrlRunnable=false, ReadInMotCtrlRunnable=true, WrittenIn2msRunnable=true, ReadIn2msRunnable=true, ImplementationDataType=boolean, Size=1, InitialValue=FALSE, Min=0, Max=1, Units=Cnt
          MotAndThermProtnLoaMod: WrittenInMotCtrlRunnable=false, ReadInMotCtrlRunnable=true, WrittenIn2msRunnable=true, ReadIn2msRunnable=true, ImplementationDataType=uint8, Size=1, InitialValue=0U, Min=0, Max=7, Units=Cnt
          MotAgBufIdx: WrittenInMotCtrlRunnable=true, ReadInMotCtrlRunnable=false, WrittenIn2msRunnable=false, ReadIn2msRunnable=true, ImplementationDataType=uint8, Size=1, InitialValue=0U, Min=0, Max=7, Units=Cnt
          MotAgBuf: WrittenInMotCtrlRunnable=true, ReadInMotCtrlRunnable=true, WrittenIn2msRunnable=false, ReadIn2msRunnable=true, ImplementationDataType=uint16, Size=8, InitialValue=0U, 0U, 0U, 0U, 0U, 0U, 0U, 0U, Min=0, Max=0.9999847412, Units=MotRev
          MotAgTiBuf: WrittenInMotCtrlRunnable=true, ReadInMotCtrlRunnable=true, WrittenIn2msRunnable=false, ReadIn2msRunnable=true, ImplementationDataType=uint32, Size=8, InitialValue=0U, 62U, 125U, 187U, 250U, 312U, 375U, 437U, Min=0, Max=4294967295, Units=MicroSec
          MotVelMrf: WrittenInMotCtrlRunnable=false, ReadInMotCtrlRunnable=true, WrittenIn2msRunnable=true, ReadIn2msRunnable=true, ImplementationDataType=float32, Size=1, InitialValue=0.0F, Min=-1350, Max=1350, Units=MotRadPerSec
          VehSpd: WrittenInMotCtrlRunnable=false, ReadInMotCtrlRunnable=true, WrittenIn2msRunnable=true, ReadIn2msRunnable=true, ImplementationDataType=float32, Size=1, InitialValue=0.0F, Min=0, Max=511, Units=Kph
          DiagcStsIvtr1Inactv: WrittenInMotCtrlRunnable=false, ReadInMotCtrlRunnable=true, WrittenIn2msRunnable=true, ReadIn2msRunnable=true, ImplementationDataType=boolean, Size=1, InitialValue=FALSE, Min=0, Max=1, Units=Cnt
          IvtrFetFltPha: WrittenInMotCtrlRunnable=false, ReadInMotCtrlRunnable=true, WrittenIn2msRunnable=true, ReadIn2msRunnable=true, ImplementationDataType=uint8, Size=1, InitialValue=IVTRFETFLTPHA_NOPHASNGFETFLT, Min=0, Max=4, Units=Cnt, EnumerationNameReference=IvtrFetFltPha1
          IvtrFetFltTyp: WrittenInMotCtrlRunnable=false, ReadInMotCtrlRunnable=true, WrittenIn2msRunnable=true, ReadIn2msRunnable=true, ImplementationDataType=uint8, Size=1, InitialValue=IVTRFETFLTTYP_NOFETFLT, Min=0, Max=4, Units=Cnt, EnumerationNameReference=IvtrFetFltTyp1
          CmuOffs: WrittenInMotCtrlRunnable=true, ReadInMotCtrlRunnable=false, WrittenIn2msRunnable=false, ReadIn2msRunnable=false, ImplementationDataType=uint32, Size=1, InitialValue=0U, Min=0, Max=71429, Units=NanoSec
          PhaOnTiA: WrittenInMotCtrlRunnable=true, ReadInMotCtrlRunnable=true, WrittenIn2msRunnable=false, ReadIn2msRunnable=false, ImplementationDataType=uint32, Size=1, InitialValue=0U, Min=0, Max=71429, Units=NanoSec
          PhaOnTiB: WrittenInMotCtrlRunnable=true, ReadInMotCtrlRunnable=true, WrittenIn2msRunnable=false, ReadIn2msRunnable=false, ImplementationDataType=uint32, Size=1, InitialValue=0U, Min=0, Max=71429, Units=NanoSec
          PhaOnTiC: WrittenInMotCtrlRunnable=true, ReadInMotCtrlRunnable=true, WrittenIn2msRunnable=false, ReadIn2msRunnable=false, ImplementationDataType=uint32, Size=1, InitialValue=0U, Min=0, Max=71429, Units=NanoSec
          PhaOnTiSumA: WrittenInMotCtrlRunnable=true, ReadInMotCtrlRunnable=false, WrittenIn2msRunnable=false, ReadIn2msRunnable=true, ImplementationDataType=uint32, Size=1, InitialValue=0U, Min=0, Max=4294967295, Units=NanoSec
          PhaOnTiSumB: WrittenInMotCtrlRunnable=true, ReadInMotCtrlRunnable=false, WrittenIn2msRunnable=false, ReadIn2msRunnable=true, ImplementationDataType=uint32, Size=1, InitialValue=0U, Min=0, Max=4294967295, Units=NanoSec
          PhaOnTiSumC: WrittenInMotCtrlRunnable=true, ReadInMotCtrlRunnable=false, WrittenIn2msRunnable=false, ReadIn2msRunnable=true, ImplementationDataType=uint32, Size=1, InitialValue=0U, Min=0, Max=4294967295, Units=NanoSec
          PwmPerd: WrittenInMotCtrlRunnable=true, ReadInMotCtrlRunnable=true, WrittenIn2msRunnable=false, ReadIn2msRunnable=false, ImplementationDataType=uint32, Size=1, InitialValue=62500U, Min=55555, Max=71429, Units=NanoSec
          SwCalEna: WrittenInMotCtrlRunnable=true, ReadInMotCtrlRunnable=true, WrittenIn2msRunnable=false, ReadIn2msRunnable=false, ImplementationDataType=boolean, Size=1, InitialValue=FALSE, Min=0, Max=1, Units=Cnt
          SwCalModlnIdx: WrittenInMotCtrlRunnable=true, ReadInMotCtrlRunnable=true, WrittenIn2msRunnable=false, ReadIn2msRunnable=false, ImplementationDataType=float32, Size=1, InitialValue=0.0F, Min=0, Max=1, Units=Uls
          SwCalPosnIdx: WrittenInMotCtrlRunnable=true, ReadInMotCtrlRunnable=true, WrittenIn2msRunnable=false, ReadIn2msRunnable=false, ImplementationDataType=uint16, Size=1, InitialValue=0U, Min=0, Max=0.9999847412, Units=Cnt
          BrdgVltg: WrittenInMotCtrlRunnable=false, ReadInMotCtrlRunnable=true, WrittenIn2msRunnable=true, ReadIn2msRunnable=true, ImplementationDataType=float32, Size=1, InitialValue=6.0F, Min=6, Max=26.5, Units=Volt
          MotAgMeclCorrlnSt: WrittenInMotCtrlRunnable=false, ReadInMotCtrlRunnable=false, WrittenIn2msRunnable=true, ReadIn2msRunnable=false, ImplementationDataType=uint8, Size=1, InitialValue=7U, Min=0, Max=7, Units=Cnt
          MotAgMecl: WrittenInMotCtrlRunnable=true, ReadInMotCtrlRunnable=true, WrittenIn2msRunnable=false, ReadIn2msRunnable=false, ImplementationDataType=uint16, Size=1, InitialValue=0U, Min=0, Max=0.9999847412, Units=MotRev
          MotAgCumvAlgndMrfRev: WrittenInMotCtrlRunnable=true, ReadInMotCtrlRunnable=false, WrittenIn2msRunnable=false, ReadIn2msRunnable=true, ImplementationDataType=sint32, Size=1, InitialValue=0, Min=-32768, Max=32767.99998, Units=MotRev
          MotAgCumvInid: WrittenInMotCtrlRunnable=true, ReadInMotCtrlRunnable=false, WrittenIn2msRunnable=false, ReadIn2msRunnable=true, ImplementationDataType=boolean, Size=1, InitialValue=FALSE, Min=0, Max=1, Units=Cnt
          MotAgElec: WrittenInMotCtrlRunnable=true, ReadInMotCtrlRunnable=true, WrittenIn2msRunnable=false, ReadIn2msRunnable=false, ImplementationDataType=uint16, Size=1, InitialValue=0U, Min=0, Max=0.9999847412, Units=MotRevElec
          MotAg6CosRtAmpRecpr: WrittenInMotCtrlRunnable=false, ReadInMotCtrlRunnable=true, WrittenIn2msRunnable=true, ReadIn2msRunnable=false, ImplementationDataType=float32, Size=1, InitialValue=1.0F, Min=0.32, Max=5.1, Units=IvsVolt
          MotAg6CosRtOffs: WrittenInMotCtrlRunnable=false, ReadInMotCtrlRunnable=true, WrittenIn2msRunnable=true, ReadIn2msRunnable=false, ImplementationDataType=float32, Size=1, InitialValue=2.5F, Min=0.25, Max=3.75, Units=Volt
          MotAg6MeclQlfr: WrittenInMotCtrlRunnable=false, ReadInMotCtrlRunnable=false, WrittenIn2msRunnable=true, ReadIn2msRunnable=false, ImplementationDataType=uint8, Size=1, InitialValue=SIGQLFR_NORES, Min=0, Max=2, Units=Cnt, EnumerationNameReference=SigQlfr1
          MotAg6MeclRollgCntr: WrittenInMotCtrlRunnable=false, ReadInMotCtrlRunnable=false, WrittenIn2msRunnable=true, ReadIn2msRunnable=false, ImplementationDataType=uint8, Size=1, InitialValue=0U, Min=0, Max=255, Units=Cnt
          MotAg6SinRtAmpRecpr: WrittenInMotCtrlRunnable=false, ReadInMotCtrlRunnable=true, WrittenIn2msRunnable=true, ReadIn2msRunnable=false, ImplementationDataType=float32, Size=1, InitialValue=1.0F, Min=0.32, Max=5.1, Units=IvsVolt
          MotAg6SinRtOffs: WrittenInMotCtrlRunnable=false, ReadInMotCtrlRunnable=true, WrittenIn2msRunnable=true, ReadIn2msRunnable=false, ImplementationDataType=float32, Size=1, InitialValue=2.5F, Min=0.25, Max=3.75, Units=Volt
          MotAg6Mecl: WrittenInMotCtrlRunnable=true, ReadInMotCtrlRunnable=false, WrittenIn2msRunnable=false, ReadIn2msRunnable=false, ImplementationDataType=uint16, Size=1, InitialValue=0U, Min=0, Max=0.9999847412, Units=MotRev
          MotAg6RawMecl: WrittenInMotCtrlRunnable=true, ReadInMotCtrlRunnable=false, WrittenIn2msRunnable=false, ReadIn2msRunnable=true, ImplementationDataType=uint16, Size=1, InitialValue=0U, Min=0, Max=0.9999847412, Units=MotRev
          MotAg5CosRtAmpRecpr: WrittenInMotCtrlRunnable=false, ReadInMotCtrlRunnable=true, WrittenIn2msRunnable=true, ReadIn2msRunnable=false, ImplementationDataType=float32, Size=1, InitialValue=1.0F, Min=0.32, Max=5.1, Units=IvsVolt
          MotAg5CosRtOffs: WrittenInMotCtrlRunnable=false, ReadInMotCtrlRunnable=true, WrittenIn2msRunnable=true, ReadIn2msRunnable=false, ImplementationDataType=float32, Size=1, InitialValue=2.5F, Min=0.25, Max=3.75, Units=Volt
          MotAg5MeclQlfr: WrittenInMotCtrlRunnable=false, ReadInMotCtrlRunnable=false, WrittenIn2msRunnable=true, ReadIn2msRunnable=false, ImplementationDataType=uint8, Size=1, InitialValue=SIGQLFR_NORES, Min=0, Max=2, Units=Cnt, EnumerationNameReference=SigQlfr1
          MotAg5MeclRollgCntr: WrittenInMotCtrlRunnable=false, ReadInMotCtrlRunnable=false, WrittenIn2msRunnable=true, ReadIn2msRunnable=false, ImplementationDataType=uint8, Size=1, InitialValue=0U, Min=0, Max=255, Units=Cnt
          MotAg5SinRtAmpRecpr: WrittenInMotCtrlRunnable=false, ReadInMotCtrlRunnable=true, WrittenIn2msRunnable=true, ReadIn2msRunnable=false, ImplementationDataType=float32, Size=1, InitialValue=1.0F, Min=0.32, Max=5.1, Units=IvsVolt
          MotAg5SinRtOffs: WrittenInMotCtrlRunnable=false, ReadInMotCtrlRunnable=true, WrittenIn2msRunnable=true, ReadIn2msRunnable=false, ImplementationDataType=float32, Size=1, InitialValue=2.5F, Min=0.25, Max=3.75, Units=Volt
          MotAgMeasTi: WrittenInMotCtrlRunnable=true, ReadInMotCtrlRunnable=true, WrittenIn2msRunnable=false, ReadIn2msRunnable=false, ImplementationDataType=uint32, Size=1, InitialValue=0U, Min=0, Max=4294967295, Units=Cnt
          MotAg5Mecl: WrittenInMotCtrlRunnable=true, ReadInMotCtrlRunnable=false, WrittenIn2msRunnable=false, ReadIn2msRunnable=false, ImplementationDataType=uint16, Size=1, InitialValue=0U, Min=0, Max=0.9999847412, Units=MotRev
          MotAg5RawMecl: WrittenInMotCtrlRunnable=true, ReadInMotCtrlRunnable=false, WrittenIn2msRunnable=false, ReadIn2msRunnable=true, ImplementationDataType=uint16, Size=1, InitialValue=0U, Min=0, Max=0.9999847412, Units=MotRev
          EcuTFild: WrittenInMotCtrlRunnable=false, ReadInMotCtrlRunnable=true, WrittenIn2msRunnable=true, ReadIn2msRunnable=true, ImplementationDataType=float32, Size=1, InitialValue=25.0F, Min=-50, Max=150, Units=DegCgrd
          CurrMeasCorrlnSts: WrittenInMotCtrlRunnable=false, ReadInMotCtrlRunnable=true, WrittenIn2msRunnable=true, ReadIn2msRunnable=false, ImplementationDataType=uint8, Size=1, InitialValue=63U, Min=0, Max=63, Units=Cnt
          MotCurrDax: WrittenInMotCtrlRunnable=true, ReadInMotCtrlRunnable=true, WrittenIn2msRunnable=false, ReadIn2msRunnable=true, ImplementationDataType=float32, Size=1, InitialValue=0.0F, Min=-200, Max=200, Units=Ampr
          MotCurrQax: WrittenInMotCtrlRunnable=true, ReadInMotCtrlRunnable=true, WrittenIn2msRunnable=false, ReadIn2msRunnable=true, ImplementationDataType=float32, Size=1, InitialValue=0.0F, Min=-200, Max=200, Units=Ampr
          CurrMeasWrmIninTestCmpl: WrittenInMotCtrlRunnable=false, ReadInMotCtrlRunnable=true, WrittenIn2msRunnable=true, ReadIn2msRunnable=true, ImplementationDataType=boolean, Size=1, InitialValue=FALSE, Min=0, Max=1, Units=Cnt
          CurrMeasMotAgCorrd: WrittenInMotCtrlRunnable=true, ReadInMotCtrlRunnable=true, WrittenIn2msRunnable=false, ReadIn2msRunnable=false, ImplementationDataType=float32, Size=1, InitialValue=0.0F, Min=-6.2832, Max=6.2832, Units=MotRad
          MotCurrCorrdA: WrittenInMotCtrlRunnable=true, ReadInMotCtrlRunnable=true, WrittenIn2msRunnable=false, ReadIn2msRunnable=true, ImplementationDataType=float32, Size=1, InitialValue=0.0F, Min=-200, Max=200, Units=Ampr
          MotCurrCorrdB: WrittenInMotCtrlRunnable=true, ReadInMotCtrlRunnable=true, WrittenIn2msRunnable=false, ReadIn2msRunnable=true, ImplementationDataType=float32, Size=1, InitialValue=0.0F, Min=-200, Max=200, Units=Ampr
          MotCurrCorrdC: WrittenInMotCtrlRunnable=true, ReadInMotCtrlRunnable=true, WrittenIn2msRunnable=false, ReadIn2msRunnable=true, ImplementationDataType=float32, Size=1, InitialValue=0.0F, Min=-200, Max=200, Units=Ampr
          MotCurrRollgCntr1: WrittenInMotCtrlRunnable=true, ReadInMotCtrlRunnable=true, WrittenIn2msRunnable=false, ReadIn2msRunnable=true, ImplementationDataType=uint8, Size=1, InitialValue=0U, Min=0, Max=255, Units=Cnt
          Ntc5DErrCnt: WrittenInMotCtrlRunnable=true, ReadInMotCtrlRunnable=false, WrittenIn2msRunnable=false, ReadIn2msRunnable=true, ImplementationDataType=uint16, Size=1, InitialValue=0U, Min=0, Max=65535, Units=Cnt
          MotCurrEolCalSt: WrittenInMotCtrlRunnable=false, ReadInMotCtrlRunnable=true, WrittenIn2msRunnable=true, ReadIn2msRunnable=true, ImplementationDataType=uint8, Size=1, InitialValue=MCECS_OFFSCMDSTRT, Min=0, Max=8, Units=Cnt, EnumerationNameReference=MotCurrEolCalSt2
          MotCurrQlfr1: WrittenInMotCtrlRunnable=false, ReadInMotCtrlRunnable=true, WrittenIn2msRunnable=true, ReadIn2msRunnable=false, ImplementationDataType=uint8, Size=1, InitialValue=SIGQLFR_NORES, Min=0, Max=2, Units=Cnt, EnumerationNameReference=SigQlfr1
          MotAgMecl5Polarity: WrittenInMotCtrlRunnable=false, ReadInMotCtrlRunnable=false, WrittenIn2msRunnable=true, ReadIn2msRunnable=false, ImplementationDataType=sint8, Size=1, InitialValue=1, Min=-1, Max=1, Units=Uls
          MotAgMecl6Polarity: WrittenInMotCtrlRunnable=false, ReadInMotCtrlRunnable=false, WrittenIn2msRunnable=true, ReadIn2msRunnable=false, ImplementationDataType=sint8, Size=1, InitialValue=1, Min=-1, Max=1, Units=Uls
          MotElecMeclPolarity: WrittenInMotCtrlRunnable=false, ReadInMotCtrlRunnable=true, WrittenIn2msRunnable=true, ReadIn2msRunnable=false, ImplementationDataType=sint8, Size=1, InitialValue=1, Min=-1, Max=1, Units=Uls
          SysSt: WrittenInMotCtrlRunnable=false, ReadInMotCtrlRunnable=true, WrittenIn2msRunnable=true, ReadIn2msRunnable=true, ImplementationDataType=uint8, Size=1, InitialValue=SYSST_WRMININ, Min=0, Max=3, Units=Cnt, EnumerationNameReference=SysSt1
          LoopCntr2MilliSec: WrittenInMotCtrlRunnable=false, ReadInMotCtrlRunnable=true, WrittenIn2msRunnable=true, ReadIn2msRunnable=false, ImplementationDataType=uint16, Size=1, InitialValue=0U, Min=0, Max=65535, Units=Cnt
          FastLoopCntr: WrittenInMotCtrlRunnable=true, ReadInMotCtrlRunnable=false, WrittenIn2msRunnable=false, ReadIn2msRunnable=true, ImplementationDataType=uint16, Size=1, InitialValue=0U, Min=0, Max=65535, Units=Cnt
          SlowLoopCntr: WrittenInMotCtrlRunnable=true, ReadInMotCtrlRunnable=false, WrittenIn2msRunnable=false, ReadIn2msRunnable=true, ImplementationDataType=uint16, Size=1, InitialValue=0U, Min=0, Max=65535, Units=Cnt
          Adc0RawRes: WrittenInMotCtrlRunnable=false, ReadInMotCtrlRunnable=true, WrittenIn2msRunnable=false, ReadIn2msRunnable=false, ImplementationDataType=uint16, Size=24, InitialValue=0U, 0U, 0U, 0U, 0U, 0U, 0U, 0U, 0U, 0U, 0U, 0U, 0U, 0U, 0U, 0U, 0U, 0U, 0U, 0U, 0U, 0U, 0U, 0U, Min=0, Max=4095, Units=Cnt
          MotAg2Cos: WrittenInMotCtrlRunnable=false, ReadInMotCtrlRunnable=true, WrittenIn2msRunnable=true, ReadIn2msRunnable=true, ImplementationDataType=float32, Size=1, InitialValue=0.0F, Min=0, Max=5, Units=MotRev
          MotAg2CosAdcFaild: WrittenInMotCtrlRunnable=false, ReadInMotCtrlRunnable=true, WrittenIn2msRunnable=true, ReadIn2msRunnable=true, ImplementationDataType=boolean, Size=1, InitialValue=FALSE, Min=0, Max=1, Units=Cnt
          MotAg2Sin: WrittenInMotCtrlRunnable=false, ReadInMotCtrlRunnable=true, WrittenIn2msRunnable=true, ReadIn2msRunnable=true, ImplementationDataType=float32, Size=1, InitialValue=0.0F, Min=0, Max=5, Units=MotRev
          MotAg2SinAdcFaild: WrittenInMotCtrlRunnable=false, ReadInMotCtrlRunnable=true, WrittenIn2msRunnable=true, ReadIn2msRunnable=true, ImplementationDataType=boolean, Size=1, InitialValue=FALSE, Min=0, Max=1, Units=Cnt
          MotAg5CosAdcFaild: WrittenInMotCtrlRunnable=false, ReadInMotCtrlRunnable=true, WrittenIn2msRunnable=true, ReadIn2msRunnable=true, ImplementationDataType=boolean, Size=1, InitialValue=FALSE, Min=0, Max=1, Units=Cnt
          MotAg5SinAdcFaild: WrittenInMotCtrlRunnable=false, ReadInMotCtrlRunnable=true, WrittenIn2msRunnable=true, ReadIn2msRunnable=true, ImplementationDataType=boolean, Size=1, InitialValue=FALSE, Min=0, Max=1, Units=Cnt
          MotAg6CosAdcFaild: WrittenInMotCtrlRunnable=false, ReadInMotCtrlRunnable=true, WrittenIn2msRunnable=true, ReadIn2msRunnable=true, ImplementationDataType=boolean, Size=1, InitialValue=FALSE, Min=0, Max=1, Units=Cnt
          MotAg6SinAdcFaild: WrittenInMotCtrlRunnable=false, ReadInMotCtrlRunnable=true, WrittenIn2msRunnable=true, ReadIn2msRunnable=true, ImplementationDataType=boolean, Size=1, InitialValue=FALSE, Min=0, Max=1, Units=Cnt
          Adc0ScanGroup2Ref0: WrittenInMotCtrlRunnable=true, ReadInMotCtrlRunnable=false, WrittenIn2msRunnable=false, ReadIn2msRunnable=false, ImplementationDataType=float32, Size=1, InitialValue=0.0F, Min=0, Max=5, Units=Volt
          Adc0ScanGroup2Ref1: WrittenInMotCtrlRunnable=true, ReadInMotCtrlRunnable=false, WrittenIn2msRunnable=false, ReadIn2msRunnable=false, ImplementationDataType=float32, Size=1, InitialValue=0.0F, Min=0, Max=5, Units=Volt
          Adc0ScanGroup3Ref0: WrittenInMotCtrlRunnable=true, ReadInMotCtrlRunnable=false, WrittenIn2msRunnable=false, ReadIn2msRunnable=false, ImplementationDataType=float32, Size=1, InitialValue=0.0F, Min=0, Max=5, Units=Volt
          Adc0ScanGroup3Ref1: WrittenInMotCtrlRunnable=true, ReadInMotCtrlRunnable=false, WrittenIn2msRunnable=false, ReadIn2msRunnable=false, ImplementationDataType=float32, Size=1, InitialValue=0.0F, Min=0, Max=5, Units=Volt
          Adc0SelfDiag0: WrittenInMotCtrlRunnable=true, ReadInMotCtrlRunnable=false, WrittenIn2msRunnable=false, ReadIn2msRunnable=false, ImplementationDataType=float32, Size=1, InitialValue=0.0F, Min=0, Max=5, Units=Volt
          Adc0SelfDiag2: WrittenInMotCtrlRunnable=true, ReadInMotCtrlRunnable=false, WrittenIn2msRunnable=false, ReadIn2msRunnable=false, ImplementationDataType=float32, Size=1, InitialValue=0.0F, Min=0, Max=5, Units=Volt
          Adc0SelfDiag4: WrittenInMotCtrlRunnable=true, ReadInMotCtrlRunnable=false, WrittenIn2msRunnable=false, ReadIn2msRunnable=false, ImplementationDataType=float32, Size=1, InitialValue=0.0F, Min=0, Max=5, Units=Volt
          MotAg5Cos: WrittenInMotCtrlRunnable=true, ReadInMotCtrlRunnable=true, WrittenIn2msRunnable=false, ReadIn2msRunnable=true, ImplementationDataType=float32, Size=1, InitialValue=0.0F, Min=0, Max=5, Units=MotRev
          MotAg5Sin: WrittenInMotCtrlRunnable=true, ReadInMotCtrlRunnable=true, WrittenIn2msRunnable=false, ReadIn2msRunnable=true, ImplementationDataType=float32, Size=1, InitialValue=0.0F, Min=0, Max=5, Units=MotRev
          MotAg6Cos: WrittenInMotCtrlRunnable=true, ReadInMotCtrlRunnable=true, WrittenIn2msRunnable=false, ReadIn2msRunnable=true, ImplementationDataType=float32, Size=1, InitialValue=0.0F, Min=0, Max=5, Units=MotRev
          MotAg6Sin: WrittenInMotCtrlRunnable=true, ReadInMotCtrlRunnable=true, WrittenIn2msRunnable=false, ReadIn2msRunnable=true, ImplementationDataType=float32, Size=1, InitialValue=0.0F, Min=0, Max=5, Units=MotRev
          MotCurrAdcPeakA: WrittenInMotCtrlRunnable=true, ReadInMotCtrlRunnable=false, WrittenIn2msRunnable=false, ReadIn2msRunnable=false, ImplementationDataType=float32, Size=1, InitialValue=0.0F, Min=0, Max=5, Units=Volt
          MotCurrAdcPeakB: WrittenInMotCtrlRunnable=true, ReadInMotCtrlRunnable=false, WrittenIn2msRunnable=false, ReadIn2msRunnable=false, ImplementationDataType=float32, Size=1, InitialValue=0.0F, Min=0, Max=5, Units=Volt
          MotCurrAdcPeakC: WrittenInMotCtrlRunnable=true, ReadInMotCtrlRunnable=false, WrittenIn2msRunnable=false, ReadIn2msRunnable=false, ImplementationDataType=float32, Size=1, InitialValue=0.0F, Min=0, Max=5, Units=Volt
          MotCurrAdcVlyA: WrittenInMotCtrlRunnable=true, ReadInMotCtrlRunnable=true, WrittenIn2msRunnable=false, ReadIn2msRunnable=true, ImplementationDataType=float32, Size=1, InitialValue=0.0F, Min=0, Max=5, Units=Volt
          MotCurrAdcVlyB: WrittenInMotCtrlRunnable=true, ReadInMotCtrlRunnable=true, WrittenIn2msRunnable=false, ReadIn2msRunnable=true, ImplementationDataType=float32, Size=1, InitialValue=0.0F, Min=0, Max=5, Units=Volt
          MotCurrAdcVlyC: WrittenInMotCtrlRunnable=true, ReadInMotCtrlRunnable=true, WrittenIn2msRunnable=false, ReadIn2msRunnable=true, ImplementationDataType=float32, Size=1, InitialValue=0.0F, Min=0, Max=5, Units=Volt
          MotCurrSnsrOffs1: WrittenInMotCtrlRunnable=true, ReadInMotCtrlRunnable=false, WrittenIn2msRunnable=false, ReadIn2msRunnable=false, ImplementationDataType=float32, Size=1, InitialValue=0.0F, Min=0, Max=5, Units=Volt
          MotCurrAdcVlyAAdcFaild: WrittenInMotCtrlRunnable=false, ReadInMotCtrlRunnable=true, WrittenIn2msRunnable=true, ReadIn2msRunnable=false, ImplementationDataType=boolean, Size=1, InitialValue=FALSE, Min=0, Max=1, Units=Cnt
          MotCurrAdcVlyBAdcFaild: WrittenInMotCtrlRunnable=false, ReadInMotCtrlRunnable=true, WrittenIn2msRunnable=true, ReadIn2msRunnable=false, ImplementationDataType=boolean, Size=1, InitialValue=FALSE, Min=0, Max=1, Units=Cnt
          MotCurrAdcVlyCAdcFaild: WrittenInMotCtrlRunnable=false, ReadInMotCtrlRunnable=true, WrittenIn2msRunnable=true, ReadIn2msRunnable=false, ImplementationDataType=boolean, Size=1, InitialValue=FALSE, Min=0, Max=1, Units=Cnt
          MfgEnaSt: WrittenInMotCtrlRunnable=false, ReadInMotCtrlRunnable=true, WrittenIn2msRunnable=false, ReadIn2msRunnable=true, ImplementationDataType=uint8, Size=1, InitialValue=MFGENAST_PRDNMOD, Min=0, Max=2, Units=Cnt, EnumerationNameReference=MfgEnaSt1
          MotAgAMecl: WrittenInMotCtrlRunnable=false, ReadInMotCtrlRunnable=true, WrittenIn2msRunnable=false, ReadIn2msRunnable=true, ImplementationDataType=uint16, Size=1, InitialValue=0U, Min=0, Max=0.9999847412, Units=MotRev
          MotAgAMeclQlfr: WrittenInMotCtrlRunnable=false, ReadInMotCtrlRunnable=true, WrittenIn2msRunnable=false, ReadIn2msRunnable=true, ImplementationDataType=uint8, Size=1, InitialValue=SIGQLFR_NORES, Min=0, Max=2, Units=Cnt, EnumerationNameReference=SigQlfr1
          MotAgAMeclRollgCntr: WrittenInMotCtrlRunnable=false, ReadInMotCtrlRunnable=true, WrittenIn2msRunnable=false, ReadIn2msRunnable=true, ImplementationDataType=uint8, Size=1, InitialValue=0U, Min=0, Max=255, Units=Cnt
          MotAgBMecl: WrittenInMotCtrlRunnable=false, ReadInMotCtrlRunnable=true, WrittenIn2msRunnable=false, ReadIn2msRunnable=true, ImplementationDataType=uint16, Size=1, InitialValue=0U, Min=0, Max=0.9999847412, Units=MotRev
          MotAgBMeclQlfr: WrittenInMotCtrlRunnable=false, ReadInMotCtrlRunnable=true, WrittenIn2msRunnable=false, ReadIn2msRunnable=true, ImplementationDataType=uint8, Size=1, InitialValue=SIGQLFR_NORES, Min=0, Max=2, Units=Cnt, EnumerationNameReference=SigQlfr1
          MotAgBMeclRollgCntr: WrittenInMotCtrlRunnable=false, ReadInMotCtrlRunnable=true, WrittenIn2msRunnable=false, ReadIn2msRunnable=true, ImplementationDataType=uint8, Size=1, InitialValue=0U, Min=0, Max=255, Units=Cnt
          MotAgMeclCorrlnSts: WrittenInMotCtrlRunnable=false, ReadInMotCtrlRunnable=true, WrittenIn2msRunnable=false, ReadIn2msRunnable=false, ImplementationDataType=uint8, Size=1, InitialValue=7U, Min=0, Max=7, Units=Cnt
          MotAg6Polarity: WrittenInMotCtrlRunnable=false, ReadInMotCtrlRunnable=true, WrittenIn2msRunnable=false, ReadIn2msRunnable=false, ImplementationDataType=sint8, Size=1, InitialValue=-1, Min=-1, Max=1, Units=Cnt
          MotAg5Polarity: WrittenInMotCtrlRunnable=false, ReadInMotCtrlRunnable=true, WrittenIn2msRunnable=false, ReadIn2msRunnable=false, ImplementationDataType=sint8, Size=1, InitialValue=-1, Min=-1, Max=1, Units=Cnt
          MotCurrCorrdD: WrittenInMotCtrlRunnable=false, ReadInMotCtrlRunnable=true, WrittenIn2msRunnable=false, ReadIn2msRunnable=false, ImplementationDataType=float32, Size=1, InitialValue=0.0F, Min=-200, Max=200, Units=Ampr
          MotCurrCorrdE: WrittenInMotCtrlRunnable=false, ReadInMotCtrlRunnable=true, WrittenIn2msRunnable=false, ReadIn2msRunnable=false, ImplementationDataType=float32, Size=1, InitialValue=0.0F, Min=-200, Max=200, Units=Ampr
          MotCurrCorrdF: WrittenInMotCtrlRunnable=false, ReadInMotCtrlRunnable=true, WrittenIn2msRunnable=false, ReadIn2msRunnable=false, ImplementationDataType=float32, Size=1, InitialValue=0.0F, Min=-200, Max=200, Units=Ampr
          MotCurrQlfr2: WrittenInMotCtrlRunnable=false, ReadInMotCtrlRunnable=true, WrittenIn2msRunnable=false, ReadIn2msRunnable=false, ImplementationDataType=uint8, Size=1, InitialValue=SIGQLFR_NORES, Min=0, Max=2, Units=Cnt, EnumerationNameReference=SigQlfr1
          MotCurrRollgCntr2: WrittenInMotCtrlRunnable=false, ReadInMotCtrlRunnable=true, WrittenIn2msRunnable=false, ReadIn2msRunnable=false, ImplementationDataType=uint8, Size=1, InitialValue=0U, Min=0, Max=255, Units=Cnt
          AdcDiagcEndPtrOutp: WrittenInMotCtrlRunnable=false, ReadInMotCtrlRunnable=true, WrittenIn2msRunnable=false, ReadIn2msRunnable=true, ImplementationDataType=uint8, Size=1, InitialValue=23U, Min=21, Max=23, Units=Cnt
          AdcDiagcStrtPtrOutp: WrittenInMotCtrlRunnable=false, ReadInMotCtrlRunnable=true, WrittenIn2msRunnable=false, ReadIn2msRunnable=true, ImplementationDataType=uint8, Size=1, InitialValue=21U, Min=21, Max=23, Units=Cnt
        6 x NonRteEnum, all with EnumImplementationDataType=uint8:
          IvtrFetFltPha1
            4 x EnumElement:
              IVTRFETFLTPHA_NOPHASNGFETFLT: Value=0
              IVTRFETFLTPHA_PHAASNGFETFLT: Value=1
              IVTRFETFLTPHA_PHABSNGFETFLT: Value=2
              IVTRFETFLTPHA_PHACSNGFETFLT: Value=4
          IvtrFetFltTyp1
            4 x EnumElement:
              IVTRFETFLTTYP_NOFETFLT: Value=0
              IVTRFETFLTTYP_LOWRFETFLT: Value=1
              IVTRFETFLTTYP_UPPRFETFLT: Value=2
              IVTRFETFLTTYP_MPLFETFLT: Value=4
          SigQlfr1
            3 x EnumElement:
              SIGQLFR_NORES: Value=0
              SIGQLFR_PASSD: Value=1
              SIGQLFR_FAILD: Value=2
          MotCurrEolCalSt2
            9 x EnumElement:
              MCECS_OFFSCMDSTRT: Value=0
              MCECS_OFFSCMDHI: Value=1
              MCECS_OFFSCMDLO: Value=2
              MCECS_OFFSCMDZERO: Value=3
              MCECS_OFFSCMDEND: Value=4
              MCECS_GAINCMDAD: Value=5
              MCECS_GAINCMDBE: Value=6
              MCECS_GAINCMDCF: Value=7
              MCECS_CMDSAFEST: Value=8
          SysSt1
            4 x EnumElement:
              SYSST_DI: Value=0
              SYSST_OFF: Value=1
              SYSST_ENA: Value=2
              SYSST_WRMININ: Value=3
          MfgEnaSt1
            3 x EnumElement:
              MFGENAST_PRDNMOD: Value=0
              MFGENAST_MFGMOD: Value=1
              MFGENAST_TESTMOD: Value=2
        9 x SignalMapping:
          MotAg5MeclQlfrMap: OutputSignalName=MotAg5MeclQlfr, InputSignalName=MotAgAMeclQlfr
          MotAg6MeclQlfrMap: OutputSignalName=MotAg6MeclQlfr, InputSignalName=MotAgBMeclQlfr
          MotAg5MeclMap: OutputSignalName=MotAg5Mecl, InputSignalName=MotAgAMecl
          MotAg6MeclMap: OutputSignalName=MotAg6Mecl, InputSignalName=MotAgBMecl
          MotAg5MeclRollgCntrMap: OutputSignalName=MotAg5MeclRollgCntr, InputSignalName=MotAgAMeclRollgCntr
          MotAg6MeclRollgCntrMap: OutputSignalName=MotAg6MeclRollgCntr, InputSignalName=MotAgBMeclRollgCntr
          MotAgMeclCorrlnStMap: OutputSignalName=MotAgMeclCorrlnSt, InputSignalName=MotAgMeclCorrlnSts
          MotAgMecl5PolarityMap: OutputSignalName=MotAgMecl5Polarity, InputSignalName=MotAg5Polarity
          MotAgMecl6PolarityMap: OutputSignalName=MotAgMecl6Polarity, InputSignalName=MotAg6Polarity
      RunnableManagement
        16 x Runnable:
          MotRplCoggCmdPer1: RunnableRate=MotorControlx2
          MotCurrRegVltgLimrPer1: RunnableRate=MotorControlx2
          MotVelPer1: RunnableRate=MotorControl
          SinVltgGennPer1: RunnableRate=MotorControl
          SinVltgGennPer2: RunnableRate=MotorControl
          MotAgSwCalPer1: RunnableRate=MotorControl
          MotAgArbnPer1: RunnableRate=MotorControl
          MotAgCmpPer1: RunnableRate=MotorControl
          MotAg6MeasPer2: RunnableRate=MotorControl
          MotAg5MeasPer2: RunnableRate=MotorControl
          CurrMeasArbnPer1: RunnableRate=MotorControlx2
          CurrMeasPer2: RunnableRate=MotorControlx2
          McuDiagcPer1: RunnableRate=MotorControlx2
          GtmCfgAndUsePer1: RunnableRate=MotorControl
          Adcf0CfgAndUsePer1: RunnableRate=MotorControlx2
          FordT3McuCfgPer1: RunnableRate=MotorControl
