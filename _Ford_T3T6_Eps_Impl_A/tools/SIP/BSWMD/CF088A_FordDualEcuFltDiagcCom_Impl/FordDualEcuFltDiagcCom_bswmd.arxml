AUTOSAR XML (schema 4-0-3)
package /Nexteer
  module definition FordDualEcuFltDiagcCom [0..1]: variants pre-compile  # Configuration of the FordDualEcuFltDiagcCom Paramters.
    container NTC_List [0..255]  # Container with list of NTCs that map to each DTC
      integer DTC_Index: 0..255, origin=NEXTEER  # The Index of DTC defined in DiagcMgr
