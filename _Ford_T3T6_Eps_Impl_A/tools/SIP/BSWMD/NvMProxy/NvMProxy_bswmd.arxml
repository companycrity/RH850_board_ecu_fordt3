AUTOSAR XML (schema 4-0-3)
package /Nexteer/EcucDefs_NvMProxy
  ecuc definition collection NexteerParameterDefinition_NvMProxy: module=NvMProxy
  module definition NvMProxy [0..1]: category=VENDOR_SPECIFIC_MODULE_DEFINITION, refined-module-def=NvMProxy, variants pre-compile  # Configuration of the NvM (NvRam Manager) Proxy module.
    container NvMProxyCommon  # Contains the common settings for NvM Proxy.
      string NvmProxyIncludes [0..65535]: origin=Nexteer  # NvM Proxy Includes | List of header files to be included for callback functions.
      symbolic name reference NvMOsApplicationRef: destination=OsApplication  # NvM Os Application | This defines the application in which the NvM BSW is integrated.
    container NvMProxyBlkSet [1..65536]  # Contains the NvM blocks that are required to be checked for CRC faults.
      enumeration NvMBlkFlt: {NTC_0x06, NTC_0x07, NTC_0x08, NTC_0x0A, None}, set at pre-compile, origin=NEXTEER, default-value=None  # NvM Block Fault | Defines the fault that shall be set for a NvM block with an invalid CRC.
      string NvMProxyApplCallCbk: set at pre-compile, default-value=NULL_PTR  # NvM Proxy Application Callback | This field allows the application to configure a specific callback in the event of the CRC failing. If no callback is required, the default NULL_PTR shall be used.
      symbolic name reference NvMBlkRef: destination=NvMBlockDescriptor  # NvM Block Reference | NvM block to check for CRC fault
  bsw implementation NvMProxy_Impl: programming-language=C, used-code-generator=EXTERNAL, behavior=NvMProxyBehavior, vendor-specific-module-def=NvMProxy
