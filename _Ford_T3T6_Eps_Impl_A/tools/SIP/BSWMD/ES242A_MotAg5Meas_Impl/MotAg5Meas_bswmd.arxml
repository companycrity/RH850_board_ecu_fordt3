AUTOSAR XML (schema 4-0-3)
package /Nexteer
  module definition MotAg5Meas: variants pre-compile  # Configurations for MotAg5Meas software component
    container MotAg5MeasGeneral  # This is the container for MotAg5Meas Diagnostics Configuration
      enumeration MotAg5PrtclFlt: {NTCNR_0X083, NTCNR_0X084, NTCNR_0X085, NTCNR_0X086, NTCNR_0X087, NTCNR_0X088, NTCNR_0X089, NTCNR_0X08A}, origin=NEXTEER, default-value=NTCNR_0X083  # NTC Number for Protocol Fault indication from MotAg5Meas
