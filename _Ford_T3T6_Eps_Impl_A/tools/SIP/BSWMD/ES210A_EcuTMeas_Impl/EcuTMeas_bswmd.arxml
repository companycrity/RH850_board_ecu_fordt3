AUTOSAR XML (schema 4-0-3)
package /Nexteer
  module definition EcuTMeas [0..1]: variants pre-compile  # Ecuc Module for EcuTMeas configuration parameters
    container EcuTMeasGeneral  # Misc configurations for EcuTMeas
      float DftTemp: -50..150, set at pre-compile, origin=NEXTEER, default-value=60  # ECUTMEAS_DFTT_DEGCGRD_F32 : Default Temperature used under Fault Conditions
      float FilTau: 0.1..100, set at pre-compile, origin=NEXTEER, default-value=100  # ECUTMEAS_FILTAU_HZ_F32 : Sets the time constant for filtering the temperature measurement
    container EcuTMeasConversionTables  # This is the container for configuring the tables that translate input analog measurements in volts to temperature
      float EcuTx [8..8]: 0..5, set at pre-compile, origin=NEXTEER  # ECUTMEAS_ECUTX_VOLT_U3P13 : This is the X table used as part of a linear interoplation to translate input analog measurements in volts to temperature. Input Values should be in Single point precision.
      float EcuTy [8..8]: -50..150, set at pre-compile, origin=NEXTEER  # ECUTMEAS_ECUTY_DEGCGRD_S8P7 : This is the Y table used as part of a linear interoplation to translate input analog measurements in volts to temperature. Input Values should be in Single point precision.
    container EcuTMeasDiagc  # This is the container for configuring the diagnostics setting for failure modes and NTCs of EcuT
      integer Ntc0x045FailStep: 0..65535, origin=NEXTEER, default-value=3000  # ECUTMEAS_NTC0X045FAILSTEP_CNT_U16 : Error Accumulator Test Step Size for Failed Ecu Temperature Test
      integer Ntc0x045PassStep: 0..65535, origin=NEXTEER, default-value=3000  # ECUTMEAS_NTC0X045PASSSTEP_CNT_U16 : Error Accumulator Test Step Size for Pass Ecu Temperature Test
      float MaxTLim: -51..151, set at pre-compile, origin=NEXTEER, default-value=145  # ECUTMEAS_RNGDIAGCMAX_DEGCGRD_F32 : Diagnostic Maximum Temperature Limit. Identifies the max temperature allowed to accumulate a diagnostic error.
      float MinTLim: -51..151, set at pre-compile, origin=NEXTEER, default-value=-45  # ECUTMEAS_RNGDIAGCMIN_DEGCGRD_F32 : Diagnostic Minimum Temperature Limit. Identifies the min temperature allowed to accumulate a diagnostic error.
