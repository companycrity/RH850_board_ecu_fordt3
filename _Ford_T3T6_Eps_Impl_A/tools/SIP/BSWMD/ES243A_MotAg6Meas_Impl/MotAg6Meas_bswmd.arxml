AUTOSAR XML (schema 4-0-3)
package /Nexteer
  module definition MotAg6Meas: variants pre-compile  # Configurations for MotAg6Meas software component
    container MotAg6MeasGeneral  # This is the container for MotAg6Meas Diagnostics Configuration
      enumeration MotAg6PrtclFlt: {NTCNR_0X083, NTCNR_0X084, NTCNR_0X085, NTCNR_0X086, NTCNR_0X087, NTCNR_0X088, NTCNR_0X089, NTCNR_0X08A}, origin=NEXTEER, default-value=NTCNR_0X085  # NTC Number for Protocol Fault indication from MotAg6Meas
