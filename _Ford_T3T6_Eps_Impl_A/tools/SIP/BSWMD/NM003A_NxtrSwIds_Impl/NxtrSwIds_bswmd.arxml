AUTOSAR XML (schema 4-0-3)
package /Nexteer
  module definition NxtrSwIds: variants pre-compile  # Configuration of Nexteer Software Identifiers.
    container NxtrSwIdsGeneral  # General configuration options for Nexteer Software Identifiers
      string SwRelNr  # Software release number/name used in service 0xF194.
      string SwRelVer  # Software release version used in service 0xF195.
      boolean PrototypeBuild: default-value=false  # Set to true if this is a PSR build
      integer PsrId [0..1]  # PSR ID number from PSR database. For example, PSR818 would have an ID of "818".
      string PsrRev [0..1]  # Single letter revision for the PSR. This will nearly always start at 'A' and increment for each re-build/release.
