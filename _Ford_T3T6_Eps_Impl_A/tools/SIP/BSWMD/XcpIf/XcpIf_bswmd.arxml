AUTOSAR XML (schema 4-0-3)
package /Nexteer/EcucDefs_XcpIf
  ecuc definition collection NexteerParameterDefinition_XcpIf: module=XcpIf
  module definition XcpIf [0..1]: category=VENDOR_SPECIFIC_MODULE_DEFINITION, refined-module-def=XcpIf, variants pre-compile  # Settings for the XCP Interface component
    container XcpIfCommon  # Contains the common settings for XcpIf.
      enumeration XcpDriverSelection: {Auto Select, AUTOSAR, CANbedded}, origin=NEXTEER, default-value=Auto Select  # Selects the version of the XCP driver. Auto Select: Lets the generation script chose the version. AUTOSAR: Forces the generation script to generate support for the AUTOSAR XCP driver. CANembedded: Forces the generation script to generate support for the CANbedded XCP driver.
      symbolic name reference TunSelnMngtOsApplicationRef: destination=OsApplication  # Tuning Selection Management Os Application | This defines the application in which the tuning selection management (ES400A) component is integrated.
  bsw implementation XcpIf_Impl: programming-language=C, ar-release-version=4.0.3
