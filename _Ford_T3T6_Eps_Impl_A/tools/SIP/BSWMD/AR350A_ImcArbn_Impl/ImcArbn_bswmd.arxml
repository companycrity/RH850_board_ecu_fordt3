AUTOSAR XML (schema 4-0-3)
package /NEXTEER
  module definition ImcArbn [0..1]: variants pre-compile
    container ImcArbnSignal [1..65536]  # Signal settings
      string SignalName: set at pre-compile in variant pre-compile / link in variant link-time / post-build in variant post-build, origin=NEXTEER  # Transmitted Signal Name
      integer DestSize: 1..32, set at pre-compile in variant pre-compile / link in variant link-time / post-build in variant post-build, origin=NEXTEER, default-value=1  # Number of bits required for this signal to pack it any Signal Group
      enumeration DataType: {boolean, uint8, sint8, uint16, sint16, uint32, sint32, float32}, set at pre-compile, origin=NEXTEER, default-value=uint32  # Data type of the configured signal
      symbolic name reference ImcArbnSigUsersRef [1..65535]: set at pre-compile, origin=NEXTEER, destination=ImcArbnSignalUserGroups  # Reference to the FDDs which are going to use this Signal
    container ImcArbnSignalGroup [1..65536]  # List of signals groups
      container ImcArbnSigRef [1..32]  # List of signals groups.
        integer StartBit: 0..31, set at pre-compile in variant pre-compile / link in variant link-time / post-build in variant post-build, origin=NEXTEER, default-value=1  # Start position of the signal in the Signal Group
        symbolic name reference ImcArbnSigNameRef: set at pre-compile, origin=NEXTEER, destination=ImcArbnSignal  # Reference to the IMC Signal in this position
      container ImcArbnSGAttributes  # General requirements for the signal group.
        boolean PrimarySrcOnlySignalGroup: origin=NEXTEER, default-value=0  # Tells whether this signal group going to be transmitted only in Primary Source
        enumeration ImcArbnGroupTxRate: {IMCARBN_2MS_GROUP, IMCARBN_10MS_GROUP, IMCARBN_100MS_GROUP}, set at pre-compile, origin=NEXTEER, default-value=IMCARBN_2MS_GROUP  # Transmission rate at which the signal group need to be processed
    container ImcArbnSignalUserGroups [1..65536]  # Settings for the components which receives Signal from Imc Arbitrator
      string FddName: set at pre-compile in variant pre-compile / link in variant link-time / post-build in variant post-build, origin=NEXTEER  # Name of FDD which is going to receive the signal
      string ReceiverSideSignalName: set at pre-compile in variant pre-compile / link in variant link-time / post-build in variant post-build, origin=NEXTEER  # Name of the signal as used by the receiving FDD
      enumeration DataType: {boolean, uint8, sint8, uint16, sint16, uint32, sint32, float32}, set at pre-compile, origin=NEXTEER, default-value=uint32  # Data type of the configured signal
