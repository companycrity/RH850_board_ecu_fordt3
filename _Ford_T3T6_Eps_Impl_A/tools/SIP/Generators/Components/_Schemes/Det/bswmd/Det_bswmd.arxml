AUTOSAR XML (schema 4-0-3)
# COPYRIGHT
# Copyright (c) 2016 by Vector Informatik GmbH. All rights reserved.
# This software is copyright protected and proprietary to Vector Informatik GmbH.
# Vector Informatik GmbH grants to you only those rights as set out in the license conditions.
package /MICROSAR
  bsw implementation Det_Impl: programming-language=C, sw-version=7.01.00, used-code-generator=DaVinci Configurator, vendor-id=30, ar-release-version=4.00.03, behavior=DetBehavior, preconfigured-configuration=Det_Pre, recommended-configuration=Det_Rec, vendor-specific-module-def=Det
  module definition Det [0..1]: category=VENDOR_SPECIFIC_MODULE_DEFINITION, refined-module-def=Det, variants pre-compile  # Configuration of the DET (Development Error Tracer) module. | There are NO standardized configuration parameters defined. All the configuration of the Det is done via vendor-specific configuration parameters which need to be defined inside this ModuleDef.
    container DetGeneral  # Generic configuration parameters of the DET module.
      boolean DetVersionInfoApi: set at pre-compile, default-value=false  # This parameter enables/disables the function Det_GetVersionInfo() to get major, minor and patch version information. | true: Version info API enabled. false: Version info API disabled.
      boolean DetForwardToDlt [0..1]: set at pre-compile, default-value=false  # If the parameter is present and set to true, the DET forwards all errors to the function Dlt_DetForwardErrorTrace before other DET functionality is performed.
      boolean DetEnableDet: set at pre-compile, origin=Vector Informatik, default-value=true  # Enable reporting of development error. This attribute can be used to disable the DET completely.
      boolean DetExtDebugSupport: set at pre-compile, origin=Vector Informatik, default-value=false  # The extended debug support feature provides additional functionality to the DET such as filtering, logging and flexible break handling of the DET module. Please refer to the technical reference for details.
      integer DetGlobalFilterSize: 0..255, set at pre-compile, origin=Vector Informatik, default-value=0  # Number of global filters which can be used to discard irrelevant errors. The filters are typically configured at runtime using a debugger. Please refer to the technical reference about details. This setting is only relevant if extended debug support (DetExtDebugSupport) is enabled.
      integer DetBreakFilterSize: 0..255, set at pre-compile, origin=Vector Informatik, default-value=0  # Number of break handler filters which can be used to exit the DET without entering the endless loop. The filters are typically configured at runtime using a debugger. Please refer to the technical reference about details. This setting is only relevant if extended debug support (DetExtDebugSupport) is enabled.
      integer DetLogBufferSize: 0..255, set at pre-compile, origin=Vector Informatik, default-value=0  # Size of the log buffer which can be used to log errors reported to the DET. The log buffer is typically accessed at runtime using a debugger. Please refer to the technical reference about details. This setting is only relevant if extended debug support (DetExtDebugSupport) is enabled.
      boolean DetEntryCallout: set at pre-compile, origin=Vector Informatik, default-value=false  # En-/ disable user extensions by Appl_DetEntryCallout. Errors reported to the DET are forwarded to this callout. The user can decide by the return value if the error shall be further handled by the DET. Please refer to the technical reference for details.
      container DetServicePort [0..*]  # For each AUTOSAR SW-C that reports errors to the DET module a dedicated Service Port interface needs to be configured.
        integer DetModuleId: 4096..65535, set at pre-compile, origin=Vector Informatik, symbolic-name-value=true, default-value=4096  # Unique ModuleId that is used to identify the SWC reporting errors through this SWC-C port. This value is set automatically.
    container DetNotification [0..0]  # Configuration of the notification functions. Currently not supported - use DetGeneral/DetEntryCallout instead.
      function name DetErrorHook [0..1]: set at pre-compile, default-value=NotSupported  # Optional list of functions to be called by the Development Error Tracer in context of each call of Det_ReportError. Currently not supported - use DetGeneral/DetEntryCallout instead. | The type of these functions shall be identical the type of Det_ReportError itself: Std_ReturnType (*f)(uint16, uint8, uint8, uint8).
  module config Det_Rec: definition=Det
  module config Det_Pre: definition=Det
