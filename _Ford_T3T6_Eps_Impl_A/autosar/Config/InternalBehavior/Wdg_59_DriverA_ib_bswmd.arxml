AUTOSAR XML (schema 4-2-1)
package /Renesas/Wdg_59_DriverA_ib_bswmd/BswModuleDescriptions
  bsw module description Wdg
    bsw internal behavior Wdg_59_DriverABehavior
      exclusive area WDG_59_DRIVERA_MODE_SWITCH_PROTECTION
      exclusive area WDG_59_DRIVERA_TRIGG_PROTECTION
