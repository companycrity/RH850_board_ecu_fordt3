AUTOSAR XML (schema 4-2-1)
package /MICROSAR/Can_Mpc5700Mcan_ib_bswmd/BswModuleDescriptions
  bsw module description Can
    provided-entrys:
      Can_MainFunction_BusOff
      Can_MainFunction_Wakeup
      Can_MainFunction_Mode
      Can_MainFunction_Write
      Can_MainFunction_Read
    bsw internal behavior Can_Can_Mpc5700McanBehavior
      7 x exclusive area:
        CAN_EXCLUSIVE_AREA_{0..6}
      5 x bsw schedulable entity:
        Can_MainFunction_BusOff: implemented-entry=Can_MainFunction_BusOff
        Can_MainFunction_Wakeup: implemented-entry=Can_MainFunction_Wakeup
        Can_MainFunction_Mode: implemented-entry=Can_MainFunction_Mode
        Can_MainFunction_Write: implemented-entry=Can_MainFunction_Write
        Can_MainFunction_Read: implemented-entry=Can_MainFunction_Read
      5 x bsw timing event, all with period=0.01:
        Can_MainFunction_BusOffTimingEvent0: starts-on-event=Can_MainFunction_BusOff
        Can_MainFunction_WakeupTimingEvent0: starts-on-event=Can_MainFunction_Wakeup
        Can_MainFunction_ModeTimingEvent0: starts-on-event=Can_MainFunction_Mode
        Can_MainFunction_WriteTimingEvent0: starts-on-event=Can_MainFunction_Write
        Can_MainFunction_ReadTimingEvent0: starts-on-event=Can_MainFunction_Read
  5 x bsw module entry, all with call-type=SCHEDULED, execution-context=TASK:
    Can_MainFunction_BusOff
    Can_MainFunction_Wakeup
    Can_MainFunction_Mode
    Can_MainFunction_Write
    Can_MainFunction_Read
