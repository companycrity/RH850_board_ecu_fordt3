AUTOSAR XML (schema 4-2-1)
package /VariantDefinition
  evaluated variant set EvaluatedVariantSet: approval-status=APPROVED, evaluated-variant=[ECU1, ECU2]
package /VariantDefinition/Variant
  predefined variant ECU1: post-build-variant-criterion-value-set=ECU1
  predefined variant ECU2: post-build-variant-criterion-value-set=ECU2
package /VariantDefinition/Variant/CriterionValueSet
  post build variant criterion value set ECU1: post-build-variant-criterion-value{variant-criterion=Communication, value=0}
  post build variant criterion value set ECU2: post-build-variant-criterion-value{variant-criterion=Communication, value=1}
package /VariantDefinition/Criterion
  post build variant criterion Communication: compu {0=ECU1, 1=ECU2}
