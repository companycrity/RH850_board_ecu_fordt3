[part 2 of 3: package /COM/VECTOR/CFG/WORKFLOW/SYSDESC/SYNC]
AUTOSAR XML (schema 4-2-1)
package /COM/VECTOR/CFG/WORKFLOW/SYSDESC/SYNC  (continued)
  flat map FLATMAP  (continued)
    3692 x flat instance descriptor:  (continued)
      AssemblySwConnector_1934: ecu-extract-reference=VehSigCdngDVehSpdVldDImcArbnDVehSpdVld
      AssemblySwConnector_123: ecu-extract-reference=DualCtrlrOutpMgrDDualEcuMotCtrlMtgtnEnaDCDD_MotCtrlMgrDDualEcuMotCtrlMtgtnEna
      AssemblySwConnector_238: ecu-extract-reference=DualCtrlrOutpMgrDDualEcuFltMtgtnEnaDDutyCycThermProtnDDualEcuFltMtgtnEna
      AssemblySwConnector_239: ecu-extract-reference=DualCtrlrOutpMgrDDualEcuFltMtgtnEnaDHiLoadStallLimrDDualEcuFltMtgtnEna
      AssemblySwConnector_248: ecu-extract-reference=DualCtrlrOutpMgrDDualEcuFltMtgtnEnaDMotCtrlPrmEstimnDDualEcuFltMtgtnEna
      AssemblySwConnector_287: ecu-extract-reference=DualCtrlrOutpMgrDDualEcuMotCtrlMtgtnEnaDMotCurrPeakEstimnDDualEcuMotCtrlMtgtnEna
      AssemblySwConnector_402: ecu-extract-reference=DualCtrlrOutpMgrDDualEcuMotCtrlMtgtnEnaDMotCurrRegCfgDDualEcuMotCtrlMtgtnEna
      AssemblySwConnector_403: ecu-extract-reference=DualCtrlrOutpMgrDDualEcuMotCtrlMtgtnEnaDMotRefMdlDDualEcuMotCtrlMtgtnEna
      AssemblySwConnector_419: ecu-extract-reference=DualCtrlrOutpMgrDDualEcuFltMtgtnScaDPwrLimrDDualEcuFltMtgtnSca
      AssemblySwConnector_420: ecu-extract-reference=DualCtrlrOutpMgrDDualEcuFltMtgtnEnaDTEstimnDDualEcuFltMtgtnEna
      ComponentPrototype_132: upstream-reference=ECU_Composition.CustDiag, ecu-extract-reference=COMPOSITIONTYPE.CustDiag
      AssemblySwConnector_421: ecu-extract-reference=CustDiagDFlashProgReqDImcArbnDFlashProgReq
      AssemblySwConnector_422: ecu-extract-reference=CustDiagDRtnCmdDiagcDiDRtnDRtnCmdDiagcDi
      AssemblySwConnector_424: ecu-extract-reference=DualEcuIdnDEcuIdDCustDiagDEcuId
      AssemblySwConnector_425: ecu-extract-reference=ImcArbnDGetSigImcData_u08DCustDiagDGetSigImcData_u08
      ComponentPrototype_133: upstream-reference=ECU_Composition.CalRegn02Rt05GroupA, ecu-extract-reference=COMPOSITIONTYPE.CalRegn02Rt05GroupA
      ComponentPrototype_134: upstream-reference=ECU_Composition.CalRegn02Rt04GroupA, ecu-extract-reference=COMPOSITIONTYPE.CalRegn02Rt04GroupA
      ComponentPrototype_135: upstream-reference=ECU_Composition.CalRegn02Rt03GroupA, ecu-extract-reference=COMPOSITIONTYPE.CalRegn02Rt03GroupA
      ComponentPrototype_136: upstream-reference=ECU_Composition.CalRegn02Rt02GroupA, ecu-extract-reference=COMPOSITIONTYPE.CalRegn02Rt02GroupA
      ComponentPrototype_137: upstream-reference=ECU_Composition.CalRegn02Rt01GroupA, ecu-extract-reference=COMPOSITIONTYPE.CalRegn02Rt01GroupA
      ComponentPrototype_138: upstream-reference=ECU_Composition.CalRegn02Rt00GroupA, ecu-extract-reference=COMPOSITIONTYPE.CalRegn02Rt00GroupA
      ComponentPrototype_139: upstream-reference=ECU_Composition.CalRegn02Inin00GroupA, ecu-extract-reference=COMPOSITIONTYPE.CalRegn02Inin00GroupA
      ComponentPrototype_140: upstream-reference=ECU_Composition.CalRegn02CmnGroupA, ecu-extract-reference=COMPOSITIONTYPE.CalRegn02CmnGroupA
      ComponentPrototype_141: upstream-reference=ECU_Composition.AAACalRegn02Rt05GroupA_Dummy, ecu-extract-reference=COMPOSITIONTYPE.AAACalRegn02Rt05GroupA_Dummy
      ComponentPrototype_142: upstream-reference=ECU_Composition.AAACalRegn02Rt04GroupA_Dummy, ecu-extract-reference=COMPOSITIONTYPE.AAACalRegn02Rt04GroupA_Dummy
      ComponentPrototype_143: upstream-reference=ECU_Composition.AAACalRegn02Rt03GroupA_Dummy, ecu-extract-reference=COMPOSITIONTYPE.AAACalRegn02Rt03GroupA_Dummy
      ComponentPrototype_144: upstream-reference=ECU_Composition.AAACalRegn02Rt02GroupA_Dummy, ecu-extract-reference=COMPOSITIONTYPE.AAACalRegn02Rt02GroupA_Dummy
      ComponentPrototype_145: upstream-reference=ECU_Composition.AAACalRegn02Rt01GroupA_Dummy, ecu-extract-reference=COMPOSITIONTYPE.AAACalRegn02Rt01GroupA_Dummy
      AssemblySwConnector_427: ecu-extract-reference=CalRegn02CmnGroupADAssiThermScaXDAssiDAssiThermScaX
      AssemblySwConnector_428: ecu-extract-reference=CalRegn02CmnGroupADAssiThermScaYDAssiDAssiThermScaY
      AssemblySwConnector_1163: ecu-extract-reference=CalRegn02Inin00GroupADAssiHiFrqHpFilFrqDAssiHiFrqDAssiHiFrqHpFilFrq
      AssemblySwConnector_1194: ecu-extract-reference=CalRegn02Inin00GroupADDampgHydAssiLimDDampgDDampgHydAssiLim
      AssemblySwConnector_1943: ecu-extract-reference=CalRegn02Inin00GroupADHysCmpAssiCmdLpFilFrqDHysCmpDHysCmpAssiCmdLpFilFrq
      AssemblySwConnector_1944: ecu-extract-reference=CalRegn02Inin00GroupADHysCmpAssiInpLimDHysCmpDHysCmpAssiInpLim
      AssemblySwConnector_1945: ecu-extract-reference=CalRegn02Inin00GroupADHysCmpFinalOutpLpFilFrqDHysCmpDHysCmpFinalOutpLpFilFrq
      AssemblySwConnector_1946: ecu-extract-reference=CalRegn02Inin00GroupADHysCmpFricTScaXDHysCmpDHysCmpFricTScaX
      AssemblySwConnector_1947: ecu-extract-reference=CalRegn02Inin00GroupADHysCmpFricTScaYDHysCmpDHysCmpFricTScaY
      AssemblySwConnector_1948: ecu-extract-reference=CalRegn02Inin00GroupADHysCmpHwTqLpFilFrqDHysCmpDHysCmpHwTqLpFilFrq
      AssemblySwConnector_1949: ecu-extract-reference=CalRegn02Inin00GroupADInertiaCmpVelAssiBasdDampgCoeffXDInertiaCmpVelDInertiaCmpVelAssiBasdDampgCoeffX
      AssemblySwConnector_1950: ecu-extract-reference=CalRegn02Inin00GroupADInertiaCmpVelAssiBasdDampgRollgWhlImbRejctnOnYDInertiaCmpVelDInertiaCmpVelAssiBasdDampgRollgWhl_92ea7e48
      AssemblySwConnector_1951: ecu-extract-reference=CalRegn02Inin00GroupADInertiaCmpVelAssiBasdDampgRollgYDInertiaCmpVelDInertiaCmpVelAssiBasdDampgRollgY
      AssemblySwConnector_1952: ecu-extract-reference=CalRegn02Inin00GroupADInertiaCmpVelAssiBasdDampgStatWhlImbRejctnOnYDInertiaCmpVelDInertiaCmpVelAssiBasdDampgStatWhlIm_a2ec8366
      AssemblySwConnector_1953: ecu-extract-reference=CalRegn02Inin00GroupADInertiaCmpVelCmdScaYDInertiaCmpVelDInertiaCmpVelCmdScaY
      AssemblySwConnector_1954: ecu-extract-reference=CalRegn02Inin00GroupADInertiaCmpVelDampgDecelGainDInertiaCmpVelDInertiaCmpVelDampgDecelGain
      AssemblySwConnector_1955: ecu-extract-reference=CalRegn02Inin00GroupADInertiaCmpVelDampgDecelGainFallSlewDInertiaCmpVelDInertiaCmpVelDampgDecelGainFallSlew
      AssemblySwConnector_1956: ecu-extract-reference=CalRegn02Inin00GroupADInertiaCmpVelDampgDecelGainRisngSlewXDInertiaCmpVelDInertiaCmpVelDampgDecelGainRisngSlewX
      AssemblySwConnector_1957: ecu-extract-reference=CalRegn02Inin00GroupADInertiaCmpVelDampgDecelGainRisngSlewYDInertiaCmpVelDInertiaCmpVelDampgDecelGainRisngSlewY
      AssemblySwConnector_1958: ecu-extract-reference=CalRegn02Inin00GroupADInertiaCmpVelDampgGainOffThdDInertiaCmpVelDInertiaCmpVelDampgGainOffThd
      AssemblySwConnector_1959: ecu-extract-reference=CalRegn02Inin00GroupADInertiaCmpVelDampgGainOnThdDInertiaCmpVelDInertiaCmpVelDampgGainOnThd
      AssemblySwConnector_1960: ecu-extract-reference=CalRegn02Inin00GroupADInertiaCmpVelDecelGainEnaCalDInertiaCmpVelDInertiaCmpVelDecelGainEnaCal
      AssemblySwConnector_1961: ecu-extract-reference=CalRegn02Inin00GroupADInertiaCmpVelModWhlImbRejctnBlndXDInertiaCmpVelDInertiaCmpVelModWhlImbRejctnBlndX
      AssemblySwConnector_1962: ecu-extract-reference=CalRegn02Inin00GroupADInertiaCmpVelModWhlImbRejctnBlndYDInertiaCmpVelDInertiaCmpVelModWhlImbRejctnBlndY
      AssemblySwConnector_1963: ecu-extract-reference=CalRegn02Inin00GroupADInertiaCmpVelMotInertiaDInertiaCmpVelDInertiaCmpVelMotInertia
      AssemblySwConnector_1964: ecu-extract-reference=CalRegn02Inin00GroupADInertiaCmpVelMotVelBasdOutpScagXDInertiaCmpVelDInertiaCmpVelMotVelBasdOutpScagX
      AssemblySwConnector_1965: ecu-extract-reference=CalRegn02Inin00GroupADInertiaCmpVelMotVelBasdOutpScagYDInertiaCmpVelDInertiaCmpVelMotVelBasdOutpScagY
      AssemblySwConnector_1966: ecu-extract-reference=CalRegn02Inin00GroupADInertiaCmpVelNotchBlndYDInertiaCmpVelDInertiaCmpVelNotchBlndY
      AssemblySwConnector_1967: ecu-extract-reference=CalRegn02Inin00GroupADInertiaCmpVelNotchFilStructDInertiaCmpVelDInertiaCmpVelNotchFilStruct
      AssemblySwConnector_1968: ecu-extract-reference=CalRegn02Inin00GroupADInertiaCmpVelTqSnsrVelFilFrqDInertiaCmpVelDInertiaCmpVelTqSnsrVelFilFrq
      AssemblySwConnector_1969: ecu-extract-reference=CalRegn02Inin00GroupADInertiaCmpVelTqSnsrVelScaDInertiaCmpVelDInertiaCmpVelTqSnsrVelSca
      AssemblySwConnector_1983: ecu-extract-reference=CalRegn02Rt00GroupADAssiMotTqWhlImbRejctnMaxXDAssiDAssiMotTqWhlImbRejctnMaxX
      AssemblySwConnector_1984: ecu-extract-reference=CalRegn02Rt00GroupADAssiMotTqWhlImbRejctnMaxYDAssiDAssiMotTqWhlImbRejctnMaxY
      AssemblySwConnector_1985: ecu-extract-reference=CalRegn02Rt00GroupADAssiMotTqWhlImbRejctnMinXDAssiDAssiMotTqWhlImbRejctnMinX
      AssemblySwConnector_1986: ecu-extract-reference=CalRegn02Rt00GroupADAssiMotTqWhlImbRejctnMinYDAssiDAssiMotTqWhlImbRejctnMinY
      AssemblySwConnector_1987: ecu-extract-reference=CalRegn02Rt00GroupADAssiWhlImbRejctnBlndScaXDAssiDAssiWhlImbRejctnBlndScaX
      AssemblySwConnector_1988: ecu-extract-reference=CalRegn02Rt00GroupADAssiWhlImbRejctnBlndScaYDAssiDAssiWhlImbRejctnBlndScaY
      AssemblySwConnector_1989: ecu-extract-reference=CalRegn02Rt00GroupADAssiHiFrqGainYDAssiHiFrqDAssiHiFrqGainY
      AssemblySwConnector_1990: ecu-extract-reference=CalRegn02Rt00GroupADAssiHiFrqHpFilFrqYDAssiHiFrqDAssiHiFrqHpFilFrqY
      AssemblySwConnector_1991: ecu-extract-reference=CalRegn02Rt00GroupADAssiHiFrqTqWhlImbRejctnTqXDAssiHiFrqDAssiHiFrqTqWhlImbRejctnTqX
      AssemblySwConnector_1992: ecu-extract-reference=CalRegn02Rt00GroupADAssiHiFrqTqXDAssiHiFrqDAssiHiFrqTqX
      AssemblySwConnector_1993: ecu-extract-reference=CalRegn02Rt00GroupADAssiHiFrqWhlImbRejctnBlndXDAssiHiFrqDAssiHiFrqWhlImbRejctnBlndX
      AssemblySwConnector_1994: ecu-extract-reference=CalRegn02Rt00GroupADAssiHiFrqWhlImbRejctnBlndYDAssiHiFrqDAssiHiFrqWhlImbRejctnBlndY
      AssemblySwConnector_1995: ecu-extract-reference=CalRegn02Rt00GroupADAssiHiFrqWhlImbRejctnGainYDAssiHiFrqDAssiHiFrqWhlImbRejctnGainY
      AssemblySwConnector_1996: ecu-extract-reference=CalRegn02Rt00GroupADDampgHwTqXDDampgDDampgHwTqX
      AssemblySwConnector_1997: ecu-extract-reference=CalRegn02Rt00GroupADDampgHwTqYDDampgDDampgHwTqY
      AssemblySwConnector_1998: ecu-extract-reference=CalRegn02Rt00GroupADDampgHydCoeff1ScaYDDampgDDampgHydCoeff1ScaY
      AssemblySwConnector_1999: ecu-extract-reference=CalRegn02Rt00GroupADDampgHydCoeff2ScaYDDampgDDampgHydCoeff2ScaY
      AssemblySwConnector_2000: ecu-extract-reference=CalRegn02Rt00GroupADDampgHydCoeff3ScaYDDampgDDampgHydCoeff3ScaY
      AssemblySwConnector_2001: ecu-extract-reference=CalRegn02Rt00GroupADDampgHydCoeff4ScaYDDampgDDampgHydCoeff4ScaY
      AssemblySwConnector_2002: ecu-extract-reference=CalRegn02Rt00GroupADDampgMotVelXDDampgDDampgMotVelX
      AssemblySwConnector_2003: ecu-extract-reference=CalRegn02Rt00GroupADDampgMotVelYDDampgDDampgMotVelY
      AssemblySwConnector_2013: ecu-extract-reference=CalRegn02Rt00GroupADHysCmpEffLossYDHysCmpDHysCmpEffLossY
      AssemblySwConnector_2014: ecu-extract-reference=CalRegn02Rt00GroupADHysCmpEffOffsYDHysCmpDHysCmpEffOffsY
      AssemblySwConnector_2015: ecu-extract-reference=CalRegn02Rt00GroupADHysCmpFricWhlImbRejctnBlndXDHysCmpDHysCmpFricWhlImbRejctnBlndX
      AssemblySwConnector_2016: ecu-extract-reference=CalRegn02Rt00GroupADHysCmpFricWhlImbRejctnBlndYDHysCmpDHysCmpFricWhlImbRejctnBlndY
      AssemblySwConnector_2017: ecu-extract-reference=CalRegn02Rt00GroupADHysCmpFricWhlImbRejctnOffYDHysCmpDHysCmpFricWhlImbRejctnOffY
      AssemblySwConnector_2018: ecu-extract-reference=CalRegn02Rt00GroupADHysCmpFricWhlImbRejctnOnYDHysCmpDHysCmpFricWhlImbRejctnOnY
      AssemblySwConnector_2019: ecu-extract-reference=CalRegn02Rt00GroupADHysCmpHwTqScaXDHysCmpDHysCmpHwTqScaX
      AssemblySwConnector_2020: ecu-extract-reference=CalRegn02Rt00GroupADHysCmpHwTqScaYDHysCmpDHysCmpHwTqScaY
      AssemblySwConnector_2021: ecu-extract-reference=CalRegn02Rt00GroupADHysCmpHysSatnYDHysCmpDHysCmpHysSatnY
      AssemblySwConnector_2022: ecu-extract-reference=CalRegn02Rt00GroupADHysCmpNegHysCmpScaXDHysCmpDHysCmpNegHysCmpScaX
      AssemblySwConnector_2023: ecu-extract-reference=CalRegn02Rt00GroupADHysCmpNegHysCmpScaYDHysCmpDHysCmpNegHysCmpScaY
      AssemblySwConnector_2024: ecu-extract-reference=CalRegn02Rt00GroupADHysCmpNegHysCmpXDHysCmpDHysCmpNegHysCmpX
      AssemblySwConnector_2025: ecu-extract-reference=CalRegn02Rt00GroupADHysCmpNegHysCmpYDHysCmpDHysCmpNegHysCmpY
      AssemblySwConnector_2026: ecu-extract-reference=CalRegn02Rt00GroupADHysCmpOutpLimDHysCmpDHysCmpOutpLim
      AssemblySwConnector_2027: ecu-extract-reference=CalRegn02Rt00GroupADHysCmpRevGainDHysCmpDHysCmpRevGain
      AssemblySwConnector_2028: ecu-extract-reference=CalRegn02Rt00GroupADHysCmpRiseXDHysCmpDHysCmpRiseX
      AssemblySwConnector_2029: ecu-extract-reference=CalRegn02Rt00GroupADHysCmpRiseYDHysCmpDHysCmpRiseY
      AssemblySwConnector_2030: ecu-extract-reference=CalRegn02Rt00GroupADInertiaCmpVelAssiBasdDampgStatYDInertiaCmpVelDInertiaCmpVelAssiBasdDampgStatY
      AssemblySwConnector_2031: ecu-extract-reference=CalRegn02Rt00GroupADInertiaCmpVelDampgFilFrqDInertiaCmpVelDInertiaCmpVelDampgFilFrq
      AssemblySwConnector_2032: ecu-extract-reference=CalRegn02Rt00GroupADInertiaCmpVelDampgFilFrqWhlImbRejctnOnDInertiaCmpVelDInertiaCmpVelDampgFilFrqWhlImbRejctnOn
      AssemblySwConnector_2033: ecu-extract-reference=CalRegn02Rt00GroupADInertiaCmpVelDampgSpdBlndYDInertiaCmpVelDInertiaCmpVelDampgSpdBlndY
      AssemblySwConnector_2034: ecu-extract-reference=CalRegn02Rt00GroupADInertiaCmpVelDampgWhlImbRejctnBlndXDInertiaCmpVelDInertiaCmpVelDampgWhlImbRejctnBlndX
      AssemblySwConnector_2035: ecu-extract-reference=CalRegn02Rt00GroupADInertiaCmpVelDampgWhlImbRejctnBlndYDInertiaCmpVelDInertiaCmpVelDampgWhlImbRejctnBlndY
      AssemblySwConnector_2044: ecu-extract-reference=CalRegn02Rt01GroupADAssiHiFrqGainYDAAACalRegn02Rt01GroupA_DummyDAssiHiFrqGainY
      AssemblySwConnector_2045: ecu-extract-reference=CalRegn02Rt01GroupADAssiHiFrqHpFilFrqYDAAACalRegn02Rt01GroupA_DummyDAssiHiFrqHpFilFrqY
      AssemblySwConnector_2046: ecu-extract-reference=CalRegn02Rt01GroupADAssiHiFrqTqWhlImbRejctnTqXDAAACalRegn02Rt01GroupA_DummyDAssiHiFrqTqWhlImbRejctnTqX
      AssemblySwConnector_2047: ecu-extract-reference=CalRegn02Rt01GroupADAssiHiFrqTqXDAAACalRegn02Rt01GroupA_DummyDAssiHiFrqTqX
      AssemblySwConnector_2048: ecu-extract-reference=CalRegn02Rt01GroupADAssiHiFrqWhlImbRejctnBlndXDAAACalRegn02Rt01GroupA_DummyDAssiHiFrqWhlImbRejctnBlndX
      AssemblySwConnector_2049: ecu-extract-reference=CalRegn02Rt01GroupADAssiHiFrqWhlImbRejctnBlndYDAAACalRegn02Rt01GroupA_DummyDAssiHiFrqWhlImbRejctnBlndY
      AssemblySwConnector_2050: ecu-extract-reference=CalRegn02Rt01GroupADAssiHiFrqWhlImbRejctnGainYDAAACalRegn02Rt01GroupA_DummyDAssiHiFrqWhlImbRejctnGainY
      AssemblySwConnector_2051: ecu-extract-reference=CalRegn02Rt01GroupADAssiMotTqWhlImbRejctnMaxXDAAACalRegn02Rt01GroupA_DummyDAssiMotTqWhlImbRejctnMaxX
      AssemblySwConnector_2052: ecu-extract-reference=CalRegn02Rt01GroupADAssiMotTqWhlImbRejctnMaxYDAAACalRegn02Rt01GroupA_DummyDAssiMotTqWhlImbRejctnMaxY
      AssemblySwConnector_2053: ecu-extract-reference=CalRegn02Rt01GroupADAssiMotTqWhlImbRejctnMinXDAAACalRegn02Rt01GroupA_DummyDAssiMotTqWhlImbRejctnMinX
      AssemblySwConnector_2054: ecu-extract-reference=CalRegn02Rt01GroupADAssiMotTqWhlImbRejctnMinYDAAACalRegn02Rt01GroupA_DummyDAssiMotTqWhlImbRejctnMinY
      AssemblySwConnector_2055: ecu-extract-reference=CalRegn02Rt01GroupADAssiWhlImbRejctnBlndScaXDAAACalRegn02Rt01GroupA_DummyDAssiWhlImbRejctnBlndScaX
      AssemblySwConnector_2056: ecu-extract-reference=CalRegn02Rt01GroupADAssiWhlImbRejctnBlndScaYDAAACalRegn02Rt01GroupA_DummyDAssiWhlImbRejctnBlndScaY
      AssemblySwConnector_2057: ecu-extract-reference=CalRegn02Rt01GroupADDampgHwTqXDAAACalRegn02Rt01GroupA_DummyDDampgHwTqX
      AssemblySwConnector_2058: ecu-extract-reference=CalRegn02Rt01GroupADDampgHwTqYDAAACalRegn02Rt01GroupA_DummyDDampgHwTqY
      AssemblySwConnector_2059: ecu-extract-reference=CalRegn02Rt01GroupADDampgHydCoeff1ScaYDAAACalRegn02Rt01GroupA_DummyDDampgHydCoeff1ScaY
      AssemblySwConnector_2060: ecu-extract-reference=CalRegn02Rt01GroupADDampgHydCoeff2ScaYDAAACalRegn02Rt01GroupA_DummyDDampgHydCoeff2ScaY
      AssemblySwConnector_2061: ecu-extract-reference=CalRegn02Rt01GroupADDampgHydCoeff3ScaYDAAACalRegn02Rt01GroupA_DummyDDampgHydCoeff3ScaY
      AssemblySwConnector_2062: ecu-extract-reference=CalRegn02Rt01GroupADDampgHydCoeff4ScaYDAAACalRegn02Rt01GroupA_DummyDDampgHydCoeff4ScaY
      AssemblySwConnector_2063: ecu-extract-reference=CalRegn02Rt01GroupADDampgMotVelXDAAACalRegn02Rt01GroupA_DummyDDampgMotVelX
      AssemblySwConnector_2064: ecu-extract-reference=CalRegn02Rt01GroupADDampgMotVelYDAAACalRegn02Rt01GroupA_DummyDDampgMotVelY
      AssemblySwConnector_2073: ecu-extract-reference=CalRegn02Rt01GroupADHysCmpEffLossYDAAACalRegn02Rt01GroupA_DummyDHysCmpEffLossY
      AssemblySwConnector_2074: ecu-extract-reference=CalRegn02Rt01GroupADHysCmpEffOffsYDAAACalRegn02Rt01GroupA_DummyDHysCmpEffOffsY
      AssemblySwConnector_2075: ecu-extract-reference=CalRegn02Rt01GroupADHysCmpFricWhlImbRejctnBlndXDAAACalRegn02Rt01GroupA_DummyDHysCmpFricWhlImbRejctnBlndX
      AssemblySwConnector_2076: ecu-extract-reference=CalRegn02Rt01GroupADHysCmpFricWhlImbRejctnBlndYDAAACalRegn02Rt01GroupA_DummyDHysCmpFricWhlImbRejctnBlndY
      AssemblySwConnector_2077: ecu-extract-reference=CalRegn02Rt01GroupADHysCmpFricWhlImbRejctnOffYDAAACalRegn02Rt01GroupA_DummyDHysCmpFricWhlImbRejctnOffY
      AssemblySwConnector_2078: ecu-extract-reference=CalRegn02Rt01GroupADHysCmpFricWhlImbRejctnOnYDAAACalRegn02Rt01GroupA_DummyDHysCmpFricWhlImbRejctnOnY
      AssemblySwConnector_2079: ecu-extract-reference=CalRegn02Rt01GroupADHysCmpHwTqScaXDAAACalRegn02Rt01GroupA_DummyDHysCmpHwTqScaX
      AssemblySwConnector_2080: ecu-extract-reference=CalRegn02Rt01GroupADHysCmpHwTqScaYDAAACalRegn02Rt01GroupA_DummyDHysCmpHwTqScaY
      AssemblySwConnector_2081: ecu-extract-reference=CalRegn02Rt01GroupADHysCmpHysSatnYDAAACalRegn02Rt01GroupA_DummyDHysCmpHysSatnY
      AssemblySwConnector_2082: ecu-extract-reference=CalRegn02Rt01GroupADHysCmpNegHysCmpScaXDAAACalRegn02Rt01GroupA_DummyDHysCmpNegHysCmpScaX
      AssemblySwConnector_2083: ecu-extract-reference=CalRegn02Rt01GroupADHysCmpNegHysCmpScaYDAAACalRegn02Rt01GroupA_DummyDHysCmpNegHysCmpScaY
      AssemblySwConnector_2084: ecu-extract-reference=CalRegn02Rt01GroupADHysCmpNegHysCmpXDAAACalRegn02Rt01GroupA_DummyDHysCmpNegHysCmpX
      AssemblySwConnector_2085: ecu-extract-reference=CalRegn02Rt01GroupADHysCmpNegHysCmpYDAAACalRegn02Rt01GroupA_DummyDHysCmpNegHysCmpY
      AssemblySwConnector_2086: ecu-extract-reference=CalRegn02Rt01GroupADHysCmpOutpLimDAAACalRegn02Rt01GroupA_DummyDHysCmpOutpLim
      AssemblySwConnector_2087: ecu-extract-reference=CalRegn02Rt01GroupADHysCmpRevGainDAAACalRegn02Rt01GroupA_DummyDHysCmpRevGain
      AssemblySwConnector_2088: ecu-extract-reference=CalRegn02Rt01GroupADHysCmpRiseXDAAACalRegn02Rt01GroupA_DummyDHysCmpRiseX
      AssemblySwConnector_2089: ecu-extract-reference=CalRegn02Rt01GroupADHysCmpRiseYDAAACalRegn02Rt01GroupA_DummyDHysCmpRiseY
      AssemblySwConnector_2090: ecu-extract-reference=CalRegn02Rt01GroupADInertiaCmpVelAssiBasdDampgStatYDAAACalRegn02Rt01GroupA_DummyDInertiaCmpVelAssiBasdDampgStatY
      AssemblySwConnector_2091: ecu-extract-reference=CalRegn02Rt01GroupADInertiaCmpVelDampgFilFrqDAAACalRegn02Rt01GroupA_DummyDInertiaCmpVelDampgFilFrq
      AssemblySwConnector_2092: ecu-extract-reference=CalRegn02Rt01GroupADInertiaCmpVelDampgFilFrqWhlImbRejctnOnDAAACalRegn02Rt01GroupA_DummyDInertiaCmpVelDampgFilFrqWhlImbRejctnOn
      AssemblySwConnector_2093: ecu-extract-reference=CalRegn02Rt01GroupADInertiaCmpVelDampgSpdBlndYDAAACalRegn02Rt01GroupA_DummyDInertiaCmpVelDampgSpdBlndY
      AssemblySwConnector_2094: ecu-extract-reference=CalRegn02Rt01GroupADInertiaCmpVelDampgWhlImbRejctnBlndXDAAACalRegn02Rt01GroupA_DummyDInertiaCmpVelDampgWhlImbRejctnBlndX
      AssemblySwConnector_2095: ecu-extract-reference=CalRegn02Rt01GroupADInertiaCmpVelDampgWhlImbRejctnBlndYDAAACalRegn02Rt01GroupA_DummyDInertiaCmpVelDampgWhlImbRejctnBlndY
      AssemblySwConnector_2104: ecu-extract-reference=CalRegn02Rt02GroupADAssiHiFrqGainYDAAACalRegn02Rt01GroupA_Dummy_1DAssiHiFrqGainY
      AssemblySwConnector_2105: ecu-extract-reference=CalRegn02Rt02GroupADAssiHiFrqHpFilFrqYDAAACalRegn02Rt01GroupA_Dummy_1DAssiHiFrqHpFilFrqY
      AssemblySwConnector_2106: ecu-extract-reference=CalRegn02Rt02GroupADAssiHiFrqTqWhlImbRejctnTqXDAAACalRegn02Rt01GroupA_Dummy_1DAssiHiFrqTqWhlImbRejctnTqX
      AssemblySwConnector_2107: ecu-extract-reference=CalRegn02Rt02GroupADAssiHiFrqTqXDAAACalRegn02Rt01GroupA_Dummy_1DAssiHiFrqTqX
      AssemblySwConnector_2108: ecu-extract-reference=CalRegn02Rt02GroupADAssiHiFrqWhlImbRejctnBlndXDAAACalRegn02Rt01GroupA_Dummy_1DAssiHiFrqWhlImbRejctnBlndX
      AssemblySwConnector_2109: ecu-extract-reference=CalRegn02Rt02GroupADAssiHiFrqWhlImbRejctnBlndYDAAACalRegn02Rt01GroupA_Dummy_1DAssiHiFrqWhlImbRejctnBlndY
      AssemblySwConnector_2110: ecu-extract-reference=CalRegn02Rt02GroupADAssiHiFrqWhlImbRejctnGainYDAAACalRegn02Rt01GroupA_Dummy_1DAssiHiFrqWhlImbRejctnGainY
      AssemblySwConnector_2111: ecu-extract-reference=CalRegn02Rt02GroupADAssiMotTqWhlImbRejctnMaxXDAAACalRegn02Rt01GroupA_Dummy_1DAssiMotTqWhlImbRejctnMaxX
      AssemblySwConnector_2112: ecu-extract-reference=CalRegn02Rt02GroupADAssiMotTqWhlImbRejctnMaxYDAAACalRegn02Rt01GroupA_Dummy_1DAssiMotTqWhlImbRejctnMaxY
      AssemblySwConnector_2113: ecu-extract-reference=CalRegn02Rt02GroupADAssiMotTqWhlImbRejctnMinXDAAACalRegn02Rt01GroupA_Dummy_1DAssiMotTqWhlImbRejctnMinX
      AssemblySwConnector_2114: ecu-extract-reference=CalRegn02Rt02GroupADAssiMotTqWhlImbRejctnMinYDAAACalRegn02Rt01GroupA_Dummy_1DAssiMotTqWhlImbRejctnMinY
      AssemblySwConnector_2115: ecu-extract-reference=CalRegn02Rt02GroupADAssiWhlImbRejctnBlndScaXDAAACalRegn02Rt01GroupA_Dummy_1DAssiWhlImbRejctnBlndScaX
      AssemblySwConnector_2116: ecu-extract-reference=CalRegn02Rt02GroupADAssiWhlImbRejctnBlndScaYDAAACalRegn02Rt01GroupA_Dummy_1DAssiWhlImbRejctnBlndScaY
      AssemblySwConnector_2117: ecu-extract-reference=CalRegn02Rt02GroupADDampgHwTqXDAAACalRegn02Rt01GroupA_Dummy_1DDampgHwTqX
      AssemblySwConnector_2118: ecu-extract-reference=CalRegn02Rt02GroupADDampgHwTqYDAAACalRegn02Rt01GroupA_Dummy_1DDampgHwTqY
      AssemblySwConnector_2119: ecu-extract-reference=CalRegn02Rt02GroupADDampgHydCoeff1ScaYDAAACalRegn02Rt01GroupA_Dummy_1DDampgHydCoeff1ScaY
      AssemblySwConnector_2120: ecu-extract-reference=CalRegn02Rt02GroupADDampgHydCoeff2ScaYDAAACalRegn02Rt01GroupA_Dummy_1DDampgHydCoeff2ScaY
      AssemblySwConnector_2121: ecu-extract-reference=CalRegn02Rt02GroupADDampgHydCoeff3ScaYDAAACalRegn02Rt01GroupA_Dummy_1DDampgHydCoeff3ScaY
      AssemblySwConnector_2122: ecu-extract-reference=CalRegn02Rt02GroupADDampgHydCoeff4ScaYDAAACalRegn02Rt01GroupA_Dummy_1DDampgHydCoeff4ScaY
      AssemblySwConnector_2123: ecu-extract-reference=CalRegn02Rt02GroupADDampgMotVelXDAAACalRegn02Rt01GroupA_Dummy_1DDampgMotVelX
      AssemblySwConnector_2124: ecu-extract-reference=CalRegn02Rt02GroupADDampgMotVelYDAAACalRegn02Rt01GroupA_Dummy_1DDampgMotVelY
      AssemblySwConnector_2133: ecu-extract-reference=CalRegn02Rt02GroupADHysCmpEffLossYDAAACalRegn02Rt01GroupA_Dummy_1DHysCmpEffLossY
      AssemblySwConnector_2134: ecu-extract-reference=CalRegn02Rt02GroupADHysCmpEffOffsYDAAACalRegn02Rt01GroupA_Dummy_1DHysCmpEffOffsY
      AssemblySwConnector_2135: ecu-extract-reference=CalRegn02Rt02GroupADHysCmpFricWhlImbRejctnBlndXDAAACalRegn02Rt01GroupA_Dummy_1DHysCmpFricWhlImbRejctnBlndX
      AssemblySwConnector_2136: ecu-extract-reference=CalRegn02Rt02GroupADHysCmpFricWhlImbRejctnBlndYDAAACalRegn02Rt01GroupA_Dummy_1DHysCmpFricWhlImbRejctnBlndY
      AssemblySwConnector_2137: ecu-extract-reference=CalRegn02Rt02GroupADHysCmpFricWhlImbRejctnOffYDAAACalRegn02Rt01GroupA_Dummy_1DHysCmpFricWhlImbRejctnOffY
      AssemblySwConnector_2138: ecu-extract-reference=CalRegn02Rt02GroupADHysCmpFricWhlImbRejctnOnYDAAACalRegn02Rt01GroupA_Dummy_1DHysCmpFricWhlImbRejctnOnY
      AssemblySwConnector_2139: ecu-extract-reference=CalRegn02Rt02GroupADHysCmpHwTqScaXDAAACalRegn02Rt01GroupA_Dummy_1DHysCmpHwTqScaX
      AssemblySwConnector_2140: ecu-extract-reference=CalRegn02Rt02GroupADHysCmpHwTqScaYDAAACalRegn02Rt01GroupA_Dummy_1DHysCmpHwTqScaY
      AssemblySwConnector_2141: ecu-extract-reference=CalRegn02Rt02GroupADHysCmpHysSatnYDAAACalRegn02Rt01GroupA_Dummy_1DHysCmpHysSatnY
      AssemblySwConnector_2142: ecu-extract-reference=CalRegn02Rt02GroupADHysCmpNegHysCmpScaXDAAACalRegn02Rt01GroupA_Dummy_1DHysCmpNegHysCmpScaX
      AssemblySwConnector_2143: ecu-extract-reference=CalRegn02Rt02GroupADHysCmpNegHysCmpScaYDAAACalRegn02Rt01GroupA_Dummy_1DHysCmpNegHysCmpScaY
      AssemblySwConnector_2144: ecu-extract-reference=CalRegn02Rt02GroupADHysCmpNegHysCmpXDAAACalRegn02Rt01GroupA_Dummy_1DHysCmpNegHysCmpX
      AssemblySwConnector_2145: ecu-extract-reference=CalRegn02Rt02GroupADHysCmpNegHysCmpYDAAACalRegn02Rt01GroupA_Dummy_1DHysCmpNegHysCmpY
      AssemblySwConnector_2146: ecu-extract-reference=CalRegn02Rt02GroupADHysCmpOutpLimDAAACalRegn02Rt01GroupA_Dummy_1DHysCmpOutpLim
      AssemblySwConnector_2147: ecu-extract-reference=CalRegn02Rt02GroupADHysCmpRevGainDAAACalRegn02Rt01GroupA_Dummy_1DHysCmpRevGain
      AssemblySwConnector_2148: ecu-extract-reference=CalRegn02Rt02GroupADHysCmpRiseXDAAACalRegn02Rt01GroupA_Dummy_1DHysCmpRiseX
      AssemblySwConnector_2149: ecu-extract-reference=CalRegn02Rt02GroupADHysCmpRiseYDAAACalRegn02Rt01GroupA_Dummy_1DHysCmpRiseY
      AssemblySwConnector_2150: ecu-extract-reference=CalRegn02Rt02GroupADInertiaCmpVelAssiBasdDampgStatYDAAACalRegn02Rt01GroupA_Dummy_1DInertiaCmpVelAssiBasdDampgStatY
      AssemblySwConnector_2151: ecu-extract-reference=CalRegn02Rt02GroupADInertiaCmpVelDampgFilFrqDAAACalRegn02Rt01GroupA_Dummy_1DInertiaCmpVelDampgFilFrq
      AssemblySwConnector_2152: ecu-extract-reference=CalRegn02Rt02GroupADInertiaCmpVelDampgFilFrqWhlImbRejctnOnDAAACalRegn02Rt01GroupA_Dummy_1DInertiaCmpVelDampgFilFrqWhl_ece45a47
      AssemblySwConnector_2153: ecu-extract-reference=CalRegn02Rt02GroupADInertiaCmpVelDampgSpdBlndYDAAACalRegn02Rt01GroupA_Dummy_1DInertiaCmpVelDampgSpdBlndY
      AssemblySwConnector_2154: ecu-extract-reference=CalRegn02Rt02GroupADInertiaCmpVelDampgWhlImbRejctnBlndXDAAACalRegn02Rt01GroupA_Dummy_1DInertiaCmpVelDampgWhlImbRejctnBlndX
      AssemblySwConnector_2155: ecu-extract-reference=CalRegn02Rt02GroupADInertiaCmpVelDampgWhlImbRejctnBlndYDAAACalRegn02Rt01GroupA_Dummy_1DInertiaCmpVelDampgWhlImbRejctnBlndY
      AssemblySwConnector_2164: ecu-extract-reference=CalRegn02Rt03GroupADAssiHiFrqGainYDAAACalRegn02Rt01GroupA_Dummy_2DAssiHiFrqGainY
      AssemblySwConnector_2165: ecu-extract-reference=CalRegn02Rt03GroupADAssiHiFrqHpFilFrqYDAAACalRegn02Rt01GroupA_Dummy_2DAssiHiFrqHpFilFrqY
      AssemblySwConnector_2166: ecu-extract-reference=CalRegn02Rt03GroupADAssiHiFrqTqWhlImbRejctnTqXDAAACalRegn02Rt01GroupA_Dummy_2DAssiHiFrqTqWhlImbRejctnTqX
      AssemblySwConnector_2167: ecu-extract-reference=CalRegn02Rt03GroupADAssiHiFrqTqXDAAACalRegn02Rt01GroupA_Dummy_2DAssiHiFrqTqX
      AssemblySwConnector_2168: ecu-extract-reference=CalRegn02Rt03GroupADAssiHiFrqWhlImbRejctnBlndXDAAACalRegn02Rt01GroupA_Dummy_2DAssiHiFrqWhlImbRejctnBlndX
      AssemblySwConnector_2169: ecu-extract-reference=CalRegn02Rt03GroupADAssiHiFrqWhlImbRejctnBlndYDAAACalRegn02Rt01GroupA_Dummy_2DAssiHiFrqWhlImbRejctnBlndY
      AssemblySwConnector_2170: ecu-extract-reference=CalRegn02Rt03GroupADAssiHiFrqWhlImbRejctnGainYDAAACalRegn02Rt01GroupA_Dummy_2DAssiHiFrqWhlImbRejctnGainY
      AssemblySwConnector_2171: ecu-extract-reference=CalRegn02Rt03GroupADAssiMotTqWhlImbRejctnMaxXDAAACalRegn02Rt01GroupA_Dummy_2DAssiMotTqWhlImbRejctnMaxX
      AssemblySwConnector_2172: ecu-extract-reference=CalRegn02Rt03GroupADAssiMotTqWhlImbRejctnMaxYDAAACalRegn02Rt01GroupA_Dummy_2DAssiMotTqWhlImbRejctnMaxY
      AssemblySwConnector_2173: ecu-extract-reference=CalRegn02Rt03GroupADAssiMotTqWhlImbRejctnMinXDAAACalRegn02Rt01GroupA_Dummy_2DAssiMotTqWhlImbRejctnMinX
      AssemblySwConnector_2174: ecu-extract-reference=CalRegn02Rt03GroupADAssiMotTqWhlImbRejctnMinYDAAACalRegn02Rt01GroupA_Dummy_2DAssiMotTqWhlImbRejctnMinY
      AssemblySwConnector_2175: ecu-extract-reference=CalRegn02Rt03GroupADAssiWhlImbRejctnBlndScaXDAAACalRegn02Rt01GroupA_Dummy_2DAssiWhlImbRejctnBlndScaX
      AssemblySwConnector_2176: ecu-extract-reference=CalRegn02Rt03GroupADAssiWhlImbRejctnBlndScaYDAAACalRegn02Rt01GroupA_Dummy_2DAssiWhlImbRejctnBlndScaY
      AssemblySwConnector_2177: ecu-extract-reference=CalRegn02Rt03GroupADDampgHwTqXDAAACalRegn02Rt01GroupA_Dummy_2DDampgHwTqX
      AssemblySwConnector_2178: ecu-extract-reference=CalRegn02Rt03GroupADDampgHwTqYDAAACalRegn02Rt01GroupA_Dummy_2DDampgHwTqY
      AssemblySwConnector_2179: ecu-extract-reference=CalRegn02Rt03GroupADDampgHydCoeff1ScaYDAAACalRegn02Rt01GroupA_Dummy_2DDampgHydCoeff1ScaY
      AssemblySwConnector_2180: ecu-extract-reference=CalRegn02Rt03GroupADDampgHydCoeff2ScaYDAAACalRegn02Rt01GroupA_Dummy_2DDampgHydCoeff2ScaY
      AssemblySwConnector_2181: ecu-extract-reference=CalRegn02Rt03GroupADDampgHydCoeff3ScaYDAAACalRegn02Rt01GroupA_Dummy_2DDampgHydCoeff3ScaY
      AssemblySwConnector_2182: ecu-extract-reference=CalRegn02Rt03GroupADDampgHydCoeff4ScaYDAAACalRegn02Rt01GroupA_Dummy_2DDampgHydCoeff4ScaY
      AssemblySwConnector_2183: ecu-extract-reference=CalRegn02Rt03GroupADDampgMotVelXDAAACalRegn02Rt01GroupA_Dummy_2DDampgMotVelX
      AssemblySwConnector_2184: ecu-extract-reference=CalRegn02Rt03GroupADDampgMotVelYDAAACalRegn02Rt01GroupA_Dummy_2DDampgMotVelY
      AssemblySwConnector_2193: ecu-extract-reference=CalRegn02Rt03GroupADHysCmpEffLossYDAAACalRegn02Rt01GroupA_Dummy_2DHysCmpEffLossY
      AssemblySwConnector_2194: ecu-extract-reference=CalRegn02Rt03GroupADHysCmpEffOffsYDAAACalRegn02Rt01GroupA_Dummy_2DHysCmpEffOffsY
      AssemblySwConnector_2195: ecu-extract-reference=CalRegn02Rt03GroupADHysCmpFricWhlImbRejctnBlndXDAAACalRegn02Rt01GroupA_Dummy_2DHysCmpFricWhlImbRejctnBlndX
      AssemblySwConnector_2196: ecu-extract-reference=CalRegn02Rt03GroupADHysCmpFricWhlImbRejctnBlndYDAAACalRegn02Rt01GroupA_Dummy_2DHysCmpFricWhlImbRejctnBlndY
      AssemblySwConnector_2197: ecu-extract-reference=CalRegn02Rt03GroupADHysCmpFricWhlImbRejctnOffYDAAACalRegn02Rt01GroupA_Dummy_2DHysCmpFricWhlImbRejctnOffY
      AssemblySwConnector_2198: ecu-extract-reference=CalRegn02Rt03GroupADHysCmpFricWhlImbRejctnOnYDAAACalRegn02Rt01GroupA_Dummy_2DHysCmpFricWhlImbRejctnOnY
      AssemblySwConnector_2199: ecu-extract-reference=CalRegn02Rt03GroupADHysCmpHwTqScaXDAAACalRegn02Rt01GroupA_Dummy_2DHysCmpHwTqScaX
      AssemblySwConnector_2200: ecu-extract-reference=CalRegn02Rt03GroupADHysCmpHwTqScaYDAAACalRegn02Rt01GroupA_Dummy_2DHysCmpHwTqScaY
      AssemblySwConnector_2201: ecu-extract-reference=CalRegn02Rt03GroupADHysCmpHysSatnYDAAACalRegn02Rt01GroupA_Dummy_2DHysCmpHysSatnY
      AssemblySwConnector_2202: ecu-extract-reference=CalRegn02Rt03GroupADHysCmpNegHysCmpScaXDAAACalRegn02Rt01GroupA_Dummy_2DHysCmpNegHysCmpScaX
      AssemblySwConnector_2203: ecu-extract-reference=CalRegn02Rt03GroupADHysCmpNegHysCmpScaYDAAACalRegn02Rt01GroupA_Dummy_2DHysCmpNegHysCmpScaY
      AssemblySwConnector_2204: ecu-extract-reference=CalRegn02Rt03GroupADHysCmpNegHysCmpXDAAACalRegn02Rt01GroupA_Dummy_2DHysCmpNegHysCmpX
      AssemblySwConnector_2205: ecu-extract-reference=CalRegn02Rt03GroupADHysCmpNegHysCmpYDAAACalRegn02Rt01GroupA_Dummy_2DHysCmpNegHysCmpY
      AssemblySwConnector_2206: ecu-extract-reference=CalRegn02Rt03GroupADHysCmpOutpLimDAAACalRegn02Rt01GroupA_Dummy_2DHysCmpOutpLim
      AssemblySwConnector_2207: ecu-extract-reference=CalRegn02Rt03GroupADHysCmpRevGainDAAACalRegn02Rt01GroupA_Dummy_2DHysCmpRevGain
      AssemblySwConnector_2208: ecu-extract-reference=CalRegn02Rt03GroupADHysCmpRiseXDAAACalRegn02Rt01GroupA_Dummy_2DHysCmpRiseX
      AssemblySwConnector_2209: ecu-extract-reference=CalRegn02Rt03GroupADHysCmpRiseYDAAACalRegn02Rt01GroupA_Dummy_2DHysCmpRiseY
      AssemblySwConnector_2210: ecu-extract-reference=CalRegn02Rt03GroupADInertiaCmpVelAssiBasdDampgStatYDAAACalRegn02Rt01GroupA_Dummy_2DInertiaCmpVelAssiBasdDampgStatY
      AssemblySwConnector_2211: ecu-extract-reference=CalRegn02Rt03GroupADInertiaCmpVelDampgFilFrqDAAACalRegn02Rt01GroupA_Dummy_2DInertiaCmpVelDampgFilFrq
      AssemblySwConnector_2212: ecu-extract-reference=CalRegn02Rt03GroupADInertiaCmpVelDampgFilFrqWhlImbRejctnOnDAAACalRegn02Rt01GroupA_Dummy_2DInertiaCmpVelDampgFilFrqWhl_c7c08c27
      AssemblySwConnector_2213: ecu-extract-reference=CalRegn02Rt03GroupADInertiaCmpVelDampgSpdBlndYDAAACalRegn02Rt01GroupA_Dummy_2DInertiaCmpVelDampgSpdBlndY
      AssemblySwConnector_2214: ecu-extract-reference=CalRegn02Rt03GroupADInertiaCmpVelDampgWhlImbRejctnBlndXDAAACalRegn02Rt01GroupA_Dummy_2DInertiaCmpVelDampgWhlImbRejctnBlndX
      AssemblySwConnector_2215: ecu-extract-reference=CalRegn02Rt03GroupADInertiaCmpVelDampgWhlImbRejctnBlndYDAAACalRegn02Rt01GroupA_Dummy_2DInertiaCmpVelDampgWhlImbRejctnBlndY
      AssemblySwConnector_2224: ecu-extract-reference=CalRegn02Rt04GroupADAssiHiFrqGainYDAAACalRegn02Rt01GroupA_Dummy_3DAssiHiFrqGainY
      AssemblySwConnector_2225: ecu-extract-reference=CalRegn02Rt04GroupADAssiHiFrqHpFilFrqYDAAACalRegn02Rt01GroupA_Dummy_3DAssiHiFrqHpFilFrqY
      AssemblySwConnector_2226: ecu-extract-reference=CalRegn02Rt04GroupADAssiHiFrqTqWhlImbRejctnTqXDAAACalRegn02Rt01GroupA_Dummy_3DAssiHiFrqTqWhlImbRejctnTqX
      AssemblySwConnector_2227: ecu-extract-reference=CalRegn02Rt04GroupADAssiHiFrqTqXDAAACalRegn02Rt01GroupA_Dummy_3DAssiHiFrqTqX
      AssemblySwConnector_2228: ecu-extract-reference=CalRegn02Rt04GroupADAssiHiFrqWhlImbRejctnBlndXDAAACalRegn02Rt01GroupA_Dummy_3DAssiHiFrqWhlImbRejctnBlndX
      AssemblySwConnector_2229: ecu-extract-reference=CalRegn02Rt04GroupADAssiHiFrqWhlImbRejctnBlndYDAAACalRegn02Rt01GroupA_Dummy_3DAssiHiFrqWhlImbRejctnBlndY
      AssemblySwConnector_2230: ecu-extract-reference=CalRegn02Rt04GroupADAssiHiFrqWhlImbRejctnGainYDAAACalRegn02Rt01GroupA_Dummy_3DAssiHiFrqWhlImbRejctnGainY
      AssemblySwConnector_2231: ecu-extract-reference=CalRegn02Rt04GroupADAssiMotTqWhlImbRejctnMaxXDAAACalRegn02Rt01GroupA_Dummy_3DAssiMotTqWhlImbRejctnMaxX
      AssemblySwConnector_2232: ecu-extract-reference=CalRegn02Rt04GroupADAssiMotTqWhlImbRejctnMaxYDAAACalRegn02Rt01GroupA_Dummy_3DAssiMotTqWhlImbRejctnMaxY
      AssemblySwConnector_2233: ecu-extract-reference=CalRegn02Rt04GroupADAssiMotTqWhlImbRejctnMinXDAAACalRegn02Rt01GroupA_Dummy_3DAssiMotTqWhlImbRejctnMinX
      AssemblySwConnector_2234: ecu-extract-reference=CalRegn02Rt04GroupADAssiMotTqWhlImbRejctnMinYDAAACalRegn02Rt01GroupA_Dummy_3DAssiMotTqWhlImbRejctnMinY
      AssemblySwConnector_2235: ecu-extract-reference=CalRegn02Rt04GroupADAssiWhlImbRejctnBlndScaXDAAACalRegn02Rt01GroupA_Dummy_3DAssiWhlImbRejctnBlndScaX
      AssemblySwConnector_2236: ecu-extract-reference=CalRegn02Rt04GroupADAssiWhlImbRejctnBlndScaYDAAACalRegn02Rt01GroupA_Dummy_3DAssiWhlImbRejctnBlndScaY
      AssemblySwConnector_2237: ecu-extract-reference=CalRegn02Rt04GroupADDampgHwTqXDAAACalRegn02Rt01GroupA_Dummy_3DDampgHwTqX
      AssemblySwConnector_2238: ecu-extract-reference=CalRegn02Rt04GroupADDampgHwTqYDAAACalRegn02Rt01GroupA_Dummy_3DDampgHwTqY
      AssemblySwConnector_2239: ecu-extract-reference=CalRegn02Rt04GroupADDampgHydCoeff1ScaYDAAACalRegn02Rt01GroupA_Dummy_3DDampgHydCoeff1ScaY
      AssemblySwConnector_2240: ecu-extract-reference=CalRegn02Rt04GroupADDampgHydCoeff2ScaYDAAACalRegn02Rt01GroupA_Dummy_3DDampgHydCoeff2ScaY
      AssemblySwConnector_2241: ecu-extract-reference=CalRegn02Rt04GroupADDampgHydCoeff3ScaYDAAACalRegn02Rt01GroupA_Dummy_3DDampgHydCoeff3ScaY
      AssemblySwConnector_2242: ecu-extract-reference=CalRegn02Rt04GroupADDampgHydCoeff4ScaYDAAACalRegn02Rt01GroupA_Dummy_3DDampgHydCoeff4ScaY
      AssemblySwConnector_2243: ecu-extract-reference=CalRegn02Rt04GroupADDampgMotVelXDAAACalRegn02Rt01GroupA_Dummy_3DDampgMotVelX
      AssemblySwConnector_2244: ecu-extract-reference=CalRegn02Rt04GroupADDampgMotVelYDAAACalRegn02Rt01GroupA_Dummy_3DDampgMotVelY
      AssemblySwConnector_2253: ecu-extract-reference=CalRegn02Rt04GroupADHysCmpEffLossYDAAACalRegn02Rt01GroupA_Dummy_3DHysCmpEffLossY
      AssemblySwConnector_2254: ecu-extract-reference=CalRegn02Rt04GroupADHysCmpEffOffsYDAAACalRegn02Rt01GroupA_Dummy_3DHysCmpEffOffsY
      AssemblySwConnector_2255: ecu-extract-reference=CalRegn02Rt04GroupADHysCmpFricWhlImbRejctnBlndXDAAACalRegn02Rt01GroupA_Dummy_3DHysCmpFricWhlImbRejctnBlndX
      AssemblySwConnector_2256: ecu-extract-reference=CalRegn02Rt04GroupADHysCmpFricWhlImbRejctnBlndYDAAACalRegn02Rt01GroupA_Dummy_3DHysCmpFricWhlImbRejctnBlndY
      AssemblySwConnector_2257: ecu-extract-reference=CalRegn02Rt04GroupADHysCmpFricWhlImbRejctnOffYDAAACalRegn02Rt01GroupA_Dummy_3DHysCmpFricWhlImbRejctnOffY
      AssemblySwConnector_2258: ecu-extract-reference=CalRegn02Rt04GroupADHysCmpFricWhlImbRejctnOnYDAAACalRegn02Rt01GroupA_Dummy_3DHysCmpFricWhlImbRejctnOnY
      AssemblySwConnector_2259: ecu-extract-reference=CalRegn02Rt04GroupADHysCmpHwTqScaXDAAACalRegn02Rt01GroupA_Dummy_3DHysCmpHwTqScaX
      AssemblySwConnector_2260: ecu-extract-reference=CalRegn02Rt04GroupADHysCmpHwTqScaYDAAACalRegn02Rt01GroupA_Dummy_3DHysCmpHwTqScaY
      AssemblySwConnector_2261: ecu-extract-reference=CalRegn02Rt04GroupADHysCmpHysSatnYDAAACalRegn02Rt01GroupA_Dummy_3DHysCmpHysSatnY
      AssemblySwConnector_2262: ecu-extract-reference=CalRegn02Rt04GroupADHysCmpNegHysCmpScaXDAAACalRegn02Rt01GroupA_Dummy_3DHysCmpNegHysCmpScaX
      AssemblySwConnector_2263: ecu-extract-reference=CalRegn02Rt04GroupADHysCmpNegHysCmpScaYDAAACalRegn02Rt01GroupA_Dummy_3DHysCmpNegHysCmpScaY
      AssemblySwConnector_2264: ecu-extract-reference=CalRegn02Rt04GroupADHysCmpNegHysCmpXDAAACalRegn02Rt01GroupA_Dummy_3DHysCmpNegHysCmpX
      AssemblySwConnector_2265: ecu-extract-reference=CalRegn02Rt04GroupADHysCmpNegHysCmpYDAAACalRegn02Rt01GroupA_Dummy_3DHysCmpNegHysCmpY
      AssemblySwConnector_2266: ecu-extract-reference=CalRegn02Rt04GroupADHysCmpOutpLimDAAACalRegn02Rt01GroupA_Dummy_3DHysCmpOutpLim
      AssemblySwConnector_2267: ecu-extract-reference=CalRegn02Rt04GroupADHysCmpRevGainDAAACalRegn02Rt01GroupA_Dummy_3DHysCmpRevGain
      AssemblySwConnector_2268: ecu-extract-reference=CalRegn02Rt04GroupADHysCmpRiseXDAAACalRegn02Rt01GroupA_Dummy_3DHysCmpRiseX
      AssemblySwConnector_2269: ecu-extract-reference=CalRegn02Rt04GroupADHysCmpRiseYDAAACalRegn02Rt01GroupA_Dummy_3DHysCmpRiseY
      AssemblySwConnector_2270: ecu-extract-reference=CalRegn02Rt04GroupADInertiaCmpVelAssiBasdDampgStatYDAAACalRegn02Rt01GroupA_Dummy_3DInertiaCmpVelAssiBasdDampgStatY
      AssemblySwConnector_2271: ecu-extract-reference=CalRegn02Rt04GroupADInertiaCmpVelDampgFilFrqDAAACalRegn02Rt01GroupA_Dummy_3DInertiaCmpVelDampgFilFrq
      AssemblySwConnector_2272: ecu-extract-reference=CalRegn02Rt04GroupADInertiaCmpVelDampgFilFrqWhlImbRejctnOnDAAACalRegn02Rt01GroupA_Dummy_3DInertiaCmpVelDampgFilFrqWhl_6c4d2ef8
      AssemblySwConnector_2273: ecu-extract-reference=CalRegn02Rt04GroupADInertiaCmpVelDampgSpdBlndYDAAACalRegn02Rt01GroupA_Dummy_3DInertiaCmpVelDampgSpdBlndY
      AssemblySwConnector_2274: ecu-extract-reference=CalRegn02Rt04GroupADInertiaCmpVelDampgWhlImbRejctnBlndXDAAACalRegn02Rt01GroupA_Dummy_3DInertiaCmpVelDampgWhlImbRejctnBlndX
      AssemblySwConnector_2275: ecu-extract-reference=CalRegn02Rt04GroupADInertiaCmpVelDampgWhlImbRejctnBlndYDAAACalRegn02Rt01GroupA_Dummy_3DInertiaCmpVelDampgWhlImbRejctnBlndY
      AssemblySwConnector_2284: ecu-extract-reference=CalRegn02Rt05GroupADAssiHiFrqGainYDAAACalRegn02Rt01GroupA_Dummy_4DAssiHiFrqGainY
      AssemblySwConnector_2285: ecu-extract-reference=CalRegn02Rt05GroupADAssiHiFrqHpFilFrqYDAAACalRegn02Rt01GroupA_Dummy_4DAssiHiFrqHpFilFrqY
      AssemblySwConnector_2286: ecu-extract-reference=CalRegn02Rt05GroupADAssiHiFrqTqWhlImbRejctnTqXDAAACalRegn02Rt01GroupA_Dummy_4DAssiHiFrqTqWhlImbRejctnTqX
      AssemblySwConnector_2287: ecu-extract-reference=CalRegn02Rt05GroupADAssiHiFrqTqXDAAACalRegn02Rt01GroupA_Dummy_4DAssiHiFrqTqX
      AssemblySwConnector_2288: ecu-extract-reference=CalRegn02Rt05GroupADAssiHiFrqWhlImbRejctnBlndXDAAACalRegn02Rt01GroupA_Dummy_4DAssiHiFrqWhlImbRejctnBlndX
      AssemblySwConnector_2289: ecu-extract-reference=CalRegn02Rt05GroupADAssiHiFrqWhlImbRejctnBlndYDAAACalRegn02Rt01GroupA_Dummy_4DAssiHiFrqWhlImbRejctnBlndY
      AssemblySwConnector_2290: ecu-extract-reference=CalRegn02Rt05GroupADAssiHiFrqWhlImbRejctnGainYDAAACalRegn02Rt01GroupA_Dummy_4DAssiHiFrqWhlImbRejctnGainY
      AssemblySwConnector_2291: ecu-extract-reference=CalRegn02Rt05GroupADAssiMotTqWhlImbRejctnMaxXDAAACalRegn02Rt01GroupA_Dummy_4DAssiMotTqWhlImbRejctnMaxX
      AssemblySwConnector_2292: ecu-extract-reference=CalRegn02Rt05GroupADAssiMotTqWhlImbRejctnMaxYDAAACalRegn02Rt01GroupA_Dummy_4DAssiMotTqWhlImbRejctnMaxY
      AssemblySwConnector_2293: ecu-extract-reference=CalRegn02Rt05GroupADAssiMotTqWhlImbRejctnMinXDAAACalRegn02Rt01GroupA_Dummy_4DAssiMotTqWhlImbRejctnMinX
      AssemblySwConnector_2294: ecu-extract-reference=CalRegn02Rt05GroupADAssiMotTqWhlImbRejctnMinYDAAACalRegn02Rt01GroupA_Dummy_4DAssiMotTqWhlImbRejctnMinY
      AssemblySwConnector_2295: ecu-extract-reference=CalRegn02Rt05GroupADAssiWhlImbRejctnBlndScaXDAAACalRegn02Rt01GroupA_Dummy_4DAssiWhlImbRejctnBlndScaX
      AssemblySwConnector_2296: ecu-extract-reference=CalRegn02Rt05GroupADAssiWhlImbRejctnBlndScaYDAAACalRegn02Rt01GroupA_Dummy_4DAssiWhlImbRejctnBlndScaY
      AssemblySwConnector_2297: ecu-extract-reference=CalRegn02Rt05GroupADDampgHwTqXDAAACalRegn02Rt01GroupA_Dummy_4DDampgHwTqX
      AssemblySwConnector_2298: ecu-extract-reference=CalRegn02Rt05GroupADDampgHwTqYDAAACalRegn02Rt01GroupA_Dummy_4DDampgHwTqY
      AssemblySwConnector_2299: ecu-extract-reference=CalRegn02Rt05GroupADDampgHydCoeff1ScaYDAAACalRegn02Rt01GroupA_Dummy_4DDampgHydCoeff1ScaY
      AssemblySwConnector_2300: ecu-extract-reference=CalRegn02Rt05GroupADDampgHydCoeff2ScaYDAAACalRegn02Rt01GroupA_Dummy_4DDampgHydCoeff2ScaY
      AssemblySwConnector_2301: ecu-extract-reference=CalRegn02Rt05GroupADDampgHydCoeff3ScaYDAAACalRegn02Rt01GroupA_Dummy_4DDampgHydCoeff3ScaY
      AssemblySwConnector_2302: ecu-extract-reference=CalRegn02Rt05GroupADDampgHydCoeff4ScaYDAAACalRegn02Rt01GroupA_Dummy_4DDampgHydCoeff4ScaY
      AssemblySwConnector_2303: ecu-extract-reference=CalRegn02Rt05GroupADDampgMotVelXDAAACalRegn02Rt01GroupA_Dummy_4DDampgMotVelX
      AssemblySwConnector_2304: ecu-extract-reference=CalRegn02Rt05GroupADDampgMotVelYDAAACalRegn02Rt01GroupA_Dummy_4DDampgMotVelY
      AssemblySwConnector_2313: ecu-extract-reference=CalRegn02Rt05GroupADHysCmpEffLossYDAAACalRegn02Rt01GroupA_Dummy_4DHysCmpEffLossY
      AssemblySwConnector_2314: ecu-extract-reference=CalRegn02Rt05GroupADHysCmpEffOffsYDAAACalRegn02Rt01GroupA_Dummy_4DHysCmpEffOffsY
      AssemblySwConnector_2315: ecu-extract-reference=CalRegn02Rt05GroupADHysCmpFricWhlImbRejctnBlndXDAAACalRegn02Rt01GroupA_Dummy_4DHysCmpFricWhlImbRejctnBlndX
      AssemblySwConnector_2316: ecu-extract-reference=CalRegn02Rt05GroupADHysCmpFricWhlImbRejctnBlndYDAAACalRegn02Rt01GroupA_Dummy_4DHysCmpFricWhlImbRejctnBlndY
      AssemblySwConnector_2317: ecu-extract-reference=CalRegn02Rt05GroupADHysCmpFricWhlImbRejctnOffYDAAACalRegn02Rt01GroupA_Dummy_4DHysCmpFricWhlImbRejctnOffY
      AssemblySwConnector_2318: ecu-extract-reference=CalRegn02Rt05GroupADHysCmpFricWhlImbRejctnOnYDAAACalRegn02Rt01GroupA_Dummy_4DHysCmpFricWhlImbRejctnOnY
      AssemblySwConnector_2319: ecu-extract-reference=CalRegn02Rt05GroupADHysCmpHwTqScaXDAAACalRegn02Rt01GroupA_Dummy_4DHysCmpHwTqScaX
      AssemblySwConnector_2320: ecu-extract-reference=CalRegn02Rt05GroupADHysCmpHwTqScaYDAAACalRegn02Rt01GroupA_Dummy_4DHysCmpHwTqScaY
      AssemblySwConnector_2321: ecu-extract-reference=CalRegn02Rt05GroupADHysCmpHysSatnYDAAACalRegn02Rt01GroupA_Dummy_4DHysCmpHysSatnY
      AssemblySwConnector_2322: ecu-extract-reference=CalRegn02Rt05GroupADHysCmpNegHysCmpScaXDAAACalRegn02Rt01GroupA_Dummy_4DHysCmpNegHysCmpScaX
      AssemblySwConnector_2323: ecu-extract-reference=CalRegn02Rt05GroupADHysCmpNegHysCmpScaYDAAACalRegn02Rt01GroupA_Dummy_4DHysCmpNegHysCmpScaY
      AssemblySwConnector_2324: ecu-extract-reference=CalRegn02Rt05GroupADHysCmpNegHysCmpXDAAACalRegn02Rt01GroupA_Dummy_4DHysCmpNegHysCmpX
      AssemblySwConnector_2325: ecu-extract-reference=CalRegn02Rt05GroupADHysCmpNegHysCmpYDAAACalRegn02Rt01GroupA_Dummy_4DHysCmpNegHysCmpY
      AssemblySwConnector_2326: ecu-extract-reference=CalRegn02Rt05GroupADHysCmpOutpLimDAAACalRegn02Rt01GroupA_Dummy_4DHysCmpOutpLim
      AssemblySwConnector_2327: ecu-extract-reference=CalRegn02Rt05GroupADHysCmpRevGainDAAACalRegn02Rt01GroupA_Dummy_4DHysCmpRevGain
      AssemblySwConnector_2328: ecu-extract-reference=CalRegn02Rt05GroupADHysCmpRiseXDAAACalRegn02Rt01GroupA_Dummy_4DHysCmpRiseX
      AssemblySwConnector_2329: ecu-extract-reference=CalRegn02Rt05GroupADHysCmpRiseYDAAACalRegn02Rt01GroupA_Dummy_4DHysCmpRiseY
      AssemblySwConnector_2330: ecu-extract-reference=CalRegn02Rt05GroupADInertiaCmpVelAssiBasdDampgStatYDAAACalRegn02Rt01GroupA_Dummy_4DInertiaCmpVelAssiBasdDampgStatY
      AssemblySwConnector_2331: ecu-extract-reference=CalRegn02Rt05GroupADInertiaCmpVelDampgFilFrqDAAACalRegn02Rt01GroupA_Dummy_4DInertiaCmpVelDampgFilFrq
      AssemblySwConnector_2332: ecu-extract-reference=CalRegn02Rt05GroupADInertiaCmpVelDampgFilFrqWhlImbRejctnOnDAAACalRegn02Rt01GroupA_Dummy_4DInertiaCmpVelDampgFilFrqWhl_97e8bb47
      AssemblySwConnector_2333: ecu-extract-reference=CalRegn02Rt05GroupADInertiaCmpVelDampgSpdBlndYDAAACalRegn02Rt01GroupA_Dummy_4DInertiaCmpVelDampgSpdBlndY
      AssemblySwConnector_2334: ecu-extract-reference=CalRegn02Rt05GroupADInertiaCmpVelDampgWhlImbRejctnBlndXDAAACalRegn02Rt01GroupA_Dummy_4DInertiaCmpVelDampgWhlImbRejctnBlndX
      AssemblySwConnector_2335: ecu-extract-reference=CalRegn02Rt05GroupADInertiaCmpVelDampgWhlImbRejctnBlndYDAAACalRegn02Rt01GroupA_Dummy_4DInertiaCmpVelDampgWhlImbRejctnBlndY
      ComponentPrototype_041: upstream-reference=ECU_Composition.AAACalRegn02Rt00GroupA_Dummy, ecu-extract-reference=COMPOSITIONTYPE.AAACalRegn02Rt00GroupA_Dummy
      AssemblySwConnector_078: ecu-extract-reference=CalRegn02Rt00GroupADAssiHiFrqGainYDAAACalRegn02Rt00GroupA_DummyDAssiHiFrqGainY
      AssemblySwConnector_083: ecu-extract-reference=CalRegn02Rt00GroupADAssiHiFrqHpFilFrqYDAAACalRegn02Rt00GroupA_DummyDAssiHiFrqHpFilFrqY
      AssemblySwConnector_230: ecu-extract-reference=CalRegn02Rt00GroupADAssiHiFrqTqWhlImbRejctnTqXDAAACalRegn02Rt00GroupA_DummyDAssiHiFrqTqWhlImbRejctnTqX
      AssemblySwConnector_233: ecu-extract-reference=CalRegn02Rt00GroupADAssiHiFrqTqXDAAACalRegn02Rt00GroupA_DummyDAssiHiFrqTqX
      AssemblySwConnector_288: ecu-extract-reference=CalRegn02Rt00GroupADAssiHiFrqWhlImbRejctnBlndXDAAACalRegn02Rt00GroupA_DummyDAssiHiFrqWhlImbRejctnBlndX
      AssemblySwConnector_289: ecu-extract-reference=CalRegn02Rt00GroupADAssiHiFrqWhlImbRejctnBlndYDAAACalRegn02Rt00GroupA_DummyDAssiHiFrqWhlImbRejctnBlndY
      AssemblySwConnector_297: ecu-extract-reference=CalRegn02Rt00GroupADAssiHiFrqWhlImbRejctnGainYDAAACalRegn02Rt00GroupA_DummyDAssiHiFrqWhlImbRejctnGainY
      AssemblySwConnector_307: ecu-extract-reference=CalRegn02Rt00GroupADAssiMotTqWhlImbRejctnMaxXDAAACalRegn02Rt00GroupA_DummyDAssiMotTqWhlImbRejctnMaxX
      AssemblySwConnector_322: ecu-extract-reference=CalRegn02Rt00GroupADAssiMotTqWhlImbRejctnMaxYDAAACalRegn02Rt00GroupA_DummyDAssiMotTqWhlImbRejctnMaxY
      AssemblySwConnector_323: ecu-extract-reference=CalRegn02Rt00GroupADAssiMotTqWhlImbRejctnMinXDAAACalRegn02Rt00GroupA_DummyDAssiMotTqWhlImbRejctnMinX
      AssemblySwConnector_324: ecu-extract-reference=CalRegn02Rt00GroupADAssiMotTqWhlImbRejctnMinYDAAACalRegn02Rt00GroupA_DummyDAssiMotTqWhlImbRejctnMinY
      AssemblySwConnector_325: ecu-extract-reference=CalRegn02Rt00GroupADAssiWhlImbRejctnBlndScaXDAAACalRegn02Rt00GroupA_DummyDAssiWhlImbRejctnBlndScaX
      AssemblySwConnector_326: ecu-extract-reference=CalRegn02Rt00GroupADAssiWhlImbRejctnBlndScaYDAAACalRegn02Rt00GroupA_DummyDAssiWhlImbRejctnBlndScaY
      AssemblySwConnector_327: ecu-extract-reference=CalRegn02Rt00GroupADDampgHwTqXDAAACalRegn02Rt00GroupA_DummyDDampgHwTqX
      AssemblySwConnector_328: ecu-extract-reference=CalRegn02Rt00GroupADDampgHwTqYDAAACalRegn02Rt00GroupA_DummyDDampgHwTqY
      AssemblySwConnector_329: ecu-extract-reference=CalRegn02Rt00GroupADDampgHydCoeff1ScaYDAAACalRegn02Rt00GroupA_DummyDDampgHydCoeff1ScaY
      AssemblySwConnector_330: ecu-extract-reference=CalRegn02Rt00GroupADDampgHydCoeff2ScaYDAAACalRegn02Rt00GroupA_DummyDDampgHydCoeff2ScaY
      AssemblySwConnector_331: ecu-extract-reference=CalRegn02Rt00GroupADDampgHydCoeff3ScaYDAAACalRegn02Rt00GroupA_DummyDDampgHydCoeff3ScaY
      AssemblySwConnector_332: ecu-extract-reference=CalRegn02Rt00GroupADDampgHydCoeff4ScaYDAAACalRegn02Rt00GroupA_DummyDDampgHydCoeff4ScaY
      AssemblySwConnector_333: ecu-extract-reference=CalRegn02Rt00GroupADDampgMotVelXDAAACalRegn02Rt00GroupA_DummyDDampgMotVelX
      AssemblySwConnector_334: ecu-extract-reference=CalRegn02Rt00GroupADDampgMotVelYDAAACalRegn02Rt00GroupA_DummyDDampgMotVelY
      AssemblySwConnector_345: ecu-extract-reference=CalRegn02Rt00GroupADHysCmpEffLossYDAAACalRegn02Rt00GroupA_DummyDHysCmpEffLossY
      AssemblySwConnector_346: ecu-extract-reference=CalRegn02Rt00GroupADHysCmpEffOffsYDAAACalRegn02Rt00GroupA_DummyDHysCmpEffOffsY
      AssemblySwConnector_347: ecu-extract-reference=CalRegn02Rt00GroupADHysCmpFricWhlImbRejctnBlndXDAAACalRegn02Rt00GroupA_DummyDHysCmpFricWhlImbRejctnBlndX
      AssemblySwConnector_348: ecu-extract-reference=CalRegn02Rt00GroupADHysCmpFricWhlImbRejctnBlndYDAAACalRegn02Rt00GroupA_DummyDHysCmpFricWhlImbRejctnBlndY
      AssemblySwConnector_349: ecu-extract-reference=CalRegn02Rt00GroupADHysCmpFricWhlImbRejctnOffYDAAACalRegn02Rt00GroupA_DummyDHysCmpFricWhlImbRejctnOffY
      AssemblySwConnector_350: ecu-extract-reference=CalRegn02Rt00GroupADHysCmpFricWhlImbRejctnOnYDAAACalRegn02Rt00GroupA_DummyDHysCmpFricWhlImbRejctnOnY
      AssemblySwConnector_351: ecu-extract-reference=CalRegn02Rt00GroupADHysCmpHwTqScaXDAAACalRegn02Rt00GroupA_DummyDHysCmpHwTqScaX
      AssemblySwConnector_352: ecu-extract-reference=CalRegn02Rt00GroupADHysCmpHwTqScaYDAAACalRegn02Rt00GroupA_DummyDHysCmpHwTqScaY
      AssemblySwConnector_367: ecu-extract-reference=CalRegn02Rt00GroupADHysCmpHysSatnYDAAACalRegn02Rt00GroupA_DummyDHysCmpHysSatnY
      AssemblySwConnector_368: ecu-extract-reference=CalRegn02Rt00GroupADHysCmpNegHysCmpScaXDAAACalRegn02Rt00GroupA_DummyDHysCmpNegHysCmpScaX
      AssemblySwConnector_369: ecu-extract-reference=CalRegn02Rt00GroupADHysCmpNegHysCmpScaYDAAACalRegn02Rt00GroupA_DummyDHysCmpNegHysCmpScaY
      AssemblySwConnector_370: ecu-extract-reference=CalRegn02Rt00GroupADHysCmpNegHysCmpXDAAACalRegn02Rt00GroupA_DummyDHysCmpNegHysCmpX
      AssemblySwConnector_371: ecu-extract-reference=CalRegn02Rt00GroupADHysCmpNegHysCmpYDAAACalRegn02Rt00GroupA_DummyDHysCmpNegHysCmpY
      AssemblySwConnector_372: ecu-extract-reference=CalRegn02Rt00GroupADHysCmpOutpLimDAAACalRegn02Rt00GroupA_DummyDHysCmpOutpLim
      AssemblySwConnector_373: ecu-extract-reference=CalRegn02Rt00GroupADHysCmpRevGainDAAACalRegn02Rt00GroupA_DummyDHysCmpRevGain
      AssemblySwConnector_374: ecu-extract-reference=CalRegn02Rt00GroupADHysCmpRiseXDAAACalRegn02Rt00GroupA_DummyDHysCmpRiseX
      AssemblySwConnector_375: ecu-extract-reference=CalRegn02Rt00GroupADHysCmpRiseYDAAACalRegn02Rt00GroupA_DummyDHysCmpRiseY
      AssemblySwConnector_376: ecu-extract-reference=CalRegn02Rt00GroupADInertiaCmpVelAssiBasdDampgStatYDAAACalRegn02Rt00GroupA_DummyDInertiaCmpVelAssiBasdDampgStatY
      AssemblySwConnector_377: ecu-extract-reference=CalRegn02Rt00GroupADInertiaCmpVelDampgFilFrqDAAACalRegn02Rt00GroupA_DummyDInertiaCmpVelDampgFilFrq
      AssemblySwConnector_378: ecu-extract-reference=CalRegn02Rt00GroupADInertiaCmpVelDampgFilFrqWhlImbRejctnOnDAAACalRegn02Rt00GroupA_DummyDInertiaCmpVelDampgFilFrqWhlImbRejctnOn
      AssemblySwConnector_379: ecu-extract-reference=CalRegn02Rt00GroupADInertiaCmpVelDampgSpdBlndYDAAACalRegn02Rt00GroupA_DummyDInertiaCmpVelDampgSpdBlndY
      AssemblySwConnector_380: ecu-extract-reference=CalRegn02Rt00GroupADInertiaCmpVelDampgWhlImbRejctnBlndXDAAACalRegn02Rt00GroupA_DummyDInertiaCmpVelDampgWhlImbRejctnBlndX
      AssemblySwConnector_381: ecu-extract-reference=CalRegn02Rt00GroupADInertiaCmpVelDampgWhlImbRejctnBlndYDAAACalRegn02Rt00GroupA_DummyDInertiaCmpVelDampgWhlImbRejctnBlndY
      AssemblySwConnector_390: ecu-extract-reference=DiagcMgrProxyAppl10DGetNtcQlfrSts10DHwAgSysArbnDGetNtcQlfrSts
      ComponentPrototype_146: upstream-reference=ECU_Composition.FordVltgIf, ecu-extract-reference=COMPOSITIONTYPE.FordVltgIf
      ComponentPrototype_147: upstream-reference=ECU_Composition.FordVehSpdArbn, ecu-extract-reference=COMPOSITIONTYPE.FordVehSpdArbn
      ComponentPrototype_148: upstream-reference=ECU_Composition.FordSysSt, ecu-extract-reference=COMPOSITIONTYPE.FordSysSt
      ComponentPrototype_149: upstream-reference=ECU_Composition.FordHwTqCdng, ecu-extract-reference=COMPOSITIONTYPE.FordHwTqCdng
      ComponentPrototype_150: upstream-reference=ECU_Composition.FordHwAgArbn, ecu-extract-reference=COMPOSITIONTYPE.FordHwAgArbn
      ComponentPrototype_151: upstream-reference=ECU_Composition.FordCanDtcInhb, ecu-extract-reference=COMPOSITIONTYPE.FordCanDtcInhb
      AssemblySwConnector_391: ecu-extract-reference=AssiDAssiCmdBasDFordHwTqCdngDAssiCmdBas
      AssemblySwConnector_392: ecu-extract-reference=BattVltgDBrdgVltgDFordCanDtcInhbDFordBattVltgEstimn
      AssemblySwConnector_393: ecu-extract-reference=BattVltgDBrdgVltgDFordVltgIfDBattVltg
      AssemblySwConnector_552: ecu-extract-reference=CDD_MotAgCmpDMotAgCumvAlgndMrfDFordHwAgArbnDFordMotPosn
      AssemblySwConnector_553: ecu-extract-reference=CDD_MotVelDMotVelVldDFordHwAgArbnDFordMotVelVld
      AssemblySwConnector_554: ecu-extract-reference=CDD_NxtrTiDGetRefTmr100MicroSec32bitDFordCanDtcInhbDGetRefTmr100MicroSec32bit
      AssemblySwConnector_560: ecu-extract-reference=CDD_NxtrTiDGetTiSpan100MicroSec32bitDFordCanDtcInhbDGetTiSpan100MicroSec32bit
      AssemblySwConnector_561: ecu-extract-reference=CDD_NxtrTiDGetRefTmr100MicroSec32bitDFordHwAgArbnDGetRefTmr100MicroSec32bit
      AssemblySwConnector_562: ecu-extract-reference=CDD_NxtrTiDGetTiSpan100MicroSec32bitDFordHwAgArbnDGetTiSpan100MicroSec32bit
      AssemblySwConnector_563: ecu-extract-reference=CDD_NxtrTiDGetRefTmr100MicroSec32bitDFordHwTqCdngDGetRefTmr100MicroSec32bit
      AssemblySwConnector_564: ecu-extract-reference=CDD_NxtrTiDGetTiSpan100MicroSec32bitDFordHwTqCdngDGetTiSpan100MicroSec32bit
      AssemblySwConnector_565: ecu-extract-reference=CDD_NxtrTiDGetRefTmr100MicroSec32bitDFordVltgIfDGetRefTmr100MicroSec32bit
      AssemblySwConnector_566: ecu-extract-reference=CDD_NxtrTiDGetTiSpan100MicroSec32bitDFordVltgIfDGetTiSpan100MicroSec32bit
      AssemblySwConnector_567: ecu-extract-reference=CmnMfgSrvDSysStReqEnaOvrdDFordSysStDEngOnSerlComSrvDft
      AssemblySwConnector_568: ecu-extract-reference=CustDiagDFordAbsModlPrsntDFordHwAgArbnDFordAbsPrsnt
      AssemblySwConnector_569: ecu-extract-reference=CustDiagDFordAbsModlPrsntDFordVehSpdArbnDFordAbsModlPrsnt
      AssemblySwConnector_570: ecu-extract-reference=CustDiagDFordEscModlPrsntDFordVehSpdArbnDFordEscModlPrsnt
      AssemblySwConnector_571: ecu-extract-reference=CustDiagDFordActvParkAssiEnadDFordVltgIfDFordActvParkAssiEnad
      AssemblySwConnector_572: ecu-extract-reference=CustDiagDFordEvasSteerAssiEnadDFordVltgIfDFordEvasSteerAssiEnad
      AssemblySwConnector_573: ecu-extract-reference=CustDiagDFordLaneCentrAssiEnadDFordVltgIfDFordLaneCentrAssiEnad
      AssemblySwConnector_574: ecu-extract-reference=CustDiagDFordLaneDprtrWarnEnadDFordVltgIfDFordLaneDprtrWarnEnad
      AssemblySwConnector_575: ecu-extract-reference=CustDiagDFordLaneKeepAssiEnadDFordVltgIfDFordLaneKeepAssiEnad
      AssemblySwConnector_590: ecu-extract-reference=CustDiagDFordTrfcJamAssiEnadDFordVltgIfDFordTrfcJamAssiEnad
      AssemblySwConnector_1035: ecu-extract-reference=DiagcMgrProxyAppl10DSetNtcSts10DFordHwAgArbnDSetNtcSts
      AssemblySwConnector_1036: ecu-extract-reference=DiagcMgrProxyAppl10DGetNtcQlfrSts10DFordHwTqCdngDGetNtcQlfrSts
      AssemblySwConnector_1037: ecu-extract-reference=DiagcMgrProxyAppl10DGetNtcQlfrSts10DFordSysStDGetNtcQlfrSts
      AssemblySwConnector_1055: ecu-extract-reference=DiagcMgrProxyAppl10DSetNtcSts10DFordVltgIfDSetNtcSts
      AssemblySwConnector_1056: ecu-extract-reference=ElecPwrCnsDSplyCurrEstimDFordVltgIfDBattRtnCurr
      AssemblySwConnector_1058: ecu-extract-reference=FordCanDtcInhbDFordEpsLifeCycModDFordMsg167BusHiSpdDFordEpsLifeCycMod
      AssemblySwConnector_1060: ecu-extract-reference=FordCanDtcInhbDFordEpsLifeCycModDFordMsg202BusHiSpdDFordEpsLifeCycMod
      AssemblySwConnector_1062: ecu-extract-reference=FordCanDtcInhbDFordEpsLifeCycModDFordMsg217BusHiSpdDFordEpsLifeCycMod
      AssemblySwConnector_1064: ecu-extract-reference=FordCanDtcInhbDFordEpsLifeCycModDFordMsg3B3BusHiSpdDFordEpsLifeCycMod
      AssemblySwConnector_1066: ecu-extract-reference=FordCanDtcInhbDFordEpsLifeCycModDFordMsg40ABusHiSpdDFordEpsLifeCycMod
      AssemblySwConnector_1112: ecu-extract-reference=FordCanDtcInhbDFordEpsLifeCycModDFordMsg415BusHiSpdDFordEpsLifeCycMod
      AssemblySwConnector_1390: ecu-extract-reference=FordCanDtcInhbDFordEpsLifeCycModDFordMsg41ABusHiSpdDFordEpsLifeCycMod
      AssemblySwConnector_1397: ecu-extract-reference=FordCanDtcInhbDFordEpsLifeCycModDFordMsg41EBusHiSpdDFordEpsLifeCycMod
      AssemblySwConnector_1412: ecu-extract-reference=FordCanDtcInhbDFordEpsLifeCycModDFordMsg430BusHiSpdDFordEpsLifeCycMod
      AssemblySwConnector_1415: ecu-extract-reference=FordHwAgArbnDFordCmpdHwPosnQlyFacDFordMsg07EBusHiSpdDCmpdSteerPinionAgQlyFac
      AssemblySwConnector_1423: ecu-extract-reference=FordMsg167BusHiSpdDFordVehElecPwrStsDFordCanDtcInhbDFordVehElecPwrSts
      AssemblySwConnector_1437: ecu-extract-reference=FordMsg167BusHiSpdDFordVehPwrpkTqStsDFordCanDtcInhbDFordVehPwrpkTqSts
      AssemblySwConnector_1438: ecu-extract-reference=FordMsg167BusHiSpdDFordVehPwrpkTqStsDFordSysStDFordVehPwrpkTqSts
      AssemblySwConnector_1604: ecu-extract-reference=FordMsg167BusHiSpdDFordVehElecPwrStsDFordVltgIfDFordVehElecPwrSts
      AssemblySwConnector_1605: ecu-extract-reference=FordMsg167BusHiSpdDFordVehPwrpkTqStsDFordVltgIfDFordVehPwrpkTqSts
      AssemblySwConnector_1606: ecu-extract-reference=FordMsg202BusHiSpdDFordVehSpdEngModlDFordHwAgArbnDFordEngVehSpd
      AssemblySwConnector_1651: ecu-extract-reference=FordMsg202BusHiSpdDFordVehSpdEngModlDFordVehSpdArbnDFordVehSpdEngModl
      AssemblySwConnector_1652: ecu-extract-reference=FordMsg202BusHiSpdDFordVehSpdEngModLoQlyVldDFordVehSpdArbnDFordVehSpdEngModlLoQlyVld
      AssemblySwConnector_1653: ecu-extract-reference=FordMsg202BusHiSpdDFordVehSpdEngModlVldDFordVehSpdArbnDFordVehSpdEngModlVld
      AssemblySwConnector_2344: ecu-extract-reference=FordMsg217BusHiSpdDFordVehFrntLeWhlSpdDFordVehSpdArbnDFordVehFrntLeWhlSpd
      AssemblySwConnector_2345: ecu-extract-reference=FordMsg217BusHiSpdDFordVehFrntLeWhlSpdVldDFordVehSpdArbnDFordVehFrntLeWhlSpdVld
      AssemblySwConnector_2346: ecu-extract-reference=FordMsg217BusHiSpdDFordVehFrntRiWhlSpdDFordVehSpdArbnDFordVehFrntRiWhlSpd
      AssemblySwConnector_2347: ecu-extract-reference=FordMsg217BusHiSpdDFordVehFrntRiWhlSpdVldDFordVehSpdArbnDFordVehFrntRiWhlSpdVld
      AssemblySwConnector_2348: ecu-extract-reference=FordMsg217BusHiSpdDFordVehReLeWhlSpdDFordVehSpdArbnDFordVehReLeWhlSpd
      AssemblySwConnector_2349: ecu-extract-reference=FordMsg217BusHiSpdDFordVehReLeWhlSpdVldDFordVehSpdArbnDFordVehReLeWhlSpdVld
      AssemblySwConnector_2350: ecu-extract-reference=FordMsg217BusHiSpdDFordVehReRiWhlSpdDFordVehSpdArbnDFordVehReRiWhlSpd
      AssemblySwConnector_2351: ecu-extract-reference=FordMsg217BusHiSpdDFordVehReRiWhlSpdVldDFordVehSpdArbnDFordVehReRiWhlSpdVld
      AssemblySwConnector_2352: ecu-extract-reference=FordMsg3B3BusHiSpdDFordVehIgnStsDFordCanDtcInhbDFordVehIgnStsQly
      AssemblySwConnector_2353: ecu-extract-reference=FordMsg3B3BusHiSpdDFordVehLifeCycModDFordCanDtcInhbDFordVehLifeCycModQly
      AssemblySwConnector_2354: ecu-extract-reference=FordMsg40ABusHiSpdDFordVehTireCircumDFordVehSpdArbnDFordVehTireCircumIn
      AssemblySwConnector_2355: ecu-extract-reference=FordMsg414BusHiSpdDFordVehSteerPinionAgOffsDFordHwAgArbnDFordSteerPinionOffs
      AssemblySwConnector_2356: ecu-extract-reference=FordMsg414BusHiSpdDFordVehSteerPinionOffsStsDFordHwAgArbnDFordSteerPinionOffsSts
      AssemblySwConnector_2357: ecu-extract-reference=FordMsg415BusHiSpdDFordVehSpdBrkModlDFordVehSpdArbnDFordVehSpdBrkModl
      AssemblySwConnector_2358: ecu-extract-reference=FordMsg415BusHiSpdDFordVehSpdBrkModlLoQlyVldDFordVehSpdArbnDFordVehSpdBrkModlLoQlyVld
      AssemblySwConnector_2359: ecu-extract-reference=FordMsg415BusHiSpdDFordVehSpdBrkModlVldDFordVehSpdArbnDFordVehSpdBrkModlVld
      AssemblySwConnector_2360: ecu-extract-reference=FordSysStDFordEpsSysStDFordCanDtcInhbDFordEpsSysSt
      AssemblySwConnector_2361: ecu-extract-reference=FordSysStDFordSteerModlStsDFordMsg082BusHiSpdDFordSteerModlSts
      AssemblySwConnector_2362: ecu-extract-reference=FordSysStDFordEpsSysStDFordVltgIfDFordEpsSysSt
      AssemblySwConnector_2363: ecu-extract-reference=FordSysStDOperScaFctrDStOutpCtrlDSysOperMotTqCmdSca
      AssemblySwConnector_2364: ecu-extract-reference=FordSysStDOperRampRateDStOutpCtrlDSysOperRampRate
      AssemblySwConnector_2365: ecu-extract-reference=FordSysStDFordPwrSplyEnaReqDSysStModDPwrSplyEnaReq
      AssemblySwConnector_2366: ecu-extract-reference=FordSysStDSysStReqEnaDSysStModDSysStReqEna
      AssemblySwConnector_2367: ecu-extract-reference=FordVehSpdArbnDFordVehSpdDVehSigCdngDVehSpdSerlCom
      AssemblySwConnector_2368: ecu-extract-reference=FordVehSpdArbnDFordVehSpdVldDVehSigCdngDVehSpdVldSerlCom
      AssemblySwConnector_2369: ecu-extract-reference=FordVltgIfDFordInhbBattVltgDiagcDBattVltgCorrlnDInhbBattVltgDiagc
      AssemblySwConnector_2370: ecu-extract-reference=FordVltgIfDFordEpsCurrDFordMsg082BusHiSpdDElecPwrSteerCurr
      AssemblySwConnector_2371: ecu-extract-reference=FordVltgIfDFordEpsVltgDFordMsg082BusHiSpdDElecPwrSteerVltg
      AssemblySwConnector_2372: ecu-extract-reference=FordVltgIfDFordVltgOperRampDFordSysStDFordVltgOperRamp
      AssemblySwConnector_2373: ecu-extract-reference=FordVltgIfDFordVltgOperScarDFordSysStDFordVltgOperScar
      AssemblySwConnector_2374: ecu-extract-reference=FordVltgIfDFordVltgOperStDFordSysStDFordVltgOperSt
      AssemblySwConnector_2376: ecu-extract-reference=ImcArbnDGetSigImcData_f32DFordVltgIfDGetSigImcData_f32
      AssemblySwConnector_2377: ecu-extract-reference=ImcSigArbnDHwTqImcCorrdDFordHwAgArbnDFordInpTq
      AssemblySwConnector_2378: ecu-extract-reference=ImcSigArbnDHwTqImcCorrdDFordHwTqCdngDHwTq
      AssemblySwConnector_2379: ecu-extract-reference=IoHwAbDGetGpioMcuEnaDFordCanDtcInhbDGetGpioMcuEna
      AssemblySwConnector_2380: ecu-extract-reference=IoHwAbDGetGpioMcuEnaDFordHwAgArbnDGetGpioMcuEna
      AssemblySwConnector_2381: ecu-extract-reference=IoHwAbDGetGpioMcuEnaDFordSysStDGetGpioMcuEna
      AssemblySwConnector_2382: ecu-extract-reference=LoaMgrDLoaStDFordSysStDLoaSt
      AssemblySwConnector_2383: ecu-extract-reference=PwrLimrDMotTqCmdPwrLimdDFordHwTqCdngDMotTqCmdPwrLimd
      AssemblySwConnector_2384: ecu-extract-reference=StabyCmpDAssiCmdDFordHwTqCdngDAssiCmd
      AssemblySwConnector_2385: ecu-extract-reference=SwpDMotTqCmdSwpDFordHwTqCdngDMotTqCmd
      AssemblySwConnector_2386: ecu-extract-reference=SysStModDSysStDFordSysStDSysSt
      AssemblySwConnector_2387: ecu-extract-reference=SysStModDSysStDFordVltgIfDFordSysSt
      AssemblySwConnector_2390: ecu-extract-reference=VehSigCdngDVehSpdVldDFordSysStDFordVehSpdVld
      AssemblySwConnector_2392: ecu-extract-reference=VehSigCdngDVehSpdVldDFordVltgIfDFordVehSpdVld
      AssemblySwConnector_984: ecu-extract-reference=FordMsg3B3BusHiSpdDFordVehIgnStsDFordVltgIfDFordVehIgnStsQly
      AssemblySwConnector_1446: ecu-extract-reference=IoHwAbDSetFctPrphlHwTqBDCDD_HwTq1MeasDIoHwAb_SetFctPrphlHwTq1
      AssemblySwConnector_1574: ecu-extract-reference=IoHwAbDSetFctPrphlHwTqADCDD_HwTq8MeasDIoHwAb_SetFctPrphlHwTq8
      AssemblySwConnector_1535: ecu-extract-reference=DiagcMgrProxyAppl10DSetNtcSts10DCustDiagDSetNtcSts_PortIf1
      ComponentPrototype_075: upstream-reference=ECU_Composition.NxtrCalIds, ecu-extract-reference=COMPOSITIONTYPE.NxtrCalIds
      AssemblySwConnector_2409: ecu-extract-reference=CmnMfgSrvDSysStReqEnaOvrdDFordSysStDSysStReqEnaOvrd
      AssemblySwConnector_2410: ecu-extract-reference=NxtrCalIdsDNxtrCalIdsCalDevlpRdDCmnMfgSrvDNxtrCalIdsCalDevlpRd
      AssemblySwConnector_2411: ecu-extract-reference=NxtrCalIdsDNxtrCalIdsCalRelRdDCmnMfgSrvDNxtrCalIdsCalRelRd
      AssemblySwConnector_2412: ecu-extract-reference=PwrUpSeqDSysStWrmIninCmplDFordSysStDSysStWrmIninCmpl
      AssemblySwConnector_431: ecu-extract-reference=EcuTMeasDEcuTFildDCustDiagDEcuTFild
      AssemblySwConnector_457: ecu-extract-reference=FordHwTqCdngDFordInpTqRawDCustDiagDFordInpTqRaw
      AssemblySwConnector_458: ecu-extract-reference=FordMsg40ABusHiSpdDFordVehGlbRealTiDCustDiagDFordVehGlbRealTi
      AssemblySwConnector_459: ecu-extract-reference=FordSysStDFordEpsSysStDCustDiagDFordEpsSysSt
      AssemblySwConnector_2413: ecu-extract-reference=FordSysStDFordEpsFailrDFordMsg082BusHiSpdDFordElecPwrAssidSteerFailr
      AssemblySwConnector_2414: ecu-extract-reference=CDD_MotCtrlMgrDMotCurrQaxDCustDiagDMotCurrQax
      AssemblySwConnector_2415: ecu-extract-reference=CDD_NxtrTiDGetRefTmr100MicroSec32bitDCustDiagDGetRefTmr100MicroSec32bit
      AssemblySwConnector_2416: ecu-extract-reference=CmnMfgSrvDIgnCntrDCustDiagDIgnCntr
      AssemblySwConnector_2417: ecu-extract-reference=FordHwTqCdngDFordAppldFinalMotTqDCustDiagDFordAppldFinalMotTq
      AssemblySwConnector_2418: ecu-extract-reference=FordMsg40ABusHiSpdDFordVehIdnNrDCustDiagDFordVehIdnNr
      AssemblySwConnector_2419: ecu-extract-reference=FordMsg430BusHiSpdDFordVehOdomDCustDiagDFordVehOdom
      AssemblySwConnector_2420: ecu-extract-reference=FordVltgIfDFordEpsCurrDCustDiagDFordEpsCurr
      AssemblySwConnector_2421: ecu-extract-reference=FordVltgIfDFordEpsVltgDCustDiagDFordEpsVltg
      AssemblySwConnector_2422: ecu-extract-reference=ImcSigArbnDVehSpdImcCorrdDCustDiagDVehSpd
      AssemblySwConnector_2424: ecu-extract-reference=FordMsg414BusHiSpdDFordVehSteerPinionAgOffsDCustDiagDFordVehSteerPinionAgOffs
      AssemblySwConnector_2425: ecu-extract-reference=MotTqCmdScaDMotTqCmdMrfScadDMotQuadDetnDMotTqCmd
      AssemblySwConnector_1930: ecu-extract-reference=SwpDMotTqCmdSwpDCmnMfgSrvDMotTqCmd
      AssemblySwConnector_1933: ecu-extract-reference=HwAgSysArbnDHwVelToSerlComDCustDiagDHwVelToSerlCom
      AssemblySwConnector_2427: ecu-extract-reference=FordVltgIfDFordMaxBattCurrDCustDiagDFordMaxBattCurr
      AssemblySwConnector_2428: ecu-extract-reference=FordVltgIfDFordMinBattVltgDCustDiagDFordMinBattVltg
      AssemblySwConnector_2430: ecu-extract-reference=DiagcMgrDClrLtchCntrDataDCustDiagDClrLtchCntrData
      AssemblySwConnector_2431: ecu-extract-reference=FordVehSpdArbnDFordVehSpdLoQlyDCustDiagDFordVehSpdLoQly
      AssemblySwConnector_2432: ecu-extract-reference=FordVehSpdArbnDFordVehSpdLoQlyVldDCustDiagDFordVehSpdLoQlyVld
      AssemblySwConnector_2433: ecu-extract-reference=CustDiagDFordBrkOscnRednEnadDFordMsg167BusHiSpdDFordBrkOscnRednEnad
      AssemblySwConnector_2434: ecu-extract-reference=CustDiagDFordTqSteerCmpEnadDFordMsg167BusHiSpdDFordTqSteerCmpEnad
      AssemblySwConnector_2436: ecu-extract-reference=CustDiagDFordAbsModlPrsntDFordMsg202BusHiSpdDFordAbsPrsnt
      AssemblySwConnector_2437: ecu-extract-reference=CustDiagDFordBrkOscnRednEnadDFordMsg202BusHiSpdDFordBrkOscnRednEnad
      AssemblySwConnector_2438: ecu-extract-reference=CustDiagDFordTqSteerCmpEnadDFordMsg202BusHiSpdDFordTqSteerCmpEnad
      AssemblySwConnector_2440: ecu-extract-reference=CustDiagDFordAbsModlPrsntDFordMsg217BusHiSpdDFordAbsPrsnt
      AssemblySwConnector_2441: ecu-extract-reference=CustDiagDFordActvNiblCtrlEnadDFordMsg217BusHiSpdDFordActvNiblCtrlEnad
      AssemblySwConnector_2442: ecu-extract-reference=CustDiagDFordBrkOscnRednEnadDFordMsg217BusHiSpdDFordBrkOscnRednEnad
      AssemblySwConnector_2443: ecu-extract-reference=CustDiagDFordTqSteerCmpEnadDFordMsg217BusHiSpdDFordTqSteerCmpEnad
      AssemblySwConnector_2446: ecu-extract-reference=CustDiagDFordAbsModlPrsntDFordMsg415BusHiSpdDFordAbsPrsnt
      AssemblySwConnector_2448: ecu-extract-reference=CustDiagDFordSelDrvModEnadDFordMsg41EBusHiSpdDFordSelDrvModEnad
      AssemblySwConnector_2449: ecu-extract-reference=DiagcMgrDClrDiagcFlgProxyDFordMsg430BusHiSpdDClrDiagcFlgProxy
      DelegationSwConnector_056: ecu-extract-reference=Ford_Outside_Air_Temp_StatDDFordMsg41ABusHiSpdDFordOutdAirTSts
      ComponentPrototype_152: upstream-reference=ECU_Composition.StackMeas, ecu-extract-reference=COMPOSITIONTYPE.StackMeas
      AssemblySwConnector_2450: ecu-extract-reference=HwAgArbnDHwAgDHwAgSysArbnDHwAg
      AssemblySwConnector_2451: ecu-extract-reference=HwAgArbnDHwAgDHwAgSysArbnDHwAgCorrd
      AssemblySwConnector_2452: ecu-extract-reference=HwAgSysArbnDHwAgFinalDImcArbnDHwAg
      AssemblySwConnector_2453: ecu-extract-reference=HwAgSysArbnDHwAgFinalDImcSigArbnDHwAg
      AssemblySwConnector_2454: ecu-extract-reference=ImcSigArbnDHwAgImcCorrdDDrvrTqEstimnDHwAg
      AssemblySwConnector_2455: ecu-extract-reference=ImcSigArbnDHwAgImcCorrdDEotLrngDHwAg
      AssemblySwConnector_2456: ecu-extract-reference=ImcSigArbnDHwAgImcCorrdDEotProtnDHwAg
      AssemblySwConnector_2457: ecu-extract-reference=ImcSigArbnDHwAgImcCorrdDEotProtnFwlDHwAg
      AssemblySwConnector_2458: ecu-extract-reference=ImcSigArbnDVehSpdImcCorrdDFordHwTqCdngDFordVehSpd
      AssemblySwConnector_2459: ecu-extract-reference=ImcSigArbnDVehSpdImcCorrdDFordSysStDFordVehSpd
      AssemblySwConnector_2460: ecu-extract-reference=ImcSigArbnDVehSpdImcCorrdDFordVltgIfDFordVehSpd
      AssemblySwConnector_2461: ecu-extract-reference=ImcSigArbnDHwAgImcCorrdDMotTqTranlDampgDHwAg
      AssemblySwConnector_2462: ecu-extract-reference=ImcSigArbnDHwAgImcCorrdDPosnTrakgServoDHwAg
      AssemblySwConnector_2463: ecu-extract-reference=ImcSigArbnDHwAgImcCorrdDRtnDHwAg
      AssemblySwConnector_2464: ecu-extract-reference=ImcSigArbnDHwAgImcCorrdDRtnPahFwlDHwAg
      AssemblySwConnector_2465: ecu-extract-reference=ImcSigArbnDHwAgImcCorrdDSysFricLrngDHwAg
      AssemblySwConnector_2466: ecu-extract-reference=ImcSigArbnDHwAgImcCorrdDTqLoaDPinionAg
      AssemblySwConnector_2467: ecu-extract-reference=ImcSigArbnDHwAgImcCorrdDVehSpdLimrDHwAg
      AssemblySwConnector_540: ecu-extract-reference=GateDrv0CtrlDIvtrFetFltPhaDCDD_GtmCfgAndUseDIvtrFetFltPha
      ComponentPrototype_153: upstream-reference=ECU_Composition.FordDualEcuFltDiagcCom, ecu-extract-reference=COMPOSITIONTYPE.FordDualEcuFltDiagcCom
      AssemblySwConnector_1465: ecu-extract-reference=DiagcMgrProxyAppl10DSetNtcSts10DFordDualEcuFltDiagcComDSetNtcSts
      AssemblySwConnector_1466: ecu-extract-reference=DualEcuIdnDEcuIdDFordDualEcuFltDiagcComDEcuId
      AssemblySwConnector_1468: ecu-extract-reference=FordDualEcuFltDiagcComDFordCtcIdxDImcArbnDFordCtcIdx
      AssemblySwConnector_1470: ecu-extract-reference=FordDualEcuFltDiagcComDFordCtcStsDImcArbnDFordCtcSts
      AssemblySwConnector_1471: ecu-extract-reference=ImcArbnDGetSigImcData_u08DFordDualEcuFltDiagcComDGetSigImcData_u08
      AssemblySwConnector_1472: ecu-extract-reference=CDD_MotCtrlMgrDMotAg5RawMeclDCDD_MotAg5MeasDMotAg5RawMecl
      AssemblySwConnector_1473: ecu-extract-reference=CDD_MotCtrlMgrDMotAg6RawMeclDCDD_MotAg6MeasDMotAg6RawMecl
      ComponentPrototype_154: upstream-reference=ECU_Composition.CDD_CoreVltgMonr, ecu-extract-reference=COMPOSITIONTYPE.CDD_CoreVltgMonr
      AssemblySwConnector_937: ecu-extract-reference=DiagcMgrProxyAppl10DSetNtcSts10DCDD_CoreVltgMonrDSetNtcSts
      AssemblySwConnector_112: ecu-extract-reference=HwAgSysArbnDHwAgNotCorrdDFordHwAgArbnDFordSnsrInp
      AssemblySwConnector_940: ecu-extract-reference=FordHwAgArbnDFordCmpdHwPosntoSerlComDCustDiagDFordCmpdHwPosn
      AssemblySwConnector_1474: ecu-extract-reference=FordHwAgArbnDFordCmpdHwPosntoSerlComDFordMsg07EBusHiSpdDCmpdSteerPinionAg
      AssemblySwConnector_1599: ecu-extract-reference=FordHwAgArbnDFordRelHwPosntoSerlComDFordMsg07EBusHiSpdDRelSteerPinionAg
      AssemblySwConnector_1414: ecu-extract-reference=CustDiagDClrDiagcReqDImcArbnDClrDiagcReq
      AssemblySwConnector_1422: ecu-extract-reference=CustDiagDFordAbsPrsntDImcArbnDFordAbsPrsnt
      AssemblySwConnector_1603: ecu-extract-reference=CustDiagDFordActvParkAssiEnadDImcArbnDFordActvParkAssiEnad
      AssemblySwConnector_1858: ecu-extract-reference=CustDiagDFordActvRtnEnadDImcArbnDFordActvRtnEnad
      AssemblySwConnector_1859: ecu-extract-reference=CustDiagDFordAfsEquidDImcArbnDFordAfsEquid
      AssemblySwConnector_1899: ecu-extract-reference=CustDiagDFordDrvrSteerRecomEnadDImcArbnDFordDrvrSteerRecomEnad
      AssemblySwConnector_2375: ecu-extract-reference=CustDiagDFordEngTqClassDImcArbnDFordEngTqClass
      AssemblySwConnector_2388: ecu-extract-reference=CustDiagDFordEscPrsntDImcArbnDFordEscPrsnt
      AssemblySwConnector_2389: ecu-extract-reference=CustDiagDFordSelDrvModEnadDImcArbnDFordSelDrvModEnad
      AssemblySwConnector_2391: ecu-extract-reference=CustDiagDFordSoftEndStopEnadDImcArbnDFordSoftEndStopEnad
      AssemblySwConnector_2423: ecu-extract-reference=CustDiagDFordStrtStopStDImcArbnDFordStrtStopSt
      AssemblySwConnector_2468: ecu-extract-reference=CustDiagDRtnDC00ReqDImcArbnDRtnDC00Req
      AssemblySwConnector_2469: ecu-extract-reference=DiagcMgrDClrAllDiagcDCustDiagDClrAllDiagc
      AssemblySwConnector_2470: ecu-extract-reference=FordCanDtcInhbDFordEpsLifeCycModDCustDiagDFordEpsLifeCycMod
      AssemblySwConnector_2471: ecu-extract-reference=ImcArbnDGetSigImcData_loglDCustDiagDGetSigImcData_logl
      AssemblySwConnector_2472: ecu-extract-reference=StackMeasDStackMeasClrDCmnMfgSrvDStackMeasClr
      AssemblySwConnector_2473: ecu-extract-reference=StackMeasDStackMeasReadDCmnMfgSrvDStackMeasRead
      AssemblySwConnector_2474: ecu-extract-reference=CustDiagDCustXcpEnaDCDD_XcpIfDCustXcpEna
      AssemblySwConnector_2475: ecu-extract-reference=DiagcMgrDReadSnpshtDataDCmnMfgSrvDReadExtdSnpshtData
      AssemblySwConnector_2485: ecu-extract-reference=DualEcuIdnDEcuIdDHwAgSnsrlsDEcuId
      AssemblySwConnector_2486: ecu-extract-reference=DualEcuIdnDEcuIdDHwAgSysArbnDEcuID
      AssemblySwConnector_2487: ecu-extract-reference=HwAgSysArbnDPinionAgDImcArbnDPinionAg
      AssemblySwConnector_2488: ecu-extract-reference=HwAgSysArbnDPinionAgConfDImcArbnDPinionAgConf
      AssemblySwConnector_2489: ecu-extract-reference=ImcArbnDGetSigImcData_f32DHwAgSnsrlsDGetSigImcData_f32
      AssemblySwConnector_2490: ecu-extract-reference=ImcArbnDGetSigImcData_f32DHwAgSysArbnDGetSigImcData_f32
      AssemblySwConnector_2491: ecu-extract-reference=MotAgCorrlnDMotAgMeclIdptSigDHwAgSnsrlsDMotAgMeclIdptSig
      AssemblySwConnector_2492: ecu-extract-reference=VehSigCdngDVehYawRateVldDHwAgSnsrlsDVehYawRateVld
      AssemblySwConnector_196: ecu-extract-reference=HwAgSysArbnDHwAgToMotAgCorrlnFltFldDImcArbnDHwAgToMotAgCorrlnFltFld
      AssemblySwConnector_2493: ecu-extract-reference=ImcArbnDGetSigImcData_loglDHwAgSysArbnDGetSigImcData_logl
      ComponentPrototype_155: upstream-reference=ECU_Composition.CalRegn02Rt05GroupB, ecu-extract-reference=COMPOSITIONTYPE.CalRegn02Rt05GroupB
      ComponentPrototype_156: upstream-reference=ECU_Composition.CalRegn02Rt04GroupB, ecu-extract-reference=COMPOSITIONTYPE.CalRegn02Rt04GroupB
      ComponentPrototype_157: upstream-reference=ECU_Composition.CalRegn02Rt03GroupB, ecu-extract-reference=COMPOSITIONTYPE.CalRegn02Rt03GroupB
      ComponentPrototype_158: upstream-reference=ECU_Composition.CalRegn02Rt02GroupB, ecu-extract-reference=COMPOSITIONTYPE.CalRegn02Rt02GroupB
      ComponentPrototype_159: upstream-reference=ECU_Composition.CalRegn02Rt01GroupB, ecu-extract-reference=COMPOSITIONTYPE.CalRegn02Rt01GroupB
      ComponentPrototype_160: upstream-reference=ECU_Composition.CalRegn02Rt00GroupB, ecu-extract-reference=COMPOSITIONTYPE.CalRegn02Rt00GroupB
      ComponentPrototype_161: upstream-reference=ECU_Composition.CalRegn02Inin00GroupB, ecu-extract-reference=COMPOSITIONTYPE.CalRegn02Inin00GroupB
      ComponentPrototype_162: upstream-reference=ECU_Composition.CalRegn02Inin00, ecu-extract-reference=COMPOSITIONTYPE.CalRegn02Inin00
      ComponentPrototype_163: upstream-reference=ECU_Composition.CalRegn02CmnGroupB, ecu-extract-reference=COMPOSITIONTYPE.CalRegn02CmnGroupB
      ComponentPrototype_164: upstream-reference=ECU_Composition.CalRegn02Cmn, ecu-extract-reference=COMPOSITIONTYPE.CalRegn02Cmn
      ComponentPrototype_165: upstream-reference=ECU_Composition.CalRegn01Rt05, ecu-extract-reference=COMPOSITIONTYPE.CalRegn01Rt05
      ComponentPrototype_166: upstream-reference=ECU_Composition.CalRegn01Rt04, ecu-extract-reference=COMPOSITIONTYPE.CalRegn01Rt04
      ComponentPrototype_167: upstream-reference=ECU_Composition.CalRegn01Rt03, ecu-extract-reference=COMPOSITIONTYPE.CalRegn01Rt03
      ComponentPrototype_168: upstream-reference=ECU_Composition.CalRegn01Rt02, ecu-extract-reference=COMPOSITIONTYPE.CalRegn01Rt02
      ComponentPrototype_169: upstream-reference=ECU_Composition.CalRegn01Rt01, ecu-extract-reference=COMPOSITIONTYPE.CalRegn01Rt01
      ComponentPrototype_170: upstream-reference=ECU_Composition.CalRegn01Rt00, ecu-extract-reference=COMPOSITIONTYPE.CalRegn01Rt00
      ComponentPrototype_171: upstream-reference=ECU_Composition.CalRegn01Inin00GroupD, ecu-extract-reference=COMPOSITIONTYPE.CalRegn01Inin00GroupD
      ComponentPrototype_172: upstream-reference=ECU_Composition.CalRegn01Inin00GroupB, ecu-extract-reference=COMPOSITIONTYPE.CalRegn01Inin00GroupB
      ComponentPrototype_173: upstream-reference=ECU_Composition.CalRegn01Inin00, ecu-extract-reference=COMPOSITIONTYPE.CalRegn01Inin00
      ComponentPrototype_174: upstream-reference=ECU_Composition.CalRegn01Cmn, ecu-extract-reference=COMPOSITIONTYPE.CalRegn01Cmn
      ComponentPrototype_175: upstream-reference=ECU_Composition.AAACalRegn02Rt05GroupB_Dummy, ecu-extract-reference=COMPOSITIONTYPE.AAACalRegn02Rt05GroupB_Dummy
      ComponentPrototype_176: upstream-reference=ECU_Composition.AAACalRegn02Rt04GroupB_Dummy, ecu-extract-reference=COMPOSITIONTYPE.AAACalRegn02Rt04GroupB_Dummy
      ComponentPrototype_177: upstream-reference=ECU_Composition.AAACalRegn02Rt03GroupB_Dummy, ecu-extract-reference=COMPOSITIONTYPE.AAACalRegn02Rt03GroupB_Dummy
      ComponentPrototype_178: upstream-reference=ECU_Composition.AAACalRegn02Rt02GroupB_Dummy, ecu-extract-reference=COMPOSITIONTYPE.AAACalRegn02Rt02GroupB_Dummy
      ComponentPrototype_179: upstream-reference=ECU_Composition.AAACalRegn02Rt01GroupB_Dummy, ecu-extract-reference=COMPOSITIONTYPE.AAACalRegn02Rt01GroupB_Dummy
      ComponentPrototype_180: upstream-reference=ECU_Composition.AAACalRegn02Rt00GroupB_Dummy, ecu-extract-reference=COMPOSITIONTYPE.AAACalRegn02Rt00GroupB_Dummy
      ComponentPrototype_181: upstream-reference=ECU_Composition.AAACalRegn01Rt05_Dummy, ecu-extract-reference=COMPOSITIONTYPE.AAACalRegn01Rt05_Dummy
      ComponentPrototype_182: upstream-reference=ECU_Composition.AAACalRegn01Rt04_Dummy, ecu-extract-reference=COMPOSITIONTYPE.AAACalRegn01Rt04_Dummy
      ComponentPrototype_183: upstream-reference=ECU_Composition.AAACalRegn01Rt03_Dummy, ecu-extract-reference=COMPOSITIONTYPE.AAACalRegn01Rt03_Dummy
      ComponentPrototype_184: upstream-reference=ECU_Composition.AAACalRegn01Rt02_Dummy, ecu-extract-reference=COMPOSITIONTYPE.AAACalRegn01Rt02_Dummy
      ComponentPrototype_185: upstream-reference=ECU_Composition.AAACalRegn01Rt01_Dummy, ecu-extract-reference=COMPOSITIONTYPE.AAACalRegn01Rt01_Dummy
      ComponentPrototype_186: upstream-reference=ECU_Composition.AAACalRegn01Rt00_Dummy, ecu-extract-reference=COMPOSITIONTYPE.AAACalRegn01Rt00_Dummy
      AssemblySwConnector: ecu-extract-reference=CalRegn01CmnDAssiSumLimCmdSumFilActvDAssiSumLimDAssiSumLimCmdSumFilActv
      AssemblySwConnector_001: ecu-extract-reference=CalRegn01CmnDAssiSumLimNtc0x0C4FailStepDAssiSumLimDAssiSumLimNtc0x0C4FailStep
      AssemblySwConnector_2494: ecu-extract-reference=CalRegn01CmnDAssiSumLimNtc0x0C4PassStepDAssiSumLimDAssiSumLimNtc0x0C4PassStep
      AssemblySwConnector_2495: ecu-extract-reference=CalRegn01CmnDAssiSumLimPullCmpLimDAssiSumLimDAssiSumLimPullCmpLim
      AssemblySwConnector_2496: ecu-extract-reference=CalRegn01CmnDBattVltgSwdMaxDBattVltgDBattVltgSwdMax
      AssemblySwConnector_2497: ecu-extract-reference=CalRegn01CmnDBattVltgCorrlnAllwdVltgDifDBattVltgCorrlnDBattVltgCorrlnAllwdVltgDif
      AssemblySwConnector_2498: ecu-extract-reference=CalRegn01CmnDBattVltgCorrlnBattLoVltgDBattVltgCorrlnDBattVltgCorrlnBattLoVltg
      AssemblySwConnector_2499: ecu-extract-reference=CalRegn01CmnDBattVltgCorrlnBattOverVltgDBattVltgCorrlnDBattVltgCorrlnBattOverVltg
      AssemblySwConnector_2500: ecu-extract-reference=CalRegn01CmnDBattVltgCorrlnBattUnderVltgDBattVltgCorrlnDBattVltgCorrlnBattUnderVltg
      AssemblySwConnector_2501: ecu-extract-reference=CalRegn01CmnDBattVltgCorrlnNtc0x03C0x044FailStepDBattVltgCorrlnDBattVltgCorrlnNtc0x03C0x044FailStep
      AssemblySwConnector_2502: ecu-extract-reference=CalRegn01CmnDBattVltgCorrlnNtc0x03C0x044PassStepDBattVltgCorrlnDBattVltgCorrlnNtc0x03C0x044PassStep
      AssemblySwConnector_2503: ecu-extract-reference=CalRegn01CmnDBattVltgCorrlnNtc0x0B0FailStepDBattVltgCorrlnDBattVltgCorrlnNtc0x0B0FailStep
      AssemblySwConnector_2504: ecu-extract-reference=CalRegn01CmnDBattVltgCorrlnNtc0x0B0PassStepDBattVltgCorrlnDBattVltgCorrlnNtc0x0B0PassStep
      AssemblySwConnector_2505: ecu-extract-reference=CalRegn01CmnDBattVltgCorrlnNtc0x0B1FailStepDBattVltgCorrlnDBattVltgCorrlnNtc0x0B1FailStep
      AssemblySwConnector_2506: ecu-extract-reference=CalRegn01CmnDBattVltgCorrlnNtc0x0B1PassStepDBattVltgCorrlnDBattVltgCorrlnNtc0x0B1PassStep
      AssemblySwConnector_2507: ecu-extract-reference=CalRegn01CmnDBattVltgCorrlnNtc0x0B5FailStepDBattVltgCorrlnDBattVltgCorrlnNtc0x0B5FailStep
      AssemblySwConnector_2508: ecu-extract-reference=CalRegn01CmnDBattVltgCorrlnNtc0x0B5PassStepDBattVltgCorrlnDBattVltgCorrlnNtc0x0B5PassStep
      AssemblySwConnector_2509: ecu-extract-reference=CalRegn01CmnDBattVltgCorrlnRcvrlBattLoVltgDBattVltgCorrlnDBattVltgCorrlnRcvrlBattLoVltg
      AssemblySwConnector_2510: ecu-extract-reference=CalRegn01CmnDBattVltgCorrlnRcvrlBattOverVltgDBattVltgCorrlnDBattVltgCorrlnRcvrlBattOverVltg
      AssemblySwConnector_2511: ecu-extract-reference=CalRegn01CmnDBattVltgCorrlnRcvrlBattUnderVltgDBattVltgCorrlnDBattVltgCorrlnRcvrlBattUnderVltg
      AssemblySwConnector_2512: ecu-extract-reference=CalRegn01CmnDBattVltgCorrlnSwdMaxDBattVltgCorrlnDBattVltgCorrlnSwdMax
      AssemblySwConnector_2513: ecu-extract-reference=CalRegn01CmnDBattVltgCorrlnSysMinVltgDBattVltgCorrlnDBattVltgCorrlnSysMinVltg
      AssemblySwConnector_2514: ecu-extract-reference=CalRegn01CmnDCurrMeasEolFixdPwmPerdDCDD_CurrMeasDCurrMeasEolFixdPwmPerd
      AssemblySwConnector_2515: ecu-extract-reference=CalRegn01CmnDCurrMeasEolGainMaxDCDD_CurrMeasDCurrMeasEolGainMax
      AssemblySwConnector_2516: ecu-extract-reference=CalRegn01CmnDCurrMeasEolGainMinDCDD_CurrMeasDCurrMeasEolGainMin
      AssemblySwConnector_2517: ecu-extract-reference=CalRegn01CmnDCurrMeasEolGainNomDCDD_CurrMeasDCurrMeasEolGainNom
      AssemblySwConnector_2518: ecu-extract-reference=CalRegn01CmnDCurrMeasEolGainNrOfSampleDCDD_CurrMeasDCurrMeasEolGainNrOfSample
      AssemblySwConnector_2519: ecu-extract-reference=CalRegn01CmnDCurrMeasEolGainNumerDCDD_CurrMeasDCurrMeasEolGainNumer
      AssemblySwConnector_2520: ecu-extract-reference=CalRegn01CmnDCurrMeasEolMaxMotVelDCDD_CurrMeasDCurrMeasEolMaxMotVel
      AssemblySwConnector_2521: ecu-extract-reference=CalRegn01CmnDCurrMeasEolOffsHiBrdgVltgMinDCDD_CurrMeasDCurrMeasEolOffsHiBrdgVltgMin
      AssemblySwConnector_2522: ecu-extract-reference=CalRegn01CmnDCurrMeasEolOffsHiCmuOffsDCDD_CurrMeasDCurrMeasEolOffsHiCmuOffs
      AssemblySwConnector_2523: ecu-extract-reference=CalRegn01CmnDCurrMeasEolOffsLoCmuOffsDCDD_CurrMeasDCurrMeasEolOffsLoCmuOffs
      AssemblySwConnector_2524: ecu-extract-reference=CalRegn01CmnDCurrMeasEolOffsMaxDCDD_CurrMeasDCurrMeasEolOffsMax
      AssemblySwConnector_2525: ecu-extract-reference=CalRegn01CmnDCurrMeasEolOffsMinDCDD_CurrMeasDCurrMeasEolOffsMin
      AssemblySwConnector_2526: ecu-extract-reference=CalRegn01CmnDCurrMeasEolOffsNomDCDD_CurrMeasDCurrMeasEolOffsNom
      AssemblySwConnector_2527: ecu-extract-reference=CalRegn01CmnDCurrMeasEolOffsNrOfSampleDCDD_CurrMeasDCurrMeasEolOffsNrOfSample
      AssemblySwConnector_2528: ecu-extract-reference=CalRegn01CmnDCurrMeasEolTranCntrThdDCDD_CurrMeasDCurrMeasEolTranCntrThd
      AssemblySwConnector_2529: ecu-extract-reference=CalRegn01CmnDCurrMeasMinRqrdPhaOnTiDCDD_CurrMeasDCurrMeasMinRqrdPhaOnTi
      AssemblySwConnector_2530: ecu-extract-reference=CalRegn01CmnDCurrMeasMotAgCompuDlyDCDD_CurrMeasDCurrMeasMotAgCompuDly
      AssemblySwConnector_2531: ecu-extract-reference=CalRegn01CmnDCurrMeasMotCurrAdcVlyWrmIninMaxDCDD_CurrMeasDCurrMeasMotCurrAdcVlyWrmIninMax
      AssemblySwConnector_2532: ecu-extract-reference=CalRegn01CmnDCurrMeasMotCurrAdcVlyWrmIninMinDCDD_CurrMeasDCurrMeasMotCurrAdcVlyWrmIninMin
      AssemblySwConnector_2533: ecu-extract-reference=CalRegn01CmnDCurrMeasNtc0x05DFailStepDCDD_CurrMeasDCurrMeasNtc0x05DFailStep
      AssemblySwConnector_2534: ecu-extract-reference=CalRegn01CmnDCurrMeasNtc0x05DPassStepDCDD_CurrMeasDCurrMeasNtc0x05DPassStep
      AssemblySwConnector_2535: ecu-extract-reference=CalRegn01CmnDCurrMeasArbnMaxStallCntrDCDD_CurrMeasArbnDCurrMeasArbnMaxStallCntr
      AssemblySwConnector_2536: ecu-extract-reference=CalRegn01CmnDCurrMeasEolFixdPwmPerdDCDD_GtmCfgAndUseDCurrMeasEolFixdPwmPerd
      AssemblySwConnector_2537: ecu-extract-reference=CalRegn01CmnDCurrMeasEolOffsHiCmuOffsDCDD_GtmCfgAndUseDCurrMeasEolOffsHiCmuOffs
      AssemblySwConnector_2538: ecu-extract-reference=CalRegn01CmnDCurrMeasEolOffsLoCmuOffsDCDD_GtmCfgAndUseDCurrMeasEolOffsLoCmuOffs
      AssemblySwConnector_2539: ecu-extract-reference=CalRegn01CmnDGtmCfgAndUseAdcStrtOfCnvn2OffsDCDD_GtmCfgAndUseDGtmCfgAndUseAdcStrtOfCnvn2Offs
      AssemblySwConnector_2540: ecu-extract-reference=CalRegn01CmnDGtmCfgAndUseAdcStrtOfCnvnPeakOffsDCDD_GtmCfgAndUseDGtmCfgAndUseAdcStrtOfCnvnPeakOffs
      AssemblySwConnector_2541: ecu-extract-reference=CalRegn01CmnDGtmCfgAndUseDma2MilliSecToMotCtrlTrigDCDD_GtmCfgAndUseDGtmCfgAndUseDma2MilliSecToMotCtrlTrig
      AssemblySwConnector_2542: ecu-extract-reference=CalRegn01CmnDGtmCfgAndUseDmaMotAgATrigDCDD_GtmCfgAndUseDGtmCfgAndUseDmaMotAgATrig
      AssemblySwConnector_2543: ecu-extract-reference=CalRegn01CmnDGtmCfgAndUseDmaMotCtrlTo2MilliSecTrigDCDD_GtmCfgAndUseDGtmCfgAndUseDmaMotCtrlTo2MilliSecTrig
      AssemblySwConnector_2544: ecu-extract-reference=CalRegn01CmnDGtmCfgAndUsePwmDbndDCDD_GtmCfgAndUseDGtmCfgAndUsePwmDbnd
      AssemblySwConnector_2545: ecu-extract-reference=CalRegn01CmnDMotAg5MeasAmpSqdMaxThdDCDD_MotAg5MeasDMotAg5MeasAmpSqdMaxThd
      AssemblySwConnector_2546: ecu-extract-reference=CalRegn01CmnDMotAg5MeasAmpSqdMinThdDCDD_MotAg5MeasDMotAg5MeasAmpSqdMinThd
      AssemblySwConnector_2547: ecu-extract-reference=CalRegn01CmnDMotAg5MeasLpFilFrqDCDD_MotAg5MeasDMotAg5MeasLpFilFrq
      AssemblySwConnector_2548: ecu-extract-reference=CalRegn01CmnDMotAg5MeasOffsDCDD_MotAg5MeasDMotAg5MeasOffs
      AssemblySwConnector_2549: ecu-extract-reference=CalRegn01CmnDMotAg5MeasRtAmpRecprLimDCDD_MotAg5MeasDMotAg5MeasRtAmpRecprLim
      AssemblySwConnector_2550: ecu-extract-reference=CalRegn01CmnDMotAg5MeasRtFilEnaThdDCDD_MotAg5MeasDMotAg5MeasRtFilEnaThd
      AssemblySwConnector_2551: ecu-extract-reference=CalRegn01CmnDMotAg5MeasRtMotVelFilEnaThdDCDD_MotAg5MeasDMotAg5MeasRtMotVelFilEnaThd
      AssemblySwConnector_2552: ecu-extract-reference=CalRegn01CmnDMotAg5MeasRtOffsLimDCDD_MotAg5MeasDMotAg5MeasRtOffsLim
      AssemblySwConnector_2553: ecu-extract-reference=CalRegn01CmnDMotAg5MeasRtToNomRatLimDCDD_MotAg5MeasDMotAg5MeasRtToNomRatLim
      AssemblySwConnector_2554: ecu-extract-reference=CalRegn01CmnDMotAg6MeasAmpSqdMaxThdDCDD_MotAg6MeasDMotAg6MeasAmpSqdMaxThd
      AssemblySwConnector_2555: ecu-extract-reference=CalRegn01CmnDMotAg6MeasAmpSqdMinThdDCDD_MotAg6MeasDMotAg6MeasAmpSqdMinThd
      AssemblySwConnector_2556: ecu-extract-reference=CalRegn01CmnDMotAg6MeasLpFilFrqDCDD_MotAg6MeasDMotAg6MeasLpFilFrq
      AssemblySwConnector_2557: ecu-extract-reference=CalRegn01CmnDMotAg6MeasOffsDCDD_MotAg6MeasDMotAg6MeasOffs
      AssemblySwConnector_2558: ecu-extract-reference=CalRegn01CmnDMotAg6MeasRtAmpRecprLimDCDD_MotAg6MeasDMotAg6MeasRtAmpRecprLim
      AssemblySwConnector_2559: ecu-extract-reference=CalRegn01CmnDMotAg6MeasRtFilEnaThdDCDD_MotAg6MeasDMotAg6MeasRtFilEnaThd
      AssemblySwConnector_2560: ecu-extract-reference=CalRegn01CmnDMotAg6MeasRtMotVelFilEnaThdDCDD_MotAg6MeasDMotAg6MeasRtMotVelFilEnaThd
      AssemblySwConnector_2561: ecu-extract-reference=CalRegn01CmnDMotAg6MeasRtOffsLimDCDD_MotAg6MeasDMotAg6MeasRtOffsLim
      AssemblySwConnector_2562: ecu-extract-reference=CalRegn01CmnDMotAg6MeasRtToNomRatLimDCDD_MotAg6MeasDMotAg6MeasRtToNomRatLim
      AssemblySwConnector_2563: ecu-extract-reference=CalRegn01CmnDMotAgSwCalVehSpdThdDCDD_MotAgSwCalDMotAgSwCalVehSpdThd
      AssemblySwConnector_2564: ecu-extract-reference=CalRegn01CmnDMotCurrRegCfgCurrLoopSecOrderTrfFctEnaDCDD_MotCurrRegVltgLimrDMotCurrRegCfgCurrLoopSecOrderTrfFctEna
      AssemblySwConnector_2565: ecu-extract-reference=CalRegn01CmnDMotCurrRegCfgMotRVirtDaxDCDD_MotCurrRegVltgLimrDMotCurrRegCfgMotRVirtDax
      AssemblySwConnector_2566: ecu-extract-reference=CalRegn01CmnDMotCurrRegCfgMotRVirtQaxDCDD_MotCurrRegVltgLimrDMotCurrRegCfgMotRVirtQax
      AssemblySwConnector_2567: ecu-extract-reference=CalRegn01CmnDMotCurrRegVltgLimrCurrLoaScarSlewRateDCDD_MotCurrRegVltgLimrDMotCurrRegVltgLimrCurrLoaScarSlewRate
      AssemblySwConnector_2568: ecu-extract-reference=CalRegn01CmnDMotCurrRegVltgLimrDaxAntiWdupCoeffDCDD_MotCurrRegVltgLimrDMotCurrRegVltgLimrDaxAntiWdupCoeff
      AssemblySwConnector_2569: ecu-extract-reference=CalRegn01CmnDMotCurrRegVltgLimrDualEcuLoaScarSlewRateDCDD_MotCurrRegVltgLimrDMotCurrRegVltgLimrDualEcuLoaScarSlewRate
      AssemblySwConnector_2570: ecu-extract-reference=CalRegn01CmnDMotCurrRegVltgLimrFETLoaScarSlewRateDCDD_MotCurrRegVltgLimrDMotCurrRegVltgLimrFETLoaScarSlewRate
      AssemblySwConnector_2571: ecu-extract-reference=CalRegn01CmnDMotCurrRegVltgLimrIvtrLoaScarSlewRateDCDD_MotCurrRegVltgLimrDMotCurrRegVltgLimrIvtrLoaScarSlewRate
      AssemblySwConnector_2572: ecu-extract-reference=CalRegn01CmnDMotCurrRegVltgLimrMotCurrPredEnaDCDD_MotCurrRegVltgLimrDMotCurrRegVltgLimrMotCurrPredEna
      AssemblySwConnector_2573: ecu-extract-reference=CalRegn01CmnDMotCurrRegVltgLimrMotCurrPredTiDCDD_MotCurrRegVltgLimrDMotCurrRegVltgLimrMotCurrPredTi
      AssemblySwConnector_2574: ecu-extract-reference=CalRegn01CmnDMotCurrRegVltgLimrMotCurrQaxRefMdfnRplEnaDCDD_MotCurrRegVltgLimrDMotCurrRegVltgLimrMotCurrQaxRefMdfnRplEna
      AssemblySwConnector_2575: ecu-extract-reference=CalRegn01CmnDMotCurrRegVltgLimrMotVltgBrdgFilEnaDCDD_MotCurrRegVltgLimrDMotCurrRegVltgLimrMotVltgBrdgFilEna
      AssemblySwConnector_2576: ecu-extract-reference=CalRegn01CmnDMotCurrRegVltgLimrMotVltgBrdgLpFilFrqDCDD_MotCurrRegVltgLimrDMotCurrRegVltgLimrMotVltgBrdgLpFilFrq
      AssemblySwConnector_2577: ecu-extract-reference=CalRegn01CmnDMotCurrRegVltgLimrMotVltgDaxIntglHiLimDCDD_MotCurrRegVltgLimrDMotCurrRegVltgLimrMotVltgDaxIntglHiLim
      AssemblySwConnector_2578: ecu-extract-reference=CalRegn01CmnDMotCurrRegVltgLimrMotVltgDaxIntglLoLimDCDD_MotCurrRegVltgLimrDMotCurrRegVltgLimrMotVltgDaxIntglLoLim
      AssemblySwConnector_2579: ecu-extract-reference=CalRegn01CmnDMotCurrRegVltgLimrMotVltgQaxFfFilEnaDCDD_MotCurrRegVltgLimrDMotCurrRegVltgLimrMotVltgQaxFfFilEna
      AssemblySwConnector_2580: ecu-extract-reference=CalRegn01CmnDMotCurrRegVltgLimrMotVltgQaxFfLpFilFrqDCDD_MotCurrRegVltgLimrDMotCurrRegVltgLimrMotVltgQaxFfLpFilFrq
      AssemblySwConnector_2581: ecu-extract-reference=CalRegn01CmnDMotCurrRegVltgLimrMotVltgQaxIntglHiLimDCDD_MotCurrRegVltgLimrDMotCurrRegVltgLimrMotVltgQaxIntglHiLim
      AssemblySwConnector_2582: ecu-extract-reference=CalRegn01CmnDMotCurrRegVltgLimrMotVltgQaxIntglLoLimDCDD_MotCurrRegVltgLimrDMotCurrRegVltgLimrMotVltgQaxIntglLoLim
      AssemblySwConnector_2583: ecu-extract-reference=CalRegn01CmnDMotCurrRegVltgLimrQaxAntiWdupCoeffDCDD_MotCurrRegVltgLimrDMotCurrRegVltgLimrQaxAntiWdupCoeff
      AssemblySwConnector_2584: ecu-extract-reference=CalRegn01CmnDMotCurrRegVltgLimrQaxAntiWdupScagDiDCDD_MotCurrRegVltgLimrDMotCurrRegVltgLimrQaxAntiWdupScagDi
      AssemblySwConnector_2585: ecu-extract-reference=CalRegn01CmnDMotRefMdlFbCtrlDiDCDD_MotCurrRegVltgLimrDMotRefMdlFbCtrlDi
      AssemblySwConnector_2586: ecu-extract-reference=CalRegn01CmnDMotRefMdlIvtrDeadTiBrdgVltgScaDCDD_MotCurrRegVltgLimrDMotRefMdlIvtrDeadTiBrdgVltgSca
      AssemblySwConnector_2587: ecu-extract-reference=CalRegn01CmnDMotAgSwCalVehSpdThdDCDD_SinVltgGennDMotAgSwCalVehSpdThd
      AssemblySwConnector_2588: ecu-extract-reference=CalRegn01CmnDSinVltgGennDthrEnaDCDD_SinVltgGennDSinVltgGennDthrEna
      AssemblySwConnector_2589: ecu-extract-reference=CalRegn01CmnDSinVltgGennDthrLpFilCoeffDCDD_SinVltgGennDSinVltgGennDthrLpFilCoeff
      AssemblySwConnector_2590: ecu-extract-reference=CalRegn01CmnDCmnMfgSrvSecuAcsAtmptTiOutDCmnMfgSrvDCmnMfgSrvSecuAcsAtmptTiOut
      AssemblySwConnector_2591: ecu-extract-reference=CalRegn01CmnDCmnMfgSrvSecuAcsMaxNrAtmptDCmnMfgSrvDCmnMfgSrvSecuAcsMaxNrAtmpt
      AssemblySwConnector_2592: ecu-extract-reference=CalRegn01CmnDCurrMeasCorrlnMaxErrCurrDCurrMeasCorrlnDCurrMeasCorrlnMaxErrCurr
      AssemblySwConnector_2593: ecu-extract-reference=CalRegn01CmnDCurrMeasCorrlnMaxStallCntrDCurrMeasCorrlnDCurrMeasCorrlnMaxStallCntr
      AssemblySwConnector_2594: ecu-extract-reference=CalRegn01CmnDCurrMeasCorrlnNtc0x04DFailStepDCurrMeasCorrlnDCurrMeasCorrlnNtc0x04DFailStep
      AssemblySwConnector_2595: ecu-extract-reference=CalRegn01CmnDCurrMeasCorrlnNtc0x04DPassStepDCurrMeasCorrlnDCurrMeasCorrlnNtc0x04DPassStep
      AssemblySwConnector_2611: ecu-extract-reference=CalRegn01CmnDNxtrCalIdsCal0DevlpDescDCustDiagDNxtrCalIdsCal0DevlpDesc
      AssemblySwConnector_2612: ecu-extract-reference=CalRegn01CmnDDiagcMgrFltRespDDiagcMgrDDiagcMgrFltResp
      AssemblySwConnector_2613: ecu-extract-reference=CalRegn01CmnDDiagcMgrFltRespDDiagcMgrProxyAppl10DDiagcMgrFltResp
      AssemblySwConnector_2614: ecu-extract-reference=CalRegn01CmnDDrvrTqEstimnMtrxADDrvrTqEstimnDDrvrTqEstimnMtrxA
      AssemblySwConnector_2615: ecu-extract-reference=CalRegn01CmnDDrvrTqEstimnMtrxBDDrvrTqEstimnDDrvrTqEstimnMtrxB
      AssemblySwConnector_2616: ecu-extract-reference=CalRegn01CmnDDrvrTqEstimnMtrxCDDrvrTqEstimnDDrvrTqEstimnMtrxC
      AssemblySwConnector_2617: ecu-extract-reference=CalRegn01CmnDDrvrTqEstimnMtrxDDDrvrTqEstimnDDrvrTqEstimnMtrxD
      AssemblySwConnector_2618: ecu-extract-reference=CalRegn01CmnDDutyCycThermProtnAbsltCtrlTFetMtgtnTblXDDutyCycThermProtnDDutyCycThermProtnAbsltCtrlTFetMtgtnTblX
      AssemblySwConnector_2619: ecu-extract-reference=CalRegn01CmnDDutyCycThermProtnAbsltCtrlTTblXDDutyCycThermProtnDDutyCycThermProtnAbsltCtrlTTblX
      AssemblySwConnector_2620: ecu-extract-reference=CalRegn01CmnDDutyCycThermProtnAbsltCtrlTTqFetMtgtnTblYDDutyCycThermProtnDDutyCycThermProtnAbsltCtrlTTqFetMtgtnTblY
      AssemblySwConnector_2621: ecu-extract-reference=CalRegn01CmnDDutyCycThermProtnAbsltCtrlTTqTblYDDutyCycThermProtnDDutyCycThermProtnAbsltCtrlTTqTblY
      AssemblySwConnector_2622: ecu-extract-reference=CalRegn01CmnDDutyCycThermProtnAbsltCuTFetMtgtnTblXDDutyCycThermProtnDDutyCycThermProtnAbsltCuTFetMtgtnTblX
      AssemblySwConnector_2623: ecu-extract-reference=CalRegn01CmnDDutyCycThermProtnAbsltCuTTblXDDutyCycThermProtnDDutyCycThermProtnAbsltCuTTblX
      AssemblySwConnector_2624: ecu-extract-reference=CalRegn01CmnDDutyCycThermProtnAbsltCuTTqFetMtgtnTblYDDutyCycThermProtnDDutyCycThermProtnAbsltCuTTqFetMtgtnTblY
      AssemblySwConnector_2625: ecu-extract-reference=CalRegn01CmnDDutyCycThermProtnAbsltCuTTqTblYDDutyCycThermProtnDDutyCycThermProtnAbsltCuTTqTblY
      AssemblySwConnector_2626: ecu-extract-reference=CalRegn01CmnDDutyCycThermProtnAbsltMotVelBreakPtDDutyCycThermProtnDDutyCycThermProtnAbsltMotVelBreakPt
      AssemblySwConnector_2627: ecu-extract-reference=CalRegn01CmnDDutyCycThermProtnAbsltTTqSlewHiLimDDutyCycThermProtnDDutyCycThermProtnAbsltTTqSlewHiLim
      AssemblySwConnector_2628: ecu-extract-reference=CalRegn01CmnDDutyCycThermProtnAbsltTTqSlewLoLimDDutyCycThermProtnDDutyCycThermProtnAbsltTTqSlewLoLim
      AssemblySwConnector_2629: ecu-extract-reference=CalRegn01CmnDDutyCycThermProtnCtrlTDDutyCycThermProtnDDutyCycThermProtnCtrlT
      AssemblySwConnector_2630: ecu-extract-reference=CalRegn01CmnDDutyCycThermProtnCtrlTSelnDDutyCycThermProtnDDutyCycThermProtnCtrlTSeln
      AssemblySwConnector_2631: ecu-extract-reference=CalRegn01CmnDDutyCycThermProtnDutyCycFildThdDDutyCycThermProtnDDutyCycThermProtnDutyCycFildThd
      AssemblySwConnector_2632: ecu-extract-reference=CalRegn01CmnDDutyCycThermProtnIgnOffCtrlEnaDDutyCycThermProtnDDutyCycThermProtnIgnOffCtrlEna
      AssemblySwConnector_2633: ecu-extract-reference=CalRegn01CmnDDutyCycThermProtnIgnOffMsgWaitTiDDutyCycThermProtnDDutyCycThermProtnIgnOffMsgWaitTi
      AssemblySwConnector_2634: ecu-extract-reference=CalRegn01CmnDDutyCycThermProtnLstTblValNonStallDDutyCycThermProtnDDutyCycThermProtnLstTblValNonStall
      AssemblySwConnector_2635: ecu-extract-reference=CalRegn01CmnDDutyCycThermProtnLstTblValStallDDutyCycThermProtnDDutyCycThermProtnLstTblValStall
      AssemblySwConnector_2636: ecu-extract-reference=CalRegn01CmnDDutyCycThermProtnMotPrTSelnDDutyCycThermProtnDDutyCycThermProtnMotPrTSeln
      AssemblySwConnector_2637: ecu-extract-reference=CalRegn01CmnDDutyCycThermProtnMplr1FetMtgtnNonStallTblYDDutyCycThermProtnDDutyCycThermProtnMplr1FetMtgtnNonStallTblY
      AssemblySwConnector_2638: ecu-extract-reference=CalRegn01CmnDDutyCycThermProtnMplr1FetMtgtnStallTblYDDutyCycThermProtnDDutyCycThermProtnMplr1FetMtgtnStallTblY
      AssemblySwConnector_2639: ecu-extract-reference=CalRegn01CmnDDutyCycThermProtnMplr1NonStallTblYDDutyCycThermProtnDDutyCycThermProtnMplr1NonStallTblY
      AssemblySwConnector_2640: ecu-extract-reference=CalRegn01CmnDDutyCycThermProtnMplr1StallTblYDDutyCycThermProtnDDutyCycThermProtnMplr1StallTblY
      AssemblySwConnector_2641: ecu-extract-reference=CalRegn01CmnDDutyCycThermProtnMplr2FetMtgtnNonStallTblYDDutyCycThermProtnDDutyCycThermProtnMplr2FetMtgtnNonStallTblY
      AssemblySwConnector_2642: ecu-extract-reference=CalRegn01CmnDDutyCycThermProtnMplr2FetMtgtnStallTblYDDutyCycThermProtnDDutyCycThermProtnMplr2FetMtgtnStallTblY
      AssemblySwConnector_2643: ecu-extract-reference=CalRegn01CmnDDutyCycThermProtnMplr2NonStallTblYDDutyCycThermProtnDDutyCycThermProtnMplr2NonStallTblY
      AssemblySwConnector_2644: ecu-extract-reference=CalRegn01CmnDDutyCycThermProtnMplr2StallTblYDDutyCycThermProtnDDutyCycThermProtnMplr2StallTblY
      AssemblySwConnector_2645: ecu-extract-reference=CalRegn01CmnDDutyCycThermProtnMplr3FetMtgtnNonStallTblYDDutyCycThermProtnDDutyCycThermProtnMplr3FetMtgtnNonStallTblY
      AssemblySwConnector_2646: ecu-extract-reference=CalRegn01CmnDDutyCycThermProtnMplr3FetMtgtnStallTblYDDutyCycThermProtnDDutyCycThermProtnMplr3FetMtgtnStallTblY
      AssemblySwConnector_2647: ecu-extract-reference=CalRegn01CmnDDutyCycThermProtnMplr3NonStallTblYDDutyCycThermProtnDDutyCycThermProtnMplr3NonStallTblY
      AssemblySwConnector_2648: ecu-extract-reference=CalRegn01CmnDDutyCycThermProtnMplr3StallTblYDDutyCycThermProtnDDutyCycThermProtnMplr3StallTblY
      AssemblySwConnector_2649: ecu-extract-reference=CalRegn01CmnDDutyCycThermProtnMplr4FetMtgtnNonStallTblYDDutyCycThermProtnDDutyCycThermProtnMplr4FetMtgtnNonStallTblY
      AssemblySwConnector_2650: ecu-extract-reference=CalRegn01CmnDDutyCycThermProtnMplr4FetMtgtnStallTblYDDutyCycThermProtnDDutyCycThermProtnMplr4FetMtgtnStallTblY
      AssemblySwConnector_2651: ecu-extract-reference=CalRegn01CmnDDutyCycThermProtnMplr4NonStallTblYDDutyCycThermProtnDDutyCycThermProtnMplr4NonStallTblY
      AssemblySwConnector_2652: ecu-extract-reference=CalRegn01CmnDDutyCycThermProtnMplr4StallTblYDDutyCycThermProtnDDutyCycThermProtnMplr4StallTblY
      AssemblySwConnector_2653: ecu-extract-reference=CalRegn01CmnDDutyCycThermProtnMplr5FetMtgtnNonStallTblYDDutyCycThermProtnDDutyCycThermProtnMplr5FetMtgtnNonStallTblY
      AssemblySwConnector_2654: ecu-extract-reference=CalRegn01CmnDDutyCycThermProtnMplr5FetMtgtnStallTblYDDutyCycThermProtnDDutyCycThermProtnMplr5FetMtgtnStallTblY
      AssemblySwConnector_2655: ecu-extract-reference=CalRegn01CmnDDutyCycThermProtnMplr5NonStallTblYDDutyCycThermProtnDDutyCycThermProtnMplr5NonStallTblY
      AssemblySwConnector_2656: ecu-extract-reference=CalRegn01CmnDDutyCycThermProtnMplr5StallTblYDDutyCycThermProtnDDutyCycThermProtnMplr5StallTblY
      AssemblySwConnector_2657: ecu-extract-reference=CalRegn01CmnDDutyCycThermProtnMplr6FetMtgtnNonStallTblYDDutyCycThermProtnDDutyCycThermProtnMplr6FetMtgtnNonStallTblY
      AssemblySwConnector_2658: ecu-extract-reference=CalRegn01CmnDDutyCycThermProtnMplr6FetMtgtnStallTblYDDutyCycThermProtnDDutyCycThermProtnMplr6FetMtgtnStallTblY
      AssemblySwConnector_2659: ecu-extract-reference=CalRegn01CmnDDutyCycThermProtnMplr6NonStallTblYDDutyCycThermProtnDDutyCycThermProtnMplr6NonStallTblY
      AssemblySwConnector_2660: ecu-extract-reference=CalRegn01CmnDDutyCycThermProtnMplr6StallTblYDDutyCycThermProtnDDutyCycThermProtnMplr6StallTblY
      AssemblySwConnector_2661: ecu-extract-reference=CalRegn01CmnDDutyCycThermProtnMplrFetMtgtnTblXDDutyCycThermProtnDDutyCycThermProtnMplrFetMtgtnTblX
      AssemblySwConnector_2662: ecu-extract-reference=CalRegn01CmnDDutyCycThermProtnMplrTblXDDutyCycThermProtnDDutyCycThermProtnMplrTblX
      AssemblySwConnector_2663: ecu-extract-reference=CalRegn01CmnDDutyCycThermProtnMplrTSelnDDutyCycThermProtnDDutyCycThermProtnMplrTSeln
      AssemblySwConnector_2664: ecu-extract-reference=CalRegn01CmnDDutyCycThermProtnSlowFilTSelnDDutyCycThermProtnDDutyCycThermProtnSlowFilTSeln
      AssemblySwConnector_2665: ecu-extract-reference=CalRegn01CmnDDutyCycThermProtnThermLimScaFacDDutyCycThermProtnDDutyCycThermProtnThermLimScaFac
      AssemblySwConnector_2666: ecu-extract-reference=CalRegn01CmnDDutyCycThermProtnThermLoadLimTblXDDutyCycThermProtnDDutyCycThermProtnThermLoadLimTblX
      AssemblySwConnector_2667: ecu-extract-reference=CalRegn01CmnDDutyCycThermProtnThermLoadLimTblYDDutyCycThermProtnDDutyCycThermProtnThermLoadLimTblY
      AssemblySwConnector_2668: ecu-extract-reference=CalRegn01CmnDDutyCycThermProtnTqCmdSlewDwnDDutyCycThermProtnDDutyCycThermProtnTqCmdSlewDwn
      AssemblySwConnector_2669: ecu-extract-reference=CalRegn01CmnDDutyCycThermProtnTqCmdSlewUpDDutyCycThermProtnDDutyCycThermProtnTqCmdSlewUp
      AssemblySwConnector_2670: ecu-extract-reference=CalRegn01CmnDElecPwrCnsCtrlrInpRDElecPwrCnsDElecPwrCnsCtrlrInpR
      AssemblySwConnector_2671: ecu-extract-reference=CalRegn01CmnDFordMsg167BusHiSpdMissMsgFaildTiThdDFordMsg167BusHiSpdDFordMsg167BusHiSpdMissMsgFaildTiThd
      AssemblySwConnector_2672: ecu-extract-reference=CalRegn01CmnDFordMsg167BusHiSpdMissMsgPassdTiThdDFordMsg167BusHiSpdDFordMsg167BusHiSpdMissMsgPassdTiThd
      AssemblySwConnector_2673: ecu-extract-reference=CalRegn01CmnDFordMsg167BusHiSpdPrpnWhlTqFaildTiThdDFordMsg167BusHiSpdDFordMsg167BusHiSpdPrpnWhlTqFaildTiThd
      AssemblySwConnector_2674: ecu-extract-reference=CalRegn01CmnDFordMsg167BusHiSpdPrpnWhlTqMissTiThdDFordMsg167BusHiSpdDFordMsg167BusHiSpdPrpnWhlTqMissTiThd
      AssemblySwConnector_2675: ecu-extract-reference=CalRegn01CmnDFordMsg167BusHiSpdPrpnWhlTqPassdTiThdDFordMsg167BusHiSpdDFordMsg167BusHiSpdPrpnWhlTqPassdTiThd
      AssemblySwConnector_2676: ecu-extract-reference=CalRegn01CmnDFordMsg167BusHiSpdPrpnWhlTqSigInvldFaildTiThdDFordMsg167BusHiSpdDFordMsg167BusHiSpdPrpnWhlTqSigInvldFaildTiThd
      AssemblySwConnector_2677: ecu-extract-reference=CalRegn01CmnDFordMsg167BusHiSpdPrpnWhlTqSigInvldPassdTiThdDFordMsg167BusHiSpdDFordMsg167BusHiSpdPrpnWhlTqSigInvldPassdTiThd
      AssemblySwConnector_2678: ecu-extract-reference=CalRegn01CmnDFordMsg202BusHiSpdEngModLoQlyVldFaildThdDFordMsg202BusHiSpdDFordMsg202BusHiSpdEngModLoQlyVldFaildThd
      AssemblySwConnector_2679: ecu-extract-reference=CalRegn01CmnDFordMsg202BusHiSpdEngModLoQlyVldMissThdDFordMsg202BusHiSpdDFordMsg202BusHiSpdEngModLoQlyVldMissThd
      AssemblySwConnector_2680: ecu-extract-reference=CalRegn01CmnDFordMsg202BusHiSpdEngModLoQlyVldPassdThdDFordMsg202BusHiSpdDFordMsg202BusHiSpdEngModLoQlyVldPassdThd
      AssemblySwConnector_2681: ecu-extract-reference=CalRegn01CmnDFordMsg202BusHiSpdEngModlVldFaildThdDFordMsg202BusHiSpdDFordMsg202BusHiSpdEngModlVldFaildThd
      AssemblySwConnector_2682: ecu-extract-reference=CalRegn01CmnDFordMsg202BusHiSpdEngModlVldMissThdDFordMsg202BusHiSpdDFordMsg202BusHiSpdEngModlVldMissThd
      AssemblySwConnector_2683: ecu-extract-reference=CalRegn01CmnDFordMsg202BusHiSpdGearRvsStsInvldFaildThdDFordMsg202BusHiSpdDFordMsg202BusHiSpdGearRvsStsInvldFaildThd
      AssemblySwConnector_2684: ecu-extract-reference=CalRegn01CmnDFordMsg202BusHiSpdGearRvsStsInvldPassdThdDFordMsg202BusHiSpdDFordMsg202BusHiSpdGearRvsStsInvldPassdThd
      AssemblySwConnector_2685: ecu-extract-reference=CalRegn01CmnDFordMsg202BusHiSpdGearRvsStsVldFaildThdDFordMsg202BusHiSpdDFordMsg202BusHiSpdGearRvsStsVldFaildThd
      AssemblySwConnector_2686: ecu-extract-reference=CalRegn01CmnDFordMsg202BusHiSpdGearRvsStsVldMissThdDFordMsg202BusHiSpdDFordMsg202BusHiSpdGearRvsStsVldMissThd
      AssemblySwConnector_2687: ecu-extract-reference=CalRegn01CmnDFordMsg202BusHiSpdGearRvsStsVldPassdThdDFordMsg202BusHiSpdDFordMsg202BusHiSpdGearRvsStsVldPassdThd
      AssemblySwConnector_2688: ecu-extract-reference=CalRegn01CmnDFordMsg202BusHiSpdMissMsgFaildAbsPrsntDisadThdDFordMsg202BusHiSpdDFordMsg202BusHiSpdMissMsgFaildAbsPrsntDisadThd
      AssemblySwConnector_2689: ecu-extract-reference=CalRegn01CmnDFordMsg202BusHiSpdMissMsgFaildAbsPrsntEnadThdDFordMsg202BusHiSpdDFordMsg202BusHiSpdMissMsgFaildAbsPrsntEnadThd
      AssemblySwConnector_2690: ecu-extract-reference=CalRegn01CmnDFordMsg202BusHiSpdMissMsgPassdThdDFordMsg202BusHiSpdDFordMsg202BusHiSpdMissMsgPassdThd
      AssemblySwConnector_2691: ecu-extract-reference=CalRegn01CmnDFordMsg202BusHiSpdQlyFacEngModInvldFaildThdDFordMsg202BusHiSpdDFordMsg202BusHiSpdQlyFacEngModInvldFaildThd
      AssemblySwConnector_2692: ecu-extract-reference=CalRegn01CmnDFordMsg202BusHiSpdQlyFacEngModInvldPassdThdDFordMsg202BusHiSpdDFordMsg202BusHiSpdQlyFacEngModInvldPassdThd
      AssemblySwConnector_2693: ecu-extract-reference=CalRegn01CmnDFordMsg202BusHiSpdTrlrBackupAssiAvlVldMissThdDFordMsg202BusHiSpdDFordMsg202BusHiSpdTrlrBackupAssiAvlVldMissThd
      AssemblySwConnector_2694: ecu-extract-reference=CalRegn01CmnDFordMsg202BusHiSpdTrlrBackupAssiAvlVldPassdThdDFordMsg202BusHiSpdDFordMsg202BusHiSpdTrlrBackupAssiAvlVldPassdThd
      AssemblySwConnector_2695: ecu-extract-reference=CalRegn01CmnDFordMsg217BusHiSpdFrntLeWhlSpdInvldFaildThdDFordMsg217BusHiSpdDFordMsg217BusHiSpdFrntLeWhlSpdInvldFaildThd
      AssemblySwConnector_2696: ecu-extract-reference=CalRegn01CmnDFordMsg217BusHiSpdFrntLeWhlSpdInvldPassdThdDFordMsg217BusHiSpdDFordMsg217BusHiSpdFrntLeWhlSpdInvldPassdThd
      AssemblySwConnector_2697: ecu-extract-reference=CalRegn01CmnDFordMsg217BusHiSpdFrntLeWhlVldFaildThdDFordMsg217BusHiSpdDFordMsg217BusHiSpdFrntLeWhlVldFaildThd
      AssemblySwConnector_2698: ecu-extract-reference=CalRegn01CmnDFordMsg217BusHiSpdFrntLeWhlVldMissThdDFordMsg217BusHiSpdDFordMsg217BusHiSpdFrntLeWhlVldMissThd
      AssemblySwConnector_2699: ecu-extract-reference=CalRegn01CmnDFordMsg217BusHiSpdFrntLeWhlVldPassdThdDFordMsg217BusHiSpdDFordMsg217BusHiSpdFrntLeWhlVldPassdThd
      AssemblySwConnector_2700: ecu-extract-reference=CalRegn01CmnDFordMsg217BusHiSpdFrntRiWhlSpdInvldFaildThdDFordMsg217BusHiSpdDFordMsg217BusHiSpdFrntRiWhlSpdInvldFaildThd
      AssemblySwConnector_2701: ecu-extract-reference=CalRegn01CmnDFordMsg217BusHiSpdFrntRiWhlSpdInvldPassdThdDFordMsg217BusHiSpdDFordMsg217BusHiSpdFrntRiWhlSpdInvldPassdThd
      AssemblySwConnector_2702: ecu-extract-reference=CalRegn01CmnDFordMsg217BusHiSpdFrntRiWhlVldFaildThdDFordMsg217BusHiSpdDFordMsg217BusHiSpdFrntRiWhlVldFaildThd
      AssemblySwConnector_2703: ecu-extract-reference=CalRegn01CmnDFordMsg217BusHiSpdFrntRiWhlVldMissThdDFordMsg217BusHiSpdDFordMsg217BusHiSpdFrntRiWhlVldMissThd
      AssemblySwConnector_2704: ecu-extract-reference=CalRegn01CmnDFordMsg217BusHiSpdFrntRiWhlVldPassdThdDFordMsg217BusHiSpdDFordMsg217BusHiSpdFrntRiWhlVldPassdThd
      AssemblySwConnector_2705: ecu-extract-reference=CalRegn01CmnDFordMsg217BusHiSpdMissMsgFaildThdDFordMsg217BusHiSpdDFordMsg217BusHiSpdMissMsgFaildThd
      AssemblySwConnector_2706: ecu-extract-reference=CalRegn01CmnDFordMsg217BusHiSpdMissMsgPassdThdDFordMsg217BusHiSpdDFordMsg217BusHiSpdMissMsgPassdThd
      AssemblySwConnector_2707: ecu-extract-reference=CalRegn01CmnDFordMsg217BusHiSpdReLeWhlSpdInvldFaildThdDFordMsg217BusHiSpdDFordMsg217BusHiSpdReLeWhlSpdInvldFaildThd
      AssemblySwConnector_2708: ecu-extract-reference=CalRegn01CmnDFordMsg217BusHiSpdReLeWhlSpdInvldPassdThdDFordMsg217BusHiSpdDFordMsg217BusHiSpdReLeWhlSpdInvldPassdThd
      AssemblySwConnector_2709: ecu-extract-reference=CalRegn01CmnDFordMsg217BusHiSpdReLeWhlVldFaildThdDFordMsg217BusHiSpdDFordMsg217BusHiSpdReLeWhlVldFaildThd
      AssemblySwConnector_2710: ecu-extract-reference=CalRegn01CmnDFordMsg217BusHiSpdReLeWhlVldMissThdDFordMsg217BusHiSpdDFordMsg217BusHiSpdReLeWhlVldMissThd
      AssemblySwConnector_2711: ecu-extract-reference=CalRegn01CmnDFordMsg217BusHiSpdReLeWhlVldPassdThdDFordMsg217BusHiSpdDFordMsg217BusHiSpdReLeWhlVldPassdThd
      AssemblySwConnector_2712: ecu-extract-reference=CalRegn01CmnDFordMsg217BusHiSpdReRiWhlSpdInvldFaildThdDFordMsg217BusHiSpdDFordMsg217BusHiSpdReRiWhlSpdInvldFaildThd
      AssemblySwConnector_2713: ecu-extract-reference=CalRegn01CmnDFordMsg217BusHiSpdReRiWhlSpdInvldPassdThdDFordMsg217BusHiSpdDFordMsg217BusHiSpdReRiWhlSpdInvldPassdThd
      AssemblySwConnector_2714: ecu-extract-reference=CalRegn01CmnDFordMsg217BusHiSpdReRiWhlVldFaildThdDFordMsg217BusHiSpdDFordMsg217BusHiSpdReRiWhlVldFaildThd
      AssemblySwConnector_2715: ecu-extract-reference=CalRegn01CmnDFordMsg217BusHiSpdReRiWhlVldMissThdDFordMsg217BusHiSpdDFordMsg217BusHiSpdReRiWhlVldMissThd
      AssemblySwConnector_2716: ecu-extract-reference=CalRegn01CmnDFordMsg217BusHiSpdReRiWhlVldPassdThdDFordMsg217BusHiSpdDFordMsg217BusHiSpdReRiWhlVldPassdThd
      AssemblySwConnector_2717: ecu-extract-reference=CalRegn01CmnDFordMsg3B3BusHiSpdIgnStsVldFaildThdDFordMsg3B3BusHiSpdDFordMsg3B3BusHiSpdIgnStsVldFaildThd
      AssemblySwConnector_2718: ecu-extract-reference=CalRegn01CmnDFordMsg3B3BusHiSpdIgnStsVldMissThdDFordMsg3B3BusHiSpdDFordMsg3B3BusHiSpdIgnStsVldMissThd
      AssemblySwConnector_2719: ecu-extract-reference=CalRegn01CmnDFordMsg3B3BusHiSpdIgnStsVldPassdThdDFordMsg3B3BusHiSpdDFordMsg3B3BusHiSpdIgnStsVldPassdThd
      AssemblySwConnector_2720: ecu-extract-reference=CalRegn01CmnDFordMsg3B3BusHiSpdInvldSigFaildThdDFordMsg3B3BusHiSpdDFordMsg3B3BusHiSpdInvldSigFaildThd
      AssemblySwConnector_2721: ecu-extract-reference=CalRegn01CmnDFordMsg3B3BusHiSpdInvldSigPassdThdDFordMsg3B3BusHiSpdDFordMsg3B3BusHiSpdInvldSigPassdThd
      AssemblySwConnector_2722: ecu-extract-reference=CalRegn01CmnDFordMsg3B3BusHiSpdMissMsgFaildThdDFordMsg3B3BusHiSpdDFordMsg3B3BusHiSpdMissMsgFaildThd
      AssemblySwConnector_2723: ecu-extract-reference=CalRegn01CmnDFordMsg3B3BusHiSpdMissMsgPassdThdDFordMsg3B3BusHiSpdDFordMsg3B3BusHiSpdMissMsgPassdThd
      AssemblySwConnector_2724: ecu-extract-reference=CalRegn01CmnDFordMsg40ABusHiSpdMissMsgFaildThdDFordMsg40ABusHiSpdDFordMsg40ABusHiSpdMissMsgFaildThd
      AssemblySwConnector_2725: ecu-extract-reference=CalRegn01CmnDFordMsg40ABusHiSpdMissMsgPassdThdDFordMsg40ABusHiSpdDFordMsg40ABusHiSpdMissMsgPassdThd
      AssemblySwConnector_2726: ecu-extract-reference=CalRegn01CmnDFordMsg414BusHiSpdAgOffsVldFaildThdDFordMsg414BusHiSpdDFordMsg414BusHiSpdAgOffsVldFaildThd
      AssemblySwConnector_2727: ecu-extract-reference=CalRegn01CmnDFordMsg414BusHiSpdAgOffsVldMissThdDFordMsg414BusHiSpdDFordMsg414BusHiSpdAgOffsVldMissThd
      AssemblySwConnector_2728: ecu-extract-reference=CalRegn01CmnDFordMsg414BusHiSpdAgOffsVldPassdThdDFordMsg414BusHiSpdDFordMsg414BusHiSpdAgOffsVldPassdThd
      AssemblySwConnector_2729: ecu-extract-reference=CalRegn01CmnDFordMsg415BusHiSpdBrkModlLoQlyVldFaildThdDFordMsg415BusHiSpdDFordMsg415BusHiSpdBrkModlLoQlyVldFaildThd
      AssemblySwConnector_2730: ecu-extract-reference=CalRegn01CmnDFordMsg415BusHiSpdBrkModlLoQlyVldMissThdDFordMsg415BusHiSpdDFordMsg415BusHiSpdBrkModlLoQlyVldMissThd
      AssemblySwConnector_2731: ecu-extract-reference=CalRegn01CmnDFordMsg415BusHiSpdBrkModlLoQlyVldPassdThdDFordMsg415BusHiSpdDFordMsg415BusHiSpdBrkModlLoQlyVldPassdThd
      AssemblySwConnector_2732: ecu-extract-reference=CalRegn01CmnDFordMsg415BusHiSpdBrkModlVldFaildThdDFordMsg415BusHiSpdDFordMsg415BusHiSpdBrkModlVldFaildThd
      AssemblySwConnector_2733: ecu-extract-reference=CalRegn01CmnDFordMsg415BusHiSpdBrkModlVldMissThdDFordMsg415BusHiSpdDFordMsg415BusHiSpdBrkModlVldMissThd
      AssemblySwConnector_2734: ecu-extract-reference=CalRegn01CmnDFordMsg415BusHiSpdBrkModlVldPassdThdDFordMsg415BusHiSpdDFordMsg415BusHiSpdBrkModlVldPassdThd
      AssemblySwConnector_2735: ecu-extract-reference=CalRegn01CmnDFordMsg415BusHiSpdBrkSprtVldMissThdDFordMsg415BusHiSpdDFordMsg415BusHiSpdBrkSprtVldMissThd
      AssemblySwConnector_2736: ecu-extract-reference=CalRegn01CmnDFordMsg415BusHiSpdBrkSprtVldPassdThdDFordMsg415BusHiSpdDFordMsg415BusHiSpdBrkSprtVldPassdThd
      AssemblySwConnector_2737: ecu-extract-reference=CalRegn01CmnDFordMsg415BusHiSpdChksBrkModlInvldFaildThdDFordMsg415BusHiSpdDFordMsg415BusHiSpdChksBrkModlInvldFaildThd
      AssemblySwConnector_2738: ecu-extract-reference=CalRegn01CmnDFordMsg415BusHiSpdChksBrkModlInvldPassdThdDFordMsg415BusHiSpdDFordMsg415BusHiSpdChksBrkModlInvldPassdThd
      AssemblySwConnector_2739: ecu-extract-reference=CalRegn01CmnDFordMsg415BusHiSpdCntrBrkModlInvldFaildThdDFordMsg415BusHiSpdDFordMsg415BusHiSpdCntrBrkModlInvldFaildThd
      AssemblySwConnector_2740: ecu-extract-reference=CalRegn01CmnDFordMsg415BusHiSpdCntrBrkModlInvldPassdThdDFordMsg415BusHiSpdDFordMsg415BusHiSpdCntrBrkModlInvldPassdThd
      AssemblySwConnector_2741: ecu-extract-reference=CalRegn01CmnDFordMsg415BusHiSpdMissMsgFaildThdDFordMsg415BusHiSpdDFordMsg415BusHiSpdMissMsgFaildThd
      AssemblySwConnector_2742: ecu-extract-reference=CalRegn01CmnDFordMsg415BusHiSpdMissMsgPassdThdDFordMsg415BusHiSpdDFordMsg415BusHiSpdMissMsgPassdThd
      AssemblySwConnector_2743: ecu-extract-reference=CalRegn01CmnDFordMsg415BusHiSpdQlyFacBrkModlInvldFaildThdDFordMsg415BusHiSpdDFordMsg415BusHiSpdQlyFacBrkModlInvldFaildThd
      AssemblySwConnector_2744: ecu-extract-reference=CalRegn01CmnDFordMsg415BusHiSpdQlyFacBrkModlInvldSigPassdThdDFordMsg415BusHiSpdDFordMsg415BusHiSpdQlyFacBrkModlInvldS_81050188
      AssemblySwConnector_2745: ecu-extract-reference=CalRegn01CmnDFordMsg41ABusHiSpdMissMsgFaildThdDFordMsg41ABusHiSpdDFordMsg41ABusHiSpdMissMsgFaildThd
      AssemblySwConnector_2746: ecu-extract-reference=CalRegn01CmnDFordMsg41ABusHiSpdMissMsgPassdThdDFordMsg41ABusHiSpdDFordMsg41ABusHiSpdMissMsgPassdThd
      AssemblySwConnector_2747: ecu-extract-reference=CalRegn01CmnDFordMsg41EBusHiSpdChassisVldMissFaildThdDFordMsg41EBusHiSpdDFordMsg41EBusHiSpdChassisVldMissFaildThd
      AssemblySwConnector_2748: ecu-extract-reference=CalRegn01CmnDFordMsg41EBusHiSpdChassisVldSigFaildThdDFordMsg41EBusHiSpdDFordMsg41EBusHiSpdChassisVldSigFaildThd
      AssemblySwConnector_2749: ecu-extract-reference=CalRegn01CmnDFordMsg41EBusHiSpdChassisVldSigPassdThdDFordMsg41EBusHiSpdDFordMsg41EBusHiSpdChassisVldSigPassdThd
      AssemblySwConnector_2750: ecu-extract-reference=CalRegn01CmnDFordMsg41EBusHiSpdInvldMsgFaildThdDFordMsg41EBusHiSpdDFordMsg41EBusHiSpdInvldMsgFaildThd
      AssemblySwConnector_2751: ecu-extract-reference=CalRegn01CmnDFordMsg41EBusHiSpdInvldMsgPassdThdDFordMsg41EBusHiSpdDFordMsg41EBusHiSpdInvldMsgPassdThd
      AssemblySwConnector_2752: ecu-extract-reference=CalRegn01CmnDFordMsg41EBusHiSpdMissMsgFaildThdDFordMsg41EBusHiSpdDFordMsg41EBusHiSpdMissMsgFaildThd
      AssemblySwConnector_2753: ecu-extract-reference=CalRegn01CmnDFordMsg41EBusHiSpdMissMsgPassdThdDFordMsg41EBusHiSpdDFordMsg41EBusHiSpdMissMsgPassdThd
      AssemblySwConnector_2754: ecu-extract-reference=CalRegn01CmnDFordMsg430BusHiSpdMissMsgFaildThdDFordMsg430BusHiSpdDFordMsg430BusHiSpdMissMsgFaildThd
      AssemblySwConnector_2755: ecu-extract-reference=CalRegn01CmnDFordMsg430BusHiSpdMissMsgPassdThdDFordMsg430BusHiSpdDFordMsg430BusHiSpdMissMsgPassdThd
      AssemblySwConnector_2756: ecu-extract-reference=CalRegn01CmnDGateDrv0CtrlErrFilFrqDGateDrv0CtrlDGateDrv0CtrlErrFilFrq
      AssemblySwConnector_2757: ecu-extract-reference=CalRegn01CmnDGateDrv0CtrlErrOffsDGateDrv0CtrlDGateDrv0CtrlErrOffs
      AssemblySwConnector_2758: ecu-extract-reference=CalRegn01CmnDGateDrv0CtrlErrThdDGateDrv0CtrlDGateDrv0CtrlErrThd
      AssemblySwConnector_2759: ecu-extract-reference=CalRegn01CmnDGateDrv0CtrlNtcNr0x050FailStepDGateDrv0CtrlDGateDrv0CtrlNtcNr0x050FailStep
      AssemblySwConnector_2760: ecu-extract-reference=CalRegn01CmnDGateDrv0CtrlNtcNr0x050PassStepDGateDrv0CtrlDGateDrv0CtrlNtcNr0x050PassStep
      AssemblySwConnector_2761: ecu-extract-reference=CalRegn01CmnDGateDrv0CtrlNtcNr0x051FailStepDGateDrv0CtrlDGateDrv0CtrlNtcNr0x051FailStep
      AssemblySwConnector_2762: ecu-extract-reference=CalRegn01CmnDGateDrv0CtrlNtcNr0x051PassStepDGateDrv0CtrlDGateDrv0CtrlNtcNr0x051PassStep
      AssemblySwConnector_2763: ecu-extract-reference=CalRegn01CmnDGateDrv0CtrlNtcNr0x055FailStepDGateDrv0CtrlDGateDrv0CtrlNtcNr0x055FailStep
      AssemblySwConnector_2764: ecu-extract-reference=CalRegn01CmnDGateDrv0CtrlNtcNr0x055PassStepDGateDrv0CtrlDGateDrv0CtrlNtcNr0x055PassStep
      AssemblySwConnector_2765: ecu-extract-reference=CalRegn01CmnDGateDrv0CtrlUnit0Cfg2WrValDGateDrv0CtrlDGateDrv0CtrlUnit0Cfg2WrVal
      AssemblySwConnector_2766: ecu-extract-reference=CalRegn01CmnDGateDrv0CtrlUnit0Cfg3WrValDGateDrv0CtrlDGateDrv0CtrlUnit0Cfg3WrVal
      AssemblySwConnector_2767: ecu-extract-reference=CalRegn01CmnDGateDrv0CtrlUnit0Cfg4WrValDGateDrv0CtrlDGateDrv0CtrlUnit0Cfg4WrVal
      AssemblySwConnector_2768: ecu-extract-reference=CalRegn01CmnDGateDrv0CtrlUnit0Cfg7WrValDGateDrv0CtrlDGateDrv0CtrlUnit0Cfg7WrVal
      AssemblySwConnector_2769: ecu-extract-reference=CalRegn01CmnDHwAgSnsrlsCorrdPinionAgConfThdDHwAgSnsrlsDHwAgSnsrlsCorrdPinionAgConfThd
      AssemblySwConnector_2770: ecu-extract-reference=CalRegn01CmnDHwAgSnsrlsCorrdPinionAgHwConfDHwAgSnsrlsDHwAgSnsrlsCorrdPinionAgHwConf
      AssemblySwConnector_2771: ecu-extract-reference=CalRegn01CmnDHwAgSnsrlsFCentrHwConfDHwAgSnsrlsDHwAgSnsrlsFCentrHwConf
      AssemblySwConnector_2772: ecu-extract-reference=CalRegn01CmnDHwAgSnsrlsMotAgIdptSigThdDHwAgSnsrlsDHwAgSnsrlsMotAgIdptSigThd
      AssemblySwConnector_2773: ecu-extract-reference=CalRegn01CmnDHwAgSnsrlsPinionTqFilFrqDHwAgSnsrlsDHwAgSnsrlsPinionTqFilFrq
      AssemblySwConnector_2774: ecu-extract-reference=CalRegn01CmnDHwAgSnsrlsRelHwAgFil1FrqDHwAgSnsrlsDHwAgSnsrlsRelHwAgFil1Frq
      AssemblySwConnector_2775: ecu-extract-reference=CalRegn01CmnDHwAgSnsrlsRelHwAgFil2FrqDHwAgSnsrlsDHwAgSnsrlsRelHwAgFil2Frq
      AssemblySwConnector_2776: ecu-extract-reference=CalRegn01CmnDHwAgSnsrlsSmotngCoeffDHwAgSnsrlsDHwAgSnsrlsSmotngCoeff
      AssemblySwConnector_2777: ecu-extract-reference=CalRegn01CmnDHwAgSnsrlsSmotngStepThdDHwAgSnsrlsDHwAgSnsrlsSmotngStepThd
      AssemblySwConnector_2778: ecu-extract-reference=CalRegn01CmnDHwAgSnsrlsStordPinionConfDHwAgSnsrlsDHwAgSnsrlsStordPinionConf
      AssemblySwConnector_2779: ecu-extract-reference=CalRegn01CmnDHwAgSnsrlsStordPinionConfThdDHwAgSnsrlsDHwAgSnsrlsStordPinionConfThd
      AssemblySwConnector_2780: ecu-extract-reference=CalRegn01CmnDHwAgSnsrlsVehDynDifThdDHwAgSnsrlsDHwAgSnsrlsVehDynDifThd
      AssemblySwConnector_2781: ecu-extract-reference=CalRegn01CmnDHwAgSnsrlsVehDynHwConfDHwAgSnsrlsDHwAgSnsrlsVehDynHwConf
      AssemblySwConnector_2782: ecu-extract-reference=CalRegn01CmnDHwAgSnsrlsVehDynMotVelThdDHwAgSnsrlsDHwAgSnsrlsVehDynMotVelThd
      AssemblySwConnector_2783: ecu-extract-reference=CalRegn01CmnDHwAgSnsrlsVehDynPinionTqThdDHwAgSnsrlsDHwAgSnsrlsVehDynPinionTqThd
      AssemblySwConnector_2784: ecu-extract-reference=CalRegn01CmnDHwAgSnsrlsVehDynTmr1ThdDHwAgSnsrlsDHwAgSnsrlsVehDynTmr1Thd
      AssemblySwConnector_2785: ecu-extract-reference=CalRegn01CmnDHwAgSnsrlsVehDynTmr2ThdDHwAgSnsrlsDHwAgSnsrlsVehDynTmr2Thd
      AssemblySwConnector_2786: ecu-extract-reference=CalRegn01CmnDHwAgSnsrlsWhlFrqThdDHwAgSnsrlsDHwAgSnsrlsWhlFrqThd
      AssemblySwConnector_2787: ecu-extract-reference=CalRegn01CmnDHwAgSnsrlsWhlSpdHwAgCoeff1DHwAgSnsrlsDHwAgSnsrlsWhlSpdHwAgCoeff1
      AssemblySwConnector_2788: ecu-extract-reference=CalRegn01CmnDHwAgSnsrlsWhlSpdHwAgCoeff2DHwAgSnsrlsDHwAgSnsrlsWhlSpdHwAgCoeff2
      AssemblySwConnector_2789: ecu-extract-reference=CalRegn01CmnDHwAgSnsrlsWhlSpdHwAgThdDHwAgSnsrlsDHwAgSnsrlsWhlSpdHwAgThd
      AssemblySwConnector_2790: ecu-extract-reference=CalRegn01CmnDHwAgSnsrlsWhlSpdHwConfDHwAgSnsrlsDHwAgSnsrlsWhlSpdHwConf
      AssemblySwConnector_2791: ecu-extract-reference=CalRegn01CmnDHwAgSnsrlsWhlSpdRatThdDHwAgSnsrlsDHwAgSnsrlsWhlSpdRatThd
      AssemblySwConnector_2792: ecu-extract-reference=CalRegn01CmnDHwAgSnsrlsWhlSpdTmrThdDHwAgSnsrlsDHwAgSnsrlsWhlSpdTmrThd
      AssemblySwConnector_2793: ecu-extract-reference=CalRegn01CmnDHwAgSnsrlsWhlSpdVehSpdThdDHwAgSnsrlsDHwAgSnsrlsWhlSpdVehSpdThd
      AssemblySwConnector_2794: ecu-extract-reference=CalRegn01CmnDHwAgSysArbnHwAgConf1SnsrDHwAgSysArbnDHwAgSysArbnHwAgConf1Snsr
      AssemblySwConnector_2795: ecu-extract-reference=CalRegn01CmnDHwAgSysArbnHwAgConf1SnsrHwAgTrimNotPrfmdDHwAgSysArbnDHwAgSysArbnHwAgConf1SnsrHwAgTrimNotPrfmd
      AssemblySwConnector_2796: ecu-extract-reference=CalRegn01CmnDHwAgSysArbnHwAgConf2SnsrDHwAgSysArbnDHwAgSysArbnHwAgConf2Snsr
      AssemblySwConnector_2797: ecu-extract-reference=CalRegn01CmnDHwAgSysArbnHwAgConf2SnsrHwAgTrimNotPrfmdDHwAgSysArbnDHwAgSysArbnHwAgConf2SnsrHwAgTrimNotPrfmd
      AssemblySwConnector_2798: ecu-extract-reference=CalRegn01CmnDHwAgSysArbnHwAgConfNoSnsrDHwAgSysArbnDHwAgSysArbnHwAgConfNoSnsr
      AssemblySwConnector_2799: ecu-extract-reference=CalRegn01CmnDHwAgSysArbnHwAgConfTiThdDHwAgSysArbnDHwAgSysArbnHwAgConfTiThd
      AssemblySwConnector_2800: ecu-extract-reference=CalRegn01CmnDHwAgSysArbnHwAgCorrdCorrlnThdDHwAgSysArbnDHwAgSysArbnHwAgCorrdCorrlnThd
      AssemblySwConnector_2801: ecu-extract-reference=CalRegn01CmnDHwAgSysArbnHwAgCorrlnFailDebStepDHwAgSysArbnDHwAgSysArbnHwAgCorrlnFailDebStep
      AssemblySwConnector_2802: ecu-extract-reference=CalRegn01CmnDHwAgSysArbnHwAgCorrlnPassDebStepDHwAgSysArbnDHwAgSysArbnHwAgCorrlnPassDebStep
      AssemblySwConnector_2803: ecu-extract-reference=CalRegn01CmnDHwAgSysArbnHwAgCorrlnRngDHwAgSysArbnDHwAgSysArbnHwAgCorrlnRng
      AssemblySwConnector_2804: ecu-extract-reference=CalRegn01CmnDHwAgSysArbnHwAgIdptSigLimDHwAgSysArbnDHwAgSysArbnHwAgIdptSigLim
      AssemblySwConnector_2805: ecu-extract-reference=CalRegn01CmnDHwAgSysArbnHwAgSlewRateDHwAgSysArbnDHwAgSysArbnHwAgSlewRate
      AssemblySwConnector_2806: ecu-extract-reference=CalRegn01CmnDHwAgSysArbnHwAgSnsrlsCorrlnThdDHwAgSysArbnDHwAgSysArbnHwAgSnsrlsCorrlnThd
      AssemblySwConnector_2807: ecu-extract-reference=CalRegn01CmnDHwAgSysArbnHwAgSnsrlsKineThdDHwAgSysArbnDHwAgSysArbnHwAgSnsrlsKineThd
      AssemblySwConnector_2808: ecu-extract-reference=CalRegn01CmnDHwAgSysArbnImcHwAgCorrlnRngDHwAgSysArbnDHwAgSysArbnImcHwAgCorrlnRng
      AssemblySwConnector_2809: ecu-extract-reference=CalRegn01CmnDHwAgSysArbnPinionAgConfThdDHwAgSysArbnDHwAgSysArbnPinionAgConfThd
      AssemblySwConnector_2810: ecu-extract-reference=CalRegn01CmnDHwAgSysArbnSerlComHwAgCorrdConfDHwAgSysArbnDHwAgSysArbnSerlComHwAgCorrdConf
      AssemblySwConnector_2811: ecu-extract-reference=CalRegn01CmnDHwAgSysArbnSerlComHwAgSnsrlsConfDHwAgSysArbnDHwAgSysArbnSerlComHwAgSnsrlsConf
      AssemblySwConnector_2812: ecu-extract-reference=CalRegn01CmnDHwAgSysArbnSlewRateTmrDHwAgSysArbnDHwAgSysArbnSlewRateTmr
      AssemblySwConnector_2813: ecu-extract-reference=CalRegn01CmnDHwTqArbnHwTqMaxStallCntDHwTqArbnDHwTqArbnHwTqMaxStallCnt
      AssemblySwConnector_2814: ecu-extract-reference=CalRegn01CmnDHwTqArbnHwTqMaxStallCntDHwTqCorrlnDHwTqArbnHwTqMaxStallCnt
      AssemblySwConnector_2815: ecu-extract-reference=CalRegn01CmnDHwTqCorrlnImdtCorrlnChkFailThdDHwTqCorrlnDHwTqCorrlnImdtCorrlnChkFailThd
      AssemblySwConnector_2816: ecu-extract-reference=CalRegn01CmnDHwTqCorrlnNtcFailStepDHwTqCorrlnDHwTqCorrlnNtcFailStep
      AssemblySwConnector_2817: ecu-extract-reference=CalRegn01CmnDHwTqCorrlnNtcPassStepDHwTqCorrlnDHwTqCorrlnNtcPassStep
      AssemblySwConnector_2818: ecu-extract-reference=CalRegn01CmnDImcArbnEcuIninTiOutThdDImcArbnDImcArbnEcuIninTiOutThd
      AssemblySwConnector_2819: ecu-extract-reference=CalRegn01CmnDImcArbnFrmFltThdDImcArbnDImcArbnFrmFltThd
      AssemblySwConnector_2820: ecu-extract-reference=CalRegn01CmnDLoaMgrCurrIvtrMtgtnScaZeroEnaDLoaMgrDLoaMgrCurrIvtrMtgtnScaZeroEna
      AssemblySwConnector_2821: ecu-extract-reference=CalRegn01CmnDLoaMgrCurrMeasIdptSig0RespDLoaMgrDLoaMgrCurrMeasIdptSig0Resp
      AssemblySwConnector_2822: ecu-extract-reference=CalRegn01CmnDLoaMgrCurrMeasIdptSig1RespDLoaMgrDLoaMgrCurrMeasIdptSig1Resp
      AssemblySwConnector_2823: ecu-extract-reference=CalRegn01CmnDLoaMgrCurrMeasIdptSig2RespDLoaMgrDLoaMgrCurrMeasIdptSig2Resp
      AssemblySwConnector_2824: ecu-extract-reference=CalRegn01CmnDLoaMgrCurrMeasIdptSigFltThdDLoaMgrDLoaMgrCurrMeasIdptSigFltThd
      AssemblySwConnector_2825: ecu-extract-reference=CalRegn01CmnDLoaMgrCurrMeasMtgtnScaZeroEnaDLoaMgrDLoaMgrCurrMeasMtgtnScaZeroEna
      AssemblySwConnector_2826: ecu-extract-reference=CalRegn01CmnDLoaMgrFadeOutStRateDLoaMgrDLoaMgrFadeOutStRate
      AssemblySwConnector_2827: ecu-extract-reference=CalRegn01CmnDLoaMgrHwTqIdptSig0NoTqLoaRespDLoaMgrDLoaMgrHwTqIdptSig0NoTqLoaResp
      AssemblySwConnector_2828: ecu-extract-reference=CalRegn01CmnDLoaMgrHwTqIdptSig1NoTqLoaRespDLoaMgrDLoaMgrHwTqIdptSig1NoTqLoaResp
      AssemblySwConnector_2829: ecu-extract-reference=CalRegn01CmnDLoaMgrHwTqIdptSig2RespDLoaMgrDLoaMgrHwTqIdptSig2Resp
      AssemblySwConnector_2830: ecu-extract-reference=CalRegn01CmnDLoaMgrHwTqIdptSig3RespDLoaMgrDLoaMgrHwTqIdptSig3Resp
      AssemblySwConnector_2831: ecu-extract-reference=CalRegn01CmnDLoaMgrHwTqIdptSig4RespDLoaMgrDLoaMgrHwTqIdptSig4Resp
      AssemblySwConnector_2832: ecu-extract-reference=CalRegn01CmnDLoaMgrHwTqIdptSigFltThdDLoaMgrDLoaMgrHwTqIdptSigFltThd
      AssemblySwConnector_2833: ecu-extract-reference=CalRegn01CmnDLoaMgrHwTqLoaAvlRespDLoaMgrDLoaMgrHwTqLoaAvlResp
      AssemblySwConnector_2834: ecu-extract-reference=CalRegn01CmnDLoaMgrIvtrIdptSig0RespDLoaMgrDLoaMgrIvtrIdptSig0Resp
      AssemblySwConnector_2835: ecu-extract-reference=CalRegn01CmnDLoaMgrIvtrIdptSig1RespDLoaMgrDLoaMgrIvtrIdptSig1Resp
      AssemblySwConnector_2836: ecu-extract-reference=CalRegn01CmnDLoaMgrIvtrIdptSig2RespDLoaMgrDLoaMgrIvtrIdptSig2Resp
      AssemblySwConnector_2837: ecu-extract-reference=CalRegn01CmnDLoaMgrIvtrIdptSigFltThdDLoaMgrDLoaMgrIvtrIdptSigFltThd
      AssemblySwConnector_2838: ecu-extract-reference=CalRegn01CmnDLoaMgrIvtrMtgtnScaZeroEnaDLoaMgrDLoaMgrIvtrMtgtnScaZeroEna
      AssemblySwConnector_2839: ecu-extract-reference=CalRegn01CmnDLoaMgrMotAgAvlSnsrlsRespDLoaMgrDLoaMgrMotAgAvlSnsrlsResp
      AssemblySwConnector_2840: ecu-extract-reference=CalRegn01CmnDLoaMgrMotAgIdptSig0NoSnsrlsRespDLoaMgrDLoaMgrMotAgIdptSig0NoSnsrlsResp
      AssemblySwConnector_2841: ecu-extract-reference=CalRegn01CmnDLoaMgrMotAgIdptSig1NoSnsrlsRespDLoaMgrDLoaMgrMotAgIdptSig1NoSnsrlsResp
      AssemblySwConnector_2842: ecu-extract-reference=CalRegn01CmnDLoaMgrMotAgIdptSig2RespDLoaMgrDLoaMgrMotAgIdptSig2Resp
      AssemblySwConnector_2843: ecu-extract-reference=CalRegn01CmnDLoaMgrMotAgIdptSig3RespDLoaMgrDLoaMgrMotAgIdptSig3Resp
      AssemblySwConnector_2844: ecu-extract-reference=CalRegn01CmnDLoaMgrMotAgIdptSigFltThdDLoaMgrDLoaMgrMotAgIdptSigFltThd
      AssemblySwConnector_2845: ecu-extract-reference=CalRegn01CmnDLoaMgrMotAgMtgtnScaZeroEnaDLoaMgrDLoaMgrMotAgMtgtnScaZeroEna
      AssemblySwConnector_2846: ecu-extract-reference=CalRegn01CmnDMotAg2MeasOffsDMotAg2MeasDMotAg2MeasOffs
      AssemblySwConnector_2847: ecu-extract-reference=CalRegn01CmnDMotCtrlPrmEstimnFetRNomDMotCtrlPrmEstimnDMotCtrlPrmEstimnFetRNom
      AssemblySwConnector_2848: ecu-extract-reference=CalRegn01CmnDMotCtrlPrmEstimnFetThermCoeffDMotCtrlPrmEstimnDMotCtrlPrmEstimnFetThermCoeff
      AssemblySwConnector_2849: ecu-extract-reference=CalRegn01CmnDMotCtrlPrmEstimnMagThermCoeffDMotCtrlPrmEstimnDMotCtrlPrmEstimnMagThermCoeff
      AssemblySwConnector_2850: ecu-extract-reference=CalRegn01CmnDMotCtrlPrmEstimnMotBackEmfConHiLimDMotCtrlPrmEstimnDMotCtrlPrmEstimnMotBackEmfConHiLim
      AssemblySwConnector_2851: ecu-extract-reference=CalRegn01CmnDMotCtrlPrmEstimnMotBackEmfConLoLimDMotCtrlPrmEstimnDMotCtrlPrmEstimnMotBackEmfConLoLim
      AssemblySwConnector_2852: ecu-extract-reference=CalRegn01CmnDMotCtrlPrmEstimnMotBackEmfConNomDMotCtrlPrmEstimnDMotCtrlPrmEstimnMotBackEmfConNom
      AssemblySwConnector_2853: ecu-extract-reference=CalRegn01CmnDMotCtrlPrmEstimnMotBackEmfConSatnScaIvtrLoaMtgtnDMotCtrlPrmEstimnDMotCtrlPrmEstimnMotBackEmfConSatnScaIv_566c9b8d
      AssemblySwConnector_2854: ecu-extract-reference=CalRegn01CmnDMotCtrlPrmEstimnMotBackEmfConSatnXDMotCtrlPrmEstimnDMotCtrlPrmEstimnMotBackEmfConSatnX
      AssemblySwConnector_2855: ecu-extract-reference=CalRegn01CmnDMotCtrlPrmEstimnMotBackEmfConSatnYDMotCtrlPrmEstimnDMotCtrlPrmEstimnMotBackEmfConSatnY
      AssemblySwConnector_2856: ecu-extract-reference=CalRegn01CmnDMotCtrlPrmEstimnMotCurrDaxInduSatnBilnrSelnDMotCtrlPrmEstimnDMotCtrlPrmEstimnMotCurrDaxInduSatnBilnrSeln
      AssemblySwConnector_2857: ecu-extract-reference=CalRegn01CmnDMotCtrlPrmEstimnMotCurrQaxInduSatnXDMotCtrlPrmEstimnDMotCtrlPrmEstimnMotCurrQaxInduSatnX
      AssemblySwConnector_2858: ecu-extract-reference=CalRegn01CmnDMotCtrlPrmEstimnMotInduDaxHiLimDMotCtrlPrmEstimnDMotCtrlPrmEstimnMotInduDaxHiLim
      AssemblySwConnector_2859: ecu-extract-reference=CalRegn01CmnDMotCtrlPrmEstimnMotInduDaxIvtrLoaMtgtnDMotCtrlPrmEstimnDMotCtrlPrmEstimnMotInduDaxIvtrLoaMtgtn
      AssemblySwConnector_2860: ecu-extract-reference=CalRegn01CmnDMotCtrlPrmEstimnMotInduDaxLoLimDMotCtrlPrmEstimnDMotCtrlPrmEstimnMotInduDaxLoLim
      AssemblySwConnector_2861: ecu-extract-reference=CalRegn01CmnDMotCtrlPrmEstimnMotInduDaxNomDMotCtrlPrmEstimnDMotCtrlPrmEstimnMotInduDaxNom
      AssemblySwConnector_2862: ecu-extract-reference=CalRegn01CmnDMotCtrlPrmEstimnMotInduDaxSatnScaYDMotCtrlPrmEstimnDMotCtrlPrmEstimnMotInduDaxSatnScaY
      AssemblySwConnector_2863: ecu-extract-reference=CalRegn01CmnDMotCtrlPrmEstimnMotInduQaxHiLimDMotCtrlPrmEstimnDMotCtrlPrmEstimnMotInduQaxHiLim
      AssemblySwConnector_2864: ecu-extract-reference=CalRegn01CmnDMotCtrlPrmEstimnMotInduQaxIvtrLoaMtgtnDMotCtrlPrmEstimnDMotCtrlPrmEstimnMotInduQaxIvtrLoaMtgtn
      AssemblySwConnector_2865: ecu-extract-reference=CalRegn01CmnDMotCtrlPrmEstimnMotInduQaxLoLimDMotCtrlPrmEstimnDMotCtrlPrmEstimnMotInduQaxLoLim
      AssemblySwConnector_2866: ecu-extract-reference=CalRegn01CmnDMotCtrlPrmEstimnMotInduQaxNomDMotCtrlPrmEstimnDMotCtrlPrmEstimnMotInduQaxNom
      AssemblySwConnector_2867: ecu-extract-reference=CalRegn01CmnDMotCtrlPrmEstimnMotInduQaxSatnScaYDMotCtrlPrmEstimnDMotCtrlPrmEstimnMotInduQaxSatnScaY
      AssemblySwConnector_2868: ecu-extract-reference=CalRegn01CmnDMotCtrlPrmEstimnMotRHiLimDMotCtrlPrmEstimnDMotCtrlPrmEstimnMotRHiLim
      AssemblySwConnector_2869: ecu-extract-reference=CalRegn01CmnDMotCtrlPrmEstimnMotRLoLimDMotCtrlPrmEstimnDMotCtrlPrmEstimnMotRLoLim
      AssemblySwConnector_2870: ecu-extract-reference=CalRegn01CmnDMotCtrlPrmEstimnMotRNomDMotCtrlPrmEstimnDMotCtrlPrmEstimnMotRNom
      AssemblySwConnector_2871: ecu-extract-reference=CalRegn01CmnDMotCtrlPrmEstimnMotWidgThermCoeffDMotCtrlPrmEstimnDMotCtrlPrmEstimnMotWidgThermCoeff
      AssemblySwConnector_2872: ecu-extract-reference=CalRegn01CmnDMotCtrlPrmEstimnTNomDMotCtrlPrmEstimnDMotCtrlPrmEstimnTNom
      AssemblySwConnector_2873: ecu-extract-reference=CalRegn01CmnDMotCurrPeakEstimnCurrFilFrqDMotCurrPeakEstimnDMotCurrPeakEstimnCurrFilFrq
      AssemblySwConnector_2874: ecu-extract-reference=CalRegn01CmnDMotCurrPeakEstimnCurrPeakEstimdFilFrqDMotCurrPeakEstimnDMotCurrPeakEstimnCurrPeakEstimdFilFrq
      AssemblySwConnector_2875: ecu-extract-reference=CalRegn01CmnDMotCurrRegCfgCtrlrDynGainVehSpdCutOffDMotCurrRegCfgDMotCurrRegCfgCtrlrDynGainVehSpdCutOff
      AssemblySwConnector_2876: ecu-extract-reference=CalRegn01CmnDMotCurrRegCfgCurrLoopSecOrderTrfFctEnaDMotCurrRegCfgDMotCurrRegCfgCurrLoopSecOrderTrfFctEna
      AssemblySwConnector_2877: ecu-extract-reference=CalRegn01CmnDMotCurrRegCfgIntglGainSampleTiDMotCurrRegCfgDMotCurrRegCfgIntglGainSampleTi
      AssemblySwConnector_2878: ecu-extract-reference=CalRegn01CmnDMotCurrRegCfgMotAgCompuDlyDMotCurrRegCfgDMotCurrRegCfgMotAgCompuDly
      AssemblySwConnector_2879: ecu-extract-reference=CalRegn01CmnDMotCurrRegCfgMotClsdLoopBwDaxYDMotCurrRegCfgDMotCurrRegCfgMotClsdLoopBwDaxY
      AssemblySwConnector_2880: ecu-extract-reference=CalRegn01CmnDMotCurrRegCfgMotClsdLoopBwQaxYDMotCurrRegCfgDMotCurrRegCfgMotClsdLoopBwQaxY
      AssemblySwConnector_2881: ecu-extract-reference=CalRegn01CmnDMotCurrRegCfgMotCtrlPrmSelnXDMotCurrRegCfgDMotCurrRegCfgMotCtrlPrmSelnX
      AssemblySwConnector_2882: ecu-extract-reference=CalRegn01CmnDMotCurrRegCfgMotDampgRatDaxDMotCurrRegCfgDMotCurrRegCfgMotDampgRatDax
      AssemblySwConnector_2883: ecu-extract-reference=CalRegn01CmnDMotCurrRegCfgMotDampgRatQaxDMotCurrRegCfgDMotCurrRegCfgMotDampgRatQax
      AssemblySwConnector_2884: ecu-extract-reference=CalRegn01CmnDMotCurrRegCfgMotNatFrqDaxYDMotCurrRegCfgDMotCurrRegCfgMotNatFrqDaxY
      AssemblySwConnector_2885: ecu-extract-reference=CalRegn01CmnDMotCurrRegCfgMotNatFrqQaxYDMotCurrRegCfgDMotCurrRegCfgMotNatFrqQaxY
      AssemblySwConnector_2886: ecu-extract-reference=CalRegn01CmnDMotCurrRegCfgMotRVirtDaxDMotCurrRegCfgDMotCurrRegCfgMotRVirtDax
      AssemblySwConnector_2887: ecu-extract-reference=CalRegn01CmnDMotCurrRegCfgMotRVirtQaxDMotCurrRegCfgDMotCurrRegCfgMotRVirtQax
      AssemblySwConnector_2888: ecu-extract-reference=CalRegn01CmnDMotCurrRegCfgMotVelFilFrqDMotCurrRegCfgDMotCurrRegCfgMotVelFilFrq
      AssemblySwConnector_2889: ecu-extract-reference=CalRegn01CmnDMotRefMdlFbCtrlDiDMotCurrRegCfgDMotRefMdlFbCtrlDi
      AssemblySwConnector_2890: ecu-extract-reference=CalRegn01CmnDMotQuadDetnMotDirHysInstsDMotQuadDetnDMotQuadDetnMotDirHysInsts
      AssemblySwConnector_2891: ecu-extract-reference=CalRegn01CmnDMotRefMdlCurrDaxBoostGainDMotRefMdlDMotRefMdlCurrDaxBoostGain
      AssemblySwConnector_2892: ecu-extract-reference=CalRegn01CmnDMotRefMdlCurrDaxBoostTqScaXDMotRefMdlDMotRefMdlCurrDaxBoostTqScaX
      AssemblySwConnector_2893: ecu-extract-reference=CalRegn01CmnDMotRefMdlCurrDaxBoostTqScaYDMotRefMdlDMotRefMdlCurrDaxBoostTqScaY
      AssemblySwConnector_2894: ecu-extract-reference=CalRegn01CmnDMotRefMdlCurrDaxQaxRefDeltaDMotRefMdlDMotRefMdlCurrDaxQaxRefDelta
      AssemblySwConnector_2895: ecu-extract-reference=CalRegn01CmnDMotRefMdlCurrItrnTolrDMotRefMdlDMotRefMdlCurrItrnTolr
      AssemblySwConnector_2896: ecu-extract-reference=CalRegn01CmnDMotRefMdlFbCtrlDiDMotRefMdlDMotRefMdlFbCtrlDi
      AssemblySwConnector_2897: ecu-extract-reference=CalRegn01CmnDMotRefMdlIvtrDeadTiBrdgVltgScaDMotRefMdlDMotRefMdlIvtrDeadTiBrdgVltgSca
      AssemblySwConnector_2898: ecu-extract-reference=CalRegn01CmnDMotRefMdlMinCurrItrnLimDMotRefMdlDMotRefMdlMinCurrItrnLim
      AssemblySwConnector_2899: ecu-extract-reference=CalRegn01CmnDMotRefMdlMotCurrDaxMaxScaDMotRefMdlDMotRefMdlMotCurrDaxMaxSca
      AssemblySwConnector_2900: ecu-extract-reference=CalRegn01CmnDMotRefMdlMotVelLpFilFrqDMotRefMdlDMotRefMdlMotVelLpFilFrq
      AssemblySwConnector_2901: ecu-extract-reference=CalRegn01CmnDMotRefMdlMotVltgDerivtvTiConDMotRefMdlDMotRefMdlMotVltgDerivtvTiCon
      AssemblySwConnector_2902: ecu-extract-reference=CalRegn01CmnDMotRefMdlQuad13VltgSdlXDMotRefMdlDMotRefMdlQuad13VltgSdlX
      AssemblySwConnector_2903: ecu-extract-reference=CalRegn01CmnDMotRefMdlQuad13VltgSdlYDMotRefMdlDMotRefMdlQuad13VltgSdlY
      AssemblySwConnector_2904: ecu-extract-reference=CalRegn01CmnDMotRefMdlQuad24VltgSdlXDMotRefMdlDMotRefMdlQuad24VltgSdlX
      AssemblySwConnector_2905: ecu-extract-reference=CalRegn01CmnDMotRefMdlQuad24VltgSdlYDMotRefMdlDMotRefMdlQuad24VltgSdlY
      AssemblySwConnector_2906: ecu-extract-reference=CalRegn01CmnDMotRefMdlRefLocnItrnLimDMotRefMdlDMotRefMdlRefLocnItrnLim
      AssemblySwConnector_2907: ecu-extract-reference=CalRegn01CmnDMotRefMdlTqItrnLimDMotRefMdlDMotRefMdlTqItrnLim
      AssemblySwConnector_2908: ecu-extract-reference=CalRegn01CmnDMotRefMdlTqItrnTolrDMotRefMdlDMotRefMdlTqItrnTolr
      AssemblySwConnector_2909: ecu-extract-reference=CalRegn01CmnDMotRefMdlVltgModDynCmpEnaDMotRefMdlDMotRefMdlVltgModDynCmpEna
      AssemblySwConnector_2910: ecu-extract-reference=CalRegn01CmnDMotRefMdlVltgOverRThdScaDMotRefMdlDMotRefMdlVltgOverRThdSca
      AssemblySwConnector_2911: ecu-extract-reference=CalRegn01CmnDMotCtrlPrmEstimnMotBackEmfConNomDMotRplCoggCfgDMotCtrlPrmEstimnMotBackEmfConNom
      AssemblySwConnector_2912: ecu-extract-reference=CalRegn01CmnDMotTqTranlDampgVehSpdBlndYDMotTqTranlDampgDMotTqTranlDampgVehSpdBlndY
      AssemblySwConnector_2913: ecu-extract-reference=CalRegn01CmnDNxtrCalIdsCal0DevlpAuthorDNxtrCalIdsDNxtrCalIdsCal0DevlpAuthor
      AssemblySwConnector_2914: ecu-extract-reference=CalRegn01CmnDNxtrCalIdsCal0DevlpRelNrDNxtrCalIdsDNxtrCalIdsCal0DevlpRelNr
      AssemblySwConnector_2915: ecu-extract-reference=CalRegn01CmnDNxtrCalIdsCal0DevlpRelStDNxtrCalIdsDNxtrCalIdsCal0DevlpRelSt
      AssemblySwConnector_2916: ecu-extract-reference=CalRegn01CmnDNxtrCalIdsCal0DevlpTiStampDNxtrCalIdsDNxtrCalIdsCal0DevlpTiStamp
      AssemblySwConnector_2917: ecu-extract-reference=CalRegn01CmnDNxtrCalIdsCal0DevlpVersDNxtrCalIdsDNxtrCalIdsCal0DevlpVers
      AssemblySwConnector_2918: ecu-extract-reference=CalRegn01CmnDNxtrCalIdsCal2DevlpAuthorDNxtrCalIdsDNxtrCalIdsCal2DevlpAuthor
      AssemblySwConnector_2919: ecu-extract-reference=CalRegn01CmnDNxtrCalIdsCal2DevlpRelNrDNxtrCalIdsDNxtrCalIdsCal2DevlpRelNr
      AssemblySwConnector_2920: ecu-extract-reference=CalRegn01CmnDNxtrCalIdsCal2DevlpRelStDNxtrCalIdsDNxtrCalIdsCal2DevlpRelSt
      AssemblySwConnector_2921: ecu-extract-reference=CalRegn01CmnDNxtrCalIdsCal2DevlpTiStampDNxtrCalIdsDNxtrCalIdsCal2DevlpTiStamp
      AssemblySwConnector_2922: ecu-extract-reference=CalRegn01CmnDNxtrCalIdsCal2DevlpVersDNxtrCalIdsDNxtrCalIdsCal2DevlpVers
      AssemblySwConnector_2923: ecu-extract-reference=CalRegn01CmnDBattVltgSwdMaxDPwrDiscnctDBattVltgSwdMax
      AssemblySwConnector_2924: ecu-extract-reference=CalRegn01CmnDPwrLimrAssiRednLpFilFrqDPwrLimrDPwrLimrAssiRednLpFilFrq
      AssemblySwConnector_2925: ecu-extract-reference=CalRegn01CmnDPwrLimrBackEmfConStdTDPwrLimrDPwrLimrBackEmfConStdT
      AssemblySwConnector_2926: ecu-extract-reference=CalRegn01CmnDPwrLimrBrdgVltgAdjSlewDPwrLimrDPwrLimrBrdgVltgAdjSlew
      AssemblySwConnector_2927: ecu-extract-reference=CalRegn01CmnDPwrLimrBrdgVltgAltFltAdjDPwrLimrDPwrLimrBrdgVltgAltFltAdj
      AssemblySwConnector_2928: ecu-extract-reference=CalRegn01CmnDPwrLimrFilAssiRednThdDPwrLimrDPwrLimrFilAssiRednThd
      AssemblySwConnector_2929: ecu-extract-reference=CalRegn01CmnDPwrLimrLoVoltAssiRcvrThdDPwrLimrDPwrLimrLoVoltAssiRcvrThd
      AssemblySwConnector_2930: ecu-extract-reference=CalRegn01CmnDPwrLimrLoVoltAssiRcvrTiDPwrLimrDPwrLimrLoVoltAssiRcvrTi
      AssemblySwConnector_2931: ecu-extract-reference=CalRegn01CmnDPwrLimrMotEnvlpXDPwrLimrDPwrLimrMotEnvlpX
      AssemblySwConnector_2932: ecu-extract-reference=CalRegn01CmnDPwrLimrMotEnvlpYDPwrLimrDPwrLimrMotEnvlpY
      AssemblySwConnector_2933: ecu-extract-reference=CalRegn01CmnDPwrLimrMotVelLpFilFrqDPwrLimrDPwrLimrMotVelLpFilFrq
      AssemblySwConnector_2934: ecu-extract-reference=CalRegn01CmnDPwrLimrSpdAdjSlewDecDPwrLimrDPwrLimrSpdAdjSlewDec
      AssemblySwConnector_2935: ecu-extract-reference=CalRegn01CmnDPwrLimrSpdAdjSlewEnaDPwrLimrDPwrLimrSpdAdjSlewEna
      AssemblySwConnector_2936: ecu-extract-reference=CalRegn01CmnDPwrLimrSpdAdjSlewIncDPwrLimrDPwrLimrSpdAdjSlewInc
      AssemblySwConnector_2937: ecu-extract-reference=CalRegn01CmnDPwrLimrStdOperMotEnvlpXDPwrLimrDPwrLimrStdOperMotEnvlpX
      AssemblySwConnector_2938: ecu-extract-reference=CalRegn01CmnDPwrLimrStdOperMotEnvlpYDPwrLimrDPwrLimrStdOperMotEnvlpY
      AssemblySwConnector_2939: ecu-extract-reference=CalRegn01CmnDPwrLimrVltgDptMotVelOffsXDPwrLimrDPwrLimrVltgDptMotVelOffsX
      AssemblySwConnector_2940: ecu-extract-reference=CalRegn01CmnDPwrLimrVltgDptMotVelOffsYDPwrLimrDPwrLimrVltgDptMotVelOffsY
      AssemblySwConnector_2941: ecu-extract-reference=CalRegn01CmnDPwrSplyNtc0x07BFailStepDPwrSplyDPwrSplyNtc0x07BFailStep
      AssemblySwConnector_2942: ecu-extract-reference=CalRegn01CmnDPwrSplyNtc0x07BPassStepDPwrSplyDPwrSplyNtc0x07BPassStep
      AssemblySwConnector_2943: ecu-extract-reference=CalRegn01CmnDPwrSplyNtc0x07CFailStepDPwrSplyDPwrSplyNtc0x07CFailStep
      AssemblySwConnector_2944: ecu-extract-reference=CalRegn01CmnDPwrSplyNtc0x07CPassStepDPwrSplyDPwrSplyNtc0x07CPassStep
      AssemblySwConnector_2945: ecu-extract-reference=CalRegn01CmnDPwrSplyNtc0x07DFailStepDPwrSplyDPwrSplyNtc0x07DFailStep
      AssemblySwConnector_2946: ecu-extract-reference=CalRegn01CmnDPwrSplyNtc0x07DPassStepDPwrSplyDPwrSplyNtc0x07DPassStep
      AssemblySwConnector_2947: ecu-extract-reference=CalRegn01CmnDSysPrfmncStsAbsltCtrlTFltThdDSysPrfmncStsDSysPrfmncStsAbsltCtrlTFltThd
      AssemblySwConnector_2948: ecu-extract-reference=CalRegn01CmnDSysPrfmncStsAssiStallLimDecThdDSysPrfmncStsDSysPrfmncStsAssiStallLimDecThd
      AssemblySwConnector_2949: ecu-extract-reference=CalRegn01CmnDSysPrfmncStsBattDiagcHiCritDSysPrfmncStsDSysPrfmncStsBattDiagcHiCrit
      AssemblySwConnector_2950: ecu-extract-reference=CalRegn01CmnDSysPrfmncStsBattDiagcHiWarnDSysPrfmncStsDSysPrfmncStsBattDiagcHiWarn
      AssemblySwConnector_2951: ecu-extract-reference=CalRegn01CmnDSysPrfmncStsBattDiagcLoCritDSysPrfmncStsDSysPrfmncStsBattDiagcLoCrit
      AssemblySwConnector_2952: ecu-extract-reference=CalRegn01CmnDSysPrfmncStsBattDiagcLoWarnDSysPrfmncStsDSysPrfmncStsBattDiagcLoWarn
      AssemblySwConnector_2953: ecu-extract-reference=CalRegn01CmnDSysPrfmncStsBattVltgFilFrqDSysPrfmncStsDSysPrfmncStsBattVltgFilFrq
      AssemblySwConnector_2954: ecu-extract-reference=CalRegn01CmnDSysPrfmncStsDutyCycLvlFltThdDSysPrfmncStsDSysPrfmncStsDutyCycLvlFltThd
      AssemblySwConnector_2955: ecu-extract-reference=CalRegn01CmnDSysPrfmncStsLoadDptLimDecThdDSysPrfmncStsDSysPrfmncStsLoadDptLimDecThd
      AssemblySwConnector_2956: ecu-extract-reference=CalRegn01CmnDSysPrfmncStsTDptLimThdDSysPrfmncStsDSysPrfmncStsTDptLimThd
      AssemblySwConnector_2957: ecu-extract-reference=CalRegn01CmnDTEstimnIgnOffCtrlEnaDTEstimnDTEstimnIgnOffCtrlEna
      AssemblySwConnector_2958: ecu-extract-reference=CalRegn01CmnDTEstimnIgnOffMsgWaitTiDTEstimnDTEstimnIgnOffMsgWaitTi
      AssemblySwConnector_2959: ecu-extract-reference=CalRegn01CmnDTqLoaDrvrTqNomDTqLoaDTqLoaDrvrTqNom
      AssemblySwConnector_2960: ecu-extract-reference=CalRegn01CmnDTqLoaMotTqCmdLimDTqLoaDTqLoaMotTqCmdLim
      AssemblySwConnector_2961: ecu-extract-reference=CalRegn01CmnDTqLoaMotVelAndTqBasdScaFacFallRateDTqLoaDTqLoaMotVelAndTqBasdScaFacFallRate
      AssemblySwConnector_2962: ecu-extract-reference=CalRegn01CmnDTqLoaMotVelAndTqBasdScaFacMaxDTqLoaDTqLoaMotVelAndTqBasdScaFacMax
      AssemblySwConnector_2963: ecu-extract-reference=CalRegn01CmnDTqLoaMotVelAndTqBasdScaFacMinDTqLoaDTqLoaMotVelAndTqBasdScaFacMin
      AssemblySwConnector_2964: ecu-extract-reference=CalRegn01CmnDTqLoaMotVelAndTqBasdScaFacRiseRateDTqLoaDTqLoaMotVelAndTqBasdScaFacRiseRate
      AssemblySwConnector_2965: ecu-extract-reference=CalRegn01CmnDTqLoaMotVelMgnThdDTqLoaDTqLoaMotVelMgnThd
      AssemblySwConnector_2966: ecu-extract-reference=CalRegn01CmnDTqLoaTqCmdLimYDTqLoaDTqLoaTqCmdLimY
      AssemblySwConnector_2967: ecu-extract-reference=CalRegn01CmnDTqLoaTqCmdMgnThdDTqLoaDTqLoaTqCmdMgnThd
      AssemblySwConnector_2968: ecu-extract-reference=CalRegn01CmnDTqLoaVehLatADifScaFacFallRateDTqLoaDTqLoaVehLatADifScaFacFallRate
      AssemblySwConnector_2969: ecu-extract-reference=CalRegn01CmnDTqLoaVehLatADifScaFacRiseRateDTqLoaDTqLoaVehLatADifScaFacRiseRate
      AssemblySwConnector_2970: ecu-extract-reference=CalRegn01CmnDTqLoaVehLatADifScaFacXDTqLoaDTqLoaVehLatADifScaFacX
      AssemblySwConnector_2971: ecu-extract-reference=CalRegn01CmnDTqLoaVehLatADifScaFacYDTqLoaDTqLoaVehLatADifScaFacY
      AssemblySwConnector_2972: ecu-extract-reference=CalRegn01CmnDTqLoaVehLatAEstimnFilFrqDTqLoaDTqLoaVehLatAEstimnFilFrq
      AssemblySwConnector_2973: ecu-extract-reference=CalRegn01CmnDTqLoaVehLatAGainYDTqLoaDTqLoaVehLatAGainY
      AssemblySwConnector_2974: ecu-extract-reference=CalRegn01CmnDTqLoaVehSpdScaFacXDTqLoaDTqLoaVehSpdScaFacX
      AssemblySwConnector_2975: ecu-extract-reference=CalRegn01CmnDTqLoaVehSpdScaFacYDTqLoaDTqLoaVehSpdScaFacY
      AssemblySwConnector_2976: ecu-extract-reference=CalRegn01CmnDTqLoaVehSpdXDTqLoaDTqLoaVehSpdX
      AssemblySwConnector_2977: ecu-extract-reference=CalRegn01CmnDTqLoaVehSteerRatDTqLoaDTqLoaVehSteerRat
      AssemblySwConnector_2978: ecu-extract-reference=CalRegn01CmnDTqLoaVehUnderSteerGrdtDTqLoaDTqLoaVehUnderSteerGrdt
      AssemblySwConnector_2979: ecu-extract-reference=CalRegn01CmnDTqLoaVehWhlBasDTqLoaDTqLoaVehWhlBas
      AssemblySwConnector_2980: ecu-extract-reference=CalRegn01CmnDVehSigCdngDftLatADVehSigCdngDVehSigCdngDftLatA
      AssemblySwConnector_2981: ecu-extract-reference=CalRegn01CmnDVehSigCdngDftLgtADVehSigCdngDVehSigCdngDftLgtA
      AssemblySwConnector_2982: ecu-extract-reference=CalRegn01CmnDVehSigCdngDftVehSpdDVehSigCdngDVehSigCdngDftVehSpd
      AssemblySwConnector_2983: ecu-extract-reference=CalRegn01CmnDVehSigCdngDftYawRateDVehSigCdngDVehSigCdngDftYawRate
      AssemblySwConnector_2984: ecu-extract-reference=CalRegn01CmnDVehSigCdngLatADifThdDVehSigCdngDVehSigCdngLatADifThd
      AssemblySwConnector_2985: ecu-extract-reference=CalRegn01CmnDVehSigCdngLatAFilFrqDVehSigCdngDVehSigCdngLatAFilFrq
      AssemblySwConnector_2986: ecu-extract-reference=CalRegn01CmnDVehSigCdngLtgADifThdDVehSigCdngDVehSigCdngLtgADifThd
      AssemblySwConnector_2987: ecu-extract-reference=CalRegn01CmnDVehSigCdngVehSpdDifThdDVehSigCdngDVehSigCdngVehSpdDifThd
      AssemblySwConnector_2988: ecu-extract-reference=CalRegn01CmnDVehSigCdngVehYawSlewRateDVehSigCdngDVehSigCdngVehYawSlewRate
      AssemblySwConnector_2989: ecu-extract-reference=CalRegn01CmnDVehSigCdngYawRateDifThdDVehSigCdngDVehSigCdngYawRateDifThd
      AssemblySwConnector_2990: ecu-extract-reference=CalRegn01CmnDVehSpdLimrMaxAssiXDVehSpdLimrDVehSpdLimrMaxAssiX
      AssemblySwConnector_2991: ecu-extract-reference=CalRegn01CmnDVehSpdLimrMaxAssiYDVehSpdLimrDVehSpdLimrMaxAssiY
      AssemblySwConnector_2992: ecu-extract-reference=CalRegn01CmnDVehSpdLimrPosMaxOffs1DVehSpdLimrDVehSpdLimrPosMaxOffs1
      AssemblySwConnector_2993: ecu-extract-reference=CalRegn01CmnDVehSpdLimrPosMaxOffs2DVehSpdLimrDVehSpdLimrPosMaxOffs2
      AssemblySwConnector_2994: ecu-extract-reference=CalRegn01Inin00DSysGlbPrmVehSpdBilnrSelnDAssiDSysGlbPrmVehSpdBilnrSeln
      AssemblySwConnector_2995: ecu-extract-reference=CalRegn01Inin00DSysGlbPrmVehSpdBilnrSelnDAssiHiFrqDSysGlbPrmVehSpdBilnrSeln
      AssemblySwConnector_2996: ecu-extract-reference=CalRegn01Inin00DAssiSumLimBlndCmdSumFrqLimXDAssiSumLimDAssiSumLimBlndCmdSumFrqLimX
      AssemblySwConnector_2997: ecu-extract-reference=CalRegn01Inin00DAssiSumLimBlndCmdSumFrqLimYDAssiSumLimDAssiSumLimBlndCmdSumFrqLimY
      AssemblySwConnector_2998: ecu-extract-reference=CalRegn01Inin00DAssiSumLimHiSpdCmdSumFrqLimXDAssiSumLimDAssiSumLimHiSpdCmdSumFrqLimX
      AssemblySwConnector_2999: ecu-extract-reference=CalRegn01Inin00DAssiSumLimHiSpdCmdSumFrqLimYDAssiSumLimDAssiSumLimHiSpdCmdSumFrqLimY
      AssemblySwConnector_3000: ecu-extract-reference=CalRegn01Inin00DAssiSumLimLoSpdCmdSumFrqLimXDAssiSumLimDAssiSumLimLoSpdCmdSumFrqLimX
      AssemblySwConnector_3001: ecu-extract-reference=CalRegn01Inin00DAssiSumLimLoSpdCmdSumFrqLimYDAssiSumLimDAssiSumLimLoSpdCmdSumFrqLimY
      AssemblySwConnector_3002: ecu-extract-reference=CalRegn01Inin00DAssiSumLimMotVelLpFilFrqDAssiSumLimDAssiSumLimMotVelLpFilFrq
      AssemblySwConnector_3003: ecu-extract-reference=CalRegn01Inin00DSysGlbPrmMotPoleCntDCDD_CurrMeasDSysGlbPrmMotPoleCnt
      AssemblySwConnector_3004: ecu-extract-reference=CalRegn01Inin00DHwTq1MeasHwTq1PrtclFltFailStepDCDD_HwTq1MeasDHwTq1MeasHwTq1PrtclFltFailStep
      AssemblySwConnector_3005: ecu-extract-reference=CalRegn01Inin00DHwTq1MeasHwTq1PrtclFltPassStepDCDD_HwTq1MeasDHwTq1MeasHwTq1PrtclFltPassStep
      AssemblySwConnector_3006: ecu-extract-reference=CalRegn01Inin00DHwTq8MeasHwTq8PrtclFltFailStepDCDD_HwTq8MeasDHwTq8MeasHwTq8PrtclFltFailStep
      AssemblySwConnector_3007: ecu-extract-reference=CalRegn01Inin00DHwTq8MeasHwTq8PrtclFltPassStepDCDD_HwTq8MeasDHwTq8MeasHwTq8PrtclFltPassStep
      AssemblySwConnector_3008: ecu-extract-reference=CalRegn01Inin00DMcuDiagc2MilliSecCntrCompThdDCDD_McuDiagcDMcuDiagc2MilliSecCntrCompThd
      AssemblySwConnector_3009: ecu-extract-reference=CalRegn01Inin00DMcuDiagcFltFailStepDCDD_McuDiagcDMcuDiagcFltFailStep
      AssemblySwConnector_3010: ecu-extract-reference=CalRegn01Inin00DMcuDiagcFltPassStepDCDD_McuDiagcDMcuDiagcFltPassStep
      AssemblySwConnector_3011: ecu-extract-reference=CalRegn01Inin00DSysGlbPrmMotPoleCntDCDD_MotAgCmpDSysGlbPrmMotPoleCnt
      AssemblySwConnector_3012: ecu-extract-reference=CalRegn01Inin00DCmplncErrHwAgNonLinCmplncDepTblYDCmplncErrDCmplncErrHwAgNonLinCmplncDepTblY
      AssemblySwConnector_3013: ecu-extract-reference=CalRegn01Inin00DCmplncErrHwAgNonLinCmplncIndTblXDCmplncErrDCmplncErrHwAgNonLinCmplncIndTblX
      AssemblySwConnector_3014: ecu-extract-reference=CalRegn01Inin00DCmplncErrMotAgNonLinCmplncDepTblYDCmplncErrDCmplncErrMotAgNonLinCmplncDepTblY
      AssemblySwConnector_3015: ecu-extract-reference=CalRegn01Inin00DCmplncErrMotAgNonLinCmplncIndTblXDCmplncErrDCmplncErrMotAgNonLinCmplncIndTblX
      AssemblySwConnector_3017: ecu-extract-reference=CalRegn01Inin00DSysGlbPrmVehSpdBilnrSelnDDampgDSysGlbPrmVehSpdBilnrSeln
      AssemblySwConnector_3018: ecu-extract-reference=CalRegn01Inin00DSysGlbPrmSysTqRatDDrvrTqEstimnDSysGlbPrmSysTqRat
      AssemblySwConnector_3019: ecu-extract-reference=CalRegn01Inin00DDualCtrlrOutpMgrConOutpScaDDualCtrlrOutpMgrDDualCtrlrOutpMgrConOutpSca
      AssemblySwConnector_3020: ecu-extract-reference=CalRegn01Inin00DDualCtrlrOutpMgrDiRateTblYDDualCtrlrOutpMgrDDualCtrlrOutpMgrDiRateTblY
      AssemblySwConnector_3021: ecu-extract-reference=CalRegn01Inin00DDualCtrlrOutpMgrEnaRateDDualCtrlrOutpMgrDDualCtrlrOutpMgrEnaRate
      AssemblySwConnector_3022: ecu-extract-reference=CalRegn01Inin00DDualCtrlrOutpMgrFltThdTmrDDualCtrlrOutpMgrDDualCtrlrOutpMgrFltThdTmr
      AssemblySwConnector_3023: ecu-extract-reference=CalRegn01Inin00DDualCtrlrOutpMgrLimdOutpScaDDualCtrlrOutpMgrDDualCtrlrOutpMgrLimdOutpSca
      AssemblySwConnector_3024: ecu-extract-reference=CalRegn01Inin00DDualCtrlrOutpMgrMaxOutpScaDDualCtrlrOutpMgrDDualCtrlrOutpMgrMaxOutpSca
      AssemblySwConnector_3025: ecu-extract-reference=CalRegn01Inin00DDualCtrlrOutpMgrMaxOutpTmrDDualCtrlrOutpMgrDDualCtrlrOutpMgrMaxOutpTmr
      AssemblySwConnector_3026: ecu-extract-reference=CalRegn01Inin00DDualCtrlrOutpMgrMinOutpTmrDDualCtrlrOutpMgrDDualCtrlrOutpMgrMinOutpTmr
      AssemblySwConnector_3027: ecu-extract-reference=CalRegn01Inin00DDualCtrlrOutpMgrNonRecFltThdTmrDDualCtrlrOutpMgrDDualCtrlrOutpMgrNonRecFltThdTmr
      AssemblySwConnector_3028: ecu-extract-reference=CalRegn01Inin00DDualCtrlrOutpMgrThdTmrDDualCtrlrOutpMgrDDualCtrlrOutpMgrThdTmr
      AssemblySwConnector_3029: ecu-extract-reference=CalRegn01Inin00DDualCtrlrOutpMgrVehSpdRefTblXDDualCtrlrOutpMgrDDualCtrlrOutpMgrVehSpdRefTblX
      AssemblySwConnector_3030: ecu-extract-reference=CalRegn01Inin00DDualCtrlrOutpMgrVltgModFltThdTmrDDualCtrlrOutpMgrDDualCtrlrOutpMgrVltgModFltThdTmr
      AssemblySwConnector_3031: ecu-extract-reference=CalRegn01Inin00DHwAg1MeasHwAg1IfFltFailStepDHwAg1MeasDHwAg1MeasHwAg1IfFltFailStep
      AssemblySwConnector_3032: ecu-extract-reference=CalRegn01Inin00DHwAg1MeasHwAg1IfFltPassStepDHwAg1MeasDHwAg1MeasHwAg1IfFltPassStep
      AssemblySwConnector_3033: ecu-extract-reference=CalRegn01Inin00DHwAg1MeasHwAg1Snsr0PrtclFltFailStepDHwAg1MeasDHwAg1MeasHwAg1Snsr0PrtclFltFailStep
      AssemblySwConnector_3034: ecu-extract-reference=CalRegn01Inin00DHwAg1MeasHwAg1Snsr0PrtclFltPassStepDHwAg1MeasDHwAg1MeasHwAg1Snsr0PrtclFltPassStep
      AssemblySwConnector_3035: ecu-extract-reference=CalRegn01Inin00DHwAg1MeasHwAg1Snsr1PrtclFltFailStepDHwAg1MeasDHwAg1MeasHwAg1Snsr1PrtclFltFailStep
      AssemblySwConnector_3036: ecu-extract-reference=CalRegn01Inin00DHwAg1MeasHwAg1Snsr1PrtclFltPassStepDHwAg1MeasDHwAg1MeasHwAg1Snsr1PrtclFltPassStep
      AssemblySwConnector_3037: ecu-extract-reference=CalRegn01Inin00DHwAg1MeasSnsr0RevDHwAg1MeasDHwAg1MeasSnsr0Rev
      AssemblySwConnector_3038: ecu-extract-reference=CalRegn01Inin00DHwAg1MeasSnsr1RevDHwAg1MeasDHwAg1MeasSnsr1Rev
      AssemblySwConnector_3039: ecu-extract-reference=CalRegn01Inin00DHwAg1MeasStepDHwAg1MeasDHwAg1MeasStep
      AssemblySwConnector_3040: ecu-extract-reference=CalRegn01Inin00DHwAg1MeasVrnrErrThdDHwAg1MeasDHwAg1MeasVrnrErrThd
      AssemblySwConnector_3041: ecu-extract-reference=CalRegn01Inin00DHwAgSnsrlsFeatEnaDHwAgSnsrlsDHwAgSnsrlsFeatEna
      AssemblySwConnector_3042: ecu-extract-reference=CalRegn01Inin00DHwAgSnsrlsVehDynVehSpdThdDHwAgSnsrlsDHwAgSnsrlsVehDynVehSpdThd
      AssemblySwConnector_3043: ecu-extract-reference=CalRegn01Inin00DHwAgSnsrlsVehDynYawRateThdDHwAgSnsrlsDHwAgSnsrlsVehDynYawRateThd
      AssemblySwConnector_3044: ecu-extract-reference=CalRegn01Inin00DHwAgSnsrlsYawRateFilFrqDHwAgSnsrlsDHwAgSnsrlsYawRateFilFrq
      AssemblySwConnector_3045: ecu-extract-reference=CalRegn01Inin00DSysGlbPrmSysTqRatDHwAgSnsrlsDSysGlbPrmSysTqRat
      AssemblySwConnector_3046: ecu-extract-reference=CalRegn01Inin00DHwAgSysArbn2PinionPosSnsrAvlDHwAgSysArbnDHwAgSysArbn2PinionPosSnsrAvl
      AssemblySwConnector_3047: ecu-extract-reference=CalRegn01Inin00DHwAgSysArbnTqSnsrVelFilFrqDHwAgSysArbnDHwAgSysArbnTqSnsrVelFilFrq
      AssemblySwConnector_3048: ecu-extract-reference=CalRegn01Inin00DSysGlbPrmTorsBarStfnDHwAgSysArbnDSysGlbPrmTorsBarStfn
      AssemblySwConnector_3049: ecu-extract-reference=CalRegn01Inin00DSysGlbPrmSysTqRatDHysCmpDSysGlbPrmSysTqRat
      AssemblySwConnector_3050: ecu-extract-reference=CalRegn01Inin00DSysGlbPrmVehSpdBilnrSelnDHysCmpDSysGlbPrmVehSpdBilnrSeln
      AssemblySwConnector_3051: ecu-extract-reference=CalRegn01Inin00DImcSigArbnArbnFltTmrDImcSigArbnDImcSigArbnArbnFltTmr
