[part 3 of 3: package /COM/VECTOR/CFG/WORKFLOW/SYSDESC/SYNC]
AUTOSAR XML (schema 4-2-1)
package /COM/VECTOR/CFG/WORKFLOW/SYSDESC/SYNC  (continued)
  flat map FLATMAP  (continued)
    3692 x flat instance descriptor:  (continued)
      AssemblySwConnector_3052: ecu-extract-reference=CalRegn01Inin00DImcSigArbnHwAgArbnEnaDImcSigArbnDImcSigArbnHwAgArbnEna
      AssemblySwConnector_3053: ecu-extract-reference=CalRegn01Inin00DImcSigArbnHwAgArbnLpFilDImcSigArbnDImcSigArbnHwAgArbnLpFil
      AssemblySwConnector_3054: ecu-extract-reference=CalRegn01Inin00DImcSigArbnHwAgArbnOffsLimDImcSigArbnDImcSigArbnHwAgArbnOffsLim
      AssemblySwConnector_3055: ecu-extract-reference=CalRegn01Inin00DImcSigArbnHwAgTarArbnEnaDImcSigArbnDImcSigArbnHwAgTarArbnEna
      AssemblySwConnector_3056: ecu-extract-reference=CalRegn01Inin00DImcSigArbnHwAgTarArbnLpFilDImcSigArbnDImcSigArbnHwAgTarArbnLpFil
      AssemblySwConnector_3057: ecu-extract-reference=CalRegn01Inin00DImcSigArbnHwAgTarArbnOffsLimDImcSigArbnDImcSigArbnHwAgTarArbnOffsLim
      AssemblySwConnector_3058: ecu-extract-reference=CalRegn01Inin00DImcSigArbnHwTqArbnEnaDImcSigArbnDImcSigArbnHwTqArbnEna
      AssemblySwConnector_3059: ecu-extract-reference=CalRegn01Inin00DImcSigArbnHwTqArbnLpFilDImcSigArbnDImcSigArbnHwTqArbnLpFil
      AssemblySwConnector_3060: ecu-extract-reference=CalRegn01Inin00DImcSigArbnHwTqArbnOffsLimDImcSigArbnDImcSigArbnHwTqArbnOffsLim
      AssemblySwConnector_3061: ecu-extract-reference=CalRegn01Inin00DImcSigArbnMotVelArbnEnaDImcSigArbnDImcSigArbnMotVelArbnEna
      AssemblySwConnector_3062: ecu-extract-reference=CalRegn01Inin00DImcSigArbnMotVelArbnLpFilDImcSigArbnDImcSigArbnMotVelArbnLpFil
      AssemblySwConnector_3063: ecu-extract-reference=CalRegn01Inin00DImcSigArbnMotVelArbnOffsLimDImcSigArbnDImcSigArbnMotVelArbnOffsLim
      AssemblySwConnector_3064: ecu-extract-reference=CalRegn01Inin00DImcSigArbnPosnServoArbnOffsLimDImcSigArbnDImcSigArbnPosnServoArbnOffsLim
      AssemblySwConnector_3065: ecu-extract-reference=CalRegn01Inin00DImcSigArbnPosnServoIntgtrStArbnEnaDImcSigArbnDImcSigArbnPosnServoIntgtrStArbnEna
      AssemblySwConnector_3066: ecu-extract-reference=CalRegn01Inin00DImcSigArbnPosnServoIntgtrStArbnLpFilDImcSigArbnDImcSigArbnPosnServoIntgtrStArbnLpFil
      AssemblySwConnector_3067: ecu-extract-reference=CalRegn01Inin00DImcSigArbnPosnTrakg1ArbnOffsLimDImcSigArbnDImcSigArbnPosnTrakg1ArbnOffsLim
      AssemblySwConnector_3068: ecu-extract-reference=CalRegn01Inin00DImcSigArbnPosnTrakg2ArbnOffsLimDImcSigArbnDImcSigArbnPosnTrakg2ArbnOffsLim
      AssemblySwConnector_3069: ecu-extract-reference=CalRegn01Inin00DImcSigArbnPullCmpLongTermIntgtrStArbnEnaDImcSigArbnDImcSigArbnPullCmpLongTermIntgtrStArbnEna
      AssemblySwConnector_3070: ecu-extract-reference=CalRegn01Inin00DImcSigArbnPullCmpLongTermIntgtrStArbnLpFilDImcSigArbnDImcSigArbnPullCmpLongTermIntgtrStArbnLpFil
      AssemblySwConnector_3071: ecu-extract-reference=CalRegn01Inin00DImcSigArbnPullCmpShoTermIntgtrStArbnEnaDImcSigArbnDImcSigArbnPullCmpShoTermIntgtrStArbnEna
      AssemblySwConnector_3072: ecu-extract-reference=CalRegn01Inin00DImcSigArbnPullCmpShoTermIntgtrStArbnLpFilDImcSigArbnDImcSigArbnPullCmpShoTermIntgtrStArbnLpFil
      AssemblySwConnector_3073: ecu-extract-reference=CalRegn01Inin00DImcSigArbnSysStTmrDImcSigArbnDImcSigArbnSysStTmr
      AssemblySwConnector_3074: ecu-extract-reference=CalRegn01Inin00DImcSigArbnTrakgIntgtrSt1ArbnEnaDImcSigArbnDImcSigArbnTrakgIntgtrSt1ArbnEna
      AssemblySwConnector_3075: ecu-extract-reference=CalRegn01Inin00DImcSigArbnTrakgIntgtrSt1ArbnLpFilDImcSigArbnDImcSigArbnTrakgIntgtrSt1ArbnLpFil
      AssemblySwConnector_3076: ecu-extract-reference=CalRegn01Inin00DImcSigArbnTrakgIntgtrSt2ArbnEnaDImcSigArbnDImcSigArbnTrakgIntgtrSt2ArbnEna
      AssemblySwConnector_3077: ecu-extract-reference=CalRegn01Inin00DImcSigArbnTrakgIntgtrSt2ArbnLpFilDImcSigArbnDImcSigArbnTrakgIntgtrSt2ArbnLpFil
      AssemblySwConnector_3078: ecu-extract-reference=CalRegn01Inin00DImcSigArbnVehSpdArbnEnaDImcSigArbnDImcSigArbnVehSpdArbnEna
      AssemblySwConnector_3079: ecu-extract-reference=CalRegn01Inin00DImcSigArbnVehSpdArbnLpFilDImcSigArbnDImcSigArbnVehSpdArbnLpFil
      AssemblySwConnector_3080: ecu-extract-reference=CalRegn01Inin00DImcSigArbnVehSpdArbnOffsLimDImcSigArbnDImcSigArbnVehSpdArbnOffsLim
      AssemblySwConnector_3081: ecu-extract-reference=CalRegn01Inin00DSysGlbPrmTorsBarStfnDInertiaCmpVelDSysGlbPrmTorsBarStfn
      AssemblySwConnector_3082: ecu-extract-reference=CalRegn01Inin00DSysGlbPrmVehSpdBilnrSelnDInertiaCmpVelDSysGlbPrmVehSpdBilnrSeln
      AssemblySwConnector_3083: ecu-extract-reference=CalRegn01Inin00DLimrCdngGainDecSlewDLimrCdngDLimrCdngGainDecSlew
      AssemblySwConnector_3084: ecu-extract-reference=CalRegn01Inin00DLimrCdngGainIncSlewXDLimrCdngDLimrCdngGainIncSlewX
      AssemblySwConnector_3085: ecu-extract-reference=CalRegn01Inin00DLimrCdngGainIncSlewYDLimrCdngDLimrCdngGainIncSlewY
      AssemblySwConnector_3086: ecu-extract-reference=CalRegn01Inin00DLimrCdngTqDecSlewDLimrCdngDLimrCdngTqDecSlew
      AssemblySwConnector_3087: ecu-extract-reference=CalRegn01Inin00DLimrCdngTqIncSlewXDLimrCdngDLimrCdngTqIncSlewX
      AssemblySwConnector_3088: ecu-extract-reference=CalRegn01Inin00DLimrCdngTqIncSlewYDLimrCdngDLimrCdngTqIncSlewY
      AssemblySwConnector_3089: ecu-extract-reference=CalRegn01Inin00DSysGlbPrmMotPoleCntDMotAgCorrlnDSysGlbPrmMotPoleCnt
      AssemblySwConnector_3090: ecu-extract-reference=CalRegn01Inin00DSysGlbPrmMotPoleCntDMotCurrRegCfgDSysGlbPrmMotPoleCnt
      AssemblySwConnector_3091: ecu-extract-reference=CalRegn01Inin00DSysGlbPrmMotPoleCntDMotRefMdlDSysGlbPrmMotPoleCnt
      AssemblySwConnector_3092: ecu-extract-reference=CalRegn01Inin00DSysGlbPrmMotPoleCntDMotRplCoggCfgDSysGlbPrmMotPoleCnt
      AssemblySwConnector_3093: ecu-extract-reference=CalRegn01Inin00DMotTqCmdScaMaxDMotTqCmdScaDMotTqCmdScaMax
      AssemblySwConnector_3094: ecu-extract-reference=CalRegn01Inin00DMotTqCmdScaMinDMotTqCmdScaDMotTqCmdScaMin
      AssemblySwConnector_3095: ecu-extract-reference=CalRegn01Inin00DMotTqTranlDampgCmdLimDMotTqTranlDampgDMotTqTranlDampgCmdLim
      AssemblySwConnector_3096: ecu-extract-reference=CalRegn01Inin00DMotTqTranlDampgDampgCoeffDMotTqTranlDampgDMotTqTranlDampgDampgCoeff
      AssemblySwConnector_3097: ecu-extract-reference=CalRegn01Inin00DMotTqTranlDampgRampEndDMotTqTranlDampgDMotTqTranlDampgRampEnd
      AssemblySwConnector_3098: ecu-extract-reference=CalRegn01Inin00DMotTqTranlDampgTmrPt1DMotTqTranlDampgDMotTqTranlDampgTmrPt1
      AssemblySwConnector_3099: ecu-extract-reference=CalRegn01Inin00DMotTqTranlDampgTmrPt2DMotTqTranlDampgDMotTqTranlDampgTmrPt2
      AssemblySwConnector_3100: ecu-extract-reference=CalRegn01Inin00DMotTqTranlDampgVehSpdBlndXDMotTqTranlDampgDMotTqTranlDampgVehSpdBlndX
      AssemblySwConnector_3101: ecu-extract-reference=CalRegn01Inin00DMotTqTranlDampgVelThdDMotTqTranlDampgDMotTqTranlDampgVelThd
      AssemblySwConnector_3102: ecu-extract-reference=CalRegn01Inin00DSysGlbPrmSysTqRatDPosnTrakgServoDSysGlbPrmSysTqRat
      AssemblySwConnector_3103: ecu-extract-reference=CalRegn01Inin00DPwrDiscnctBattVltgExtdNormThdDPwrDiscnctDPwrDiscnctBattVltgExtdNormThd
      AssemblySwConnector_3104: ecu-extract-reference=CalRegn01Inin00DPwrDiscnctBattVltgNonExtdThdDPwrDiscnctDPwrDiscnctBattVltgNonExtdThd
      AssemblySwConnector_3105: ecu-extract-reference=CalRegn01Inin00DPwrDiscnctChrgMinDeltaExtOperDPwrDiscnctDPwrDiscnctChrgMinDeltaExtOper
      AssemblySwConnector_3106: ecu-extract-reference=CalRegn01Inin00DPwrDiscnctChrgMinDeltaNonOperDPwrDiscnctDPwrDiscnctChrgMinDeltaNonOper
      AssemblySwConnector_3107: ecu-extract-reference=CalRegn01Inin00DPwrDiscnctChrgMinDeltaNormOperDPwrDiscnctDPwrDiscnctChrgMinDeltaNormOper
      AssemblySwConnector_3108: ecu-extract-reference=CalRegn01Inin00DPwrDiscnctChrgPmpDiagOpenThdDPwrDiscnctDPwrDiscnctChrgPmpDiagOpenThd
      AssemblySwConnector_3109: ecu-extract-reference=CalRegn01Inin00DPwrDiscnctDeltaSwtClsThdDPwrDiscnctDPwrDiscnctDeltaSwtClsThd
      AssemblySwConnector_3110: ecu-extract-reference=CalRegn01Inin00DPwrDiscnctDeltaVltgClsThdDPwrDiscnctDPwrDiscnctDeltaVltgClsThd
      AssemblySwConnector_3111: ecu-extract-reference=CalRegn01Inin00DPwrDiscnctDeltaVltgOpenThdDPwrDiscnctDPwrDiscnctDeltaVltgOpenThd
      AssemblySwConnector_3112: ecu-extract-reference=CalRegn01Inin00DPwrDiscnctFltFailStepDPwrDiscnctDPwrDiscnctFltFailStep
      AssemblySwConnector_3113: ecu-extract-reference=CalRegn01Inin00DPwrDiscnctFltPassStepDPwrDiscnctDPwrDiscnctFltPassStep
      AssemblySwConnector_3114: ecu-extract-reference=CalRegn01Inin00DPwrDiscnctFltThdDPwrDiscnctDPwrDiscnctFltThd
      AssemblySwConnector_3115: ecu-extract-reference=CalRegn01Inin00DPwrDiscnctMtrMtnThdDPwrDiscnctDPwrDiscnctMtrMtnThd
      AssemblySwConnector_3116: ecu-extract-reference=CalRegn01Inin00DPwrDiscnctPwrDiscnctRtFltFailStepDPwrDiscnctDPwrDiscnctPwrDiscnctRtFltFailStep
      AssemblySwConnector_3117: ecu-extract-reference=CalRegn01Inin00DPwrDiscnctPwrDiscnctRtFltPassStepDPwrDiscnctDPwrDiscnctPwrDiscnctRtFltPassStep
      AssemblySwConnector_3118: ecu-extract-reference=CalRegn01Inin00DPwrDiscnctSwtDiagOpenThdDPwrDiscnctDPwrDiscnctSwtDiagOpenThd
      AssemblySwConnector_3119: ecu-extract-reference=CalRegn01Inin00DSysFricLrngAvrgFricFrqDSysFricLrngDSysFricLrngAvrgFricFrq
      AssemblySwConnector_3120: ecu-extract-reference=CalRegn01Inin00DSysFricLrngBasLineEolFricDSysFricLrngDSysFricLrngBasLineEolFric
      AssemblySwConnector_3121: ecu-extract-reference=CalRegn01Inin00DSysFricLrngBasLineFricDSysFricLrngDSysFricLrngBasLineFric
      AssemblySwConnector_3122: ecu-extract-reference=CalRegn01Inin00DSysFricLrngBasLineHysDSysFricLrngDSysFricLrngBasLineHys
      AssemblySwConnector_3123: ecu-extract-reference=CalRegn01Inin00DSysFricLrngBasLineRngCntrDSysFricLrngDSysFricLrngBasLineRngCntr
      AssemblySwConnector_3124: ecu-extract-reference=CalRegn01Inin00DSysFricLrngDataPrepLpFilFrqDSysFricLrngDSysFricLrngDataPrepLpFilFrq
      AssemblySwConnector_3125: ecu-extract-reference=CalRegn01Inin00DSysFricLrngDebStepDSysFricLrngDSysFricLrngDebStep
      AssemblySwConnector_3126: ecu-extract-reference=CalRegn01Inin00DSysFricLrngEolFricDifHiLimDSysFricLrngDSysFricLrngEolFricDifHiLim
      AssemblySwConnector_3127: ecu-extract-reference=CalRegn01Inin00DSysFricLrngEolFricDifLoLimDSysFricLrngDSysFricLrngEolFricDifLoLim
      AssemblySwConnector_3128: ecu-extract-reference=CalRegn01Inin00DSysFricLrngEolFricDifScagFacDSysFricLrngDSysFricLrngEolFricDifScagFac
      AssemblySwConnector_3129: ecu-extract-reference=CalRegn01Inin00DSysFricLrngFricChgWghtDSysFricLrngDSysFricLrngFricChgWght
      AssemblySwConnector_3130: ecu-extract-reference=CalRegn01Inin00DSysFricLrngFricDiagcThdDSysFricLrngDSysFricLrngFricDiagcThd
      AssemblySwConnector_3131: ecu-extract-reference=CalRegn01Inin00DSysFricLrngFricHysHwAgPtDSysFricLrngDSysFricLrngFricHysHwAgPt
      AssemblySwConnector_3132: ecu-extract-reference=CalRegn01Inin00DSysFricLrngFricOffsDSysFricLrngDSysFricLrngFricOffs
      AssemblySwConnector_3133: ecu-extract-reference=CalRegn01Inin00DSysFricLrngFricOffsHiLimDSysFricLrngDSysFricLrngFricOffsHiLim
      AssemblySwConnector_3134: ecu-extract-reference=CalRegn01Inin00DSysFricLrngFricOffsLoLimDSysFricLrngDSysFricLrngFricOffsLoLim
      AssemblySwConnector_3135: ecu-extract-reference=CalRegn01Inin00DSysFricLrngFricOffsLpFilFrqDSysFricLrngDSysFricLrngFricOffsLpFilFrq
      AssemblySwConnector_3136: ecu-extract-reference=CalRegn01Inin00DSysFricLrngGainDSysFricLrngDSysFricLrngGain
      AssemblySwConnector_3137: ecu-extract-reference=CalRegn01Inin00DSysFricLrngHiFricDebStepDSysFricLrngDSysFricLrngHiFricDebStep
      AssemblySwConnector_3138: ecu-extract-reference=CalRegn01Inin00DSysFricLrngHiFricDiagcThdDSysFricLrngDSysFricLrngHiFricDiagcThd
      AssemblySwConnector_3139: ecu-extract-reference=CalRegn01Inin00DSysFricLrngHwPosnAuthyThdDSysFricLrngDSysFricLrngHwPosnAuthyThd
      AssemblySwConnector_3140: ecu-extract-reference=CalRegn01Inin00DSysFricLrngHwVelConstrLimDSysFricLrngDSysFricLrngHwVelConstrLim
      AssemblySwConnector_3141: ecu-extract-reference=CalRegn01Inin00DSysFricLrngHwVelHiLimDSysFricLrngDSysFricLrngHwVelHiLim
      AssemblySwConnector_3142: ecu-extract-reference=CalRegn01Inin00DSysFricLrngHwVelLoLimDSysFricLrngDSysFricLrngHwVelLoLim
      AssemblySwConnector_3143: ecu-extract-reference=CalRegn01Inin00DSysFricLrngIgnCycFricChgLimDSysFricLrngDSysFricLrngIgnCycFricChgLim
      AssemblySwConnector_3144: ecu-extract-reference=CalRegn01Inin00DSysFricLrngIgnCycFricOffsDSysFricLrngDSysFricLrngIgnCycFricOffs
      AssemblySwConnector_3145: ecu-extract-reference=CalRegn01Inin00DSysFricLrngIvsTrsmRatXDSysFricLrngDSysFricLrngIvsTrsmRatX
      AssemblySwConnector_3146: ecu-extract-reference=CalRegn01Inin00DSysFricLrngIvsTrsmRatYDSysFricLrngDSysFricLrngIvsTrsmRatY
      AssemblySwConnector_3147: ecu-extract-reference=CalRegn01Inin00DSysFricLrngLatAHiLimDSysFricLrngDSysFricLrngLatAHiLim
      AssemblySwConnector_3148: ecu-extract-reference=CalRegn01Inin00DSysFricLrngLatALoLimDSysFricLrngDSysFricLrngLatALoLim
      AssemblySwConnector_3149: ecu-extract-reference=CalRegn01Inin00DSysFricLrngMaskVehSpdDSysFricLrngDSysFricLrngMaskVehSpd
      AssemblySwConnector_3150: ecu-extract-reference=CalRegn01Inin00DSysFricLrngRngCntrThdDSysFricLrngDSysFricLrngRngCntrThd
      AssemblySwConnector_3151: ecu-extract-reference=CalRegn01Inin00DSysFricLrngThdDSysFricLrngDSysFricLrngThd
      AssemblySwConnector_3152: ecu-extract-reference=CalRegn01Inin00DSysFricLrngTHiLimDSysFricLrngDSysFricLrngTHiLim
      AssemblySwConnector_3153: ecu-extract-reference=CalRegn01Inin00DSysFricLrngTLoLimDSysFricLrngDSysFricLrngTLoLim
      AssemblySwConnector_3154: ecu-extract-reference=CalRegn01Inin00DSysFricLrngVehSpdDSysFricLrngDSysFricLrngVehSpd
      AssemblySwConnector_3155: ecu-extract-reference=CalRegn01Inin00DTEstimnAmbPwrMplrDTEstimnDTEstimnAmbPwrMplr
      AssemblySwConnector_3156: ecu-extract-reference=CalRegn01Inin00DTEstimnAmbTScaDTEstimnDTEstimnAmbTSca
      AssemblySwConnector_3157: ecu-extract-reference=CalRegn01Inin00DTEstimnAssiMechAmbLpFilFrqDTEstimnDTEstimnAssiMechAmbLpFilFrq
      AssemblySwConnector_3158: ecu-extract-reference=CalRegn01Inin00DTEstimnAssiMechAmbLpFilFrqDualEcuFltMtgtnDTEstimnDTEstimnAssiMechAmbLpFilFrqDualEcuFltMtgtn
      AssemblySwConnector_3159: ecu-extract-reference=CalRegn01Inin00DTEstimnAssiMechAmbLpFilFrqFetMtgtnEnaDTEstimnDTEstimnAssiMechAmbLpFilFrqFetMtgtnEna
      AssemblySwConnector_3160: ecu-extract-reference=CalRegn01Inin00DTEstimnAssiMechAmbMplrDTEstimnDTEstimnAssiMechAmbMplr
      AssemblySwConnector_3161: ecu-extract-reference=CalRegn01Inin00DTEstimnAssiMechCorrLimDTEstimnDTEstimnAssiMechCorrLim
      AssemblySwConnector_3162: ecu-extract-reference=CalRegn01Inin00DTEstimnAssiMechDampgScaDTEstimnDTEstimnAssiMechDampgSca
      AssemblySwConnector_3163: ecu-extract-reference=CalRegn01Inin00DTEstimnAssiMechDftTDTEstimnDTEstimnAssiMechDftT
      AssemblySwConnector_3164: ecu-extract-reference=CalRegn01Inin00DTEstimnAssiMechLLFilCoeffA1DTEstimnDTEstimnAssiMechLLFilCoeffA1
      AssemblySwConnector_3165: ecu-extract-reference=CalRegn01Inin00DTEstimnAssiMechLLFilCoeffB0DTEstimnDTEstimnAssiMechLLFilCoeffB0
      AssemblySwConnector_3166: ecu-extract-reference=CalRegn01Inin00DTEstimnAssiMechLLFilCoeffB1DTEstimnDTEstimnAssiMechLLFilCoeffB1
      AssemblySwConnector_3167: ecu-extract-reference=CalRegn01Inin00DTEstimnAssiMechSlewDTEstimnDTEstimnAssiMechSlew
      AssemblySwConnector_3168: ecu-extract-reference=CalRegn01Inin00DTEstimnCorrnTAssiMechDTEstimnDTEstimnCorrnTAssiMech
      AssemblySwConnector_3169: ecu-extract-reference=CalRegn01Inin00DTEstimnCorrnTCuDTEstimnDTEstimnCorrnTCu
      AssemblySwConnector_3170: ecu-extract-reference=CalRegn01Inin00DTEstimnCorrnTMagDTEstimnDTEstimnCorrnTMag
      AssemblySwConnector_3171: ecu-extract-reference=CalRegn01Inin00DTEstimnCorrnTSiDTEstimnDTEstimnCorrnTSi
      AssemblySwConnector_3172: ecu-extract-reference=CalRegn01Inin00DTEstimnCuAmbLpFilFrqDTEstimnDTEstimnCuAmbLpFilFrq
      AssemblySwConnector_3173: ecu-extract-reference=CalRegn01Inin00DTEstimnCuAmbLpFilFrqDualEcuFltMtgtnDTEstimnDTEstimnCuAmbLpFilFrqDualEcuFltMtgtn
      AssemblySwConnector_3174: ecu-extract-reference=CalRegn01Inin00DTEstimnCuAmbLpFilFrqFetMtgtnEnaDTEstimnDTEstimnCuAmbLpFilFrqFetMtgtnEna
      AssemblySwConnector_3175: ecu-extract-reference=CalRegn01Inin00DTEstimnCuAmbMplrDTEstimnDTEstimnCuAmbMplr
      AssemblySwConnector_3176: ecu-extract-reference=CalRegn01Inin00DTEstimnCuCorrnLimDTEstimnDTEstimnCuCorrnLim
      AssemblySwConnector_3177: ecu-extract-reference=CalRegn01Inin00DTEstimnCuLLFilCoeffA1DTEstimnDTEstimnCuLLFilCoeffA1
      AssemblySwConnector_3178: ecu-extract-reference=CalRegn01Inin00DTEstimnCuLLFilCoeffB0DTEstimnDTEstimnCuLLFilCoeffB0
      AssemblySwConnector_3179: ecu-extract-reference=CalRegn01Inin00DTEstimnCuLLFilCoeffB1DTEstimnDTEstimnCuLLFilCoeffB1
      AssemblySwConnector_3180: ecu-extract-reference=CalRegn01Inin00DTEstimnEngTScaDTEstimnDTEstimnEngTSca
      AssemblySwConnector_3181: ecu-extract-reference=CalRegn01Inin00DTEstimnMagAmbLpFilFrqDTEstimnDTEstimnMagAmbLpFilFrq
      AssemblySwConnector_3182: ecu-extract-reference=CalRegn01Inin00DTEstimnMagAmbLpFilFrqDualEcuFltMtgtnDTEstimnDTEstimnMagAmbLpFilFrqDualEcuFltMtgtn
      AssemblySwConnector_3183: ecu-extract-reference=CalRegn01Inin00DTEstimnMagAmbLpFilFrqFetMtgtnEnaDTEstimnDTEstimnMagAmbLpFilFrqFetMtgtnEna
      AssemblySwConnector_3184: ecu-extract-reference=CalRegn01Inin00DTEstimnMagCorrnLimDTEstimnDTEstimnMagCorrnLim
      AssemblySwConnector_3185: ecu-extract-reference=CalRegn01Inin00DTEstimnMagLLFilCoeffA1DTEstimnDTEstimnMagLLFilCoeffA1
      AssemblySwConnector_3186: ecu-extract-reference=CalRegn01Inin00DTEstimnMagLLFilCoeffB0DTEstimnDTEstimnMagLLFilCoeffB0
      AssemblySwConnector_3187: ecu-extract-reference=CalRegn01Inin00DTEstimnMagLLFilCoeffB1DTEstimnDTEstimnMagLLFilCoeffB1
      AssemblySwConnector_3188: ecu-extract-reference=CalRegn01Inin00DTEstimnSiAmbLpFilFrqDTEstimnDTEstimnSiAmbLpFilFrq
      AssemblySwConnector_3189: ecu-extract-reference=CalRegn01Inin00DTEstimnSiAmbLpFilFrqDualEcuFltMtgtnDTEstimnDTEstimnSiAmbLpFilFrqDualEcuFltMtgtn
      AssemblySwConnector_3190: ecu-extract-reference=CalRegn01Inin00DTEstimnSiAmbLpFilFrqFetMtgtnEnaDTEstimnDTEstimnSiAmbLpFilFrqFetMtgtnEna
      AssemblySwConnector_3191: ecu-extract-reference=CalRegn01Inin00DTEstimnSiAmbMplrDTEstimnDTEstimnSiAmbMplr
      AssemblySwConnector_3192: ecu-extract-reference=CalRegn01Inin00DTEstimnSiCorrnLimDTEstimnDTEstimnSiCorrnLim
      AssemblySwConnector_3193: ecu-extract-reference=CalRegn01Inin00DTEstimnSiLLFilCoeffA1DTEstimnDTEstimnSiLLFilCoeffA1
      AssemblySwConnector_3194: ecu-extract-reference=CalRegn01Inin00DTEstimnSiLLFilCoeffB0DTEstimnDTEstimnSiLLFilCoeffB0
      AssemblySwConnector_3195: ecu-extract-reference=CalRegn01Inin00DTEstimnSiLLFilCoeffB1DTEstimnDTEstimnSiLLFilCoeffB1
      AssemblySwConnector_3196: ecu-extract-reference=CalRegn01Inin00DTEstimnTauAssiMechDTEstimnDTEstimnTauAssiMech
      AssemblySwConnector_3197: ecu-extract-reference=CalRegn01Inin00DTEstimnTauCuDTEstimnDTEstimnTauCu
      AssemblySwConnector_3198: ecu-extract-reference=CalRegn01Inin00DTEstimnTauMagDTEstimnDTEstimnTauMag
      AssemblySwConnector_3199: ecu-extract-reference=CalRegn01Inin00DTEstimnTauSiDTEstimnDTEstimnTauSi
      AssemblySwConnector_3200: ecu-extract-reference=CalRegn01Inin00DTEstimnWghtAvrgTDiDTEstimnDTEstimnWghtAvrgTDi
      AssemblySwConnector_3201: ecu-extract-reference=CalRegn01Inin00DVehSigCdngLatASlewRateDVehSigCdngDVehSigCdngLatASlewRate
      AssemblySwConnector_3202: ecu-extract-reference=CalRegn01Inin00DVehSigCdngLtgASlewRateDVehSigCdngDVehSigCdngLtgASlewRate
      AssemblySwConnector_3203: ecu-extract-reference=CalRegn01Inin00GroupBDPosnTrakgServoArbnFltMtgtnLpFilCutOffFrqDPosnTrakgServoDPosnTrakgServoArbnFltMtgtnLpFilCutOffFrq
      AssemblySwConnector_3204: ecu-extract-reference=CalRegn01Inin00GroupBDPosnTrakgServoEnaBlndFacTblXDPosnTrakgServoDPosnTrakgServoEnaBlndFacTblX
      AssemblySwConnector_3205: ecu-extract-reference=CalRegn01Inin00GroupBDPosnTrakgServoEnaBlndFacTblYDPosnTrakgServoDPosnTrakgServoEnaBlndFacTblY
      AssemblySwConnector_3206: ecu-extract-reference=CalRegn01Inin00GroupBDPosnTrakgServoFfGainDPosnTrakgServoDPosnTrakgServoFfGain
      AssemblySwConnector_3207: ecu-extract-reference=CalRegn01Inin00GroupBDPosnTrakgServoFfVelGainDPosnTrakgServoDPosnTrakgServoFfVelGain
      AssemblySwConnector_3208: ecu-extract-reference=CalRegn01Inin00GroupBDPosnTrakgServoGain1DPosnTrakgServoDPosnTrakgServoGain1
      AssemblySwConnector_3209: ecu-extract-reference=CalRegn01Inin00GroupBDPosnTrakgServoGain2DPosnTrakgServoDPosnTrakgServoGain2
      AssemblySwConnector_3210: ecu-extract-reference=CalRegn01Inin00GroupBDPosnTrakgServoGain3DPosnTrakgServoDPosnTrakgServoGain3
      AssemblySwConnector_3211: ecu-extract-reference=CalRegn01Inin00GroupBDPosnTrakgServoGain4DPosnTrakgServoDPosnTrakgServoGain4
      AssemblySwConnector_3212: ecu-extract-reference=CalRegn01Inin00GroupBDPosnTrakgServoGainArbnFltMtgtnDPosnTrakgServoDPosnTrakgServoGainArbnFltMtgtn
      AssemblySwConnector_3213: ecu-extract-reference=CalRegn01Inin00GroupBDPosnTrakgServoHwAgTarMgnLimTblYDPosnTrakgServoDPosnTrakgServoHwAgTarMgnLimTblY
      AssemblySwConnector_3214: ecu-extract-reference=CalRegn01Inin00GroupBDPosnTrakgServoHwAgTarRateLimTblYDPosnTrakgServoDPosnTrakgServoHwAgTarRateLimTblY
      AssemblySwConnector_3215: ecu-extract-reference=CalRegn01Inin00GroupBDPosnTrakgServoHwVelTarRateLimTblYDPosnTrakgServoDPosnTrakgServoHwVelTarRateLimTblY
      AssemblySwConnector_3216: ecu-extract-reference=CalRegn01Inin00GroupBDPosnTrakgServoIntglGainDPosnTrakgServoDPosnTrakgServoIntglGain
      AssemblySwConnector_3217: ecu-extract-reference=CalRegn01Inin00GroupBDPosnTrakgServoIntglLimDPosnTrakgServoDPosnTrakgServoIntglLim
      AssemblySwConnector_3218: ecu-extract-reference=CalRegn01Inin00GroupBDPosnTrakgServoIntgtrAntiWdupGainDPosnTrakgServoDPosnTrakgServoIntgtrAntiWdupGain
      AssemblySwConnector_3219: ecu-extract-reference=CalRegn01Inin00GroupBDPosnTrakgServoIntgtrStCorrnGainDPosnTrakgServoDPosnTrakgServoIntgtrStCorrnGain
      AssemblySwConnector_3220: ecu-extract-reference=CalRegn01Inin00GroupBDPosnTrakgServoLpFilCutOffFrqDPosnTrakgServoDPosnTrakgServoLpFilCutOffFrq
      AssemblySwConnector_3221: ecu-extract-reference=CalRegn01Inin00GroupBDPosnTrakgServoOutpAntiWdupGainDPosnTrakgServoDPosnTrakgServoOutpAntiWdupGain
      AssemblySwConnector_3222: ecu-extract-reference=CalRegn01Inin00GroupBDPosnTrakgServoOutpLimDPosnTrakgServoDPosnTrakgServoOutpLim
      AssemblySwConnector_3223: ecu-extract-reference=CalRegn01Inin00GroupBDPosnTrakgServoVehSpdTblDPosnTrakgServoDPosnTrakgServoVehSpdTbl
      AssemblySwConnector_3224: ecu-extract-reference=CalRegn01Inin00GroupDDStabyCmpAssiScaBlndXDStabyCmpDStabyCmpAssiScaBlndX
      AssemblySwConnector_3225: ecu-extract-reference=CalRegn01Inin00GroupDDStabyCmpAssiScaBlndYDStabyCmpDStabyCmpAssiScaBlndY
      AssemblySwConnector_3226: ecu-extract-reference=CalRegn01Inin00GroupDDStabyCmpHwTqLpFilFrqDStabyCmpDStabyCmpHwTqLpFilFrq
      AssemblySwConnector_3227: ecu-extract-reference=CalRegn01Inin00GroupDDStabyCmpNotchFil1StructDStabyCmpDStabyCmpNotchFil1Struct
      AssemblySwConnector_3228: ecu-extract-reference=CalRegn01Inin00GroupDDStabyCmpNotchFil2StructDStabyCmpDStabyCmpNotchFil2Struct
      AssemblySwConnector_3229: ecu-extract-reference=CalRegn01Inin00GroupDDStabyCmpNotchFil3StructDStabyCmpDStabyCmpNotchFil3Struct
      AssemblySwConnector_3230: ecu-extract-reference=CalRegn01Inin00GroupDDStabyCmpNotchFil4StructDStabyCmpDStabyCmpNotchFil4Struct
      AssemblySwConnector_3231: ecu-extract-reference=CalRegn01Inin00GroupDDStabyCmpNotchFilBilnrBlndVehSpdDStabyCmpDStabyCmpNotchFilBilnrBlndVehSpd
      AssemblySwConnector_3232: ecu-extract-reference=CalRegn01Inin00GroupDDStabyCmpNotchFilBlnd02YDStabyCmpDStabyCmpNotchFilBlnd02Y
      AssemblySwConnector_3233: ecu-extract-reference=CalRegn01Inin00GroupDDStabyCmpNotchFilBlnd04YDStabyCmpDStabyCmpNotchFilBlnd04Y
      AssemblySwConnector_3234: ecu-extract-reference=CalRegn01Inin00GroupDDStabyCmpNotchFilBlnd12TqXDStabyCmpDStabyCmpNotchFilBlnd12TqX
      AssemblySwConnector_3235: ecu-extract-reference=CalRegn01Inin00GroupDDStabyCmpNotchFilBlnd12YDStabyCmpDStabyCmpNotchFilBlnd12Y
      AssemblySwConnector_3236: ecu-extract-reference=CalRegn01Inin00GroupDDStabyCmpNotchFilBlnd34TqXDStabyCmpDStabyCmpNotchFilBlnd34TqX
      AssemblySwConnector_3237: ecu-extract-reference=CalRegn01Inin00GroupDDStabyCmpNotchFilBlnd34YDStabyCmpDStabyCmpNotchFilBlnd34Y
      AssemblySwConnector_3238: ecu-extract-reference=CalRegn01Rt00DTEstimnMagAmbMplrDAAACalRegn01Rt00_DummyDTEstimnMagAmbMplr
      AssemblySwConnector_3239: ecu-extract-reference=CalRegn01Rt00DTEstimnMagAmbMplrDTEstimnDTEstimnMagAmbMplr
      AssemblySwConnector_3240: ecu-extract-reference=CalRegn01Rt01DTEstimnMagAmbMplrDAAACalRegn01Rt01_DummyDTEstimnMagAmbMplr
      AssemblySwConnector_3241: ecu-extract-reference=CalRegn01Rt02DTEstimnMagAmbMplrDAAACalRegn01Rt02_DummyDTEstimnMagAmbMplr
      AssemblySwConnector_3242: ecu-extract-reference=CalRegn01Rt03DTEstimnMagAmbMplrDAAACalRegn01Rt03_DummyDTEstimnMagAmbMplr
      AssemblySwConnector_3243: ecu-extract-reference=CalRegn01Rt04DTEstimnMagAmbMplrDAAACalRegn01Rt04_DummyDTEstimnMagAmbMplr
      AssemblySwConnector_3244: ecu-extract-reference=CalRegn01Rt05DTEstimnMagAmbMplrDAAACalRegn01Rt05_DummyDTEstimnMagAmbMplr
      AssemblySwConnector_3245: ecu-extract-reference=CalRegn02CmnDMotRplCoggCmdHrmncOrder1ElecDCDD_MotRplCoggCmdDMotRplCoggCmdHrmncOrder1Elec
      AssemblySwConnector_3246: ecu-extract-reference=CalRegn02CmnDMotRplCoggCmdHrmncOrder2ElecDCDD_MotRplCoggCmdDMotRplCoggCmdHrmncOrder2Elec
      AssemblySwConnector_3247: ecu-extract-reference=CalRegn02CmnDMotRplCoggCmdHrmncOrder3ElecDCDD_MotRplCoggCmdDMotRplCoggCmdHrmncOrder3Elec
      AssemblySwConnector_3248: ecu-extract-reference=CalRegn02CmnDNxtrCalIdsCal1DevlpDescDCustDiagDNxtrCalIdsCal1DevlpDesc
      AssemblySwConnector_3249: ecu-extract-reference=CalRegn02CmnDFordCanDtcInhbFactryModThdDFordCanDtcInhbDFordCanDtcInhbFactryModThd
      AssemblySwConnector_3250: ecu-extract-reference=CalRegn02CmnDFordCanDtcInhbTransptModThdDFordCanDtcInhbDFordCanDtcInhbTransptModThd
      AssemblySwConnector_3251: ecu-extract-reference=CalRegn02CmnDFordHwAgArbnMotVelVldFlgRcvrTiThdDFordHwAgArbnDFordHwAgArbnMotVelVldFlgRcvrTiThd
      AssemblySwConnector_3252: ecu-extract-reference=CalRegn02CmnDFordHwAgArbnNonAbsCentrNotDetdTiThdDFordHwAgArbnDFordHwAgArbnNonAbsCentrNotDetdTiThd
      AssemblySwConnector_3253: ecu-extract-reference=CalRegn02CmnDFordHwAgArbnPhyRackTrvlThdDFordHwAgArbnDFordHwAgArbnPhyRackTrvlThd
      AssemblySwConnector_3254: ecu-extract-reference=CalRegn02CmnDFordHwAgArbnRelPosnVldFlgRcvryTiThdDFordHwAgArbnDFordHwAgArbnRelPosnVldFlgRcvryTiThd
      AssemblySwConnector_3255: ecu-extract-reference=CalRegn02CmnDFordHwTqCdngAppldFinalMotTqVldTiThdDFordHwTqCdngDFordHwTqCdngAppldFinalMotTqVldTiThd
      AssemblySwConnector_3256: ecu-extract-reference=CalRegn02CmnDFordHwTqCdngInpTqRawVldTiThdDFordHwTqCdngDFordHwTqCdngInpTqRawVldTiThd
      AssemblySwConnector_3257: ecu-extract-reference=CalRegn02CmnDFullAssiRampUpRateDFordSysStDFullAssiRampUpRate
      AssemblySwConnector_3258: ecu-extract-reference=CalRegn02CmnDInitLimpHomeRampDFordSysStDInitLimpHomeRamp
      AssemblySwConnector_3259: ecu-extract-reference=CalRegn02CmnDInitLimpHomeScarDFordSysStDInitLimpHomeScar
      AssemblySwConnector_3260: ecu-extract-reference=CalRegn02CmnDLimdAssiRampDFordSysStDLimdAssiRamp
      AssemblySwConnector_3261: ecu-extract-reference=CalRegn02CmnDLimdAssiRampUpRateDFordSysStDLimdAssiRampUpRate
      AssemblySwConnector_3262: ecu-extract-reference=CalRegn02CmnDLimdAssiRampUpRateFaildDFordSysStDLimdAssiRampUpRateFaild
      AssemblySwConnector_3263: ecu-extract-reference=CalRegn02CmnDLimdAssiScarDFordSysStDLimdAssiScar
      AssemblySwConnector_3264: ecu-extract-reference=CalRegn02CmnDNormLimpHomeRampDFordSysStDNormLimpHomeRamp
      AssemblySwConnector_3265: ecu-extract-reference=CalRegn02CmnDNormLimpHomeScarDFordSysStDNormLimpHomeScar
      AssemblySwConnector_3266: ecu-extract-reference=CalRegn02CmnDShtdwnRampDFordSysStDShtdwnRamp
      AssemblySwConnector_3267: ecu-extract-reference=CalRegn02CmnDFordVehSpdArbnDrvnWhlDFordVehSpdArbnDFordVehSpdArbnDrvnWhl
      AssemblySwConnector_3268: ecu-extract-reference=CalRegn02CmnDFordVehSpdArbnTireCircumMaxDFordVehSpdArbnDFordVehSpdArbnTireCircumMax
      AssemblySwConnector_3269: ecu-extract-reference=CalRegn02CmnDFordVehSpdArbnTireCircumMinDFordVehSpdArbnDFordVehSpdArbnTireCircumMin
      AssemblySwConnector_3270: ecu-extract-reference=CalRegn02CmnDFordVltgIfActvParkAssiAsscTqMinDFordVltgIfDFordVltgIfActvParkAssiAsscTqMin
      AssemblySwConnector_3271: ecu-extract-reference=CalRegn02CmnDFordVltgIfEpsBattCurrLimDFordVltgIfDFordVltgIfEpsBattCurrLim
      AssemblySwConnector_3272: ecu-extract-reference=CalRegn02CmnDFordVltgIfEPSBattVltgDifThdDFordVltgIfDFordVltgIfEPSBattVltgDifThd
      AssemblySwConnector_3273: ecu-extract-reference=CalRegn02CmnDFordVltgIfEpsCurrLimDFordVltgIfDFordVltgIfEpsCurrLim
      AssemblySwConnector_3274: ecu-extract-reference=CalRegn02CmnDFordVltgIfEvasSteerAssiTqMinDFordVltgIfDFordVltgIfEvasSteerAssiTqMin
      AssemblySwConnector_3275: ecu-extract-reference=CalRegn02CmnDFordVltgIfFeatThdStsTiThdDFordVltgIfDFordVltgIfFeatThdStsTiThd
      AssemblySwConnector_3276: ecu-extract-reference=CalRegn02CmnDFordVltgIfHiVltgAssiRampDwnRateDFordVltgIfDFordVltgIfHiVltgAssiRampDwnRate
      AssemblySwConnector_3277: ecu-extract-reference=CalRegn02CmnDFordVltgIfHiVltgAssiRampUpRateDFordVltgIfDFordVltgIfHiVltgAssiRampUpRate
      AssemblySwConnector_3278: ecu-extract-reference=CalRegn02CmnDFordVltgIfHiVltgInhbTiMaxDFordVltgIfDFordVltgIfHiVltgInhbTiMax
      AssemblySwConnector_3279: ecu-extract-reference=CalRegn02CmnDFordVltgIfHiVltgNoAssiRampDwnRateDFordVltgIfDFordVltgIfHiVltgNoAssiRampDwnRate
      AssemblySwConnector_3280: ecu-extract-reference=CalRegn02CmnDFordVltgIfHiVltgNoAssiRcvrTiMaxDFordVltgIfDFordVltgIfHiVltgNoAssiRcvrTiMax
      AssemblySwConnector_3281: ecu-extract-reference=CalRegn02CmnDFordVltgIfHiVltgRcvrTiMaxDFordVltgIfDFordVltgIfHiVltgRcvrTiMax
      AssemblySwConnector_3282: ecu-extract-reference=CalRegn02CmnDFordVltgIfHiVltgThdHiDFordVltgIfDFordVltgIfHiVltgThdHi
      AssemblySwConnector_3283: ecu-extract-reference=CalRegn02CmnDFordVltgIfHiVltgThdLoDFordVltgIfDFordVltgIfHiVltgThdLo
      AssemblySwConnector_3284: ecu-extract-reference=CalRegn02CmnDFordVltgIfInhbBattVltgDiagcTiThdDFordVltgIfDFordVltgIfInhbBattVltgDiagcTiThd
      AssemblySwConnector_3285: ecu-extract-reference=CalRegn02CmnDFordVltgIfLaneCentrAssiTqMinDFordVltgIfDFordVltgIfLaneCentrAssiTqMin
      AssemblySwConnector_3286: ecu-extract-reference=CalRegn02CmnDFordVltgIfLaneDprtrWarnAsscTqMinDFordVltgIfDFordVltgIfLaneDprtrWarnAsscTqMin
      AssemblySwConnector_3287: ecu-extract-reference=CalRegn02CmnDFordVltgIfLkaAsscTqMinDFordVltgIfDFordVltgIfLkaAsscTqMin
      AssemblySwConnector_3288: ecu-extract-reference=CalRegn02CmnDFordVltgIfLoVltgAssiRampDwnRateDFordVltgIfDFordVltgIfLoVltgAssiRampDwnRate
      AssemblySwConnector_3289: ecu-extract-reference=CalRegn02CmnDFordVltgIfLoVltgAssiRampUpRateDFordVltgIfDFordVltgIfLoVltgAssiRampUpRate
      AssemblySwConnector_3290: ecu-extract-reference=CalRegn02CmnDFordVltgIfLoVltgAssiScarDFordVltgIfDFordVltgIfLoVltgAssiScar
      AssemblySwConnector_3291: ecu-extract-reference=CalRegn02CmnDFordVltgIfLoVltgInhbTiMaxDFordVltgIfDFordVltgIfLoVltgInhbTiMax
      AssemblySwConnector_3292: ecu-extract-reference=CalRegn02CmnDFordVltgIfLoVltgNoAssiRampDwnRateDFordVltgIfDFordVltgIfLoVltgNoAssiRampDwnRate
      AssemblySwConnector_3293: ecu-extract-reference=CalRegn02CmnDFordVltgIfLoVltgNoAssiRcvrTiMaxDFordVltgIfDFordVltgIfLoVltgNoAssiRcvrTiMax
      AssemblySwConnector_3294: ecu-extract-reference=CalRegn02CmnDFordVltgIfLoVltgRcvrTiMaxDFordVltgIfDFordVltgIfLoVltgRcvrTiMax
      AssemblySwConnector_3295: ecu-extract-reference=CalRegn02CmnDFordVltgIfLoVltgThdHiDFordVltgIfDFordVltgIfLoVltgThdHi
      AssemblySwConnector_3296: ecu-extract-reference=CalRegn02CmnDFordVltgIfLoVltgThdLoDFordVltgIfDFordVltgIfLoVltgThdLo
      AssemblySwConnector_3297: ecu-extract-reference=CalRegn02CmnDFordVltgIfLoVltgThdMidDFordVltgIfDFordVltgIfLoVltgThdMid
      AssemblySwConnector_3298: ecu-extract-reference=CalRegn02CmnDFordVltgIfLoVltgThdMidToLoTiMaxDFordVltgIfDFordVltgIfLoVltgThdMidToLoTiMax
      AssemblySwConnector_3299: ecu-extract-reference=CalRegn02CmnDFordVltgIfLoVltgTqScaDwnRateDFordVltgIfDFordVltgIfLoVltgTqScaDwnRate
      AssemblySwConnector_3300: ecu-extract-reference=CalRegn02CmnDFordVltgIfLoVltgTqScagFacDFordVltgIfDFordVltgIfLoVltgTqScagFac
      AssemblySwConnector_3301: ecu-extract-reference=CalRegn02CmnDFordVltgIfLoVltgTqScaUpRateDFordVltgIfDFordVltgIfLoVltgTqScaUpRate
      AssemblySwConnector_3302: ecu-extract-reference=CalRegn02CmnDFordVltgIfTrfcJamAsscTqMinDFordVltgIfDFordVltgIfTrfcJamAsscTqMin
      AssemblySwConnector_3303: ecu-extract-reference=CalRegn02CmnDFordVltgIfTrlrBackupAssiTqMinDFordVltgIfDFordVltgIfTrlrBackupAssiTqMin
      AssemblySwConnector_3304: ecu-extract-reference=CalRegn02CmnDFordVltgIfVehBattCircRDFordVltgIfDFordVltgIfVehBattCircR
      AssemblySwConnector_3305: ecu-extract-reference=CalRegn02CmnDLoaMgrCurrIvtrMtgtnRateDLoaMgrDLoaMgrCurrIvtrMtgtnRate
      AssemblySwConnector_3306: ecu-extract-reference=CalRegn02CmnDLoaMgrCurrIvtrMtgtnScaDLoaMgrDLoaMgrCurrIvtrMtgtnSca
      AssemblySwConnector_3307: ecu-extract-reference=CalRegn02CmnDLoaMgrCurrMeasMtgtnRateDLoaMgrDLoaMgrCurrMeasMtgtnRate
      AssemblySwConnector_3308: ecu-extract-reference=CalRegn02CmnDLoaMgrCurrMeasMtgtnScaDLoaMgrDLoaMgrCurrMeasMtgtnSca
      AssemblySwConnector_3309: ecu-extract-reference=CalRegn02CmnDLoaMgrIvtrMtgtnRateDLoaMgrDLoaMgrIvtrMtgtnRate
      AssemblySwConnector_3310: ecu-extract-reference=CalRegn02CmnDLoaMgrIvtrMtgtnScaDLoaMgrDLoaMgrIvtrMtgtnSca
      AssemblySwConnector_3311: ecu-extract-reference=CalRegn02CmnDLoaMgrLimdStRateDLoaMgrDLoaMgrLimdStRate
      AssemblySwConnector_3312: ecu-extract-reference=CalRegn02CmnDLoaMgrLimdStScaDLoaMgrDLoaMgrLimdStSca
      AssemblySwConnector_3313: ecu-extract-reference=CalRegn02CmnDLoaMgrMotAgMtgtnRateDLoaMgrDLoaMgrMotAgMtgtnRate
      AssemblySwConnector_3314: ecu-extract-reference=CalRegn02CmnDLoaMgrMotAgMtgtnScaDLoaMgrDLoaMgrMotAgMtgtnSca
      AssemblySwConnector_3315: ecu-extract-reference=CalRegn02CmnDMotRplCoggCfgMotAgTiDlyDMotRplCoggCfgDMotRplCoggCfgMotAgTiDly
      AssemblySwConnector_3316: ecu-extract-reference=CalRegn02CmnDMotRplCoggCfgMotCurrDaxRplBilnrSelnDMotRplCoggCfgDMotRplCoggCfgMotCurrDaxRplBilnrSeln
      AssemblySwConnector_3317: ecu-extract-reference=CalRegn02CmnDMotRplCoggCfgMotCurrQaxRplDMotRplCoggCfgDMotRplCoggCfgMotCurrQaxRpl
      AssemblySwConnector_3318: ecu-extract-reference=CalRegn02CmnDMotRplCoggCfgMotTqCmdCurrRgltrBwCmpMgnYDMotRplCoggCfgDMotRplCoggCfgMotTqCmdCurrRgltrBwCmpMgnY
      AssemblySwConnector_3319: ecu-extract-reference=CalRegn02CmnDMotRplCoggCfgMotTqCmdCurrRgltrBwCmpPhaYDMotRplCoggCfgDMotRplCoggCfgMotTqCmdCurrRgltrBwCmpPhaY
      AssemblySwConnector_3320: ecu-extract-reference=CalRegn02CmnDMotRplCoggCfgMotTqCmdCurrRgltrBwCmpXDMotRplCoggCfgDMotRplCoggCfgMotTqCmdCurrRgltrBwCmpX
      AssemblySwConnector_3321: ecu-extract-reference=CalRegn02CmnDMotRplCoggCfgMotTqRplOrder1XDMotRplCoggCfgDMotRplCoggCfgMotTqRplOrder1X
      AssemblySwConnector_3322: ecu-extract-reference=CalRegn02CmnDMotRplCoggCfgMotTqRplOrder1YDMotRplCoggCfgDMotRplCoggCfgMotTqRplOrder1Y
      AssemblySwConnector_3323: ecu-extract-reference=CalRegn02CmnDMotRplCoggCfgMotTqRplOrder2XDMotRplCoggCfgDMotRplCoggCfgMotTqRplOrder2X
      AssemblySwConnector_3324: ecu-extract-reference=CalRegn02CmnDMotRplCoggCfgMotTqRplOrder2YDMotRplCoggCfgDMotRplCoggCfgMotTqRplOrder2Y
      AssemblySwConnector_3325: ecu-extract-reference=CalRegn02CmnDMotRplCoggCfgMotTqRplOrder3XDMotRplCoggCfgDMotRplCoggCfgMotTqRplOrder3X
      AssemblySwConnector_3326: ecu-extract-reference=CalRegn02CmnDMotRplCoggCfgMotTqRplOrder3YDMotRplCoggCfgDMotRplCoggCfgMotTqRplOrder3Y
      AssemblySwConnector_3327: ecu-extract-reference=CalRegn02CmnDMotRplCoggCfgMotVelBilnrSelnDMotRplCoggCfgDMotRplCoggCfgMotVelBilnrSeln
      AssemblySwConnector_3328: ecu-extract-reference=CalRegn02CmnDMotRplCoggCmdHrmncOrder1ElecDMotRplCoggCfgDMotRplCoggCmdHrmncOrder1Elec
      AssemblySwConnector_3329: ecu-extract-reference=CalRegn02CmnDMotRplCoggCmdHrmncOrder2ElecDMotRplCoggCfgDMotRplCoggCmdHrmncOrder2Elec
      AssemblySwConnector_3330: ecu-extract-reference=CalRegn02CmnDMotRplCoggCmdHrmncOrder3ElecDMotRplCoggCfgDMotRplCoggCmdHrmncOrder3Elec
      AssemblySwConnector_3331: ecu-extract-reference=CalRegn02CmnDNxtrCalIdsCal1DevlpAuthorDNxtrCalIdsDNxtrCalIdsCal1DevlpAuthor
      AssemblySwConnector_3332: ecu-extract-reference=CalRegn02CmnDNxtrCalIdsCal1DevlpRelNrDNxtrCalIdsDNxtrCalIdsCal1DevlpRelNr
      AssemblySwConnector_3333: ecu-extract-reference=CalRegn02CmnDNxtrCalIdsCal1DevlpRelStDNxtrCalIdsDNxtrCalIdsCal1DevlpRelSt
      AssemblySwConnector_3334: ecu-extract-reference=CalRegn02CmnDNxtrCalIdsCal1DevlpTiStampDNxtrCalIdsDNxtrCalIdsCal1DevlpTiStamp
      AssemblySwConnector_3335: ecu-extract-reference=CalRegn02CmnDNxtrCalIdsCal1DevlpVersDNxtrCalIdsDNxtrCalIdsCal1DevlpVers
      AssemblySwConnector_3336: ecu-extract-reference=CalRegn02CmnGroupBDEotLrngHwAgOverTrvlCntThdDEotLrngDEotLrngHwAgOverTrvlCntThd
      AssemblySwConnector_3337: ecu-extract-reference=CalRegn02CmnGroupBDEotProtnActvRegnBypMaxThdDEotProtnDEotProtnActvRegnBypMaxThd
      AssemblySwConnector_3338: ecu-extract-reference=CalRegn02CmnGroupBDEotProtnFwlEotDampgActvBndXDEotProtnFwlDEotProtnFwlEotDampgActvBndX
      AssemblySwConnector_3339: ecu-extract-reference=CalRegn02CmnGroupBDEotProtnFwlInactvLimDEotProtnFwlDEotProtnFwlInactvLim
      AssemblySwConnector_3340: ecu-extract-reference=CalRegn02CmnGroupBDEotProtnFwlVehSpdDEotProtnFwlDEotProtnFwlVehSpd
      AssemblySwConnector_3341: ecu-extract-reference=CalRegn02Inin00DSysGlbPrmSysKineRatDCDD_MotAgCmpDSysGlbPrmSysKineRat
      AssemblySwConnector_3342: ecu-extract-reference=CalRegn02Inin00DSysGlbPrmSysKineRatDDrvrTqEstimnDSysGlbPrmSysKineRat
      AssemblySwConnector_3343: ecu-extract-reference=CalRegn02Inin00DSysGlbPrmSysKineRatDFordHwAgArbnDSysGlbPrmSysKineRat
      AssemblySwConnector_3344: ecu-extract-reference=CalRegn02Inin00DSysGlbPrmSysKineRatDFordHwTqCdngDSysGlbPrmSysKineRat
      AssemblySwConnector_3345: ecu-extract-reference=CalRegn02Inin00DHiLoadStallLimrMotTqCmdFetMtgtnEnaFilFrqDHiLoadStallLimrDHiLoadStallLimrMotTqCmdFetMtgtnEnaFilFrq
      AssemblySwConnector_3346: ecu-extract-reference=CalRegn02Inin00DHiLoadStallLimrMotTqCmdFilFrqDHiLoadStallLimrDHiLoadStallLimrMotTqCmdFilFrq
      AssemblySwConnector_3347: ecu-extract-reference=CalRegn02Inin00DHiLoadStallLimrMotVelMgnThdDHiLoadStallLimrDHiLoadStallLimrMotVelMgnThd
      AssemblySwConnector_3348: ecu-extract-reference=CalRegn02Inin00DHiLoadStallLimrStallMotTqCmdFetMtgtnLimXDHiLoadStallLimrDHiLoadStallLimrStallMotTqCmdFetMtgtnLimX
      AssemblySwConnector_3349: ecu-extract-reference=CalRegn02Inin00DHiLoadStallLimrStallMotTqCmdFetMtgtnLimYDHiLoadStallLimrDHiLoadStallLimrStallMotTqCmdFetMtgtnLimY
      AssemblySwConnector_3350: ecu-extract-reference=CalRegn02Inin00DHiLoadStallLimrStallMotTqCmdLimXDHiLoadStallLimrDHiLoadStallLimrStallMotTqCmdLimX
      AssemblySwConnector_3351: ecu-extract-reference=CalRegn02Inin00DHiLoadStallLimrStallMotTqCmdLimYDHiLoadStallLimrDHiLoadStallLimrStallMotTqCmdLimY
      AssemblySwConnector_3352: ecu-extract-reference=CalRegn02Inin00DHiLoadStallLimrStallMotTqLimSlewRateDHiLoadStallLimrDHiLoadStallLimrStallMotTqLimSlewRate
      AssemblySwConnector_3353: ecu-extract-reference=CalRegn02Inin00DHiLoadStallLimrStallThermLimScaDHiLoadStallLimrDHiLoadStallLimrStallThermLimSca
      AssemblySwConnector_3354: ecu-extract-reference=CalRegn02Inin00DSysGlbPrmSysKineRatDHwAgSnsrlsDSysGlbPrmSysKineRat
      AssemblySwConnector_3355: ecu-extract-reference=CalRegn02Inin00DSysGlbPrmSysKineRatDHwAgSysArbnDSysGlbPrmSysKineRat
      AssemblySwConnector_3356: ecu-extract-reference=CalRegn02Inin00DSysGlbPrmSysKineRatDInertiaCmpVelDSysGlbPrmSysKineRat
      AssemblySwConnector_3357: ecu-extract-reference=CalRegn02Inin00DSysGlbPrmSysKineRatDPosnTrakgServoDSysGlbPrmSysKineRat
      AssemblySwConnector_3358: ecu-extract-reference=CalRegn02Inin00DVehSigCdngVehSpdSlewRateDVehSigCdngDVehSigCdngVehSpdSlewRate
      AssemblySwConnector_3359: ecu-extract-reference=CalRegn02Inin00GroupBDEotLrngAuthyStrtLrnDEotLrngDEotLrngAuthyStrtLrn
      AssemblySwConnector_3360: ecu-extract-reference=CalRegn02Inin00GroupBDEotLrngEntrAndExitHysRngLimrDEotLrngDEotLrngEntrAndExitHysRngLimr
      AssemblySwConnector_3361: ecu-extract-reference=CalRegn02Inin00GroupBDEotLrngEotLrnTmrDEotLrngDEotLrngEotLrnTmr
      AssemblySwConnector_3362: ecu-extract-reference=CalRegn02Inin00GroupBDEotLrngHwTqEotLrnDEotLrngDEotLrngHwTqEotLrn
      AssemblySwConnector_3363: ecu-extract-reference=CalRegn02Inin00GroupBDEotLrngMotVelEotLrnDEotLrngDEotLrngMotVelEotLrn
      AssemblySwConnector_3364: ecu-extract-reference=CalRegn02Inin00GroupBDEotLrngRackTrvlMaxDEotLrngDEotLrngRackTrvlMax
      AssemblySwConnector_3365: ecu-extract-reference=CalRegn02Inin00GroupBDEotLrngRackTrvlMinDEotLrngDEotLrngRackTrvlMin
      AssemblySwConnector_3366: ecu-extract-reference=CalRegn02Inin00GroupBDEotLrngRstAuthyMinDEotLrngDEotLrngRstAuthyMin
      AssemblySwConnector_3367: ecu-extract-reference=CalRegn02Inin00GroupBDEotProtnRackTrvlLimrEnaDEotLrngDEotProtnRackTrvlLimrEna
      AssemblySwConnector_3368: ecu-extract-reference=CalRegn02Inin00GroupBDEotProtnRackTrvlLimrRngLimdDEotLrngDEotProtnRackTrvlLimrRngLimd
      AssemblySwConnector_3369: ecu-extract-reference=CalRegn02Inin00GroupBDEotProtnDampgSlewDEotProtnDEotProtnDampgSlew
      AssemblySwConnector_3370: ecu-extract-reference=CalRegn02Inin00GroupBDEotProtnDftPosnDEotProtnDEotProtnDftPosn
      AssemblySwConnector_3371: ecu-extract-reference=CalRegn02Inin00GroupBDEotProtnEntrGainAuthyThdDEotProtnDEotProtnEntrGainAuthyThd
      AssemblySwConnector_3372: ecu-extract-reference=CalRegn02Inin00GroupBDEotProtnEntrGainXDEotProtnDEotProtnEntrGainX
      AssemblySwConnector_3373: ecu-extract-reference=CalRegn02Inin00GroupBDEotProtnEntrStLpFilFrqDEotProtnDEotProtnEntrStLpFilFrq
      AssemblySwConnector_3374: ecu-extract-reference=CalRegn02Inin00GroupBDEotProtnExitDampgYDEotProtnDEotProtnExitDampgY
      AssemblySwConnector_3375: ecu-extract-reference=CalRegn02Inin00GroupBDEotProtnExitStLpFilFrqDEotProtnDEotProtnExitStLpFilFrq
      AssemblySwConnector_3376: ecu-extract-reference=CalRegn02Inin00GroupBDEotProtnHwAgGainDEotProtnDEotProtnHwAgGain
      AssemblySwConnector_3377: ecu-extract-reference=CalRegn02Inin00GroupBDEotProtnHwAgMaxDEotProtnDEotProtnHwAgMax
      AssemblySwConnector_3378: ecu-extract-reference=CalRegn02Inin00GroupBDEotProtnHwAgMinDEotProtnDEotProtnHwAgMin
      AssemblySwConnector_3379: ecu-extract-reference=CalRegn02Inin00GroupBDEotProtnHwDegDampgXDEotProtnDEotProtnHwDegDampgX
      AssemblySwConnector_3380: ecu-extract-reference=CalRegn02Inin00GroupBDEotProtnHwTqLpFilFrqDEotProtnDEotProtnHwTqLpFilFrq
      AssemblySwConnector_3381: ecu-extract-reference=CalRegn02Inin00GroupBDEotProtnHwTqScaXDEotProtnDEotProtnHwTqScaX
      AssemblySwConnector_3382: ecu-extract-reference=CalRegn02Inin00GroupBDEotProtnMotSpdIncptScaDEotProtnDEotProtnMotSpdIncptSca
      AssemblySwConnector_3383: ecu-extract-reference=CalRegn02Inin00GroupBDEotProtnMotSpdIncptXDEotProtnDEotProtnMotSpdIncptX
      AssemblySwConnector_3384: ecu-extract-reference=CalRegn02Inin00GroupBDEotProtnMotVelGainDEotProtnDEotProtnMotVelGain
      AssemblySwConnector_3385: ecu-extract-reference=CalRegn02Inin00GroupBDEotProtnPosnRampStepDEotProtnDEotProtnPosnRampStep
      AssemblySwConnector_3386: ecu-extract-reference=CalRegn02Inin00GroupBDEotProtnRackTrvlLimrAuthyThdDEotProtnDEotProtnRackTrvlLimrAuthyThd
      AssemblySwConnector_3387: ecu-extract-reference=CalRegn02Inin00GroupBDEotProtnRackTrvlLimrAuthyThdLimdDEotProtnDEotProtnRackTrvlLimrAuthyThdLimd
      AssemblySwConnector_3388: ecu-extract-reference=CalRegn02Inin00GroupBDEotProtnRackTrvlLimrEnaDEotProtnDEotProtnRackTrvlLimrEna
      AssemblySwConnector_3389: ecu-extract-reference=CalRegn02Inin00GroupBDEotProtnRackTrvlLimrRngDEotProtnDEotProtnRackTrvlLimrRng
      AssemblySwConnector_3390: ecu-extract-reference=CalRegn02Inin00GroupBDEotProtnRackTrvlLimrRngLimdDEotProtnDEotProtnRackTrvlLimrRngLimd
      AssemblySwConnector_3391: ecu-extract-reference=CalRegn02Inin00GroupBDEotProtnRackTrvlLimrVehSpdThdDEotProtnDEotProtnRackTrvlLimrVehSpdThd
      AssemblySwConnector_3392: ecu-extract-reference=CalRegn02Inin00GroupBDEotProtnRunEotVelImpctAndSoftEndStopDEotProtnDEotProtnRunEotVelImpctAndSoftEndStop
      AssemblySwConnector_3393: ecu-extract-reference=CalRegn02Inin00GroupBDEotProtnSoftEndStopEnaDEotProtnDEotProtnSoftEndStopEna
      AssemblySwConnector_3394: ecu-extract-reference=CalRegn02Inin00GroupBDEotProtnSoftEndStopVehSpdThdDEotProtnDEotProtnSoftEndStopVehSpdThd
      AssemblySwConnector_3395: ecu-extract-reference=CalRegn02Inin00GroupBDEotProtnFwlActvCmdLowrBndDEotProtnFwlDEotProtnFwlActvCmdLowrBnd
      AssemblySwConnector_3396: ecu-extract-reference=CalRegn02Inin00GroupBDEotProtnFwlActvCmdUpprBndDEotProtnFwlDEotProtnFwlActvCmdUpprBnd
      AssemblySwConnector_3397: ecu-extract-reference=CalRegn02Inin00GroupBDEotProtnFwlEotDampgActvBndYDEotProtnFwlDEotProtnFwlEotDampgActvBndY
      AssemblySwConnector_3398: ecu-extract-reference=CalRegn02Inin00GroupBDEotProtnHwAgMinDEotProtnFwlDEotProtnHwAgMin
      AssemblySwConnector_3399: ecu-extract-reference=CalRegn02Inin00GroupBDEotProtnHwDegDampgXDEotProtnFwlDEotProtnHwDegDampgX
      AssemblySwConnector_3400: ecu-extract-reference=CalRegn02Inin00GroupBDEotProtnRackTrvlLimrRngDEotProtnFwlDEotProtnRackTrvlLimrRng
      AssemblySwConnector_3401: ecu-extract-reference=CalRegn02Inin00GroupBDRtnHwAuthyScaXDRtnDRtnHwAuthyScaX
      AssemblySwConnector_3402: ecu-extract-reference=CalRegn02Inin00GroupBDRtnHwAuthyScaYDRtnDRtnHwAuthyScaY
      AssemblySwConnector_3403: ecu-extract-reference=CalRegn02Inin00GroupBDRtnHwAuthySlewDRtnDRtnHwAuthySlew
      AssemblySwConnector_3404: ecu-extract-reference=CalRegn02Inin00GroupBDRtnOffsRngDRtnDRtnOffsRng
      AssemblySwConnector_3405: ecu-extract-reference=CalRegn02Inin00GroupBDRtnOffsSlewDRtnDRtnOffsSlew
      AssemblySwConnector_3406: ecu-extract-reference=CalRegn02Inin00GroupBDRtnTScaXDRtnDRtnTScaX
      AssemblySwConnector_3407: ecu-extract-reference=CalRegn02Inin00GroupBDRtnTScaYDRtnDRtnTScaY
      AssemblySwConnector_3408: ecu-extract-reference=CalRegn02Inin00GroupBDRtnPahFwlUpprBndTblXDRtnPahFwlDRtnPahFwlUpprBndTblX
      AssemblySwConnector_3409: ecu-extract-reference=CalRegn02Inin00GroupBDRtnPahFwlUpprBndTblYDRtnPahFwlDRtnPahFwlUpprBndTblY
      AssemblySwConnector_3410: ecu-extract-reference=CalRegn02Inin00GroupBDRtnPahFwlVehSpdDRtnPahFwlDRtnPahFwlVehSpd
      AssemblySwConnector_3411: ecu-extract-reference=CalRegn02Rt00GroupBDEotProtnDampgVehSpdTblDAAACalRegn02Rt00GroupB_DummyDEotProtnDampgVehSpdTbl
      AssemblySwConnector_3412: ecu-extract-reference=CalRegn02Rt00GroupBDEotProtnDeltaTqThdDAAACalRegn02Rt00GroupB_DummyDEotProtnDeltaTqThd
      AssemblySwConnector_3413: ecu-extract-reference=CalRegn02Rt00GroupBDEotProtnEntrGainVehSpdTblDAAACalRegn02Rt00GroupB_DummyDEotProtnEntrGainVehSpdTbl
      AssemblySwConnector_3414: ecu-extract-reference=CalRegn02Rt00GroupBDEotProtnEntrGainYDAAACalRegn02Rt00GroupB_DummyDEotProtnEntrGainY
      AssemblySwConnector_3415: ecu-extract-reference=CalRegn02Rt00GroupBDEotProtnLoAuthyEntrGainYDAAACalRegn02Rt00GroupB_DummyDEotProtnLoAuthyEntrGainY
      AssemblySwConnector_3416: ecu-extract-reference=CalRegn02Rt00GroupBDEotProtnMotSpdIncptYDAAACalRegn02Rt00GroupB_DummyDEotProtnMotSpdIncptY
      AssemblySwConnector_3417: ecu-extract-reference=CalRegn02Rt00GroupBDEotProtnNormDampgYDAAACalRegn02Rt00GroupB_DummyDEotProtnNormDampgY
      AssemblySwConnector_3418: ecu-extract-reference=CalRegn02Rt00GroupBDEotProtnSoftEndStopAuthyThdDAAACalRegn02Rt00GroupB_DummyDEotProtnSoftEndStopAuthyThd
      AssemblySwConnector_3419: ecu-extract-reference=CalRegn02Rt00GroupBDRtnHwAgOffsCalcdXDAAACalRegn02Rt00GroupB_DummyDRtnHwAgOffsCalcdX
      AssemblySwConnector_3420: ecu-extract-reference=CalRegn02Rt00GroupBDRtnHwAgOffsCalcdYDAAACalRegn02Rt00GroupB_DummyDRtnHwAgOffsCalcdY
      AssemblySwConnector_3421: ecu-extract-reference=CalRegn02Rt00GroupBDRtnScaTqXDAAACalRegn02Rt00GroupB_DummyDRtnScaTqX
      AssemblySwConnector_3422: ecu-extract-reference=CalRegn02Rt00GroupBDRtnScaTqYDAAACalRegn02Rt00GroupB_DummyDRtnScaTqY
      AssemblySwConnector_3423: ecu-extract-reference=CalRegn02Rt00GroupBDRtnScaVelXDAAACalRegn02Rt00GroupB_DummyDRtnScaVelX
      AssemblySwConnector_3424: ecu-extract-reference=CalRegn02Rt00GroupBDRtnScaVelYDAAACalRegn02Rt00GroupB_DummyDRtnScaVelY
      AssemblySwConnector_3425: ecu-extract-reference=CalRegn02Rt00GroupBDRtnVehSpdSelnDAAACalRegn02Rt00GroupB_DummyDRtnVehSpdSeln
      AssemblySwConnector_3426: ecu-extract-reference=CalRegn02Rt00GroupBDEotProtnDampgVehSpdTblDEotProtnDEotProtnDampgVehSpdTbl
      AssemblySwConnector_3427: ecu-extract-reference=CalRegn02Rt00GroupBDEotProtnDeltaTqThdDEotProtnDEotProtnDeltaTqThd
      AssemblySwConnector_3428: ecu-extract-reference=CalRegn02Rt00GroupBDEotProtnEntrGainVehSpdTblDEotProtnDEotProtnEntrGainVehSpdTbl
      AssemblySwConnector_3429: ecu-extract-reference=CalRegn02Rt00GroupBDEotProtnEntrGainYDEotProtnDEotProtnEntrGainY
      AssemblySwConnector_3430: ecu-extract-reference=CalRegn02Rt00GroupBDEotProtnLoAuthyEntrGainYDEotProtnDEotProtnLoAuthyEntrGainY
      AssemblySwConnector_3431: ecu-extract-reference=CalRegn02Rt00GroupBDEotProtnMotSpdIncptYDEotProtnDEotProtnMotSpdIncptY
      AssemblySwConnector_3432: ecu-extract-reference=CalRegn02Rt00GroupBDEotProtnNormDampgYDEotProtnDEotProtnNormDampgY
      AssemblySwConnector_3433: ecu-extract-reference=CalRegn02Rt00GroupBDEotProtnSoftEndStopAuthyThdDEotProtnDEotProtnSoftEndStopAuthyThd
      AssemblySwConnector_3434: ecu-extract-reference=CalRegn02Rt00GroupBDEotProtnSoftEndStopAuthyThdDEotProtnFwlDEotProtnSoftEndStopAuthyThd
      AssemblySwConnector_3435: ecu-extract-reference=CalRegn02Rt00GroupBDRtnHwAgOffsCalcdXDRtnDRtnHwAgOffsCalcdX
      AssemblySwConnector_3436: ecu-extract-reference=CalRegn02Rt00GroupBDRtnHwAgOffsCalcdYDRtnDRtnHwAgOffsCalcdY
      AssemblySwConnector_3437: ecu-extract-reference=CalRegn02Rt00GroupBDRtnScaTqXDRtnDRtnScaTqX
      AssemblySwConnector_3438: ecu-extract-reference=CalRegn02Rt00GroupBDRtnScaTqYDRtnDRtnScaTqY
      AssemblySwConnector_3439: ecu-extract-reference=CalRegn02Rt00GroupBDRtnScaVelXDRtnDRtnScaVelX
      AssemblySwConnector_3440: ecu-extract-reference=CalRegn02Rt00GroupBDRtnScaVelYDRtnDRtnScaVelY
      AssemblySwConnector_3441: ecu-extract-reference=CalRegn02Rt00GroupBDRtnVehSpdSelnDRtnDRtnVehSpdSeln
      AssemblySwConnector_3442: ecu-extract-reference=CalRegn02Rt01GroupBDEotProtnDampgVehSpdTblDAAACalRegn02Rt01GroupB_DummyDEotProtnDampgVehSpdTbl
      AssemblySwConnector_3443: ecu-extract-reference=CalRegn02Rt01GroupBDEotProtnDeltaTqThdDAAACalRegn02Rt01GroupB_DummyDEotProtnDeltaTqThd
      AssemblySwConnector_3444: ecu-extract-reference=CalRegn02Rt01GroupBDEotProtnEntrGainVehSpdTblDAAACalRegn02Rt01GroupB_DummyDEotProtnEntrGainVehSpdTbl
      AssemblySwConnector_3445: ecu-extract-reference=CalRegn02Rt01GroupBDEotProtnEntrGainYDAAACalRegn02Rt01GroupB_DummyDEotProtnEntrGainY
      AssemblySwConnector_3446: ecu-extract-reference=CalRegn02Rt01GroupBDEotProtnLoAuthyEntrGainYDAAACalRegn02Rt01GroupB_DummyDEotProtnLoAuthyEntrGainY
      AssemblySwConnector_3447: ecu-extract-reference=CalRegn02Rt01GroupBDEotProtnMotSpdIncptYDAAACalRegn02Rt01GroupB_DummyDEotProtnMotSpdIncptY
      AssemblySwConnector_3448: ecu-extract-reference=CalRegn02Rt01GroupBDEotProtnNormDampgYDAAACalRegn02Rt01GroupB_DummyDEotProtnNormDampgY
      AssemblySwConnector_3449: ecu-extract-reference=CalRegn02Rt01GroupBDEotProtnSoftEndStopAuthyThdDAAACalRegn02Rt01GroupB_DummyDEotProtnSoftEndStopAuthyThd
      AssemblySwConnector_3450: ecu-extract-reference=CalRegn02Rt01GroupBDRtnHwAgOffsCalcdXDAAACalRegn02Rt01GroupB_DummyDRtnHwAgOffsCalcdX
      AssemblySwConnector_3451: ecu-extract-reference=CalRegn02Rt01GroupBDRtnHwAgOffsCalcdYDAAACalRegn02Rt01GroupB_DummyDRtnHwAgOffsCalcdY
      AssemblySwConnector_3452: ecu-extract-reference=CalRegn02Rt01GroupBDRtnScaTqXDAAACalRegn02Rt01GroupB_DummyDRtnScaTqX
      AssemblySwConnector_3453: ecu-extract-reference=CalRegn02Rt01GroupBDRtnScaTqYDAAACalRegn02Rt01GroupB_DummyDRtnScaTqY
      AssemblySwConnector_3454: ecu-extract-reference=CalRegn02Rt01GroupBDRtnScaVelXDAAACalRegn02Rt01GroupB_DummyDRtnScaVelX
      AssemblySwConnector_3455: ecu-extract-reference=CalRegn02Rt01GroupBDRtnScaVelYDAAACalRegn02Rt01GroupB_DummyDRtnScaVelY
      AssemblySwConnector_3456: ecu-extract-reference=CalRegn02Rt01GroupBDRtnVehSpdSelnDAAACalRegn02Rt01GroupB_DummyDRtnVehSpdSeln
      AssemblySwConnector_3457: ecu-extract-reference=CalRegn02Rt02GroupBDEotProtnDampgVehSpdTblDAAACalRegn02Rt02GroupB_DummyDEotProtnDampgVehSpdTbl
      AssemblySwConnector_3458: ecu-extract-reference=CalRegn02Rt02GroupBDEotProtnDeltaTqThdDAAACalRegn02Rt02GroupB_DummyDEotProtnDeltaTqThd
      AssemblySwConnector_3459: ecu-extract-reference=CalRegn02Rt02GroupBDEotProtnEntrGainVehSpdTblDAAACalRegn02Rt02GroupB_DummyDEotProtnEntrGainVehSpdTbl
      AssemblySwConnector_3460: ecu-extract-reference=CalRegn02Rt02GroupBDEotProtnEntrGainYDAAACalRegn02Rt02GroupB_DummyDEotProtnEntrGainY
      AssemblySwConnector_3461: ecu-extract-reference=CalRegn02Rt02GroupBDEotProtnLoAuthyEntrGainYDAAACalRegn02Rt02GroupB_DummyDEotProtnLoAuthyEntrGainY
      AssemblySwConnector_3462: ecu-extract-reference=CalRegn02Rt02GroupBDEotProtnMotSpdIncptYDAAACalRegn02Rt02GroupB_DummyDEotProtnMotSpdIncptY
      AssemblySwConnector_3463: ecu-extract-reference=CalRegn02Rt02GroupBDEotProtnNormDampgYDAAACalRegn02Rt02GroupB_DummyDEotProtnNormDampgY
      AssemblySwConnector_3464: ecu-extract-reference=CalRegn02Rt02GroupBDEotProtnSoftEndStopAuthyThdDAAACalRegn02Rt02GroupB_DummyDEotProtnSoftEndStopAuthyThd
      AssemblySwConnector_3465: ecu-extract-reference=CalRegn02Rt02GroupBDRtnHwAgOffsCalcdXDAAACalRegn02Rt02GroupB_DummyDRtnHwAgOffsCalcdX
      AssemblySwConnector_3466: ecu-extract-reference=CalRegn02Rt02GroupBDRtnHwAgOffsCalcdYDAAACalRegn02Rt02GroupB_DummyDRtnHwAgOffsCalcdY
      AssemblySwConnector_3467: ecu-extract-reference=CalRegn02Rt02GroupBDRtnScaTqXDAAACalRegn02Rt02GroupB_DummyDRtnScaTqX
      AssemblySwConnector_3468: ecu-extract-reference=CalRegn02Rt02GroupBDRtnScaTqYDAAACalRegn02Rt02GroupB_DummyDRtnScaTqY
      AssemblySwConnector_3469: ecu-extract-reference=CalRegn02Rt02GroupBDRtnScaVelXDAAACalRegn02Rt02GroupB_DummyDRtnScaVelX
      AssemblySwConnector_3470: ecu-extract-reference=CalRegn02Rt02GroupBDRtnScaVelYDAAACalRegn02Rt02GroupB_DummyDRtnScaVelY
      AssemblySwConnector_3471: ecu-extract-reference=CalRegn02Rt02GroupBDRtnVehSpdSelnDAAACalRegn02Rt02GroupB_DummyDRtnVehSpdSeln
      AssemblySwConnector_3472: ecu-extract-reference=CalRegn02Rt03GroupBDEotProtnDampgVehSpdTblDAAACalRegn02Rt03GroupB_DummyDEotProtnDampgVehSpdTbl
      AssemblySwConnector_3473: ecu-extract-reference=CalRegn02Rt03GroupBDEotProtnDeltaTqThdDAAACalRegn02Rt03GroupB_DummyDEotProtnDeltaTqThd
      AssemblySwConnector_3474: ecu-extract-reference=CalRegn02Rt03GroupBDEotProtnEntrGainVehSpdTblDAAACalRegn02Rt03GroupB_DummyDEotProtnEntrGainVehSpdTbl
      AssemblySwConnector_3475: ecu-extract-reference=CalRegn02Rt03GroupBDEotProtnEntrGainYDAAACalRegn02Rt03GroupB_DummyDEotProtnEntrGainY
      AssemblySwConnector_3476: ecu-extract-reference=CalRegn02Rt03GroupBDEotProtnLoAuthyEntrGainYDAAACalRegn02Rt03GroupB_DummyDEotProtnLoAuthyEntrGainY
      AssemblySwConnector_3477: ecu-extract-reference=CalRegn02Rt03GroupBDEotProtnMotSpdIncptYDAAACalRegn02Rt03GroupB_DummyDEotProtnMotSpdIncptY
      AssemblySwConnector_3478: ecu-extract-reference=CalRegn02Rt03GroupBDEotProtnNormDampgYDAAACalRegn02Rt03GroupB_DummyDEotProtnNormDampgY
      AssemblySwConnector_3479: ecu-extract-reference=CalRegn02Rt03GroupBDEotProtnSoftEndStopAuthyThdDAAACalRegn02Rt03GroupB_DummyDEotProtnSoftEndStopAuthyThd
      AssemblySwConnector_3480: ecu-extract-reference=CalRegn02Rt03GroupBDRtnHwAgOffsCalcdXDAAACalRegn02Rt03GroupB_DummyDRtnHwAgOffsCalcdX
      AssemblySwConnector_3481: ecu-extract-reference=CalRegn02Rt03GroupBDRtnHwAgOffsCalcdYDAAACalRegn02Rt03GroupB_DummyDRtnHwAgOffsCalcdY
      AssemblySwConnector_3482: ecu-extract-reference=CalRegn02Rt03GroupBDRtnScaTqXDAAACalRegn02Rt03GroupB_DummyDRtnScaTqX
      AssemblySwConnector_3483: ecu-extract-reference=CalRegn02Rt03GroupBDRtnScaTqYDAAACalRegn02Rt03GroupB_DummyDRtnScaTqY
      AssemblySwConnector_3484: ecu-extract-reference=CalRegn02Rt03GroupBDRtnScaVelXDAAACalRegn02Rt03GroupB_DummyDRtnScaVelX
      AssemblySwConnector_3485: ecu-extract-reference=CalRegn02Rt03GroupBDRtnScaVelYDAAACalRegn02Rt03GroupB_DummyDRtnScaVelY
      AssemblySwConnector_3486: ecu-extract-reference=CalRegn02Rt03GroupBDRtnVehSpdSelnDAAACalRegn02Rt03GroupB_DummyDRtnVehSpdSeln
      AssemblySwConnector_3487: ecu-extract-reference=CalRegn02Rt04GroupBDEotProtnDampgVehSpdTblDAAACalRegn02Rt04GroupB_DummyDEotProtnDampgVehSpdTbl
      AssemblySwConnector_3488: ecu-extract-reference=CalRegn02Rt04GroupBDEotProtnDeltaTqThdDAAACalRegn02Rt04GroupB_DummyDEotProtnDeltaTqThd
      AssemblySwConnector_3489: ecu-extract-reference=CalRegn02Rt04GroupBDEotProtnEntrGainVehSpdTblDAAACalRegn02Rt04GroupB_DummyDEotProtnEntrGainVehSpdTbl
      AssemblySwConnector_3490: ecu-extract-reference=CalRegn02Rt04GroupBDEotProtnEntrGainYDAAACalRegn02Rt04GroupB_DummyDEotProtnEntrGainY
      AssemblySwConnector_3491: ecu-extract-reference=CalRegn02Rt04GroupBDEotProtnLoAuthyEntrGainYDAAACalRegn02Rt04GroupB_DummyDEotProtnLoAuthyEntrGainY
      AssemblySwConnector_3492: ecu-extract-reference=CalRegn02Rt04GroupBDEotProtnMotSpdIncptYDAAACalRegn02Rt04GroupB_DummyDEotProtnMotSpdIncptY
      AssemblySwConnector_3493: ecu-extract-reference=CalRegn02Rt04GroupBDEotProtnNormDampgYDAAACalRegn02Rt04GroupB_DummyDEotProtnNormDampgY
      AssemblySwConnector_3494: ecu-extract-reference=CalRegn02Rt04GroupBDEotProtnSoftEndStopAuthyThdDAAACalRegn02Rt04GroupB_DummyDEotProtnSoftEndStopAuthyThd
      AssemblySwConnector_3495: ecu-extract-reference=CalRegn02Rt04GroupBDRtnHwAgOffsCalcdXDAAACalRegn02Rt04GroupB_DummyDRtnHwAgOffsCalcdX
      AssemblySwConnector_3496: ecu-extract-reference=CalRegn02Rt04GroupBDRtnHwAgOffsCalcdYDAAACalRegn02Rt04GroupB_DummyDRtnHwAgOffsCalcdY
      AssemblySwConnector_3497: ecu-extract-reference=CalRegn02Rt04GroupBDRtnScaTqXDAAACalRegn02Rt04GroupB_DummyDRtnScaTqX
      AssemblySwConnector_3498: ecu-extract-reference=CalRegn02Rt04GroupBDRtnScaTqYDAAACalRegn02Rt04GroupB_DummyDRtnScaTqY
      AssemblySwConnector_3499: ecu-extract-reference=CalRegn02Rt04GroupBDRtnScaVelXDAAACalRegn02Rt04GroupB_DummyDRtnScaVelX
      AssemblySwConnector_3500: ecu-extract-reference=CalRegn02Rt04GroupBDRtnScaVelYDAAACalRegn02Rt04GroupB_DummyDRtnScaVelY
      AssemblySwConnector_3501: ecu-extract-reference=CalRegn02Rt04GroupBDRtnVehSpdSelnDAAACalRegn02Rt04GroupB_DummyDRtnVehSpdSeln
      AssemblySwConnector_3502: ecu-extract-reference=CalRegn02Rt05GroupBDEotProtnDampgVehSpdTblDAAACalRegn02Rt05GroupB_DummyDEotProtnDampgVehSpdTbl
      AssemblySwConnector_3503: ecu-extract-reference=CalRegn02Rt05GroupBDEotProtnDeltaTqThdDAAACalRegn02Rt05GroupB_DummyDEotProtnDeltaTqThd
      AssemblySwConnector_3504: ecu-extract-reference=CalRegn02Rt05GroupBDEotProtnEntrGainVehSpdTblDAAACalRegn02Rt05GroupB_DummyDEotProtnEntrGainVehSpdTbl
      AssemblySwConnector_3505: ecu-extract-reference=CalRegn02Rt05GroupBDEotProtnEntrGainYDAAACalRegn02Rt05GroupB_DummyDEotProtnEntrGainY
      AssemblySwConnector_3506: ecu-extract-reference=CalRegn02Rt05GroupBDEotProtnLoAuthyEntrGainYDAAACalRegn02Rt05GroupB_DummyDEotProtnLoAuthyEntrGainY
      AssemblySwConnector_3507: ecu-extract-reference=CalRegn02Rt05GroupBDEotProtnMotSpdIncptYDAAACalRegn02Rt05GroupB_DummyDEotProtnMotSpdIncptY
      AssemblySwConnector_3508: ecu-extract-reference=CalRegn02Rt05GroupBDEotProtnNormDampgYDAAACalRegn02Rt05GroupB_DummyDEotProtnNormDampgY
      AssemblySwConnector_3509: ecu-extract-reference=CalRegn02Rt05GroupBDEotProtnSoftEndStopAuthyThdDAAACalRegn02Rt05GroupB_DummyDEotProtnSoftEndStopAuthyThd
      AssemblySwConnector_3510: ecu-extract-reference=CalRegn02Rt05GroupBDRtnHwAgOffsCalcdXDAAACalRegn02Rt05GroupB_DummyDRtnHwAgOffsCalcdX
      AssemblySwConnector_3511: ecu-extract-reference=CalRegn02Rt05GroupBDRtnHwAgOffsCalcdYDAAACalRegn02Rt05GroupB_DummyDRtnHwAgOffsCalcdY
      AssemblySwConnector_3512: ecu-extract-reference=CalRegn02Rt05GroupBDRtnScaTqXDAAACalRegn02Rt05GroupB_DummyDRtnScaTqX
      AssemblySwConnector_3513: ecu-extract-reference=CalRegn02Rt05GroupBDRtnScaTqYDAAACalRegn02Rt05GroupB_DummyDRtnScaTqY
      AssemblySwConnector_3514: ecu-extract-reference=CalRegn02Rt05GroupBDRtnScaVelXDAAACalRegn02Rt05GroupB_DummyDRtnScaVelX
      AssemblySwConnector_3515: ecu-extract-reference=CalRegn02Rt05GroupBDRtnScaVelYDAAACalRegn02Rt05GroupB_DummyDRtnScaVelY
      AssemblySwConnector_3516: ecu-extract-reference=CalRegn02Rt05GroupBDRtnVehSpdSelnDAAACalRegn02Rt05GroupB_DummyDRtnVehSpdSeln
      AssemblySwConnector_3518: ecu-extract-reference=DiagcMgrDClrLtchCntrDataDCmnMfgSrvDClrLtchCntrData
      AssemblySwConnector_3519: ecu-extract-reference=DiagcMgrDReadLtchCntrDataDCmnMfgSrvDReadLtchCntrData
      AssemblySwConnector_3520: ecu-extract-reference=DiagcMgrDReadSnpshtDataDCmnMfgSrvDReadSnpshtData
      AssemblySwConnector_3521: ecu-extract-reference=ImcSigArbnDPosnServoIntgtrOffsDPosnTrakgServoDPosnServoIntgtrOffs
      AssemblySwConnector_3522: ecu-extract-reference=ImcSigArbnDPosnTrakgArbnFltMtgtnEnaDPosnTrakgServoDPosnTrakgArbnFltMtgtnEna
      AssemblySwConnector_051: ecu-extract-reference=DiagcMgrProxyAppl10DGetNtcActv10DFordHwAgArbnDGetNtcActv
      AssemblySwConnector_067: ecu-extract-reference=HwAgCorrlnDHwAgIdptSigDFordHwAgArbnDHwAgIdptSig
      AssemblySwConnector_068: ecu-extract-reference=FordMsg414BusHiSpdDFordVehSteerPinionAgOffsVldDFordHwAgArbnDFordVehSteerPinionAgOffsVld
      ComponentPrototype_086: upstream-reference=ECU_Composition.FordMsg3D3BusHiSpd, ecu-extract-reference=COMPOSITIONTYPE.FordMsg3D3BusHiSpd
      ComponentPrototype_187: upstream-reference=ECU_Composition.FordMsg213BusHiSpd, ecu-extract-reference=COMPOSITIONTYPE.FordMsg213BusHiSpd
      ComponentPrototype_188: upstream-reference=ECU_Composition.FordMsg091BusHiSpd, ecu-extract-reference=COMPOSITIONTYPE.FordMsg091BusHiSpd
      ComponentPrototype_189: upstream-reference=ECU_Composition.FordMsg083BusHiSpd, ecu-extract-reference=COMPOSITIONTYPE.FordMsg083BusHiSpd
      AssemblySwConnector_069: ecu-extract-reference=CDD_NxtrTiDGetRefTmr100MicroSec32bitDFordMsg083BusHiSpdDGetRefTmr100MicroSec32bit
      AssemblySwConnector_070: ecu-extract-reference=CDD_NxtrTiDGetTiSpan100MicroSec32bitDFordMsg083BusHiSpdDGetTiSpan100MicroSec32bit
      AssemblySwConnector_071: ecu-extract-reference=CDD_NxtrTiDGetRefTmr100MicroSec32bitDFordMsg091BusHiSpdDGetRefTmr100MicroSec32bit
      AssemblySwConnector_072: ecu-extract-reference=CDD_NxtrTiDGetTiSpan100MicroSec32bitDFordMsg091BusHiSpdDGetTiSpan100MicroSec32bit
      AssemblySwConnector_073: ecu-extract-reference=CDD_NxtrTiDGetRefTmr100MicroSec32bitDFordMsg213BusHiSpdDGetRefTmr100MicroSec32bit
      AssemblySwConnector_074: ecu-extract-reference=CDD_NxtrTiDGetTiSpan100MicroSec32bitDFordMsg213BusHiSpdDGetTiSpan100MicroSec32bit
      AssemblySwConnector_075: ecu-extract-reference=CDD_NxtrTiDGetRefTmr100MicroSec32bitDFordMsg3D3BusHiSpdDGetRefTmr100MicroSec32bit
      AssemblySwConnector_076: ecu-extract-reference=CDD_NxtrTiDGetTiSpan100MicroSec32bitDFordMsg3D3BusHiSpdDGetTiSpan100MicroSec32bit
      AssemblySwConnector_077: ecu-extract-reference=CustDiagDFordLaneDprtrWarnEnadDFordMsg083BusHiSpdDFordLaneDetnWarnEnad
      AssemblySwConnector_080: ecu-extract-reference=CustDiagDFordLaneCentrAssiEnadDFordMsg091BusHiSpdDFordLaneCentrAssiEnad
      AssemblySwConnector_081: ecu-extract-reference=CustDiagDFordTrfcJamAssiEnadDFordMsg091BusHiSpdDFordTrfcJamAssiEnad
      AssemblySwConnector_086: ecu-extract-reference=CustDiagDFordBrkOscnRednEnadDFordMsg213BusHiSpdDFordBrkOscnRednEnad
      AssemblySwConnector_087: ecu-extract-reference=CustDiagDFordEvasSteerAssiEnadDFordMsg213BusHiSpdDFordEvasSteerAssiEnad
      AssemblySwConnector_088: ecu-extract-reference=CustDiagDFordLaneCentrAssiEnadDFordMsg213BusHiSpdDFordLaneCentrAssiEnad
      AssemblySwConnector_089: ecu-extract-reference=CustDiagDFordLaneDprtrWarnEnadDFordMsg213BusHiSpdDFordLaneDetnWarnEnad
      AssemblySwConnector_090: ecu-extract-reference=CustDiagDFordLaneKeepAssiEnadDFordMsg213BusHiSpdDFordLkaEnad
      AssemblySwConnector_091: ecu-extract-reference=CustDiagDFordTrfcJamAssiEnadDFordMsg213BusHiSpdDFordTrfcJamAssiEnad
      AssemblySwConnector_092: ecu-extract-reference=CustDiagDFordLaneCentrAssiEnadDFordMsg3D3BusHiSpdDFordLaneCentrAssiEnad
      AssemblySwConnector_093: ecu-extract-reference=CustDiagDFordTrfcJamAssiEnadDFordMsg3D3BusHiSpdDFordTrfcJamAssiEnad
      AssemblySwConnector_094: ecu-extract-reference=DiagcMgrDClrDiagcFlgProxyDFordMsg083BusHiSpdDClrDiagcFlgProxy
      AssemblySwConnector_095: ecu-extract-reference=DiagcMgrDClrDiagcFlgProxyDFordMsg091BusHiSpdDClrDiagcFlgProxy
      AssemblySwConnector_096: ecu-extract-reference=DiagcMgrDClrDiagcFlgProxyDFordMsg213BusHiSpdDClrDiagcFlgProxy
      AssemblySwConnector_097: ecu-extract-reference=DiagcMgrDClrDiagcFlgProxyDFordMsg3D3BusHiSpdDClrDiagcFlgProxy
      AssemblySwConnector_098: ecu-extract-reference=DiagcMgrProxyAppl10DSetNtcSts10DFordMsg083BusHiSpdDSetNtcSts
      AssemblySwConnector_099: ecu-extract-reference=DiagcMgrProxyAppl10DSetNtcSts10DFordMsg091BusHiSpdDSetNtcSts
      AssemblySwConnector_100: ecu-extract-reference=DiagcMgrProxyAppl10DSetNtcSts10DFordMsg213BusHiSpdDSetNtcSts
      AssemblySwConnector_101: ecu-extract-reference=DiagcMgrProxyAppl10DSetNtcSts10DFordMsg3D3BusHiSpdDSetNtcSts
      AssemblySwConnector_102: ecu-extract-reference=FltInjDFltInj_f32DCDD_HwTq1MeasDFltInj_f32
      AssemblySwConnector_103: ecu-extract-reference=FordCanDtcInhbDFordEpsLifeCycModDFordMsg083BusHiSpdDFordEpsLifeCycMod
      AssemblySwConnector_104: ecu-extract-reference=FordCanDtcInhbDFordEpsLifeCycModDFordMsg091BusHiSpdDFordEpsLifeCycMod
      AssemblySwConnector_105: ecu-extract-reference=FordCanDtcInhbDFordEpsLifeCycModDFordMsg213BusHiSpdDFordEpsLifeCycMod
      AssemblySwConnector_106: ecu-extract-reference=FordCanDtcInhbDFordEpsLifeCycModDFordMsg3D3BusHiSpdDFordEpsLifeCycMod
      AssemblySwConnector_107: ecu-extract-reference=FordMsg091BusHiSpdDFordVehYawRateDVehSigCdngDVehYawRateSerlCom
      AssemblySwConnector_108: ecu-extract-reference=FordMsg091BusHiSpdDFordVehYawRateRawVldDVehSigCdngDVehYawRateVldSerlCom
      DelegationSwConnector_057: ecu-extract-reference=Ford_AbsActv_B_ActlDDFordMsg213BusHiSpdDFord_AbsActv_B_Actl
      DelegationSwConnector_058: ecu-extract-reference=Ford_CmbbBrkDis_B_ActlDDFordMsg213BusHiSpdDFord_CmbbBrkDis_B_Actl
      DelegationSwConnector_059: ecu-extract-reference=Ford_CmbbDeny_B_ActlBrkDDFordMsg213BusHiSpdDFord_CmbbDeny_B_ActlBrk
      DelegationSwConnector_060: ecu-extract-reference=Ford_HandsOffCnfm_B_RqDDFordMsg3D3BusHiSpdDFord_HandsOffCnfm_B_Rq
      DelegationSwConnector_061: ecu-extract-reference=Ford_LatCtl_D_RqDDFordMsg3D3BusHiSpdDFord_LatCtl_D_Rq
      DelegationSwConnector_062: ecu-extract-reference=Ford_LatCtlPrecision_D_RqDDFordMsg3D3BusHiSpdDFord_LatCtlPrecision_D_Rq
      DelegationSwConnector_063: ecu-extract-reference=Ford_LatCtlRampType_D_RqDDFordMsg3D3BusHiSpdDFord_LatCtlRampType_D_Rq
      DelegationSwConnector_064: ecu-extract-reference=Ford_TurnLghtSwtch_D_StatDDFordMsg083BusHiSpdDFord_TurnLghtSwtch_D_Stat
      DelegationSwConnector_065: ecu-extract-reference=Ford_VehYaw_W_ActlDDFordMsg091BusHiSpdDFord_VehYaw_W_Actl
      ComponentPrototype_190: upstream-reference=ECU_Composition.FordMsg443BusHiSpd, ecu-extract-reference=COMPOSITIONTYPE.FordMsg443BusHiSpd
      AssemblySwConnector_109: ecu-extract-reference=CalRegn01CmnDFordMsg083BusHiSpdFordVehTurnSigVldThdDFordMsg083BusHiSpdDFordMsg083BusHiSpdFordVehTurnSigVldThd
      AssemblySwConnector_110: ecu-extract-reference=CalRegn01CmnDFordMsg083BusHiSpdMissMsgFaildThdDFordMsg083BusHiSpdDFordMsg083BusHiSpdMissMsgFaildThd
      AssemblySwConnector_130: ecu-extract-reference=CalRegn01CmnDFordMsg083BusHiSpdMissMsgPassdThdDFordMsg083BusHiSpdDFordMsg083BusHiSpdMissMsgPassdThd
      AssemblySwConnector_131: ecu-extract-reference=CalRegn01CmnDFordMsg083BusHiSpdVehTurnSigVldMissMsgThdDFordMsg083BusHiSpdDFordMsg083BusHiSpdVehTurnSigVldMissMsgThd
      AssemblySwConnector_132: ecu-extract-reference=CalRegn01CmnDFordMsg091BusHiSpdInvldMsgFaildThdDFordMsg091BusHiSpdDFordMsg091BusHiSpdInvldMsgFaildThd
      AssemblySwConnector_133: ecu-extract-reference=CalRegn01CmnDFordMsg091BusHiSpdInvldMsgPassdThdDFordMsg091BusHiSpdDFordMsg091BusHiSpdInvldMsgPassdThd
      AssemblySwConnector_134: ecu-extract-reference=CalRegn01CmnDFordMsg091BusHiSpdMissMsgFaildThdDFordMsg091BusHiSpdDFordMsg091BusHiSpdMissMsgFaildThd
      AssemblySwConnector_135: ecu-extract-reference=CalRegn01CmnDFordMsg091BusHiSpdMissMsgPassdThdDFordMsg091BusHiSpdDFordMsg091BusHiSpdMissMsgPassdThd
      AssemblySwConnector_136: ecu-extract-reference=CalRegn01CmnDFordMsg091BusHiSpdYawRateRawVldMissFaildThdDFordMsg091BusHiSpdDFordMsg091BusHiSpdYawRateRawVldMissFaildThd
      AssemblySwConnector_137: ecu-extract-reference=CalRegn01CmnDFordMsg091BusHiSpdYawRateRawVldSigFaildThdDFordMsg091BusHiSpdDFordMsg091BusHiSpdYawRateRawVldSigFaildThd
      AssemblySwConnector_138: ecu-extract-reference=CalRegn01CmnDFordMsg091BusHiSpdYawRateRawVldSigPassdThdDFordMsg091BusHiSpdDFordMsg091BusHiSpdYawRateRawVldSigPassdThd
      AssemblySwConnector_139: ecu-extract-reference=CalRegn01CmnDFordMsg213BusHiSpdAbsActvVldFaildThdDFordMsg213BusHiSpdDFordMsg213BusHiSpdAbsActvVldFaildThd
      AssemblySwConnector_140: ecu-extract-reference=CalRegn01CmnDFordMsg213BusHiSpdAbsActvVldPassdThdDFordMsg213BusHiSpdDFordMsg213BusHiSpdAbsActvVldPassdThd
      AssemblySwConnector_141: ecu-extract-reference=CalRegn01CmnDFordMsg213BusHiSpdEvasSteerAssiEnadThdDFordMsg213BusHiSpdDFordMsg213BusHiSpdEvasSteerAssiEnadThd
      AssemblySwConnector_142: ecu-extract-reference=CalRegn01CmnDFordMsg213BusHiSpdMissMsgFaildThdDFordMsg213BusHiSpdDFordMsg213BusHiSpdMissMsgFaildThd
      AssemblySwConnector_143: ecu-extract-reference=CalRegn01CmnDFordMsg213BusHiSpdMissMsgPassdThdDFordMsg213BusHiSpdDFordMsg213BusHiSpdMissMsgPassdThd
      AssemblySwConnector_144: ecu-extract-reference=CalRegn01CmnDFordMsg3D3BusHiSpdImgProcrModlAVldFaildThdDFordMsg3D3BusHiSpdDFordMsg3D3BusHiSpdImgProcrModlAVldFaildThd
      AssemblySwConnector_145: ecu-extract-reference=CalRegn01CmnDFordMsg3D3BusHiSpdImgProcrModlAVldPassdThdDFordMsg3D3BusHiSpdDFordMsg3D3BusHiSpdImgProcrModlAVldPassdThd
      AssemblySwConnector_146: ecu-extract-reference=CalRegn01CmnDFordMsg3D3BusHiSpdMissMsgFaildThdDFordMsg3D3BusHiSpdDFordMsg3D3BusHiSpdMissMsgFaildThd
      AssemblySwConnector_147: ecu-extract-reference=CalRegn01CmnDFordMsg3D3BusHiSpdMissMsgPassdThdDFordMsg3D3BusHiSpdDFordMsg3D3BusHiSpdMissMsgPassdThd
      AssemblySwConnector_162: ecu-extract-reference=CalRegn01CmnDFordMsg414BusHiSpdChksVldFaildThdDFordMsg414BusHiSpdDFordMsg414BusHiSpdChksVldFaildThd
      AssemblySwConnector_163: ecu-extract-reference=CalRegn01CmnDFordMsg414BusHiSpdChksVldMissThdDFordMsg414BusHiSpdDFordMsg414BusHiSpdChksVldMissThd
      AssemblySwConnector_164: ecu-extract-reference=CalRegn01CmnDFordMsg414BusHiSpdCntrVldMissThdDFordMsg414BusHiSpdDFordMsg414BusHiSpdCntrVldMissThd
      AssemblySwConnector_165: ecu-extract-reference=CalRegn01CmnDFordMsg443BusHiSpdMissMsgFaildThdDFordMsg443BusHiSpdDFordMsg443BusHiSpdMissMsgFaildThd
      AssemblySwConnector_166: ecu-extract-reference=CalRegn01CmnDFordMsg443BusHiSpdMissMsgPassdThdDFordMsg443BusHiSpdDFordMsg443BusHiSpdMissMsgPassdThd
      AssemblySwConnector_167: ecu-extract-reference=CalRegn01CmnDNxtrCalIdsCal0DevlpDescDNxtrCalIdsDNxtrCalIdsCal0DevlpDescr
      AssemblySwConnector_168: ecu-extract-reference=CalRegn01CmnDNxtrCalIdsCal2DevlpDescDNxtrCalIdsDNxtrCalIdsCal2DevlpDescr
      AssemblySwConnector_169: ecu-extract-reference=CDD_NxtrTiDGetRefTmr100MicroSec32bitDFordMsg443BusHiSpdDGetRefTmr100MicroSec32bit
      AssemblySwConnector_170: ecu-extract-reference=CDD_NxtrTiDGetTiSpan100MicroSec32bitDFordMsg443BusHiSpdDGetTiSpan100MicroSec32bit
      AssemblySwConnector_172: ecu-extract-reference=DiagcMgrDClrDiagcFlgProxyDFordMsg443BusHiSpdDClrDiagcFlgProxy
      AssemblySwConnector_173: ecu-extract-reference=DiagcMgrProxyAppl10DSetNtcSts10DFordMsg443BusHiSpdDSetNtcSts
      AssemblySwConnector_174: ecu-extract-reference=FordCanDtcInhbDFordEpsLifeCycModDFordMsg443BusHiSpdDFordEpsLifeCycMod
      DelegationSwConnector_066: ecu-extract-reference=Ford_TrlrLampCnnct_B_ActlDDFordMsg443BusHiSpdDFord_TrlrLampCnnct_B_Actl1
      ComponentPrototype_191: upstream-reference=ECU_Composition.FordMsg3CCBusHiSpd, ecu-extract-reference=COMPOSITIONTYPE.FordMsg3CCBusHiSpd
      ComponentPrototype_192: upstream-reference=ECU_Composition.FordMsg3CABusHiSpd, ecu-extract-reference=COMPOSITIONTYPE.FordMsg3CABusHiSpd
      ComponentPrototype_193: upstream-reference=ECU_Composition.FordMsg07DBusHiSpd, ecu-extract-reference=COMPOSITIONTYPE.FordMsg07DBusHiSpd
      AssemblySwConnector_175: ecu-extract-reference=CalRegn01CmnDFordMsg07DBusHiSpdActBrkTqSigInvldPassdThdDFordMsg07DBusHiSpdDFordMsg07DBusHiSpdActBrkTqSigInvldPassdThd
      AssemblySwConnector_176: ecu-extract-reference=CalRegn01CmnDFordMsg07DBusHiSpdFordVehActBrkTqInvldThdDFordMsg07DBusHiSpdDFordMsg07DBusHiSpdFordVehActBrkTqInvldThd
      AssemblySwConnector_177: ecu-extract-reference=CalRegn01CmnDFordMsg07DBusHiSpdFordVehActBrkTqVldThdDFordMsg07DBusHiSpdDFordMsg07DBusHiSpdFordVehActBrkTqVldThd
      AssemblySwConnector_178: ecu-extract-reference=CalRegn01CmnDFordMsg07DBusHiSpdFordVehBrkTqVldMissMsgThdDFordMsg07DBusHiSpdDFordMsg07DBusHiSpdFordVehBrkTqVldMissMsgThd
      AssemblySwConnector_179: ecu-extract-reference=CalRegn01CmnDFordMsg07DBusHiSpdFordVehVertACmpdSigInvldThdDFordMsg07DBusHiSpdDFordMsg07DBusHiSpdFordVehVertACmpdSigInvldThd
      AssemblySwConnector_180: ecu-extract-reference=CalRegn01CmnDFordMsg07DBusHiSpdFordVehVertACmpdSigVldThdDFordMsg07DBusHiSpdDFordMsg07DBusHiSpdFordVehVertACmpdSigVldThd
      AssemblySwConnector_181: ecu-extract-reference=CalRegn01CmnDFordMsg07DBusHiSpdFordVehVertAVldMissMsgThdDFordMsg07DBusHiSpdDFordMsg07DBusHiSpdFordVehVertAVldMissMsgThd
      AssemblySwConnector_182: ecu-extract-reference=CalRegn01CmnDFordMsg07DBusHiSpdMissMsgFaildThdDFordMsg07DBusHiSpdDFordMsg07DBusHiSpdMissMsgFaildThd
      AssemblySwConnector_183: ecu-extract-reference=CalRegn01CmnDFordMsg07DBusHiSpdMissMsgPassdThdDFordMsg07DBusHiSpdDFordMsg07DBusHiSpdMissMsgPassdThd
      AssemblySwConnector_184: ecu-extract-reference=CalRegn01CmnDFordMsg07DBusHiSpdVehActTqBrkInvldFaildThdDFordMsg07DBusHiSpdDFordMsg07DBusHiSpdVehActTqBrkInvldFaildThd
      AssemblySwConnector_185: ecu-extract-reference=CalRegn01CmnDFordMsg07DBusHiSpdVertACmpdSigInvldFaildThdDFordMsg07DBusHiSpdDFordMsg07DBusHiSpdVertACmpdSigInvldFaildThd
      AssemblySwConnector_186: ecu-extract-reference=CalRegn01CmnDFordMsg07DBusHiSpdVertACmpdSigInvldPassdThdDFordMsg07DBusHiSpdDFordMsg07DBusHiSpdVertACmpdSigInvldPassdThd
      AssemblySwConnector_187: ecu-extract-reference=CalRegn01CmnDFordMsg3CABusHiSpdLaneAssiImgProcgModlAFaildCrvtTiThdDFordMsg3CABusHiSpdDFordMsg3CABusHiSpdLaneAssiImgPr_f29e4e37
      AssemblySwConnector_188: ecu-extract-reference=CalRegn01CmnDFordMsg3CABusHiSpdLaneAssiImgProcgModlAFaildReqdAgTiThdDFordMsg3CABusHiSpdDFordMsg3CABusHiSpdLaneAssiImg_4e6ebd02
      AssemblySwConnector_189: ecu-extract-reference=CalRegn01CmnDFordMsg3CABusHiSpdLaneAssiImgProcgModlAPassdTiThdDFordMsg3CABusHiSpdDFordMsg3CABusHiSpdLaneAssiImgProcgM_4f42a0a7
      AssemblySwConnector_190: ecu-extract-reference=CalRegn01CmnDFordMsg3CABusHiSpdLaneAssiImgProcgModlAVldMissTiThdDFordMsg3CABusHiSpdDFordMsg3CABusHiSpdLaneAssiImgProc_ca7fbe14
      AssemblySwConnector_191: ecu-extract-reference=CalRegn01CmnDFordMsg3CABusHiSpdLaneKeepSysCrvtInvldFaildTiThdDFordMsg3CABusHiSpdDFordMsg3CABusHiSpdLaneKeepSysCrvtInv_47a8e500
      AssemblySwConnector_192: ecu-extract-reference=CalRegn01CmnDFordMsg3CABusHiSpdLaneKeepSysCrvtInvldPassdTiThdDFordMsg3CABusHiSpdDFordMsg3CABusHiSpdLaneKeepSysCrvtInv_8d769229
      AssemblySwConnector_193: ecu-extract-reference=CalRegn01CmnDFordMsg3CABusHiSpdLaneKeepSysReqdAgInvldFaildTiThdDFordMsg3CABusHiSpdDFordMsg3CABusHiSpdLaneKeepSysReqdA_dd9fa22c
      AssemblySwConnector_194: ecu-extract-reference=CalRegn01CmnDFordMsg3CABusHiSpdLaneKeepSysReqdAgInvldPassdTiThdDFordMsg3CABusHiSpdDFordMsg3CABusHiSpdLaneKeepSysReqdA_ed24d5c6
      AssemblySwConnector_195: ecu-extract-reference=CalRegn01CmnDFordMsg3CABusHiSpdMissMsgFaildTiThdDFordMsg3CABusHiSpdDFordMsg3CABusHiSpdMissMsgFaildTiThd
      AssemblySwConnector_197: ecu-extract-reference=CalRegn01CmnDFordMsg3CABusHiSpdMissMsgPassdTiThdDFordMsg3CABusHiSpdDFordMsg3CABusHiSpdMissMsgPassdTiThd
      AssemblySwConnector_198: ecu-extract-reference=CDD_NxtrTiDGetRefTmr100MicroSec32bitDFordMsg07DBusHiSpdDGetRefTmr100MicroSec32bit
      AssemblySwConnector_199: ecu-extract-reference=CDD_NxtrTiDGetTiSpan100MicroSec32bitDFordMsg07DBusHiSpdDGetTiSpan100MicroSec32bit
      AssemblySwConnector_200: ecu-extract-reference=CDD_NxtrTiDGetRefTmr100MicroSec32bitDFordMsg3CABusHiSpdDGetRefTmr100MicroSec32bit
      AssemblySwConnector_201: ecu-extract-reference=CDD_NxtrTiDGetTiSpan100MicroSec32bitDFordMsg3CABusHiSpdDGetTiSpan100MicroSec32bit
      AssemblySwConnector_202: ecu-extract-reference=CustDiagDFordBrkOscnRednEnadDFordMsg07DBusHiSpdDFordBrkOscnRednEnad
      AssemblySwConnector_204: ecu-extract-reference=CustDiagDFordLaneDprtrWarnEnadDFordMsg3CABusHiSpdDFordLaneDetnWarnEnad
      AssemblySwConnector_205: ecu-extract-reference=CustDiagDFordLaneKeepAssiEnadDFordMsg3CABusHiSpdDFordLaneKeepAssiEnad
      AssemblySwConnector_206: ecu-extract-reference=DiagcMgrDClrDiagcFlgProxyDFordMsg07DBusHiSpdDClrDiagcFlgProxy
      AssemblySwConnector_207: ecu-extract-reference=DiagcMgrDClrDiagcFlgProxyDFordMsg3CABusHiSpdDClrDiagcFlgProxy
      AssemblySwConnector_208: ecu-extract-reference=DiagcMgrProxyAppl10DSetNtcSts10DFordMsg07DBusHiSpdDSetNtcSts
      AssemblySwConnector_209: ecu-extract-reference=DiagcMgrProxyAppl10DSetNtcSts10DFordMsg3CABusHiSpdDSetNtcSts
      AssemblySwConnector_210: ecu-extract-reference=FordCanDtcInhbDFordEpsLifeCycModDFordMsg07DBusHiSpdDFordEpsLifeCycMod
      AssemblySwConnector_211: ecu-extract-reference=FordCanDtcInhbDFordEpsLifeCycModDFordMsg3CABusHiSpdDFordEpsLifeCycMod
      DelegationSwConnector_067: ecu-extract-reference=Ford_BrkTot_Tq_ActlDDFordMsg07DBusHiSpdDFord_BrkTot_Tq_Actl
      DelegationSwConnector_068: ecu-extract-reference=Ford_LaActAvail_D_ActlDDFordMsg3CCBusHiSpdDFord_LaActAvail_D_Actl
      DelegationSwConnector_069: ecu-extract-reference=Ford_LaActDeny_B_ActlDDFordMsg3CCBusHiSpdDFord_LaActDeny_B_Actl
      DelegationSwConnector_070: ecu-extract-reference=Ford_LaHandsOff_B_ActlDDFordMsg3CCBusHiSpdDFord_LaHandsOff_B_Actl
      DelegationSwConnector_071: ecu-extract-reference=Ford_LaRampType_B_ReqDDFordMsg3CABusHiSpdDFord_LaRampType_B_Req
      DelegationSwConnector_072: ecu-extract-reference=Ford_LdwActvIntns_D_ReqDDFordMsg3CABusHiSpdDFord_LdwActvIntns_D_Req
      DelegationSwConnector_073: ecu-extract-reference=Ford_LdwActvStats_D_ReqDDFordMsg3CABusHiSpdDFord_LdwActvStats_D_Req
      DelegationSwConnector_074: ecu-extract-reference=Ford_LkaActvStats_D2_ReqDDFordMsg3CABusHiSpdDFord_LkaActvStats_D2_Req
      DelegationSwConnector_075: ecu-extract-reference=Ford_LsmcBrk_Tq_RqDDFordMsg3CCBusHiSpdDFord_LsmcBrk_Tq_Rq
      DelegationSwConnector_076: ecu-extract-reference=Ford_LsmcBrkDecelEnbl_D_RqDDFordMsg3CCBusHiSpdDFord_LsmcBrkDecelEnbl_D_Rq
      DelegationSwConnector_077: ecu-extract-reference=Ford_TjaHandsOnCnfdnc_B_EstDDFordMsg3CCBusHiSpdDFord_TjaHandsOnCnfdnc_B_Est
      DelegationSwConnector_078: ecu-extract-reference=Ford_TrlrAn_An_TrgtCalcDDFordMsg3CCBusHiSpdDFord_TrlrAn_An_TrgtCalc
      DelegationSwConnector_079: ecu-extract-reference=Ford_VehVertComp_A_ActlDDFordMsg07DBusHiSpdDFord_VehVertComp_A_Actl
      ComponentPrototype_194: upstream-reference=ECU_Composition.CDD_FordBlaBoxIfCmp2, ecu-extract-reference=COMPOSITIONTYPE.CDD_FordBlaBoxIfCmp2
      ComponentPrototype_195: upstream-reference=ECU_Composition.CDD_FordBlaBoxIfCmp1, ecu-extract-reference=COMPOSITIONTYPE.CDD_FordBlaBoxIfCmp1
      ComponentPrototype_196: upstream-reference=ECU_Composition.CDD_FordBlaBoxIfCmn, ecu-extract-reference=COMPOSITIONTYPE.CDD_FordBlaBoxIfCmn
      AssemblySwConnector_212: ecu-extract-reference=CDD_FordBlaBoxIfCmp1DFordVehVelMaxReqTrlrAidDFordMsg082BusHiSpdDFordVehVelMaxReqTrlrAid
      AssemblySwConnector_213: ecu-extract-reference=CDD_FordBlaBoxIfCmp1DFordVehLaneAssiAvlDFordMsg3CCBusHiSpdDFordVehLaneAssiAvl
      AssemblySwConnector_214: ecu-extract-reference=CDD_FordBlaBoxIfCmp1DFordVehLaneAssiHandsOffDFordMsg3CCBusHiSpdDFordVehLaneAssiHandsOff
      AssemblySwConnector_215: ecu-extract-reference=CDD_FordBlaBoxIfCmp1DFordVehLaneAssiRejctnDFordMsg3CCBusHiSpdDFordVehLaneAssiRejctn
      AssemblySwConnector_217: ecu-extract-reference=CDD_FordBlaBoxIfCmp1DFordVehTrfcJamAvdHandsOnConfDFordMsg3CCBusHiSpdDFordVehTrfcJamAvdHandsOnConf
      AssemblySwConnector_218: ecu-extract-reference=CDD_FordBlaBoxIfCmp1DFordVehTrlrAgTarCalcnDFordMsg3CCBusHiSpdDFordVehTrlrAgTarCalcn
      AssemblySwConnector_219: ecu-extract-reference=DualEcuIdnDEcuIdDCDD_FordBlaBoxIfCmnDEcuId
      AssemblySwConnector_220: ecu-extract-reference=DualEcuIdnDEcuIdDCDD_FordBlaBoxIfCmp1DEcuId
      AssemblySwConnector_221: ecu-extract-reference=DualEcuIdnDEcuIdDCDD_FordBlaBoxIfCmp2DEcuId
      ComponentPrototype_197: upstream-reference=ECU_Composition.FordMsg230BusHiSpd, ecu-extract-reference=COMPOSITIONTYPE.FordMsg230BusHiSpd
      AssemblySwConnector_222: ecu-extract-reference=CalRegn01CmnDFordMsg230BusHiSpdFordVehGearLvrPosnFaildTiThdDFordMsg230BusHiSpdDFordMsg230BusHiSpdFordVehGearLvrPosnFaildTiThd
      AssemblySwConnector_223: ecu-extract-reference=CalRegn01CmnDFordMsg230BusHiSpdFordVehGearLvrPosnPassdTiThdDFordMsg230BusHiSpdDFordMsg230BusHiSpdFordVehGearLvrPosnPassdTiThd
      AssemblySwConnector_224: ecu-extract-reference=CalRegn01CmnDFordMsg230BusHiSpdGearLvrPosnMissTiThdDFordMsg230BusHiSpdDFordMsg230BusHiSpdGearLvrPosnMissTiThd
      AssemblySwConnector_225: ecu-extract-reference=CalRegn01CmnDFordMsg230BusHiSpdInvldSigFaildThdDFordMsg230BusHiSpdDFordMsg230BusHiSpdInvldSigFaildThd
      AssemblySwConnector_226: ecu-extract-reference=CalRegn01CmnDFordMsg230BusHiSpdInvldSigPassdThdDFordMsg230BusHiSpdDFordMsg230BusHiSpdInvldSigPassdThd
      AssemblySwConnector_227: ecu-extract-reference=CalRegn01CmnDFordMsg230BusHiSpdMissMsgFaildThdDFordMsg230BusHiSpdDFordMsg230BusHiSpdMissMsgFaildThd
      AssemblySwConnector_228: ecu-extract-reference=CalRegn01CmnDFordMsg230BusHiSpdMissMsgPassdThdDFordMsg230BusHiSpdDFordMsg230BusHiSpdMissMsgPassdThd
      AssemblySwConnector_229: ecu-extract-reference=CDD_NxtrTiDGetRefTmr100MicroSec32bitDFordMsg230BusHiSpdDGetRefTmr100MicroSec32bit
      AssemblySwConnector_231: ecu-extract-reference=CDD_NxtrTiDGetTiSpan100MicroSec32bitDFordMsg230BusHiSpdDGetTiSpan100MicroSec32bit
      AssemblySwConnector_234: ecu-extract-reference=DiagcMgrDClrDiagcFlgProxyDFordMsg230BusHiSpdDClrDiagcFlgProxy
      AssemblySwConnector_265: ecu-extract-reference=DiagcMgrProxyAppl10DSetNtcSts10DFordMsg230BusHiSpdDSetNtcSts
      AssemblySwConnector_266: ecu-extract-reference=FordCanDtcInhbDFordEpsLifeCycModDFordMsg230BusHiSpdDFordEpsLifeCycMod
      DelegationSwConnector_080: ecu-extract-reference=Ford_GearLvrPos_D_ActlDDFordMsg230BusHiSpdDFord_GearLvrPos_D_Actl
      AssemblySwConnector_267: ecu-extract-reference=CDD_FordBlaBoxIfCmp1DFordVehLoSpdMtnCtrlBrkDecelEnaReqDFordMsg3CCBusHiSpdDFordVehLoSpdMtnCtrlBrkDecelEna
      ComponentPrototype_198: upstream-reference=ECU_Composition.FordMsg216BusHiSpd, ecu-extract-reference=COMPOSITIONTYPE.FordMsg216BusHiSpd
      AssemblySwConnector_268: ecu-extract-reference=CalRegn01CmnDFordMsg216BusHiSpdFrntLeWhlCntrDirFaildTiThdDFordMsg216BusHiSpdDFordMsg216BusHiSpdFrntLeWhlCntrDirFaildTiThd
      AssemblySwConnector_269: ecu-extract-reference=CalRegn01CmnDFordMsg216BusHiSpdFrntLeWhlCntrDirPassdTiThdDFordMsg216BusHiSpdDFordMsg216BusHiSpdFrntLeWhlCntrDirPassdTiThd
      AssemblySwConnector_270: ecu-extract-reference=CalRegn01CmnDFordMsg216BusHiSpdFrntLeWhlVldMissMsgThdDFordMsg216BusHiSpdDFordMsg216BusHiSpdFrntLeWhlVldMissMsgThd
      AssemblySwConnector_271: ecu-extract-reference=CalRegn01CmnDFordMsg216BusHiSpdFrntRiWhlCntrDirFaildTiThdDFordMsg216BusHiSpdDFordMsg216BusHiSpdFrntRiWhlCntrDirFaildTiThd
      AssemblySwConnector_272: ecu-extract-reference=CalRegn01CmnDFordMsg216BusHiSpdFrntRiWhlCntrDirPassdTiThdDFordMsg216BusHiSpdDFordMsg216BusHiSpdFrntRiWhlCntrDirPassdTiThd
      AssemblySwConnector_273: ecu-extract-reference=CalRegn01CmnDFordMsg216BusHiSpdFrntRiWhlVldMissMsgThdDFordMsg216BusHiSpdDFordMsg216BusHiSpdFrntRiWhlVldMissMsgThd
      AssemblySwConnector_274: ecu-extract-reference=CalRegn01CmnDFordMsg216BusHiSpdMissMsgFaildTiThdDFordMsg216BusHiSpdDFordMsg216BusHiSpdMissMsgFaildTiThd
      AssemblySwConnector_275: ecu-extract-reference=CalRegn01CmnDFordMsg216BusHiSpdMissMsgPassdTiThdDFordMsg216BusHiSpdDFordMsg216BusHiSpdMissMsgPassdTiThd
      AssemblySwConnector_276: ecu-extract-reference=CalRegn01CmnDFordMsg216BusHiSpdReLeWhlCntrDirFaildTiThdDFordMsg216BusHiSpdDFordMsg216BusHiSpdReLeWhlCntrDirFaildTiThd
      AssemblySwConnector_277: ecu-extract-reference=CalRegn01CmnDFordMsg216BusHiSpdReLeWhlCntrDirPassdTiThdDFordMsg216BusHiSpdDFordMsg216BusHiSpdReLeWhlCntrDirPassdTiThd
      AssemblySwConnector_278: ecu-extract-reference=CalRegn01CmnDFordMsg216BusHiSpdReLeWhlVldMissMsgThdDFordMsg216BusHiSpdDFordMsg216BusHiSpdReLeWhlVldMissMsgThd
      AssemblySwConnector_279: ecu-extract-reference=CalRegn01CmnDFordMsg216BusHiSpdReRiWhlCntrDirFaildTiThdDFordMsg216BusHiSpdDFordMsg216BusHiSpdReRiWhlCntrDirFaildTiThd
      AssemblySwConnector_280: ecu-extract-reference=CalRegn01CmnDFordMsg216BusHiSpdReRiWhlCntrDirPassdTiThdDFordMsg216BusHiSpdDFordMsg216BusHiSpdReRiWhlCntrDirPassdTiThd
      AssemblySwConnector_281: ecu-extract-reference=CalRegn01CmnDFordMsg216BusHiSpdReRiWhlVldMissMsgThdDFordMsg216BusHiSpdDFordMsg216BusHiSpdReRiWhlVldMissMsgThd
      AssemblySwConnector_290: ecu-extract-reference=CalRegn02CmnDFordBlaBoxIfCmnVehSteerRatDCDD_FordBlaBoxIfCmnDFordBlaBoxIfCmnVehSteerRat
      AssemblySwConnector_291: ecu-extract-reference=CalRegn02CmnDFordBlaBoxIfCmnVehWhlBasDCDD_FordBlaBoxIfCmnDFordBlaBoxIfCmnVehWhlBas
      AssemblySwConnector_292: ecu-extract-reference=CDD_NxtrTiDGetRefTmr100MicroSec32bitDFordMsg216BusHiSpdDGetRefTmr100MicroSec32bit
      AssemblySwConnector_293: ecu-extract-reference=CDD_NxtrTiDGetTiSpan100MicroSec32bitDFordMsg216BusHiSpdDGetTiSpan100MicroSec32bit
      AssemblySwConnector_296: ecu-extract-reference=CustDiagDFordEngTqClassDCDD_FordBlaBoxIfCmnDEngTqClass
      AssemblySwConnector_298: ecu-extract-reference=CustDiagDFordActvNiblCtrlEnadDCDD_FordBlaBoxIfCmnDFordActvNiblCtrlEnad
      AssemblySwConnector_300: ecu-extract-reference=CustDiagDFordEvasSteerAssiEnadDCDD_FordBlaBoxIfCmnDFordEvasSteerAssiEnad
      AssemblySwConnector_301: ecu-extract-reference=CustDiagDFordLaneCentrAssiEnadDCDD_FordBlaBoxIfCmnDFordLaneCentrAssiEnad
      AssemblySwConnector_302: ecu-extract-reference=CustDiagDFordLaneDprtrWarnEnadDCDD_FordBlaBoxIfCmnDFordLaneDprtrWarnEnad
      AssemblySwConnector_303: ecu-extract-reference=CustDiagDFordLaneKeepAssiEnadDCDD_FordBlaBoxIfCmnDFordLaneKeepAssiEnad
      AssemblySwConnector_304: ecu-extract-reference=CustDiagDFordTqSteerCmpEnadDCDD_FordBlaBoxIfCmnDFordTqSteerCmpEnad
      AssemblySwConnector_305: ecu-extract-reference=CustDiagDFordTrfcJamAssiEnadDCDD_FordBlaBoxIfCmnDFordTrfcJamAssiEnad
      AssemblySwConnector_321: ecu-extract-reference=CustDiagDFordBrkOscnRednEnadDFordMsg216BusHiSpdDFordBrkOscnRednEnad
      AssemblySwConnector_335: ecu-extract-reference=CustDiagDFordTqSteerCmpEnadDFordMsg216BusHiSpdDFordTqSteerCmpEnad
      AssemblySwConnector_337: ecu-extract-reference=DiagcMgrDClrDiagcFlgProxyDFordMsg216BusHiSpdDClrDiagcFlgProxy
      AssemblySwConnector_338: ecu-extract-reference=DiagcMgrProxyAppl10DSetNtcSts10DFordMsg216BusHiSpdDSetNtcSts
      AssemblySwConnector_339: ecu-extract-reference=FordCanDtcInhbDFordEpsLifeCycModDFordMsg216BusHiSpdDFordEpsLifeCycMod
      AssemblySwConnector_340: ecu-extract-reference=FordHwAgArbnDFordCmpdHwPosnDCDD_FordBlaBoxIfCmnDFordCmpdHwPosn
      AssemblySwConnector_341: ecu-extract-reference=FordHwAgArbnDFordHwVelVldDCDD_FordBlaBoxIfCmnDFordHwVelVld
      AssemblySwConnector_342: ecu-extract-reference=FordHwAgArbnDFordRelHwPosnDCDD_FordBlaBoxIfCmnDFordRelHwPosn
      AssemblySwConnector_343: ecu-extract-reference=FordHwAgArbnDFordRelHwPosnVldDCDD_FordBlaBoxIfCmnDFordRelHwPosnVld
      AssemblySwConnector_344: ecu-extract-reference=FordHwTqCdngDFordAppldFinalMotTqDCDD_FordBlaBoxIfCmnDFordAppldFinalMotTq
      AssemblySwConnector_353: ecu-extract-reference=FordHwTqCdngDFordAppldFinalMotTqVldDCDD_FordBlaBoxIfCmnDFordAppldFinalMotTqVld
      AssemblySwConnector_354: ecu-extract-reference=FordHwTqCdngDFordBoostCrvAssiTqDCDD_FordBlaBoxIfCmnDFordBoostCrvAssiTq
      AssemblySwConnector_355: ecu-extract-reference=FordHwTqCdngDFordBoostCrvInpTqDCDD_FordBlaBoxIfCmnDFordBoostCrvInpTq
      AssemblySwConnector_356: ecu-extract-reference=FordHwTqCdngDFordInpTqRawDCDD_FordBlaBoxIfCmnDFordInpTqRaw
      AssemblySwConnector_357: ecu-extract-reference=FordHwTqCdngDFordInpTqRawVldDCDD_FordBlaBoxIfCmnDFordInpTqRawVld
      AssemblySwConnector_358: ecu-extract-reference=FordHwTqCdngDFordReqdFinalMotTqDCDD_FordBlaBoxIfCmnDFordReqdFinalMotTq
      AssemblySwConnector_360: ecu-extract-reference=FordMsg07DBusHiSpdDFordVehActBrkTqRawDCDD_FordBlaBoxIfCmnDFordVehActBrkTqRaw
      AssemblySwConnector_361: ecu-extract-reference=FordMsg07DBusHiSpdDFordVehBrkTqVldDCDD_FordBlaBoxIfCmnDFordVehBrkTqVld
      AssemblySwConnector_362: ecu-extract-reference=FordMsg07DBusHiSpdDFordVehVertACmpdRawDCDD_FordBlaBoxIfCmnDFordVehVertACmpdRaw
      AssemblySwConnector_363: ecu-extract-reference=FordMsg083BusHiSpdDFordVehTurnSigVldDCDD_FordBlaBoxIfCmnDFordVehTurnSigVld
      AssemblySwConnector_364: ecu-extract-reference=FordMsg091BusHiSpdDFordVehYawRateRawVldDCDD_FordBlaBoxIfCmnDFordVehYawRateRawVld
      AssemblySwConnector_365: ecu-extract-reference=FordMsg167BusHiSpdDFordVehPrpnWhlTqRawDCDD_FordBlaBoxIfCmnDFordVehPrpnWhlTqRaw
      AssemblySwConnector_366: ecu-extract-reference=FordMsg167BusHiSpdDFordVehPrpnWhlTqVldDCDD_FordBlaBoxIfCmnDFordVehPrpnWhlTqVld
      AssemblySwConnector_382: ecu-extract-reference=FordMsg202BusHiSpdDFordVehGearRvsStsRawDCDD_FordBlaBoxIfCmnDFordVehGearRvsStsRaw
      AssemblySwConnector_383: ecu-extract-reference=FordMsg202BusHiSpdDFordVehGearRvsStsVldDCDD_FordBlaBoxIfCmnDFordVehGearRvsStsVld
      AssemblySwConnector_384: ecu-extract-reference=FordMsg202BusHiSpdDFordVehTrlrAidAvlRawDCDD_FordBlaBoxIfCmnDFordVehTrlrAidAvlRaw
      AssemblySwConnector_385: ecu-extract-reference=FordMsg202BusHiSpdDFordVehTrlrBackupAssiAvlVldDCDD_FordBlaBoxIfCmnDFordVehTrlrBackupAssiAvlVld
      AssemblySwConnector_386: ecu-extract-reference=FordMsg213BusHiSpdDFordVehAbsActvDCDD_FordBlaBoxIfCmnDFordVehAbsActv
      AssemblySwConnector_387: ecu-extract-reference=FordMsg213BusHiSpdDFordVehAbsEscStsVldDCDD_FordBlaBoxIfCmnDFordVehAbsEscStsVld
      AssemblySwConnector_388: ecu-extract-reference=FordMsg213BusHiSpdDFordVehCllsnMtgtnByBrkgDeniedDCDD_FordBlaBoxIfCmnDFordVehCllsnMtgtnByBrkgDenied
      AssemblySwConnector_389: ecu-extract-reference=FordMsg213BusHiSpdDFordVehCllsnMtgtnByBrkgDisadDCDD_FordBlaBoxIfCmnDFordVehCllsnMtgtnByBrkgDisad
      AssemblySwConnector_394: ecu-extract-reference=FordMsg213BusHiSpdDFordVehEscActvDCDD_FordBlaBoxIfCmnDFordVehEscActv
      AssemblySwConnector_395: ecu-extract-reference=FordMsg216BusHiSpdDFordVehFrntLeWhlCntrDirVldDCDD_FordBlaBoxIfCmnDFordVehFrntLeWhlCntrDirVld
      AssemblySwConnector_396: ecu-extract-reference=FordMsg216BusHiSpdDFordVehFrntLeWhlDirRawDCDD_FordBlaBoxIfCmnDFordVehFrntLeWhlDirRaw
      AssemblySwConnector_397: ecu-extract-reference=FordMsg216BusHiSpdDFordVehFrntRiWhlCntrDirVldDCDD_FordBlaBoxIfCmnDFordVehFrntRiWhlCntrDirVld
      AssemblySwConnector_398: ecu-extract-reference=FordMsg216BusHiSpdDFordVehFrntRiWhlDirRawDCDD_FordBlaBoxIfCmnDFordVehFrntRiWhlDirRaw
      AssemblySwConnector_399: ecu-extract-reference=FordMsg216BusHiSpdDFordVehReLeWhlCntrDirVldDCDD_FordBlaBoxIfCmnDFordVehReLeWhlCntrDirVld
      AssemblySwConnector_400: ecu-extract-reference=FordMsg216BusHiSpdDFordVehReLeWhlDirRawDCDD_FordBlaBoxIfCmnDFordVehReLeWhlDirRaw
      AssemblySwConnector_430: ecu-extract-reference=FordMsg216BusHiSpdDFordVehReRiWhlCntrDirVldDCDD_FordBlaBoxIfCmnDFordVehReRiWhlCntrDirVld
      AssemblySwConnector_432: ecu-extract-reference=FordMsg216BusHiSpdDFordVehReRiWhlDirRawDCDD_FordBlaBoxIfCmnDFordVehReRiWhlDirRaw
      AssemblySwConnector_433: ecu-extract-reference=FordMsg217BusHiSpdDFordVehFrntLeWhlSpdRawDCDD_FordBlaBoxIfCmnDFordVehFrntLeWhlSpdRaw
      AssemblySwConnector_434: ecu-extract-reference=FordMsg217BusHiSpdDFordVehFrntLeWhlSpdVldDCDD_FordBlaBoxIfCmnDFordVehFrntLeWhlSpdVld
      AssemblySwConnector_435: ecu-extract-reference=FordMsg217BusHiSpdDFordVehFrntRiWhlSpdRawDCDD_FordBlaBoxIfCmnDFordVehFrntRiWhlSpdRaw
      AssemblySwConnector_436: ecu-extract-reference=FordMsg217BusHiSpdDFordVehFrntRiWhlSpdVldDCDD_FordBlaBoxIfCmnDFordVehFrntRiWhlSpdVld
      AssemblySwConnector_437: ecu-extract-reference=FordMsg217BusHiSpdDFordVehReLeWhlSpdRawDCDD_FordBlaBoxIfCmnDFordVehReLeWhlSpdRaw
      AssemblySwConnector_438: ecu-extract-reference=FordMsg217BusHiSpdDFordVehReLeWhlSpdVldDCDD_FordBlaBoxIfCmnDFordVehReLeWhlSpdVld
      AssemblySwConnector_439: ecu-extract-reference=FordMsg217BusHiSpdDFordVehReRiWhlSpdRawDCDD_FordBlaBoxIfCmnDFordVehReRiWhlSpdRaw
      AssemblySwConnector_440: ecu-extract-reference=FordMsg217BusHiSpdDFordVehReRiWhlSpdVldDCDD_FordBlaBoxIfCmnDFordVehReRiWhlSpdVld
      AssemblySwConnector_441: ecu-extract-reference=FordMsg230BusHiSpdDFordVehGearLvrPosnVldIntDCDD_FordBlaBoxIfCmnDFordVehGearLvrPosnVldInt
      AssemblySwConnector_442: ecu-extract-reference=FordMsg3B3BusHiSpdDFordVehIgnStsVldDCDD_FordBlaBoxIfCmnDFordVehIgnStsVld
      AssemblySwConnector_443: ecu-extract-reference=FordMsg3CABusHiSpdDFordVehLaneAssiImgProcgModlAVldDCDD_FordBlaBoxIfCmnDFordVehLaneAssiImgProcgModlAVld
      AssemblySwConnector_444: ecu-extract-reference=FordMsg3CABusHiSpdDFordVehLaneKeepSysCrvtRawDCDD_FordBlaBoxIfCmnDFordVehLaneKeepSysCrvtRaw
      AssemblySwConnector_446: ecu-extract-reference=FordMsg3D3BusHiSpdDFordVehLatCtrlCrvtRateRawDCDD_FordBlaBoxIfCmnDFordVehLatCtrlCrvtRateRaw
      AssemblySwConnector_447: ecu-extract-reference=FordMsg3D3BusHiSpdDFordVehLatCtrlCrvtRawDCDD_FordBlaBoxIfCmnDFordVehLatCtrlCrvtRaw
      AssemblySwConnector_448: ecu-extract-reference=FordMsg3D3BusHiSpdDFordVehLatCtrlImgProcrModlAVldDCDD_FordBlaBoxIfCmnDFordVehLatCtrlImgProcrModlAVld
      AssemblySwConnector_449: ecu-extract-reference=FordMsg3D3BusHiSpdDFordVehLatCtrlPahOffsRawDCDD_FordBlaBoxIfCmnDFordVehLatCtrlPahOffsRaw
      AssemblySwConnector_450: ecu-extract-reference=FordMsg3D3BusHiSpdDFordVehLatCtrlPahRawDCDD_FordBlaBoxIfCmnDFordVehLatCtrlPahRaw
      AssemblySwConnector_451: ecu-extract-reference=FordMsg3D3BusHiSpdDFordVehLatCtrlRingMaxDCDD_FordBlaBoxIfCmnDFordVehLatCtrlRingMax
      AssemblySwConnector_452: ecu-extract-reference=FordMsg40ABusHiSpdDFordVehTireCircumDCDD_FordBlaBoxIfCmnDFordVehTireCircum
      AssemblySwConnector_453: ecu-extract-reference=FordMsg414BusHiSpdDFordVehSteerPinionAgOffsRawDCDD_FordBlaBoxIfCmnDFordVehSteerPinionAgOffsRaw
      AssemblySwConnector_454: ecu-extract-reference=FordMsg414BusHiSpdDFordVehSteerPinionAgOffsVldDCDD_FordBlaBoxIfCmnDFordVehSteerPinionAgOffsVld
      AssemblySwConnector_455: ecu-extract-reference=FordMsg414BusHiSpdDFordVehSteerPinionOffsStsRawDCDD_FordBlaBoxIfCmnDFordVehSteerPinionOffsStsRaw
      AssemblySwConnector_456: ecu-extract-reference=FordMsg415BusHiSpdDFordVehLoSpdMtnCtrlBrkSprtStsRawDCDD_FordBlaBoxIfCmnDFordVehLoSpdMtnCtrlBrkSprtStsRaw
      AssemblySwConnector_460: ecu-extract-reference=FordMsg415BusHiSpdDFordVehLoSpdMtnCtrlBrkSprtVldDCDD_FordBlaBoxIfCmnDFordVehLoSpdMtnCtrlBrkSprtVld
      AssemblySwConnector_461: ecu-extract-reference=FordMsg415BusHiSpdDFordVehSpdBrkModlRawDCDD_FordBlaBoxIfCmnDFordVehSpdBrkModlRaw
      AssemblySwConnector_462: ecu-extract-reference=FordMsg41EBusHiSpdDFordVehSelDrvModChassisVldDCDD_FordBlaBoxIfCmnDFordVehSelDrvModChassisVld
      AssemblySwConnector_463: ecu-extract-reference=FordVehSpdArbnDFordVehSpdDCDD_FordBlaBoxIfCmnDFordVehSpd
      AssemblySwConnector_464: ecu-extract-reference=HwAgSysArbnDHwVelDCDD_FordBlaBoxIfCmnDHwVel
      AssemblySwConnector_465: ecu-extract-reference=ImcSigArbnDVehSpdImcCorrdDCDD_FordBlaBoxIfCmnDVehSpd
      AssemblySwConnector_466: ecu-extract-reference=VehSigCdngDVehSpdVldDCDD_FordBlaBoxIfCmnDVehSpdVld
      DelegationSwConnector_081: ecu-extract-reference=Ford_WhlDirFl_D_ActlDDFordMsg216BusHiSpdDFord_WhlDirFl_D_Actl
      DelegationSwConnector_082: ecu-extract-reference=Ford_WhlDirFr_D_ActlDDFordMsg216BusHiSpdDFord_WhlDirFr_D_Actl
      DelegationSwConnector_083: ecu-extract-reference=Ford_WhlDirRl_D_ActlDDFordMsg216BusHiSpdDFord_WhlDirRl_D_Actl
      DelegationSwConnector_084: ecu-extract-reference=Ford_WhlDirRr_D_ActlDDFordMsg216BusHiSpdDFord_WhlDirRr_D_Actl
      DelegationSwConnector_085: ecu-extract-reference=Ford_WhlRotatFl_No_CntDDFordMsg216BusHiSpdDFord_WhlRotatFl_No_Cnt
      DelegationSwConnector_086: ecu-extract-reference=Ford_WhlRotatFr_No_CntDDFordMsg216BusHiSpdDFord_WhlRotatFr_No_Cnt
      DelegationSwConnector_087: ecu-extract-reference=Ford_WhlRotatRl_No_CntDDFordMsg216BusHiSpdDFord_WhlRotatRl_No_Cnt
      DelegationSwConnector_088: ecu-extract-reference=Ford_WhlRotatRr_No_CntDDFordMsg216BusHiSpdDFord_WhlRotatRr_No_Cnt
      AssemblySwConnector_467: ecu-extract-reference=CustDiagDFordBrkPlsRejctnEnadDCDD_FordBlaBoxIfCmnDFordBrkPlsRejctnEnad
      AssemblySwConnector_468: ecu-extract-reference=CustDiagDFordPullDriftCmpEnadDCDD_FordBlaBoxIfCmnDFordPullDriftCmpEnad
      AssemblySwConnector_469: ecu-extract-reference=CustDiagDFordResrchFctEnadDCDD_FordBlaBoxIfCmnDFordResrchFctEnad
      ComponentPrototype_199: upstream-reference=ECU_Composition.FordMsg47ABusHiSpd, ecu-extract-reference=COMPOSITIONTYPE.FordMsg47ABusHiSpd
      ComponentPrototype_200: upstream-reference=ECU_Composition.FordMsg459BusHiSpd, ecu-extract-reference=COMPOSITIONTYPE.FordMsg459BusHiSpd
      ComponentPrototype_201: upstream-reference=ECU_Composition.FordMsg215BusHiSpd, ecu-extract-reference=COMPOSITIONTYPE.FordMsg215BusHiSpd
      AssemblySwConnector_306: ecu-extract-reference=CalRegn01CmnDFordMsg215BusHiSpdFordVehTrlrAidModReqVldNotRxdTiThdDFordMsg215BusHiSpdDFordMsg215BusHiSpdFordVehTrlrAid_bd66f5ed
      AssemblySwConnector_473: ecu-extract-reference=CalRegn01CmnDFordMsg215BusHiSpdFordVehTrlrAidModReqVldRxdTiThdDFordMsg215BusHiSpdDFordMsg215BusHiSpdFordVehTrlrAidMod_9045cf4e
      AssemblySwConnector_474: ecu-extract-reference=CalRegn01CmnDFordMsg215BusHiSpdMissMsgFaildTiThdDFordMsg215BusHiSpdDFordMsg215BusHiSpdMissMsgFaildTiThd
      AssemblySwConnector_475: ecu-extract-reference=CalRegn01CmnDFordMsg215BusHiSpdMissMsgPassdTiThdDFordMsg215BusHiSpdDFordMsg215BusHiSpdMissMsgPassdTiThd
      AssemblySwConnector_476: ecu-extract-reference=CalRegn01CmnDFordMsg459BusHiSpdDiagMsgMissTmrThdDFordMsg459BusHiSpdDFordMsg459BusHiSpdDiagMsgMissTmrThd
      AssemblySwConnector_477: ecu-extract-reference=CalRegn01CmnDFordMsg459BusHiSpdHitchAgInvldFaildThdDFordMsg459BusHiSpdDFordMsg459BusHiSpdHitchAgInvldFaildThd
      AssemblySwConnector_478: ecu-extract-reference=CalRegn01CmnDFordMsg459BusHiSpdHitchAgInvldPassdThdDFordMsg459BusHiSpdDFordMsg459BusHiSpdHitchAgInvldPassdThd
      AssemblySwConnector_479: ecu-extract-reference=CalRegn01CmnDFordMsg459BusHiSpdHitchAgRateInvldFaildThdDFordMsg459BusHiSpdDFordMsg459BusHiSpdHitchAgRateInvldFaildThd
      AssemblySwConnector_480: ecu-extract-reference=CalRegn01CmnDFordMsg459BusHiSpdHitchAgRateInvldPassdThdDFordMsg459BusHiSpdDFordMsg459BusHiSpdHitchAgRateInvldPassdThd
      AssemblySwConnector_481: ecu-extract-reference=CalRegn01CmnDFordMsg459BusHiSpdPrsntFlgMsgMissTmrThdDFordMsg459BusHiSpdDFordMsg459BusHiSpdPrsntFlgMsgMissTmrThd
      AssemblySwConnector_482: ecu-extract-reference=CalRegn01CmnDFordMsg459BusHiSpdRcvrDiagMsgMissTmrThdDFordMsg459BusHiSpdDFordMsg459BusHiSpdRcvrDiagMsgMissTmrThd
      AssemblySwConnector_483: ecu-extract-reference=CalRegn01CmnDFordMsg459BusHiSpdRcvrPrsntFlgTmrThdDFordMsg459BusHiSpdDFordMsg459BusHiSpdRcvrPrsntFlgTmrThd
      AssemblySwConnector_484: ecu-extract-reference=CalRegn01CmnDFordMsg459BusHiSpdTrackStInvldFaildThdDFordMsg459BusHiSpdDFordMsg459BusHiSpdTrackStInvldFaildThd
      AssemblySwConnector_485: ecu-extract-reference=CalRegn01CmnDFordMsg459BusHiSpdTrackStInvldPassdThdDFordMsg459BusHiSpdDFordMsg459BusHiSpdTrackStInvldPassdThd
      AssemblySwConnector_486: ecu-extract-reference=CalRegn01CmnDFordMsg459BusHiSpdTrlrHitchAgVldInvldMsgThdDFordMsg459BusHiSpdDFordMsg459BusHiSpdTrlrHitchAgVldInvldMsgThd
      AssemblySwConnector_487: ecu-extract-reference=CalRegn01CmnDFordMsg459BusHiSpdTrlrHitchAgVldMissMsgThdDFordMsg459BusHiSpdDFordMsg459BusHiSpdTrlrHitchAgVldMissMsgThd
      AssemblySwConnector_488: ecu-extract-reference=CalRegn01CmnDFordMsg459BusHiSpdTrlrHitchRateVldInvldMsgThdDFordMsg459BusHiSpdDFordMsg459BusHiSpdTrlrHitchRateVldInvldMsgThd
      AssemblySwConnector_489: ecu-extract-reference=CalRegn01CmnDFordMsg459BusHiSpdTrlrHitchRateVldMissMsgThdDFordMsg459BusHiSpdDFordMsg459BusHiSpdTrlrHitchRateVldMissMsgThd
      AssemblySwConnector_490: ecu-extract-reference=CalRegn01CmnDFordMsg459BusHiSpdTrlrRcvrHitchAgVldThdDFordMsg459BusHiSpdDFordMsg459BusHiSpdTrlrRcvrHitchAgVldThd
      AssemblySwConnector_491: ecu-extract-reference=CalRegn01CmnDFordMsg459BusHiSpdTrlrRcvrHitchRateVldThdDFordMsg459BusHiSpdDFordMsg459BusHiSpdTrlrRcvrHitchRateVldThd
      AssemblySwConnector_492: ecu-extract-reference=CalRegn01CmnDFordMsg459BusHiSpdTrlrRcvrTarVldThdDFordMsg459BusHiSpdDFordMsg459BusHiSpdTrlrRcvrTarVldThd
      AssemblySwConnector_493: ecu-extract-reference=CalRegn01CmnDFordMsg459BusHiSpdTrlrRcvrTrackStVldThdDFordMsg459BusHiSpdDFordMsg459BusHiSpdTrlrRcvrTrackStVldThd
      AssemblySwConnector_494: ecu-extract-reference=CalRegn01CmnDFordMsg459BusHiSpdTrlrTarVldMissMsgThdDFordMsg459BusHiSpdDFordMsg459BusHiSpdTrlrTarVldMissMsgThd
      AssemblySwConnector_495: ecu-extract-reference=CalRegn01CmnDFordMsg459BusHiSpdTrlrTrackStVldInvldMsgThdDFordMsg459BusHiSpdDFordMsg459BusHiSpdTrlrTrackStVldInvldMsgThd
      AssemblySwConnector_496: ecu-extract-reference=CalRegn01CmnDFordMsg459BusHiSpdTrlrTrackStVldMissMsgThdDFordMsg459BusHiSpdDFordMsg459BusHiSpdTrlrTrackStVldMissMsgThd
      AssemblySwConnector_497: ecu-extract-reference=CalRegn01CmnDFordMsg47ABusHiSpdMissMsgFaildTiThdDFordMsg47ABusHiSpdDFordMsg47ABusHiSpdMissMsgFaildTiThd
      AssemblySwConnector_498: ecu-extract-reference=CalRegn01CmnDFordMsg47ABusHiSpdMissMsgPassdTiThdDFordMsg47ABusHiSpdDFordMsg47ABusHiSpdMissMsgPassdTiThd
      AssemblySwConnector_499: ecu-extract-reference=CalRegn01CmnDFordMsg47ABusHiSpdTrlrAidKnobBtnFaildTiThdDFordMsg47ABusHiSpdDFordMsg47ABusHiSpdTrlrAidKnobBtnFaildTiThd
      AssemblySwConnector_500: ecu-extract-reference=CalRegn01CmnDFordMsg47ABusHiSpdTrlrAidKnobBtnInvldPassdTiThdDFordMsg47ABusHiSpdDFordMsg47ABusHiSpdTrlrAidKnobBtnInvld_82f3f49c
      AssemblySwConnector_501: ecu-extract-reference=CalRegn01CmnDFordMsg47ABusHiSpdTrlrAidKnobBtnMissTiThdDFordMsg47ABusHiSpdDFordMsg47ABusHiSpdTrlrAidKnobBtnMissTiThd
      AssemblySwConnector_502: ecu-extract-reference=CalRegn01CmnDFordMsg47ABusHiSpdTrlrAidKnobBtnPassdTiThdDFordMsg47ABusHiSpdDFordMsg47ABusHiSpdTrlrAidKnobBtnPassdTiThd
      AssemblySwConnector_503: ecu-extract-reference=CalRegn01CmnDFordMsg47ABusHiSpdTrlrAidKnobPosFaildTiThdDFordMsg47ABusHiSpdDFordMsg47ABusHiSpdTrlrAidKnobPosFaildTiThd
      AssemblySwConnector_504: ecu-extract-reference=CalRegn01CmnDFordMsg47ABusHiSpdTrlrAidKnobPosInvldPassdTiThdDFordMsg47ABusHiSpdDFordMsg47ABusHiSpdTrlrAidKnobPosInvld_f348de7e
      AssemblySwConnector_505: ecu-extract-reference=CalRegn01CmnDFordMsg47ABusHiSpdTrlrAidKnobPosMissTiThdDFordMsg47ABusHiSpdDFordMsg47ABusHiSpdTrlrAidKnobPosMissTiThd
      AssemblySwConnector_506: ecu-extract-reference=CalRegn01CmnDFordMsg47ABusHiSpdTrlrAidKnobPosPassdTiThdDFordMsg47ABusHiSpdDFordMsg47ABusHiSpdTrlrAidKnobPosPassdTiThd
      AssemblySwConnector_507: ecu-extract-reference=CDD_NxtrTiDGetRefTmr100MicroSec32bitDFordMsg215BusHiSpdDGetRefTmr100MicroSec32bit
      AssemblySwConnector_508: ecu-extract-reference=CDD_NxtrTiDGetTiSpan100MicroSec32bitDFordMsg215BusHiSpdDGetTiSpan100MicroSec32bit
      AssemblySwConnector_509: ecu-extract-reference=CDD_NxtrTiDGetRefTmr100MicroSec32bitDFordMsg459BusHiSpdDGetRefTmr100MicroSec32bit
      AssemblySwConnector_524: ecu-extract-reference=CDD_NxtrTiDGetTiSpan100MicroSec32bitDFordMsg459BusHiSpdDGetTiSpan100MicroSec32bit
      AssemblySwConnector_525: ecu-extract-reference=CDD_NxtrTiDGetTiSpan100MicroSec32bitDFordMsg47ABusHiSpdDGetTiSpan100MicroSec32bit
      AssemblySwConnector_537: ecu-extract-reference=CustDiagDFordSrvPullDriftCmpRstValDCDD_FordBlaBoxIfCmp1DFordSrvPullDriftCmpRstVal
      AssemblySwConnector_548: ecu-extract-reference=DiagcMgrDClrDiagcFlgProxyDFordMsg215BusHiSpdDClrDiagcFlgProxy
      AssemblySwConnector_550: ecu-extract-reference=DiagcMgrDClrDiagcFlgProxyDFordMsg459BusHiSpdDClrDiagcFlgProxy
      AssemblySwConnector_551: ecu-extract-reference=DiagcMgrDClrDiagcFlgProxyDFordMsg47ABusHiSpdDClrDiagcFlgProxy
      AssemblySwConnector_555: ecu-extract-reference=DiagcMgrProxyAppl10DSetNtcSts10DFordMsg215BusHiSpdDSetNtcSts
      AssemblySwConnector_556: ecu-extract-reference=DiagcMgrProxyAppl10DSetNtcSts10DFordMsg459BusHiSpdDSetNtcSts
      AssemblySwConnector_557: ecu-extract-reference=DiagcMgrProxyAppl10DSetNtcSts10DFordMsg47ABusHiSpdDSetNtcSts
      AssemblySwConnector_558: ecu-extract-reference=FordCanDtcInhbDFordEpsLifeCycModDFordMsg215BusHiSpdDFordEpsLifeCycMod
      AssemblySwConnector_559: ecu-extract-reference=FordCanDtcInhbDFordEpsLifeCycModDFordMsg47ABusHiSpdDFordEpsLifeCycMod
      AssemblySwConnector_576: ecu-extract-reference=FordMsg215BusHiSpdDFordVehTrlrAidModReqVldDCDD_FordBlaBoxIfCmnDFordVehTrlrAidModReqVld
      AssemblySwConnector_577: ecu-extract-reference=FordMsg459BusHiSpdDFordVehTrlrAidAcqStsDCDD_FordBlaBoxIfCmnDFordVehTrlrAidAcqSts
      AssemblySwConnector_578: ecu-extract-reference=FordMsg459BusHiSpdDFordVehTrlrAidHitchAgDCDD_FordBlaBoxIfCmnDFordVehTrlrAidHitchAg
      AssemblySwConnector_579: ecu-extract-reference=FordMsg459BusHiSpdDFordVehTrlrAidIdnValDCDD_FordBlaBoxIfCmnDFordVehTrlrAidIdnVal
      AssemblySwConnector_580: ecu-extract-reference=FordMsg459BusHiSpdDFordVehTrlrAidTrakgStDCDD_FordBlaBoxIfCmnDFordVehTrlrAidTrakgSt
      AssemblySwConnector_581: ecu-extract-reference=FordMsg459BusHiSpdDFordVehTrlrAidTrlrRvsGuidcStsDCDD_FordBlaBoxIfCmnDFordVehTrlrAidTrlrRvsGuidcSts
      AssemblySwConnector_582: ecu-extract-reference=FordMsg459BusHiSpdDFordVehTrlrBallToAxleDCDD_FordBlaBoxIfCmnDFordVehTrlrBallToAxle
      AssemblySwConnector_583: ecu-extract-reference=FordMsg459BusHiSpdDFordVehTrlrHitchAgVldDCDD_FordBlaBoxIfCmnDFordVehTrlrHitchAgVld
      AssemblySwConnector_584: ecu-extract-reference=FordMsg459BusHiSpdDFordVehTrlrHitchRateVldDCDD_FordBlaBoxIfCmnDFordVehTrlrHitchRateVld
      AssemblySwConnector_585: ecu-extract-reference=FordMsg459BusHiSpdDFordVehTrlrTarVldDCDD_FordBlaBoxIfCmnDFordVehTrlrTarVld
      AssemblySwConnector_586: ecu-extract-reference=FordMsg47ABusHiSpdDFordVehTrlrAidKnobPosnDCDD_FordBlaBoxIfCmnDFordVehTrlrAidKnobPosn
      DelegationSwConnector_089: ecu-extract-reference=Ford_TrlrAidMde_D_RqDDFordMsg215BusHiSpdDFord_TrlrAidMde_D_Rq
      ComponentPrototype_202: upstream-reference=ECU_Composition.FordMsg3D7BusHiSpd, ecu-extract-reference=COMPOSITIONTYPE.FordMsg3D7BusHiSpd
      ComponentPrototype_203: upstream-reference=ECU_Composition.FordMotTqCmdOvrlLimr, ecu-extract-reference=COMPOSITIONTYPE.FordMotTqCmdOvrlLimr
      ComponentPrototype_204: upstream-reference=ECU_Composition.FordHwTqCmdOvrlLimr, ecu-extract-reference=COMPOSITIONTYPE.FordHwTqCmdOvrlLimr
      ComponentPrototype_205: upstream-reference=ECU_Composition.FordCmdArbn, ecu-extract-reference=COMPOSITIONTYPE.FordCmdArbn
      AssemblySwConnector_472: ecu-extract-reference=CDD_FordBlaBoxIfCmp1DFordActvNiblCtrlFeatStDFordCmdArbnDFordActvNiblCtrlFeatSt
      AssemblySwConnector_587: ecu-extract-reference=CDD_FordBlaBoxIfCmp1DFordLaneDprtrWarnFeatStDFordCmdArbnDFordLaneDprtrWarnFeatSt
      AssemblySwConnector_588: ecu-extract-reference=CDD_FordBlaBoxIfCmp1DFordLaneKeepAssiFeatStDFordCmdArbnDFordLaneKeepAssiFeatSt
      AssemblySwConnector_589: ecu-extract-reference=CDD_FordBlaBoxIfCmp1DFordLatCtrlFeatStDFordCmdArbnDFordLatCtrlFeatSt
      AssemblySwConnector_591: ecu-extract-reference=CDD_FordBlaBoxIfCmp1DFordPullDriftCmpFeatStDFordCmdArbnDFordPullDriftCmpFeatSt
      AssemblySwConnector_592: ecu-extract-reference=CDD_FordBlaBoxIfCmp1DFordPullDriftCmpLrngFeatStDFordCmdArbnDFordPullDriftCmpLrngFeatSt
      AssemblySwConnector_593: ecu-extract-reference=CDD_FordBlaBoxIfCmp1DFordLaneKeepAssiTqReqDFordHwTqCmdOvrlLimrDFordLaneKeepAssiTqReq
      AssemblySwConnector_594: ecu-extract-reference=CDD_FordBlaBoxIfCmp1DFordActvNiblCtrlTqReqDFordMotTqCmdOvrlLimrDFordActvNiblCtrlTqReq
      AssemblySwConnector_595: ecu-extract-reference=CDD_FordBlaBoxIfCmp1DFordLaneDprtrWarnTqReqDFordMotTqCmdOvrlLimrDFordLaneDprtrWarnTqReq
      AssemblySwConnector_596: ecu-extract-reference=CDD_FordBlaBoxIfCmp1DFordLatCtrlTqReqDFordMotTqCmdOvrlLimrDFordLatCtrlTqReq
      AssemblySwConnector_597: ecu-extract-reference=CDD_FordBlaBoxIfCmp1DFordPullDriftCmpTqReqDFordMotTqCmdOvrlLimrDFordPullDriftCmpTqReq
      AssemblySwConnector_598: ecu-extract-reference=CDD_FordBlaBoxIfCmp2DFordEvasSteerAssiFeatStDFordCmdArbnDFordEvasSteerAssiFeatSt
      AssemblySwConnector_599: ecu-extract-reference=CDD_FordBlaBoxIfCmp2DFordSteerTqDstbcRejctnFeatStDFordCmdArbnDFordSteerTqDstbcRejctnFeatSt
      AssemblySwConnector_600: ecu-extract-reference=CDD_FordBlaBoxIfCmp2DFordEvasSteerAssiTqReqDFordHwTqCmdOvrlLimrDFordEvasSteerAssiTqReq
      AssemblySwConnector_601: ecu-extract-reference=CDD_FordBlaBoxIfCmp2DFordSteerTqDstbcRejctnTqReqDFordMotTqCmdOvrlLimrDFordSteerTqDstbcRejctnTqReq
      AssemblySwConnector_602: ecu-extract-reference=CDD_NxtrTiDGetRefTmr100MicroSec32bitDFordMotTqCmdOvrlLimrDGetRefTmr100MicroSec32bit
      AssemblySwConnector_603: ecu-extract-reference=CDD_NxtrTiDGetTiSpan100MicroSec32bitDFordMotTqCmdOvrlLimrDGetTiSpan100MicroSec32bit
      AssemblySwConnector_604: ecu-extract-reference=CDD_NxtrTiDGetRefTmr100MicroSec32bitDFordMsg3D7BusHiSpdDGetRefTmr100MicroSec32bit
      AssemblySwConnector_605: ecu-extract-reference=CDD_NxtrTiDGetTiSpan100MicroSec32bitDFordMsg3D7BusHiSpdDGetTiSpan100MicroSec32bit
      AssemblySwConnector_606: ecu-extract-reference=CustDiagDFordEvasSteerAssiEnadDFordMsg3D7BusHiSpdDFordEvasSteerAssiEnad
      AssemblySwConnector_607: ecu-extract-reference=DiagcMgrDClrDiagcFlgProxyDFordMsg3D7BusHiSpdDClrDiagcFlgProxy
      AssemblySwConnector_608: ecu-extract-reference=DiagcMgrProxyAppl10DSetNtcSts10DFordMotTqCmdOvrlLimrDSetNtcSts
      AssemblySwConnector_609: ecu-extract-reference=DiagcMgrProxyAppl10DSetNtcSts10DFordMsg3D7BusHiSpdDSetNtcSts
      AssemblySwConnector_610: ecu-extract-reference=DualEcuIdnDEcuIdDFordCmdArbnDEcuId
      AssemblySwConnector_611: ecu-extract-reference=DualEcuIdnDEcuIdDFordHwTqCmdOvrlLimrDEcuId
      AssemblySwConnector_612: ecu-extract-reference=DualEcuIdnDEcuIdDFordMotTqCmdOvrlLimrDEcuId
      AssemblySwConnector_613: ecu-extract-reference=FordCanDtcInhbDFordEpsLifeCycModDFordMsg3D7BusHiSpdDFordEpsLifeCycMod
      AssemblySwConnector_615: ecu-extract-reference=FordCmdArbnDFordActvNiblCtrlArbnCmdDCDD_FordBlaBoxIfCmp1DFordActvNiblCtrlArbnCmd
      AssemblySwConnector_616: ecu-extract-reference=FordCmdArbnDFordLaneDprtrWarnArbnCmdDCDD_FordBlaBoxIfCmp1DFordLaneDprtrWarnArbnCmd
      AssemblySwConnector_617: ecu-extract-reference=FordCmdArbnDFordLaneKeepAssiArbnCmdDCDD_FordBlaBoxIfCmp1DFordLaneKeepAssiArbnCmd
      AssemblySwConnector_618: ecu-extract-reference=FordCmdArbnDFordLatCtrlArbnCmdDCDD_FordBlaBoxIfCmp1DFordLatCtrlArbnCmd
      AssemblySwConnector_619: ecu-extract-reference=FordCmdArbnDFordPullDriftCmpArbnCmdDCDD_FordBlaBoxIfCmp1DFordPullDriftCmpArbnCmd
      AssemblySwConnector_620: ecu-extract-reference=FordCmdArbnDFordPullDriftCmpLrngArbnCmdDCDD_FordBlaBoxIfCmp1DFordPullDriftCmpLrngArbnCmd
      AssemblySwConnector_621: ecu-extract-reference=FordCmdArbnDFordEvasSteerAssiArbnCmdDCDD_FordBlaBoxIfCmp2DFordEvasSteerAssiArbnCmd
      AssemblySwConnector_622: ecu-extract-reference=FordCmdArbnDFordSteerTqDstbcRejctnArbnCmdDCDD_FordBlaBoxIfCmp2DFordSteerTqDstbcRejctnArbnCmd
      AssemblySwConnector_623: ecu-extract-reference=FordCmdArbnDFordDrvrSteerRcmdnArbnCmdDFordHwTqCmdOvrlLimrDFordDrvrSteerRcmdnArbnCmd
      AssemblySwConnector_624: ecu-extract-reference=FordCmdArbnDFordEvasSteerAssiArbnCmdDFordHwTqCmdOvrlLimrDFordEvasSteerAssiArbnCmd
      AssemblySwConnector_625: ecu-extract-reference=FordCmdArbnDFordLaneKeepAssiArbnCmdDFordHwTqCmdOvrlLimrDFordLaneKeepAssiArbnCmd
      AssemblySwConnector_626: ecu-extract-reference=FordCmdArbnDFordActvNiblCtrlArbnCmdDFordMotTqCmdOvrlLimrDFordActvNiblCtrlArbnCmd
      AssemblySwConnector_627: ecu-extract-reference=FordCmdArbnDFordLaneDprtrWarnArbnCmdDFordMotTqCmdOvrlLimrDFordLaneDprtrWarnArbnCmd
      AssemblySwConnector_628: ecu-extract-reference=FordCmdArbnDFordLatCtrlArbnCmdDFordMotTqCmdOvrlLimrDFordLatCtrlArbnCmd
      AssemblySwConnector_629: ecu-extract-reference=FordCmdArbnDFordPullDriftCmpArbnCmdDFordMotTqCmdOvrlLimrDFordPullDriftCmpArbnCmd
      AssemblySwConnector_630: ecu-extract-reference=FordCmdArbnDFordSteerTqDstbcRejctnArbnCmdDFordMotTqCmdOvrlLimrDFordSteerTqDstbcRejctnArbnCmd
      AssemblySwConnector_631: ecu-extract-reference=FordHwTqCmdOvrlLimrDFordColTqOvrlDAssiDHwTqOvrl
      AssemblySwConnector_632: ecu-extract-reference=FordHwTqCmdOvrlLimrDFordColTqOvrlDFordHwTqCdngDHwTqOvrl
      AssemblySwConnector_633: ecu-extract-reference=FordHwTqCmdOvrlLimrDFordColTqOvrlDHysCmpDHwTqOvrl
      AssemblySwConnector_634: ecu-extract-reference=FordMotTqCmdOvrlLimrDFordMotTqCmdOvrlDAssiSumLimDMotTqCmdOvrl
      AssemblySwConnector_637: ecu-extract-reference=FordMsg3D7BusHiSpdDFordVehCllsnMtgtnByBrkgLatDstRawDCDD_FordBlaBoxIfCmnDFordVehCllsnMtgtnByBrkgLatDstRaw
      AssemblySwConnector_638: ecu-extract-reference=FordMsg3D7BusHiSpdDFordVehCllsnMtgtnByBrkgLgtDstRawDCDD_FordBlaBoxIfCmnDFordVehCllsnMtgtnByBrkgLgtDstRaw
      AssemblySwConnector_639: ecu-extract-reference=FordMsg3D7BusHiSpdDFordVehCllsnMtgtnByBrkgObjDataConfLvlRawDCDD_FordBlaBoxIfCmnDFordVehCllsnMtgtnByBrkgObjDataConfLvlRaw
      AssemblySwConnector_640: ecu-extract-reference=FordMsg3D7BusHiSpdDFordVehCllsnMtgtnByBrkgObjTypClassnRawDCDD_FordBlaBoxIfCmnDFordVehCllsnMtgtnByBrkgObjTypClassnRaw
      AssemblySwConnector_641: ecu-extract-reference=FordMsg3D7BusHiSpdDFordVehCllsnMtgtnByBrkgRelLatVelRawDCDD_FordBlaBoxIfCmnDFordVehCllsnMtgtnByBrkgRelLatVelRaw
      AssemblySwConnector_642: ecu-extract-reference=FordMsg3D7BusHiSpdDFordVehCllsnMtgtnByBrkgRelLgtVelRawDCDD_FordBlaBoxIfCmnDFordVehCllsnMtgtnByBrkgRelLgtVelRaw
      AssemblySwConnector_643: ecu-extract-reference=FordMsg3D7BusHiSpdDFordVehCllsnMtgtnByBrkgTiToCllsnRawDCDD_FordBlaBoxIfCmnDFordVehCllsnMtgtnByBrkgTiToCllsnRaw
      AssemblySwConnector_644: ecu-extract-reference=FordMsg3D7BusHiSpdDFordVehEvasSteerAssiImgProcrModlAVldDCDD_FordBlaBoxIfCmnDFordVehEvasSteerAssiImgProcrModlAVld
      AssemblySwConnector_645: ecu-extract-reference=HwAgSysArbnDHwVelDFordMotTqCmdOvrlLimrDHwVel
      AssemblySwConnector_646: ecu-extract-reference=ImcArbnDGetSigImcData_u08DFordCmdArbnDGetSigImcData_u08
      AssemblySwConnector_647: ecu-extract-reference=ImcArbnDGetSigImcData_f32DFordHwTqCmdOvrlLimrDGetSigImcData_f32
      AssemblySwConnector_654: ecu-extract-reference=ImcSigArbnDHwTqImcCorrdDFordMotTqCmdOvrlLimrDFildHwTq
      AssemblySwConnector_668: ecu-extract-reference=ImcSigArbnDVehSpdImcCorrdDFordMotTqCmdOvrlLimrDFildVehSpd
      AssemblySwConnector_670: ecu-extract-reference=VehSigCdngDVehSpdVldDFordHwTqCmdOvrlLimrDVehSpdVld
      AssemblySwConnector_728: ecu-extract-reference=VehSigCdngDVehSpdVldDFordMotTqCmdOvrlLimrDVehSpdVld
      AssemblySwConnector_733: ecu-extract-reference=FordMsg3CABusHiSpdDFordVehLaneDetnWarnIntenDCDD_FordBlaBoxIfCmnDFordVehLaneDetnWarnInten
      AssemblySwConnector_734: ecu-extract-reference=FordMsg3CABusHiSpdDFordVehLaneDetnWarnStsDCDD_FordBlaBoxIfCmnDFordVehLaneDetnWarnSts
      AssemblySwConnector_735: ecu-extract-reference=FordMsg3CABusHiSpdDFordVehLaneKeepSysRampTypDCDD_FordBlaBoxIfCmnDFordVehLaneKeepSysRampTyp
      AssemblySwConnector_736: ecu-extract-reference=FordMsg3CABusHiSpdDFordVehLaneKeepSysStsDCDD_FordBlaBoxIfCmnDFordVehLaneKeepSysSts
      AssemblySwConnector_737: ecu-extract-reference=FordMsg3D3BusHiSpdDFordVehLatCtrlHandsOffDetnTqStimlsReqDCDD_FordBlaBoxIfCmnDFordVehLatCtrlHandsOffDetnTqStimlsReq
      AssemblySwConnector_738: ecu-extract-reference=FordMsg3D3BusHiSpdDFordVehLatCtrlPrcsnDCDD_FordBlaBoxIfCmnDFordVehLatCtrlPrcsn
      AssemblySwConnector_739: ecu-extract-reference=FordMsg3D3BusHiSpdDFordVehLatCtrlRampTypDCDD_FordBlaBoxIfCmnDFordVehLatCtrlRampTyp
      AssemblySwConnector_740: ecu-extract-reference=FordMsg3D3BusHiSpdDFordVehLatCtrlReqDCDD_FordBlaBoxIfCmnDFordVehLatCtrlReq
      AssemblySwConnector_741: ecu-extract-reference=ImcSigArbnDVehSpdImcCorrdDFordHwTqCmdOvrlLimrDFildVehSpd
      DelegationSwConnector_090: ecu-extract-reference=Ford_LaCurvature_No_CalcDDFordMsg3CABusHiSpdDFord_LaCurvature_No_Calc
      DelegationSwConnector_091: ecu-extract-reference=Ford_LaRefAng_No_ReqDDFordMsg3CABusHiSpdDFord_LaRefAng_No_Req
      DelegationSwConnector_092: ecu-extract-reference=Ford_LatCtlCurv_No_ActlDDFordMsg3D3BusHiSpdDFord_LatCtlCurv_No_Actl
      DelegationSwConnector_093: ecu-extract-reference=Ford_LatCtlCurv_NoRate_ActlDDFordMsg3D3BusHiSpdDFord_LatCtlCurv_NoRate_Actl
      DelegationSwConnector_094: ecu-extract-reference=Ford_LatCtlPath_An_ActlDDFordMsg3D3BusHiSpdDFord_LatCtlPath_An_Actl
      DelegationSwConnector_095: ecu-extract-reference=Ford_LatCtlPathOffst_L_ActlDDFordMsg3D3BusHiSpdDFord_LatCtlPathOffst_L_Actl
      DelegationSwConnector_096: ecu-extract-reference=Ford_LatCtlRng_L_MaxDDFordMsg3D3BusHiSpdDFord_LatCtlRng_L_Max
      DelegationSwConnector_097: ecu-extract-reference=Ford_StabCtlBrkActv_B_ActlDDFordMsg213BusHiSpdDFord_StabCtlBrkActv_B_Actl
      AssemblySwConnector_082: ecu-extract-reference=CalRegn02CmnDFordCmdArbnActvNiblCtrlDeactvnDFordCmdArbnDFordCmdArbnActvNiblCtrlDeactvn
      AssemblySwConnector_171: ecu-extract-reference=CalRegn02CmnDFordCmdArbnActvNiblCtrlDeniedActvnReqDFordCmdArbnDFordCmdArbnActvNiblCtrlDeniedActvnReq
      AssemblySwConnector_203: ecu-extract-reference=CalRegn02CmnDFordCmdArbnDrvrSteerDeniedActvnReqDFordCmdArbnDFordCmdArbnDrvrSteerDeniedActvnReq
      AssemblySwConnector_232: ecu-extract-reference=CalRegn02CmnDFordCmdArbnDrvrSteerRcmdnDeactvnDFordCmdArbnDFordCmdArbnDrvrSteerRcmdnDeactvn
      AssemblySwConnector_336: ecu-extract-reference=CalRegn02CmnDFordCmdArbnEvasSteerAssiDeactvnDFordCmdArbnDFordCmdArbnEvasSteerAssiDeactvn
      AssemblySwConnector_470: ecu-extract-reference=CalRegn02CmnDFordCmdArbnEvasSteerDeniedActvnReqDFordCmdArbnDFordCmdArbnEvasSteerDeniedActvnReq
      AssemblySwConnector_471: ecu-extract-reference=CalRegn02CmnDFordCmdArbnExtAgCtrlDeactvnDFordCmdArbnDFordCmdArbnExtAgCtrlDeactvn
      AssemblySwConnector_526: ecu-extract-reference=CalRegn02CmnDFordCmdArbnExtAgDeniedActvnReqDFordCmdArbnDFordCmdArbnExtAgDeniedActvnReq
      AssemblySwConnector_538: ecu-extract-reference=CalRegn02CmnDFordCmdArbnLaneDprtrWarnDeactvnDFordCmdArbnDFordCmdArbnLaneDprtrWarnDeactvn
      AssemblySwConnector_544: ecu-extract-reference=CalRegn02CmnDFordCmdArbnLaneDprtrWarnDeniedActvnReqDFordCmdArbnDFordCmdArbnLaneDprtrWarnDeniedActvnReq
      AssemblySwConnector_545: ecu-extract-reference=CalRegn02CmnDFordCmdArbnLaneKeepAssiDeactvnDFordCmdArbnDFordCmdArbnLaneKeepAssiDeactvn
      AssemblySwConnector_614: ecu-extract-reference=CalRegn02CmnDFordCmdArbnLaneKeepAssiDeniedActvnReqDFordCmdArbnDFordCmdArbnLaneKeepAssiDeniedActvnReq
      AssemblySwConnector_742: ecu-extract-reference=CalRegn02CmnDFordCmdArbnLatCtrlDeactvnDFordCmdArbnDFordCmdArbnLatCtrlDeactvn
      AssemblySwConnector_743: ecu-extract-reference=CalRegn02CmnDFordCmdArbnLatCtrlDeniedActvnReqDFordCmdArbnDFordCmdArbnLatCtrlDeniedActvnReq
      AssemblySwConnector_744: ecu-extract-reference=CalRegn02CmnDFordCmdArbnNonStMaskDFordCmdArbnDFordCmdArbnNonStMask
      AssemblySwConnector_745: ecu-extract-reference=CalRegn02CmnDFordCmdArbnNormAssiTqThdDFordCmdArbnDFordCmdArbnNormAssiTqThd
      AssemblySwConnector_746: ecu-extract-reference=CalRegn02CmnDFordCmdArbnPullDriftCmpDeactvnDFordCmdArbnDFordCmdArbnPullDriftCmpDeactvn
      AssemblySwConnector_756: ecu-extract-reference=CalRegn02CmnDFordCmdArbnPullDriftCmpDeniedActvnReqDFordCmdArbnDFordCmdArbnPullDriftCmpDeniedActvnReq
      AssemblySwConnector_757: ecu-extract-reference=CalRegn02CmnDFordCmdArbnPullDriftCmpLrngDeactvnDFordCmdArbnDFordCmdArbnPullDriftCmpLrngDeactvn
      AssemblySwConnector_758: ecu-extract-reference=CalRegn02CmnDFordCmdArbnPullDriftCmpLrngDeniedActvnReqDFordCmdArbnDFordCmdArbnPullDriftCmpLrngDeniedActvnReq
      AssemblySwConnector_759: ecu-extract-reference=CalRegn02CmnDFordCmdArbnSpare1DeactvnDFordCmdArbnDFordCmdArbnSpare1Deactvn
      AssemblySwConnector_760: ecu-extract-reference=CalRegn02CmnDFordCmdArbnSpare1DeniedActvnReqDFordCmdArbnDFordCmdArbnSpare1DeniedActvnReq
      AssemblySwConnector_761: ecu-extract-reference=CalRegn02CmnDFordCmdArbnSpare2DeactvnDFordCmdArbnDFordCmdArbnSpare2Deactvn
      AssemblySwConnector_762: ecu-extract-reference=CalRegn02CmnDFordCmdArbnSpare2DeniedActvnReqDFordCmdArbnDFordCmdArbnSpare2DeniedActvnReq
      AssemblySwConnector_763: ecu-extract-reference=CalRegn02CmnDFordCmdArbnSpare3DeactvnDFordCmdArbnDFordCmdArbnSpare3Deactvn
      AssemblySwConnector_764: ecu-extract-reference=CalRegn02CmnDFordCmdArbnSpare3DeniedActvnReqDFordCmdArbnDFordCmdArbnSpare3DeniedActvnReq
      AssemblySwConnector_765: ecu-extract-reference=CalRegn02CmnDFordCmdArbnSteerDstbcDeactvnDFordCmdArbnDFordCmdArbnSteerDstbcDeactvn
      AssemblySwConnector_766: ecu-extract-reference=CalRegn02CmnDFordCmdArbnSteerDstbcDeniedActvnReqDFordCmdArbnDFordCmdArbnSteerDstbcDeniedActvnReq
      AssemblySwConnector_767: ecu-extract-reference=CalRegn02CmnDFordHwTqCmdOvrlLimrCombdBwYDFordHwTqCmdOvrlLimrDFordHwTqCmdOvrlLimrCombdBwY
      AssemblySwConnector_768: ecu-extract-reference=CalRegn02CmnDFordHwTqCmdOvrlLimrCombdTqRateYDFordHwTqCmdOvrlLimrDFordHwTqCmdOvrlLimrCombdTqRateY
      AssemblySwConnector_769: ecu-extract-reference=CalRegn02CmnDFordHwTqCmdOvrlLimrCombdTqSatnYDFordHwTqCmdOvrlLimrDFordHwTqCmdOvrlLimrCombdTqSatnY
      AssemblySwConnector_782: ecu-extract-reference=CalRegn02CmnDFordHwTqCmdOvrlLimrCombdVehSpdBreakPtXDFordHwTqCmdOvrlLimrDFordHwTqCmdOvrlLimrCombdVehSpdBreakPtX
      AssemblySwConnector_783: ecu-extract-reference=CalRegn02CmnDFordHwTqCmdOvrlLimrDftSpdRateDFordHwTqCmdOvrlLimrDFordHwTqCmdOvrlLimrDftSpdRate
      AssemblySwConnector_784: ecu-extract-reference=CalRegn02CmnDFordHwTqCmdOvrlLimrDftSpdRcvrRateDFordHwTqCmdOvrlLimrDFordHwTqCmdOvrlLimrDftSpdRcvrRate
      AssemblySwConnector_785: ecu-extract-reference=CalRegn02CmnDFordHwTqCmdOvrlLimrLkaBwYDFordHwTqCmdOvrlLimrDFordHwTqCmdOvrlLimrLkaBwY
      AssemblySwConnector_786: ecu-extract-reference=CalRegn02CmnDFordHwTqCmdOvrlLimrLkaTqRateYDFordHwTqCmdOvrlLimrDFordHwTqCmdOvrlLimrLkaTqRateY
      AssemblySwConnector_787: ecu-extract-reference=CalRegn02CmnDFordHwTqCmdOvrlLimrLkaTqSatnYDFordHwTqCmdOvrlLimrDFordHwTqCmdOvrlLimrLkaTqSatnY
      AssemblySwConnector_788: ecu-extract-reference=CalRegn02CmnDFordHwTqCmdOvrlLimrVehSpdBreakPtXDFordHwTqCmdOvrlLimrDFordHwTqCmdOvrlLimrVehSpdBreakPtX
      AssemblySwConnector_789: ecu-extract-reference=CalRegn02CmnDFordMotTqCmdOvrlLimrDftSpdRateDFordMotTqCmdOvrlLimrDFordMotTqCmdOvrlLimrDftSpdRate
      AssemblySwConnector_790: ecu-extract-reference=CalRegn02CmnDFordMotTqCmdOvrlLimrDftSpdRcvrRateDFordMotTqCmdOvrlLimrDFordMotTqCmdOvrlLimrDftSpdRcvrRate
      AssemblySwConnector_791: ecu-extract-reference=CalRegn02CmnDFordMotTqCmdOvrlLimrHiFrqMonrActvNiblCtrlDcTqTrendThdDFordMotTqCmdOvrlLimrDFordMotTqCmdOvrlLimrHiFrqMonr_ffebb2d9
      AssemblySwConnector_792: ecu-extract-reference=CalRegn02CmnDFordMotTqCmdOvrlLimrHiFrqMonrActvNiblCtrlLoFrqTiThdDFordMotTqCmdOvrlLimrDFordMotTqCmdOvrlLimrHiFrqMonrAc_c2626da4
      AssemblySwConnector_793: ecu-extract-reference=CalRegn02CmnDFordMotTqCmdOvrlLimrHiFrqMonrActvNiblCtrlMaxMotTqDFordMotTqCmdOvrlLimrDFordMotTqCmdOvrlLimrHiFrqMonrActv_b23f779c
      AssemblySwConnector_794: ecu-extract-reference=CalRegn02CmnDFordMotTqCmdOvrlLimrHiFrqMonrLaneDprtrWarnDcTqTrendThdDFordMotTqCmdOvrlLimrDFordMotTqCmdOvrlLimrHiFrqMon_b5a5837b
      AssemblySwConnector_795: ecu-extract-reference=CalRegn02CmnDFordMotTqCmdOvrlLimrHiFrqMonrLaneDprtrWarnLoFrqTiThdDFordMotTqCmdOvrlLimrDFordMotTqCmdOvrlLimrHiFrqMonrL_aee7dbef
      AssemblySwConnector_796: ecu-extract-reference=CalRegn02CmnDFordMotTqCmdOvrlLimrHiFrqMonrLaneDprtrWarnMaxMotTqDFordMotTqCmdOvrlLimrDFordMotTqCmdOvrlLimrHiFrqMonrLan_b181ca99
      AssemblySwConnector_797: ecu-extract-reference=CalRegn02CmnDFordMotTqCmdOvrlLimrHiFrqMonrTqTrendAlphaDFordMotTqCmdOvrlLimrDFordMotTqCmdOvrlLimrHiFrqMonrTqTrendAlpha
      AssemblySwConnector_798: ecu-extract-reference=CalRegn02CmnDFordMotTqCmdOvrlLimrHiFrqMonrZeroBandTqDFordMotTqCmdOvrlLimrDFordMotTqCmdOvrlLimrHiFrqMonrZeroBandTq
      AssemblySwConnector_799: ecu-extract-reference=CalRegn02CmnDFordMotTqCmdOvrlLimrHwVelLoPassFrqDFordMotTqCmdOvrlLimrDFordMotTqCmdOvrlLimrHwVelLoPassFrq
      AssemblySwConnector_800: ecu-extract-reference=CalRegn02CmnDFordMotTqCmdOvrlLimrLatCtrlBwYDFordMotTqCmdOvrlLimrDFordMotTqCmdOvrlLimrLatCtrlBwY
      AssemblySwConnector_801: ecu-extract-reference=CalRegn02CmnDFordMotTqCmdOvrlLimrLatCtrlTqRateYDFordMotTqCmdOvrlLimrDFordMotTqCmdOvrlLimrLatCtrlTqRateY
      AssemblySwConnector_802: ecu-extract-reference=CalRegn02CmnDFordMotTqCmdOvrlLimrLatCtrlTqSatnYDFordMotTqCmdOvrlLimrDFordMotTqCmdOvrlLimrLatCtrlTqSatnY
      AssemblySwConnector_803: ecu-extract-reference=CalRegn02CmnDFordMotTqCmdOvrlLimrLatCtrlVehSpdBreakPtXDFordMotTqCmdOvrlLimrDFordMotTqCmdOvrlLimrLatCtrlVehSpdBreakPtX
      AssemblySwConnector_804: ecu-extract-reference=CalRegn02CmnDFordMotTqCmdOvrlLimrPullDriftCmpTqRateYDFordMotTqCmdOvrlLimrDFordMotTqCmdOvrlLimrPullDriftCmpTqRateY
      AssemblySwConnector_805: ecu-extract-reference=CalRegn02CmnDFordMotTqCmdOvrlLimrPullDriftCmpTqSatnYDFordMotTqCmdOvrlLimrDFordMotTqCmdOvrlLimrPullDriftCmpTqSatnY
      AssemblySwConnector_806: ecu-extract-reference=CalRegn02CmnDFordMotTqCmdOvrlLimrPullDriftCmpVehSpdBreakPtXDFordMotTqCmdOvrlLimrDFordMotTqCmdOvrlLimrPullDriftCmpVehS_beada840
      AssemblySwConnector_807: ecu-extract-reference=CalRegn02CmnDFordMotTqCmdOvrlLimrSteerReactnLimrCombAmpVehSpdLimXDFordMotTqCmdOvrlLimrDFordMotTqCmdOvrlLimrSteerReact_15bf250e
      AssemblySwConnector_808: ecu-extract-reference=CalRegn02CmnDFordMotTqCmdOvrlLimrSteerReactnLimrCombAmpVehSpdLimYDFordMotTqCmdOvrlLimrDFordMotTqCmdOvrlLimrSteerReact_e1563028
      AssemblySwConnector_809: ecu-extract-reference=CalRegn02CmnDFordMotTqCmdOvrlLimrSteerReactnLimrCombdAmpOvrrunDFordMotTqCmdOvrlLimrDFordMotTqCmdOvrlLimrSteerReactnLi_e69e2685
      AssemblySwConnector_810: ecu-extract-reference=CalRegn02CmnDFordMotTqCmdOvrlLimrSteerReactnLimrCombdAmpRcvryDFordMotTqCmdOvrlLimrDFordMotTqCmdOvrlLimrSteerReactnLim_39b663eb
      AssemblySwConnector_811: ecu-extract-reference=CalRegn02CmnDFordMotTqCmdOvrlLimrSteerReactnLimrCombdFixdOvrrunRampRateDFordMotTqCmdOvrlLimrDFordMotTqCmdOvrlLimrStee_204d1738
      AssemblySwConnector_812: ecu-extract-reference=CalRegn02CmnDFordMotTqCmdOvrlLimrSteerReactnLimrCombdLimHysDFordMotTqCmdOvrlLimrDFordMotTqCmdOvrlLimrSteerReactnLimrC_8ee4af52
      AssemblySwConnector_813: ecu-extract-reference=CalRegn02CmnDFordMotTqCmdOvrlLimrSteerReactnLimrCombdLimrHwVelYDFordMotTqCmdOvrlLimrDFordMotTqCmdOvrlLimrSteerReactnL_466bcf2d
      AssemblySwConnector_814: ecu-extract-reference=CalRegn02CmnDFordMotTqCmdOvrlLimrSteerReactnLimrCombdLimrVehSpdDFordMotTqCmdOvrlLimrDFordMotTqCmdOvrlLimrSteerReactnL_44bd4088
      AssemblySwConnector_815: ecu-extract-reference=CalRegn02CmnDFordMotTqCmdOvrlLimrSteerReactnLimrCombdLimTqXDFordMotTqCmdOvrlLimrDFordMotTqCmdOvrlLimrSteerReactnLimrC_ee0d8c4c
      AssemblySwConnector_816: ecu-extract-reference=CalRegn02CmnDFordMotTqCmdOvrlLimrSteerReactnLimrCombdRcvryIdealRampRateDFordMotTqCmdOvrlLimrDFordMotTqCmdOvrlLimrStee_cf09aec2
      AssemblySwConnector_817: ecu-extract-reference=CalRegn02CmnDFordMotTqCmdOvrlLimrSteerReactnLimrCombdRcvryRampRateStg1DFordMotTqCmdOvrlLimrDFordMotTqCmdOvrlLimrSteer_d22c6cc0
      AssemblySwConnector_818: ecu-extract-reference=CalRegn02CmnDFordMotTqCmdOvrlLimrSteerReactnLimrCombdRcvryRampRateStg2DFordMotTqCmdOvrlLimrDFordMotTqCmdOvrlLimrSteer_1ec3ffb3
      AssemblySwConnector_819: ecu-extract-reference=CalRegn02CmnDFordMotTqCmdOvrlLimrSteerReactnLimrCombOvrrunRampRateHwVelErrXDFordMotTqCmdOvrlLimrDFordMotTqCmdOvrlLimr_72cae36a
      AssemblySwConnector_820: ecu-extract-reference=CalRegn02CmnDFordMotTqCmdOvrlLimrSteerReactnLimrCombOvrrunRampRateOutYDFordMotTqCmdOvrlLimrDFordMotTqCmdOvrlLimrSteer_3117aae5
      AssemblySwConnector_821: ecu-extract-reference=CDD_NxtrTiDGetRefTmr100MicroSec32bitDFordMsg47ABusHiSpdDGetRefTmr100MicroSec32bit
      AssemblySwConnector_822: ecu-extract-reference=CustDiagDFordTrlrBackupAssiEnadDFordMsg47ABusHiSpdDFordTrlrBackupAssiEnad
      AssemblySwConnector_823: ecu-extract-reference=FordMsg083BusHiSpdDFordVehTurnSigSwtStsRawDCDD_FordBlaBoxIfCmnDFordVehTurnSigSwtStsRaw
      AssemblySwConnector_824: ecu-extract-reference=FordMsg47ABusHiSpdDFordVehTrlrAidKnobBtnDCDD_FordBlaBoxIfCmnDFordVehTrlrAidKnobBtn
      DelegationSwConnector_098: ecu-extract-reference=Ford_TrlrAidCtl_U_RqDrvDDFordMsg47ABusHiSpdDFord_TrlrAidCtl_U_RqDrv
      DelegationSwConnector_099: ecu-extract-reference=Ford_TrlrAidSwtch_D_RqDrvDDFordMsg47ABusHiSpdDFord_TrlrAidSwtch_D_RqDrv1
      AssemblySwConnector_825: ecu-extract-reference=CalRegn01CmnDFordMsg3D7BusHiSpdImgProcrModlAVldMissThdDFordMsg3D7BusHiSpdDFordMsg3D7BusHiSpdImgProcrModlAVldMissThd
      AssemblySwConnector_826: ecu-extract-reference=CalRegn01CmnDFordMsg3D7BusHiSpdImgProcrModlAVldPassdThdDFordMsg3D7BusHiSpdDFordMsg3D7BusHiSpdImgProcrModlAVldPassdThd
      AssemblySwConnector_827: ecu-extract-reference=CalRegn01CmnDFordMsg3D7BusHiSpdLatDstInvldFaildThdDFordMsg3D7BusHiSpdDFordMsg3D7BusHiSpdLatDstInvldFaildThd
      AssemblySwConnector_828: ecu-extract-reference=CalRegn01CmnDFordMsg3D7BusHiSpdLatDstInvldPassdThdDFordMsg3D7BusHiSpdDFordMsg3D7BusHiSpdLatDstInvldPassdThd
      AssemblySwConnector_829: ecu-extract-reference=CalRegn01CmnDFordMsg3D7BusHiSpdLatDstRawVldFaildThdDFordMsg3D7BusHiSpdDFordMsg3D7BusHiSpdLatDstRawVldFaildThd
      AssemblySwConnector_830: ecu-extract-reference=CalRegn01CmnDFordMsg3D7BusHiSpdLgtDstInvldFaildThdDFordMsg3D7BusHiSpdDFordMsg3D7BusHiSpdLgtDstInvldFaildThd
      AssemblySwConnector_831: ecu-extract-reference=CalRegn01CmnDFordMsg3D7BusHiSpdLgtDstInvldPassdThdDFordMsg3D7BusHiSpdDFordMsg3D7BusHiSpdLgtDstInvldPassdThd
      AssemblySwConnector_832: ecu-extract-reference=CalRegn01CmnDFordMsg3D7BusHiSpdLgtDstRawVldFaildThdDFordMsg3D7BusHiSpdDFordMsg3D7BusHiSpdLgtDstRawVldFaildThd
      AssemblySwConnector_833: ecu-extract-reference=CalRegn01CmnDFordMsg3D7BusHiSpdMissMsgFaildThdDFordMsg3D7BusHiSpdDFordMsg3D7BusHiSpdMissMsgFaildThd
      AssemblySwConnector_834: ecu-extract-reference=CalRegn01CmnDFordMsg3D7BusHiSpdMissMsgPassdThdDFordMsg3D7BusHiSpdDFordMsg3D7BusHiSpdMissMsgPassdThd
      AssemblySwConnector_835: ecu-extract-reference=CalRegn01CmnDFordMsg3D7BusHiSpdRelLatVelInvldFaildThdDFordMsg3D7BusHiSpdDFordMsg3D7BusHiSpdRelLatVelInvldFaildThd
      AssemblySwConnector_836: ecu-extract-reference=CalRegn01CmnDFordMsg3D7BusHiSpdRelLatVelInvldPassdThdDFordMsg3D7BusHiSpdDFordMsg3D7BusHiSpdRelLatVelInvldPassdThd
      AssemblySwConnector_837: ecu-extract-reference=CalRegn01CmnDFordMsg3D7BusHiSpdRelLatVelRawVldFaildThdDFordMsg3D7BusHiSpdDFordMsg3D7BusHiSpdRelLatVelRawVldFaildThd
      AssemblySwConnector_838: ecu-extract-reference=CalRegn01CmnDFordMsg3D7BusHiSpdRelLgtVelInvldFaildThdDFordMsg3D7BusHiSpdDFordMsg3D7BusHiSpdRelLgtVelInvldFaildThd
      AssemblySwConnector_839: ecu-extract-reference=CalRegn01CmnDFordMsg3D7BusHiSpdRelLgtVelInvldPassdThdDFordMsg3D7BusHiSpdDFordMsg3D7BusHiSpdRelLgtVelInvldPassdThd
      AssemblySwConnector_840: ecu-extract-reference=CalRegn01CmnDFordMsg3D7BusHiSpdRelLgtVelRawVldFaildThdDFordMsg3D7BusHiSpdDFordMsg3D7BusHiSpdRelLgtVelRawVldFaildThd
      AssemblySwConnector_841: ecu-extract-reference=CalRegn01CmnDFordMsg3D7BusHiSpdTiToCllsnInvldFaildThdDFordMsg3D7BusHiSpdDFordMsg3D7BusHiSpdTiToCllsnInvldFaildThd
      AssemblySwConnector_842: ecu-extract-reference=CalRegn01CmnDFordMsg3D7BusHiSpdTiToCllsnInvldPassdThdDFordMsg3D7BusHiSpdDFordMsg3D7BusHiSpdTiToCllsnInvldPassdThd
      AssemblySwConnector_860: ecu-extract-reference=CalRegn01CmnDFordMsg3D7BusHiSpdTiToCllsnRawVldFaildThdDFordMsg3D7BusHiSpdDFordMsg3D7BusHiSpdTiToCllsnRawVldFaildThd
      DelegationSwConnector_100: ecu-extract-reference=Ford_CmbbObjClass_D_StatDDFordMsg3D7BusHiSpdDFord_CmbbObjClass_D_Stat1
      DelegationSwConnector_101: ecu-extract-reference=Ford_CmbbObjColl_T_ActlDDFordMsg3D7BusHiSpdDFord_CmbbObjColl_T_Actl
      DelegationSwConnector_102: ecu-extract-reference=Ford_CmbbObjConfdnc_D_StatDDFordMsg3D7BusHiSpdDFord_CmbbObjConfdnc_D_Stat1
      DelegationSwConnector_103: ecu-extract-reference=Ford_CmbbObjDistLat_L_ActlDDFordMsg3D7BusHiSpdDFord_CmbbObjDistLat_L_Actl
      DelegationSwConnector_104: ecu-extract-reference=Ford_CmbbObjDistLong_L_ActlDDFordMsg3D7BusHiSpdDFord_CmbbObjDistLong_L_Actl
      DelegationSwConnector_105: ecu-extract-reference=Ford_CmbbObjRelLat_V_ActlDDFordMsg3D7BusHiSpdDFord_CmbbObjRelLat_V_Actl
      DelegationSwConnector_106: ecu-extract-reference=Ford_CmbbObjRelLong_V_ActlDDFordMsg3D7BusHiSpdDFord_CmbbObjRelLong_V_Actl
      DelegationSwConnector_107: ecu-extract-reference=Ford_EsaEnbl_D2_RqDDFordMsg3D7BusHiSpdDFord_EsaEnbl_D2_Rq1
      AssemblySwConnector_881: ecu-extract-reference=FordCanDtcInhbDFordCanDtcInhbDFordMsg167BusHiSpdDFordCanDtcInhb
      AssemblySwConnector_882: ecu-extract-reference=FordCanDtcInhbDFordCanDtcInhbDFordMsg202BusHiSpdDFordCanDtcInhb
      AssemblySwConnector_883: ecu-extract-reference=FordCanDtcInhbDFordCanDtcInhbDFordMsg217BusHiSpdDFordCanDtcInhb
      AssemblySwConnector_884: ecu-extract-reference=FordCanDtcInhbDFordCanDtcInhbDFordMsg3B3BusHiSpdDFordCanDtcInhb
      AssemblySwConnector_885: ecu-extract-reference=FordCanDtcInhbDFordCanDtcInhbDFordMsg40ABusHiSpdDFordCanDtcInhb
      AssemblySwConnector_886: ecu-extract-reference=FordCanDtcInhbDFordCanDtcInhbDFordMsg415BusHiSpdDFordCanDtcInhb
      AssemblySwConnector_887: ecu-extract-reference=FordCanDtcInhbDFordCanDtcInhbDFordMsg430BusHiSpdDFordCanDtcInhb
      AssemblySwConnector_888: ecu-extract-reference=FordCanDtcInhbDFordCanDtcInhbDFordMsg07DBusHiSpdDFordCanDtcInhb
      AssemblySwConnector_889: ecu-extract-reference=FordCanDtcInhbDFordCanDtcInhbDFordMsg083BusHiSpdDFordCanDtcInhb
      AssemblySwConnector_890: ecu-extract-reference=FordCanDtcInhbDFordCanDtcInhbDFordMsg091BusHiSpdDFordCanDtcInhb
      AssemblySwConnector_891: ecu-extract-reference=FordCanDtcInhbDFordCanDtcInhbDFordMsg213BusHiSpdDFordCanDtcInhb
      AssemblySwConnector_892: ecu-extract-reference=FordCanDtcInhbDFordCanDtcInhbDFordMsg215BusHiSpdDFordCanDtcInhb
      AssemblySwConnector_893: ecu-extract-reference=FordCanDtcInhbDFordCanDtcInhbDFordMsg216BusHiSpdDFordCanDtcInhb
      AssemblySwConnector_894: ecu-extract-reference=FordCanDtcInhbDFordCanDtcInhbDFordMsg230BusHiSpdDFordCanDtcInhb
      AssemblySwConnector_895: ecu-extract-reference=FordCanDtcInhbDFordCanDtcInhbDFordMsg3CABusHiSpdDFordCanDtcInhb
      AssemblySwConnector_896: ecu-extract-reference=FordCanDtcInhbDFordCanDtcInhbDFordMsg3D3BusHiSpdDFordCanDtcInhb
      AssemblySwConnector_897: ecu-extract-reference=FordCanDtcInhbDFordCanDtcInhbDFordMsg3D7BusHiSpdDFordCanDtcInhb
      AssemblySwConnector_898: ecu-extract-reference=FordCanDtcInhbDFordCanDtcInhbDFordMsg41ABusHiSpdDFordCanDtcInhb
      AssemblySwConnector_899: ecu-extract-reference=FordCanDtcInhbDFordCanDtcInhbDFordMsg41EBusHiSpdDFordCanDtcInhb
      AssemblySwConnector_900: ecu-extract-reference=FordCanDtcInhbDFordCanDtcInhbDFordMsg443BusHiSpdDFordCanDtcInhb
      AssemblySwConnector_901: ecu-extract-reference=FordCanDtcInhbDFordCanDtcInhbDFordMsg459BusHiSpdDFordCanDtcInhb
      AssemblySwConnector_902: ecu-extract-reference=FordCanDtcInhbDFordCanDtcInhbDFordMsg47ABusHiSpdDFordCanDtcInhb
      AssemblySwConnector_635: ecu-extract-reference=BattVltgDBrdgVltgDImcArbnDBattVltg
      AssemblySwConnector_636: ecu-extract-reference=ElecPwrCnsDSplyCurrEstimDImcArbnDBattRtnCurr
      AssemblySwConnector_903: ecu-extract-reference=FordCanDtcInhbDFordEpsLifeCycModDFordMsg459BusHiSpdDFordEpsLifeCycMod
      AssemblySwConnector_904: ecu-extract-reference=FordMsg459BusHiSpdDFordVehTrlrAidTrakgStVldDCDD_FordBlaBoxIfCmnDFordVehTrlrAidTrakgStVld
      DelegationSwConnector_108: ecu-extract-reference=Ford_HitchToVehAxle_L_CalcDDFordMsg459BusHiSpdDFord_HitchToVehAxle_L_Calc
      DelegationSwConnector_109: ecu-extract-reference=Ford_TrlrAid_An3_ActlDDFordMsg459BusHiSpdDFord_TrlrAid_An3_Actl
      DelegationSwConnector_110: ecu-extract-reference=Ford_TrlrAid_AnRate2_ActlDDFordMsg459BusHiSpdDFord_TrlrAid_AnRate2_Actl
      DelegationSwConnector_111: ecu-extract-reference=Ford_TrlrAid_D2_StatDDFordMsg459BusHiSpdDFord_TrlrAid_D2_Stat
      DelegationSwConnector_112: ecu-extract-reference=Ford_TrlrAidTrgtId_No_ActlDDFordMsg459BusHiSpdDFord_TrlrAidTrgtId_No_Actl
      DelegationSwConnector_113: ecu-extract-reference=Ford_TrlrRvrse_D_StatDDFordMsg459BusHiSpdDFord_TrlrRvrse_D_Stat
      DelegationSwConnector_114: ecu-extract-reference=Ford_TrlrTrgtAcquire_D_StatDDFordMsg459BusHiSpdDFord_TrlrTrgtAcquire_D_Stat
      AssemblySwConnector_905: ecu-extract-reference=CDD_FordBlaBoxIfCmp2DFordVehEvasSteerAssiStsDFordMsg417BusHiSpdDFordVehEvasSteerAssiSts
      AssemblySwConnector_907: ecu-extract-reference=FordMsg091BusHiSpdDFordVehYawRateRawDCDD_FordBlaBoxIfCmnDFordVehYawRateRaw
      AssemblySwConnector_908: ecu-extract-reference=FordCmdArbnDFordActvNiblCtrlArbnCmdDImcArbnDFordActvNiblCtrlArbnCmd
      AssemblySwConnector_909: ecu-extract-reference=FordCmdArbnDFordDrvrSteerRcmdnArbnCmdDImcArbnDFordDrvrSteerRcmdnArbnCmd
      AssemblySwConnector_910: ecu-extract-reference=FordCmdArbnDFordEvasSteerAssiArbnCmdDImcArbnDFordEvasSteerAssiArbnCmd
      AssemblySwConnector_911: ecu-extract-reference=FordCmdArbnDFordExtAgCtrlArbnCmdDImcArbnDFordExtAgCtrlArbnCmd
      AssemblySwConnector_912: ecu-extract-reference=FordCmdArbnDFordLaneDprtrWarnArbnCmdDImcArbnDFordLaneDprtrWarnArbnCmd
      AssemblySwConnector_913: ecu-extract-reference=FordCmdArbnDFordLaneKeepAssiArbnCmdDImcArbnDFordLaneKeepAssiArbnCmd
      AssemblySwConnector_914: ecu-extract-reference=FordCmdArbnDFordLatCtrlArbnCmdDImcArbnDFordLatCtrlArbnCmd
      AssemblySwConnector_915: ecu-extract-reference=FordCmdArbnDFordPullDriftCmpArbnCmdDImcArbnDFordPullDriftCmpArbnCmd
      AssemblySwConnector_916: ecu-extract-reference=FordCmdArbnDFordPullDriftCmpLrngArbnCmdDImcArbnDFordPullDriftCmpLrngArbnCmd
      AssemblySwConnector_917: ecu-extract-reference=FordCmdArbnDFordSpare1ArbnCmdDImcArbnDFordSpare1ArbnCmd
      AssemblySwConnector_982: ecu-extract-reference=FordCmdArbnDFordSpare2ArbnCmdDImcArbnDFordSpare2ArbnCmd
      AssemblySwConnector_983: ecu-extract-reference=FordCmdArbnDFordSpare3ArbnCmdDImcArbnDFordSpare3ArbnCmd
      AssemblySwConnector_985: ecu-extract-reference=FordCmdArbnDFordSteerTqDstbcRejctnArbnCmdDImcArbnDFordSteerTqDstbcRejctnArbnCmd
      AssemblySwConnector_986: ecu-extract-reference=FordHwAgArbnDFordCmpdHwPosnQlyFac8DCDD_FordBlaBoxIfCmnDFordCmpdHwPosnQlyFac
      AssemblySwConnector_987: ecu-extract-reference=FordHwTqCmdOvrlLimrDFordColTqOvrlDImcArbnDFordColTqOvrl
      AssemblySwConnector_988: ecu-extract-reference=FordMotTqCmdOvrlLimrDFordMotTqCmdOvrlDImcArbnDFordMotTqCmdOvrl
      ComponentPrototype_207: upstream-reference=ECU_Composition.FordMsg2FDBusHiSpd, ecu-extract-reference=COMPOSITIONTYPE.FordMsg2FDBusHiSpd
      ComponentPrototype_208: upstream-reference=ECU_Composition.FordMsg077BusHiSpd, ecu-extract-reference=COMPOSITIONTYPE.FordMsg077BusHiSpd
      AssemblySwConnector_648: ecu-extract-reference=CalRegn01CmnDPwrLimrStdOperMotEnvlpYDFordHwTqCdngDPwrLimrStdOperMotEnvlpY
      AssemblySwConnector_731: ecu-extract-reference=CalRegn01CmnDFordMsg077BusHiSpdCanDtcInhbThdDFordMsg077BusHiSpdDFordMsg077BusHiSpdCanDtcInhbThd
      AssemblySwConnector_732: ecu-extract-reference=CalRegn01CmnDFordMsg077BusHiSpdLatACmpdInvldSigFaildThdDFordMsg077BusHiSpdDFordMsg077BusHiSpdLatACmpdInvldSigFaildThd
      AssemblySwConnector_906: ecu-extract-reference=CalRegn01CmnDFordMsg077BusHiSpdLatACmpdInvldSigPassdThdDFordMsg077BusHiSpdDFordMsg077BusHiSpdLatACmpdInvldSigPassdThd
      AssemblySwConnector_989: ecu-extract-reference=CalRegn01CmnDFordMsg077BusHiSpdLatACmpdVldMissThdDFordMsg077BusHiSpdDFordMsg077BusHiSpdLatACmpdVldMissThd
      AssemblySwConnector_1003: ecu-extract-reference=CalRegn01CmnDFordMsg077BusHiSpdLgtACmpdInvldSigFaildThdDFordMsg077BusHiSpdDFordMsg077BusHiSpdLgtACmpdInvldSigFaildThd
      AssemblySwConnector_1004: ecu-extract-reference=CalRegn01CmnDFordMsg077BusHiSpdLgtACmpdInvldSigPassdThdDFordMsg077BusHiSpdDFordMsg077BusHiSpdLgtACmpdInvldSigPassdThd
      AssemblySwConnector_1005: ecu-extract-reference=CalRegn01CmnDFordMsg077BusHiSpdLgtACmpdVldMissThdDFordMsg077BusHiSpdDFordMsg077BusHiSpdLgtACmpdVldMissThd
      AssemblySwConnector_1006: ecu-extract-reference=CalRegn01CmnDFordMsg077BusHiSpdMissMsgFaildThdDFordMsg077BusHiSpdDFordMsg077BusHiSpdMissMsgFaildThd
      AssemblySwConnector_1007: ecu-extract-reference=CalRegn01CmnDFordMsg077BusHiSpdMissMsgPassdThdDFordMsg077BusHiSpdDFordMsg077BusHiSpdMissMsgPassdThd
      AssemblySwConnector_1008: ecu-extract-reference=CalRegn01CmnDFordMsg077BusHiSpdOverGndInvldSigFaildThdDFordMsg077BusHiSpdDFordMsg077BusHiSpdOverGndInvldSigFaildThd
      AssemblySwConnector_1009: ecu-extract-reference=CalRegn01CmnDFordMsg077BusHiSpdOverGndInvldSigPassdThdDFordMsg077BusHiSpdDFordMsg077BusHiSpdOverGndInvldSigPassdThd
      AssemblySwConnector_1010: ecu-extract-reference=CalRegn01CmnDFordMsg077BusHiSpdVehLatACmpdVldFaildThdDFordMsg077BusHiSpdDFordMsg077BusHiSpdVehLatACmpdVldFaildThd
      AssemblySwConnector_1011: ecu-extract-reference=CalRegn01CmnDFordMsg077BusHiSpdVehLatACmpdVldPassdThdDFordMsg077BusHiSpdDFordMsg077BusHiSpdVehLatACmpdVldPassdThd
      AssemblySwConnector_1012: ecu-extract-reference=CalRegn01CmnDFordMsg077BusHiSpdVehLgtACmpdVldFaildThdDFordMsg077BusHiSpdDFordMsg077BusHiSpdVehLgtACmpdVldFaildThd
      AssemblySwConnector_1013: ecu-extract-reference=CalRegn01CmnDFordMsg077BusHiSpdVehLgtACmpdVldPassdThdDFordMsg077BusHiSpdDFordMsg077BusHiSpdVehLgtACmpdVldPassdThd
      AssemblySwConnector_1014: ecu-extract-reference=CalRegn01CmnDFordMsg077BusHiSpdVehSpdOverGndVldFaildThdDFordMsg077BusHiSpdDFordMsg077BusHiSpdVehSpdOverGndVldFaildThd
      AssemblySwConnector_1015: ecu-extract-reference=CalRegn01CmnDFordMsg077BusHiSpdVehSpdOverGndVldMissThdDFordMsg077BusHiSpdDFordMsg077BusHiSpdVehSpdOverGndVldMissThd
      AssemblySwConnector_1016: ecu-extract-reference=CalRegn01CmnDFordMsg077BusHiSpdVehSpdOverGndVldPassdThdDFordMsg077BusHiSpdDFordMsg077BusHiSpdVehSpdOverGndVldPassdThd
      AssemblySwConnector_1017: ecu-extract-reference=CalRegn01CmnDFordMsg077BusHiSpdVehYawRateCmpdVldFaildThdDFordMsg077BusHiSpdDFordMsg077BusHiSpdVehYawRateCmpdVldFaildThd
      AssemblySwConnector_1018: ecu-extract-reference=CalRegn01CmnDFordMsg077BusHiSpdVehYawRateCmpdVldPassdThdDFordMsg077BusHiSpdDFordMsg077BusHiSpdVehYawRateCmpdVldPassdThd
      AssemblySwConnector_1019: ecu-extract-reference=CalRegn01CmnDFordMsg077BusHiSpdYawRateCmpdInvldSigFaildThdDFordMsg077BusHiSpdDFordMsg077BusHiSpdYawRateCmpdInvldSigFaildThd
      AssemblySwConnector_1020: ecu-extract-reference=CalRegn01CmnDFordMsg077BusHiSpdYawRateCmpdInvldSigPassdThdDFordMsg077BusHiSpdDFordMsg077BusHiSpdYawRateCmpdInvldSigPassdThd
      AssemblySwConnector_1021: ecu-extract-reference=CalRegn01CmnDFordMsg077BusHiSpdYawRateCmpdVldMissThdDFordMsg077BusHiSpdDFordMsg077BusHiSpdYawRateCmpdVldMissThd
      AssemblySwConnector_1022: ecu-extract-reference=CalRegn01CmnDFordMsg2FDBusHiSpdFordVehEvasSteerAssiReqVldNotRxdTiThdDFordMsg2FDBusHiSpdDFordMsg2FDBusHiSpdFordVehEvas_6ff44ddf
      AssemblySwConnector_1023: ecu-extract-reference=CalRegn01CmnDFordMsg2FDBusHiSpdFordVehEvasSteerAssiReqVldRxdTiThdDFordMsg2FDBusHiSpdDFordMsg2FDBusHiSpdFordVehEvasSte_717641b0
      AssemblySwConnector_1024: ecu-extract-reference=CalRegn01CmnDFordMsg2FDBusHiSpdMissMsgFaildTiThdDFordMsg2FDBusHiSpdDFordMsg2FDBusHiSpdMissMsgFaildTiThd
      AssemblySwConnector_1025: ecu-extract-reference=CalRegn01CmnDFordMsg2FDBusHiSpdMissMsgPassdTiThdDFordMsg2FDBusHiSpdDFordMsg2FDBusHiSpdMissMsgPassdTiThd
      AssemblySwConnector_1034: ecu-extract-reference=CalRegn01Inin00DSysGlbPrmVehSpdBilnrSelnDCDD_FordBlaBoxIfCmp1DSysGlbPrmVehSpdBilnrSeln
      AssemblySwConnector_1038: ecu-extract-reference=CalRegn02Inin00DSysGlbPrmSysKineRatDCDD_FordBlaBoxIfCmp1DSysGlbPrmSysKineRat
      AssemblySwConnector_1039: ecu-extract-reference=CalRegn02Rt00GroupADAssiMotTqWhlImbRejctnMinYDCDD_FordBlaBoxIfCmp1DAssiMotTqWhlImbRejctnMinY
      AssemblySwConnector_1041: ecu-extract-reference=CDD_NxtrTiDGetRefTmr100MicroSec32bitDFordMsg077BusHiSpdDGetRefTmr100MicroSec32bit
      AssemblySwConnector_1042: ecu-extract-reference=CDD_NxtrTiDGetTiSpan100MicroSec32bitDFordMsg077BusHiSpdDGetTiSpan100MicroSec32bit
      AssemblySwConnector_1043: ecu-extract-reference=CDD_NxtrTiDGetRefTmr100MicroSec32bitDFordMsg2FDBusHiSpdDGetRefTmr100MicroSec32bit
      AssemblySwConnector_1044: ecu-extract-reference=CDD_NxtrTiDGetTiSpan100MicroSec32bitDFordMsg2FDBusHiSpdDGetTiSpan100MicroSec32bit
      AssemblySwConnector_1047: ecu-extract-reference=CustDiagDFordBrkPlsRejctnEnadDFordMsg077BusHiSpdDFordBrkOscnRednEnad
      AssemblySwConnector_1048: ecu-extract-reference=CustDiagDFordEvasSteerAssiEnadDFordMsg077BusHiSpdDFordEvasSteerAssiEnad
      AssemblySwConnector_1049: ecu-extract-reference=CustDiagDFordLaneCentrAssiEnadDFordMsg077BusHiSpdDFordLaneCentrAssiEnad
      AssemblySwConnector_1050: ecu-extract-reference=CustDiagDFordLaneKeepAssiEnadDFordMsg077BusHiSpdDFordLaneKeepAssiEnad
      AssemblySwConnector_1051: ecu-extract-reference=CustDiagDFordPullDriftCmpEnadDFordMsg077BusHiSpdDFordPullDriftCmpEnad
      AssemblySwConnector_1052: ecu-extract-reference=CustDiagDFordTqSteerCmpEnadDFordMsg077BusHiSpdDFordTqSteerCmpEnad
      AssemblySwConnector_1053: ecu-extract-reference=CustDiagDFordTrfcJamAssiEnadDFordMsg077BusHiSpdDFordTrfcJamAssiEnad
      AssemblySwConnector_1054: ecu-extract-reference=CustDiagDFordTrlrBackupAssiEnadDFordMsg077BusHiSpdDFordTrlrBackUpAssiEnad
      AssemblySwConnector_1057: ecu-extract-reference=CustDiagDFordEvasSteerAssiEnadDFordMsg2FDBusHiSpdDFordEvasSteerAssiEnad
      AssemblySwConnector_1070: ecu-extract-reference=DiagcMgrDClrDiagcFlgProxyDFordMsg2FDBusHiSpdDClrDiagcFlgProxy
      AssemblySwConnector_1072: ecu-extract-reference=DiagcMgrProxyAppl10DSetNtcSts10DFordMsg077BusHiSpdDSetNtcSts
      AssemblySwConnector_1073: ecu-extract-reference=DiagcMgrProxyAppl10DSetNtcSts10DFordMsg2FDBusHiSpdDSetNtcSts
      AssemblySwConnector_1075: ecu-extract-reference=DualEcuIdnDEcuIdDFordHwTqCdngDEcuId
      AssemblySwConnector_1076: ecu-extract-reference=FordCanDtcInhbDFordCanDtcInhbDFordMsg077BusHiSpdDFordCanDtcInhb
      AssemblySwConnector_1077: ecu-extract-reference=FordCanDtcInhbDFordEpsLifeCycModDFordMsg077BusHiSpdDFordEpsLifeCycMod
      AssemblySwConnector_1078: ecu-extract-reference=FordCanDtcInhbDFordCanDtcInhbDFordMsg2FDBusHiSpdDFordCanDtcInhb
      AssemblySwConnector_1079: ecu-extract-reference=FordCanDtcInhbDFordEpsLifeCycModDFordMsg2FDBusHiSpdDFordEpsLifeCycMod
      AssemblySwConnector_1082: ecu-extract-reference=FordHwTqCdngDFordMaxAsscTqDCDD_FordBlaBoxIfCmnDFordMaxAsscTq
      AssemblySwConnector_1083: ecu-extract-reference=FordHwTqCdngDFordMaxAsscTqDFordVltgIfDFordMaxAsscTq
      AssemblySwConnector_1084: ecu-extract-reference=FordMsg077BusHiSpdDFordVehLatACmpdRawDCDD_FordBlaBoxIfCmnDFordVehLatACmpdRaw
      AssemblySwConnector_1085: ecu-extract-reference=FordMsg077BusHiSpdDFordVehLatACmpdVldDCDD_FordBlaBoxIfCmnDFordVehLatACmpdVld
      AssemblySwConnector_1086: ecu-extract-reference=FordMsg077BusHiSpdDFordVehLgtACmpdRawDCDD_FordBlaBoxIfCmnDFordVehLgtACmpdRaw
      AssemblySwConnector_1087: ecu-extract-reference=FordMsg077BusHiSpdDFordVehLgtACmpdVldDCDD_FordBlaBoxIfCmnDFordVehLgtACmpdVld
      AssemblySwConnector_1088: ecu-extract-reference=FordMsg077BusHiSpdDFordVehSpdOverGndRawDCDD_FordBlaBoxIfCmnDFordVehSpdOverGndRaw
      AssemblySwConnector_1089: ecu-extract-reference=FordMsg077BusHiSpdDFordVehSpdOverGndVldDCDD_FordBlaBoxIfCmnDFordVehSpdOverGndVld
      AssemblySwConnector_1090: ecu-extract-reference=FordMsg077BusHiSpdDFordVehYawRateCmpdRawDCDD_FordBlaBoxIfCmnDFordVehYawRateCmpdRaw
      AssemblySwConnector_1091: ecu-extract-reference=FordMsg2FDBusHiSpdDFordVehEvasSteerAssiReqDCDD_FordBlaBoxIfCmnDFordVehEvasSteerAssiReq
      AssemblySwConnector_1092: ecu-extract-reference=FordMsg2FDBusHiSpdDFordVehEvasSteerAssiReqVldDCDD_FordBlaBoxIfCmnDFordVehEvasSteerAssiReqVld
      AssemblySwConnector_1095: ecu-extract-reference=ImcSigArbnDVehSpdImcCorrdDCDD_FordBlaBoxIfCmp1DVehSpd
      DelegationSwConnector_115: ecu-extract-reference=Ford_EsaOn_B_RqDDFordMsg2FDBusHiSpdDFord_EsaOn_B_Rq1
      DelegationSwConnector_116: ecu-extract-reference=Ford_VehLatComp_A_ActlDDFordMsg077BusHiSpdDFord_VehLatComp_A_Actl
      DelegationSwConnector_117: ecu-extract-reference=Ford_VehLongComp_A_ActlDDFordMsg077BusHiSpdDFord_VehLongComp_A_Actl
      DelegationSwConnector_118: ecu-extract-reference=Ford_VehOverGnd_V_EstDDFordMsg077BusHiSpdDFord_VehOverGnd_V_Est
      DelegationSwConnector_119: ecu-extract-reference=Ford_VehYawComp_W_ActlDDFordMsg077BusHiSpdDFord_VehYawComp_W_Actl
      AssemblySwConnector_359: ecu-extract-reference=CalRegn02Rt00GroupADAssiMotTqWhlImbRejctnMinXDCDD_FordBlaBoxIfCmp1DAssiMotTqWhlImbRejctnMinX
      AssemblySwConnector_510: ecu-extract-reference=CDD_FordBlaBoxIfCmp1DFordVehLatCtrlLimStsDFordMsg417BusHiSpdDFordVehLatCtrlLimSts
      AssemblySwConnector_511: ecu-extract-reference=CDD_FordBlaBoxIfCmp1DFordVehLatCtrlSteerStsDFordMsg417BusHiSpdDFordVehLatCtrlSteerSts
      RPortPrototype_097: upstream-reference=Ford_VehYaw_W_Actl, ecu-extract-reference=Ford_VehYaw_W_Actl
      PPortPrototype_042: upstream-reference=Ford_EsaOn_B_Stat, ecu-extract-reference=Ford_EsaOn_B_Stat
      DataMapping_031: ecu-extract-reference=COMPOSITIONTYPE.Ford_EsaOn_B_Stat.Ford_EsaOn_B_Stat
      DataMapping_097: ecu-extract-reference=COMPOSITIONTYPE.Ford_VehYaw_W_Actl.Ford_VehYaw_W_Actl
      ComponentPrototype_206: upstream-reference=ECU_Composition.FordMsg4B0BusHiSpd, ecu-extract-reference=COMPOSITIONTYPE.FordMsg4B0BusHiSpd
      AssemblySwConnector_512: ecu-extract-reference=CalRegn01CmnDFordMsg4B0BusHiSpdCanDtcInhbTiThdDFordMsg4B0BusHiSpdDFordMsg4B0BusHiSpdCanDtcInhbTiThd
      AssemblySwConnector_513: ecu-extract-reference=CalRegn01CmnDFordMsg4B0BusHiSpdMsgFltNtcDiagcTiThdDFordMsg4B0BusHiSpdDFordMsg4B0BusHiSpdMsgFltNtcDiagcTiThd
      AssemblySwConnector_514: ecu-extract-reference=CalRegn01CmnDFordMsg4B0BusHiSpdMsgFltTiThdDFordMsg4B0BusHiSpdDFordMsg4B0BusHiSpdMsgFltTiThd
      AssemblySwConnector_515: ecu-extract-reference=CalRegn01CmnDFordMsg4B0BusHiSpdMsgMissNtcDiagcTiThdDFordMsg4B0BusHiSpdDFordMsg4B0BusHiSpdMsgMissNtcDiagcTiThd
      AssemblySwConnector_516: ecu-extract-reference=CalRegn01CmnDFordMsg4B0BusHiSpdMsgMissTiThdDFordMsg4B0BusHiSpdDFordMsg4B0BusHiSpdMsgMissTiThd
      AssemblySwConnector_517: ecu-extract-reference=CalRegn01CmnDFordMsg4B0BusHiSpdMsgRxdNtcDiagcTiThdDFordMsg4B0BusHiSpdDFordMsg4B0BusHiSpdMsgRxdNtcDiagcTiThd
      AssemblySwConnector_518: ecu-extract-reference=CalRegn01CmnDFordMsg4B0BusHiSpdMsgVldNtcDiagcTiThdDFordMsg4B0BusHiSpdDFordMsg4B0BusHiSpdMsgVldNtcDiagcTiThd
      AssemblySwConnector_519: ecu-extract-reference=CalRegn01CmnDFordMsg4B0BusHiSpdMsgVldTiThdDFordMsg4B0BusHiSpdDFordMsg4B0BusHiSpdMsgVldTiThd
      AssemblySwConnector_520: ecu-extract-reference=CDD_NxtrTiDGetRefTmr100MicroSec32bitDFordMsg4B0BusHiSpdDGetRefTmr100MicroSec32bit
      AssemblySwConnector_521: ecu-extract-reference=CDD_NxtrTiDGetTiSpan100MicroSec32bitDFordMsg4B0BusHiSpdDGetTiSpan100MicroSec32bit
      AssemblySwConnector_522: ecu-extract-reference=CustDiagDFordBrkPlsRejctnEnadDFordMsg4B0BusHiSpdDFordBrkOscnRednEnad
      AssemblySwConnector_523: ecu-extract-reference=CustDiagDFordEvasSteerAssiEnadDFordMsg4B0BusHiSpdDFordEvasSteerAssiEnad
      AssemblySwConnector_1026: ecu-extract-reference=CustDiagDFordLaneCentrAssiEnadDFordMsg4B0BusHiSpdDFordLaneCentrAssiEnad
      AssemblySwConnector_1027: ecu-extract-reference=CustDiagDFordTqSteerCmpEnadDFordMsg4B0BusHiSpdDFordTqSteerCmpEnad
      AssemblySwConnector_1028: ecu-extract-reference=CustDiagDFordLaneDprtrWarnEnadDFordMsg4B0BusHiSpdDLaneDetnWarnEnad
      AssemblySwConnector_1029: ecu-extract-reference=CustDiagDFordLaneKeepAssiEnadDFordMsg4B0BusHiSpdDLaneKeepAssiEnad
      AssemblySwConnector_1030: ecu-extract-reference=CustDiagDFordTrfcJamAssiEnadDFordMsg4B0BusHiSpdDTrfcJamAssiEnad
      AssemblySwConnector_1031: ecu-extract-reference=DiagcMgrDClrDiagcFlgProxyDFordMsg4B0BusHiSpdDClrDiagcFlgProxy
      AssemblySwConnector_1032: ecu-extract-reference=FordCanDtcInhbDFordCanDtcInhbDFordMsg4B0BusHiSpdDFordCanDtcInhb
      AssemblySwConnector_1033: ecu-extract-reference=FordCanDtcInhbDFordEpsLifeCycModDFordMsg4B0BusHiSpdDFordEpsLifeCycMod
      AssemblySwConnector_1040: ecu-extract-reference=FordMsg4B0BusHiSpdDFordVehYawStabyRawDCDD_FordBlaBoxIfCmnDFordVehYawStabyRaw
      AssemblySwConnector_1045: ecu-extract-reference=FordMsg4B0BusHiSpdDFordVehYawStabyVldDCDD_FordBlaBoxIfCmnDFordVehYawStabyVld
      DelegationSwConnector_120: ecu-extract-reference=Ford_YawStabilityIndexDDFordMsg4B0BusHiSpdDFord_YawStabilityIndex
      AssemblySwConnector_1046: ecu-extract-reference=DiagcMgrProxyAppl10DSetNtcSts10DFordMsg4B0BusHiSpdDSetNtcSts
      AssemblySwConnector_1059: ecu-extract-reference=FordMsg3CABusHiSpdDFordVehLaneKeepSysReqdAgRawDCDD_FordBlaBoxIfCmnDFordVehLaneKeepSysReqdAgRaw
