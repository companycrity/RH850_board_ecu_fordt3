[part 1 of 3: package /COM/VECTOR/CFG/WORKFLOW/SYSDESC/SYNC]
AUTOSAR XML (schema 4-2-1)
package /COM/VECTOR/CFG/WORKFLOW/SYSDESC/SYNC
  flat map FLATMAP
    3692 x flat instance descriptor:
      ComponentPrototype: upstream-reference=ECU_Composition.CDD_ChkPtAppl10, ecu-extract-reference=COMPOSITIONTYPE.CDD_ChkPtAppl10
      ComponentPrototype_001: upstream-reference=ECU_Composition.NxtrMath, ecu-extract-reference=COMPOSITIONTYPE.NxtrMath
      ComponentPrototype_002: upstream-reference=ECU_Composition.CDD_NvMProxy, ecu-extract-reference=COMPOSITIONTYPE.CDD_NvMProxy
      ComponentPrototype_003: upstream-reference=ECU_Composition.DiagcMgrStub, ecu-extract-reference=COMPOSITIONTYPE.DiagcMgrStub
      ComponentPrototype_004: upstream-reference=ECU_Composition.DiagcMgrProxyAppl10, ecu-extract-reference=COMPOSITIONTYPE.DiagcMgrProxyAppl10
      ComponentPrototype_005: upstream-reference=ECU_Composition.DiagcMgr, ecu-extract-reference=COMPOSITIONTYPE.DiagcMgr
      ComponentPrototype_006: upstream-reference=ECU_Composition.CalRegn01CmnGroupA, ecu-extract-reference=COMPOSITIONTYPE.CalRegn01CmnGroupA
      AssemblySwConnector_002: ecu-extract-reference=DiagcMgrDClrDiagcFlgProxyDDiagcMgrProxyAppl10DClrDiagcFlgProxy
      AssemblySwConnector_003: ecu-extract-reference=DiagcMgrDDiagcMgrIninCoreDDiagcMgrProxyAppl10DDiagcMgrIninCore
      AssemblySwConnector_004: ecu-extract-reference=DiagcMgrDGetNtcActvCoreDDiagcMgrProxyAppl10DGetNtcActvCore
      AssemblySwConnector_005: ecu-extract-reference=DiagcMgrDGetNtcQlfrStsCoreDDiagcMgrProxyAppl10DGetNtcQlfrStsCore
      AssemblySwConnector_006: ecu-extract-reference=DiagcMgrDGetNtcStsCoreDDiagcMgrProxyAppl10DGetNtcStsCore
      AssemblySwConnector_007: ecu-extract-reference=DiagcMgrDSetNtcStsCoreDDiagcMgrProxyAppl10DSetNtcStsCore
      AssemblySwConnector_008: ecu-extract-reference=DiagcMgrProxyAppl10DSetNtcSts10DCDD_NvMProxyDSetNtcSts
      AssemblySwConnector_009: ecu-extract-reference=DiagcMgrProxyAppl10DGetDiagcDataAppl10DDiagcMgrDGetDiagcDataAppl10
      AssemblySwConnector_010: ecu-extract-reference=DiagcMgrProxyAppl10DGetNtcDebCntrAppl10DDiagcMgrDGetNtcDebCntrAppl10
      AssemblySwConnector_011: ecu-extract-reference=DiagcMgrProxyAppl10DGetNtcInfoAppl10DDiagcMgrDGetNtcInfoAppl10
      AssemblySwConnector_012: ecu-extract-reference=DiagcMgrProxyAppl10DSetNtcSts10DNxtrMathDSetNtcSts
      AssemblySwConnector_013: ecu-extract-reference=DiagcMgrStubDGetDiagcDataStubDDiagcMgrDGetDiagcDataAppl0
      AssemblySwConnector_014: ecu-extract-reference=DiagcMgrStubDGetDiagcDataStubDDiagcMgrDGetDiagcDataAppl1
      AssemblySwConnector_015: ecu-extract-reference=DiagcMgrStubDGetDiagcDataStubDDiagcMgrDGetDiagcDataAppl2
      AssemblySwConnector_016: ecu-extract-reference=DiagcMgrStubDGetDiagcDataStubDDiagcMgrDGetDiagcDataAppl3
      AssemblySwConnector_017: ecu-extract-reference=DiagcMgrStubDGetDiagcDataStubDDiagcMgrDGetDiagcDataAppl4
      AssemblySwConnector_018: ecu-extract-reference=DiagcMgrStubDGetDiagcDataStubDDiagcMgrDGetDiagcDataAppl5
      AssemblySwConnector_019: ecu-extract-reference=DiagcMgrStubDGetDiagcDataStubDDiagcMgrDGetDiagcDataAppl6
      AssemblySwConnector_020: ecu-extract-reference=DiagcMgrStubDGetDiagcDataStubDDiagcMgrDGetDiagcDataAppl7
      AssemblySwConnector_021: ecu-extract-reference=DiagcMgrStubDGetDiagcDataStubDDiagcMgrDGetDiagcDataAppl8
      AssemblySwConnector_022: ecu-extract-reference=DiagcMgrStubDGetDiagcDataStubDDiagcMgrDGetDiagcDataAppl9
      AssemblySwConnector_023: ecu-extract-reference=DiagcMgrStubDGetNtcDebCntrStubDDiagcMgrDGetNtcDebCntrAppl0
      AssemblySwConnector_024: ecu-extract-reference=DiagcMgrStubDGetNtcDebCntrStubDDiagcMgrDGetNtcDebCntrAppl1
      AssemblySwConnector_025: ecu-extract-reference=DiagcMgrStubDGetNtcDebCntrStubDDiagcMgrDGetNtcDebCntrAppl2
      AssemblySwConnector_026: ecu-extract-reference=DiagcMgrStubDGetNtcDebCntrStubDDiagcMgrDGetNtcDebCntrAppl3
      AssemblySwConnector_027: ecu-extract-reference=DiagcMgrStubDGetNtcDebCntrStubDDiagcMgrDGetNtcDebCntrAppl4
      AssemblySwConnector_028: ecu-extract-reference=DiagcMgrStubDGetNtcDebCntrStubDDiagcMgrDGetNtcDebCntrAppl5
      AssemblySwConnector_029: ecu-extract-reference=DiagcMgrStubDGetNtcDebCntrStubDDiagcMgrDGetNtcDebCntrAppl6
      AssemblySwConnector_030: ecu-extract-reference=DiagcMgrStubDGetNtcDebCntrStubDDiagcMgrDGetNtcDebCntrAppl7
      AssemblySwConnector_031: ecu-extract-reference=DiagcMgrStubDGetNtcDebCntrStubDDiagcMgrDGetNtcDebCntrAppl8
      AssemblySwConnector_032: ecu-extract-reference=DiagcMgrStubDGetNtcDebCntrStubDDiagcMgrDGetNtcDebCntrAppl9
      AssemblySwConnector_033: ecu-extract-reference=DiagcMgrStubDGetNtcInfoStubDDiagcMgrDGetNtcInfoAppl0
      AssemblySwConnector_034: ecu-extract-reference=DiagcMgrStubDGetNtcInfoStubDDiagcMgrDGetNtcInfoAppl1
      AssemblySwConnector_035: ecu-extract-reference=DiagcMgrStubDGetNtcInfoStubDDiagcMgrDGetNtcInfoAppl2
      AssemblySwConnector_036: ecu-extract-reference=DiagcMgrStubDGetNtcInfoStubDDiagcMgrDGetNtcInfoAppl3
      AssemblySwConnector_037: ecu-extract-reference=DiagcMgrStubDGetNtcInfoStubDDiagcMgrDGetNtcInfoAppl4
      AssemblySwConnector_038: ecu-extract-reference=DiagcMgrStubDGetNtcInfoStubDDiagcMgrDGetNtcInfoAppl5
      AssemblySwConnector_039: ecu-extract-reference=DiagcMgrStubDGetNtcInfoStubDDiagcMgrDGetNtcInfoAppl6
      AssemblySwConnector_040: ecu-extract-reference=DiagcMgrStubDGetNtcInfoStubDDiagcMgrDGetNtcInfoAppl7
      AssemblySwConnector_041: ecu-extract-reference=DiagcMgrStubDGetNtcInfoStubDDiagcMgrDGetNtcInfoAppl8
      AssemblySwConnector_042: ecu-extract-reference=DiagcMgrStubDGetNtcInfoStubDDiagcMgrDGetNtcInfoAppl9
      AssemblySwConnector_043: ecu-extract-reference=DiagcMgrProxyAppl10DSetNtcSts10DDiagcMgrDSetNtcSts
      ComponentPrototype_007: upstream-reference=ECU_Composition.SysStMod, ecu-extract-reference=COMPOSITIONTYPE.SysStMod
      AssemblySwConnector_044: ecu-extract-reference=DiagcMgrDSysStFltOutpReqDiDSysStModDSysStFltOutpReqDi
      ComponentPrototype_008: upstream-reference=ECU_Composition.PwrUpSeq, ecu-extract-reference=COMPOSITIONTYPE.PwrUpSeq
      AssemblySwConnector_045: ecu-extract-reference=PwrUpSeqDStrtUpStDSysStModDStrtUpSt
      AssemblySwConnector_046: ecu-extract-reference=PwrUpSeqDSysStWrmIninCmplDSysStModDSysStWrmIninCmpl
      AssemblySwConnector_047: ecu-extract-reference=SysStModDSysStDPwrUpSeqDSysSt
      ComponentPrototype_009: upstream-reference=ECU_Composition.ShtdwnMech, ecu-extract-reference=COMPOSITIONTYPE.ShtdwnMech
      AssemblySwConnector_048: ecu-extract-reference=PwrUpSeqDStrtUpStDShtdwnMechDStrtUpSt
      ComponentPrototype_010: upstream-reference=ECU_Composition.CDD_FordT3T6McuCfg, ecu-extract-reference=COMPOSITIONTYPE.CDD_FordT3T6McuCfg
      ComponentPrototype_011: upstream-reference=ECU_Composition.IoHwAb, ecu-extract-reference=COMPOSITIONTYPE.IoHwAb
      AssemblySwConnector_049: ecu-extract-reference=IoHwAbDSetGpioPwrTurnOffCtrlDPwrUpSeqDIoHwAb_SetGpioPwrTurnOffCtrl
      AssemblySwConnector_050: ecu-extract-reference=IoHwAbDSetGpioSysFlt2ADShtdwnMechDIoHwAb_SetGpioSysFlt2A
      ComponentPrototype_012: upstream-reference=ECU_Composition.PolarityCfg, ecu-extract-reference=COMPOSITIONTYPE.PolarityCfg
      ComponentPrototype_013: upstream-reference=ECU_Composition.MotAgCorrln, ecu-extract-reference=COMPOSITIONTYPE.MotAgCorrln
      ComponentPrototype_014: upstream-reference=ECU_Composition.MotAg2Meas, ecu-extract-reference=COMPOSITIONTYPE.MotAg2Meas
      ComponentPrototype_015: upstream-reference=ECU_Composition.CDD_MotAgCmp, ecu-extract-reference=COMPOSITIONTYPE.CDD_MotAgCmp
      ComponentPrototype_016: upstream-reference=ECU_Composition.CDD_MotAgArbn, ecu-extract-reference=COMPOSITIONTYPE.CDD_MotAgArbn
      AssemblySwConnector_052: ecu-extract-reference=CDD_FordT3T6McuCfgDMotAg2CosDMotAg2MeasDMotAg2Cos
      AssemblySwConnector_053: ecu-extract-reference=CDD_FordT3T6McuCfgDMotAg2CosAdcFaildDMotAg2MeasDMotAg2CosAdcFaild
      AssemblySwConnector_054: ecu-extract-reference=CDD_FordT3T6McuCfgDMotAg2SinDMotAg2MeasDMotAg2Sin
      AssemblySwConnector_055: ecu-extract-reference=CDD_FordT3T6McuCfgDMotAg2SinAdcFaildDMotAg2MeasDMotAg2SinAdcFaild
      AssemblySwConnector_056: ecu-extract-reference=DiagcMgrProxyAppl10DGetNtcQlfrSts10DMotAg2MeasDGetNtcQlfrSts
      AssemblySwConnector_057: ecu-extract-reference=DiagcMgrProxyAppl10DSetNtcSts10DMotAg2MeasDSetNtcSts
      AssemblySwConnector_058: ecu-extract-reference=DiagcMgrProxyAppl10DGetNtcQlfrSts10DMotAgCorrlnDGetNtcQlfrSts
      AssemblySwConnector_059: ecu-extract-reference=DiagcMgrProxyAppl10DSetNtcSts10DMotAgCorrlnDSetNtcSts
      AssemblySwConnector_060: ecu-extract-reference=MotAg2MeasDMotAg2MeclDMotAgCorrlnDMotAgCMecl
      AssemblySwConnector_061: ecu-extract-reference=MotAg2MeasDMotAg2MeclQlfrDMotAgCorrlnDMotAgCMeclQlfr
      AssemblySwConnector_062: ecu-extract-reference=MotAg2MeasDMotAg2MeclRollgCntrDMotAgCorrlnDMotAgCMeclRollgCntr
      AssemblySwConnector_063: ecu-extract-reference=PolarityCfgDAssiMechPolarityDCDD_MotAgCmpDAssiMechPolarity
      AssemblySwConnector_064: ecu-extract-reference=PolarityCfgDMotAgMecl2PolarityDMotAg2MeasDMotAgMecl2Polarity
      ComponentPrototype_017: upstream-reference=ECU_Composition.FltInj, ecu-extract-reference=COMPOSITIONTYPE.FltInj
      AssemblySwConnector_065: ecu-extract-reference=FltInjDFltInj_f32DMotAg2MeasDFltInj_f32
      AssemblySwConnector_066: ecu-extract-reference=FltInjDFltInj_u08DMotAgCorrlnDFltInj_u08
      ComponentPrototype_018: upstream-reference=ECU_Composition.VehSigCdng, ecu-extract-reference=COMPOSITIONTYPE.VehSigCdng
      ComponentPrototype_019: upstream-reference=ECU_Composition.CDD_MotVel, ecu-extract-reference=COMPOSITIONTYPE.CDD_MotVel
      ComponentPrototype_020: upstream-reference=ECU_Composition.CalRegn01Inin00GroupA, ecu-extract-reference=COMPOSITIONTYPE.CalRegn01Inin00GroupA
      AssemblySwConnector_084: ecu-extract-reference=FltInjDFltInj_f32DVehSigCdngDFltInj_f32
      AssemblySwConnector_085: ecu-extract-reference=PolarityCfgDAssiMechPolarityDCDD_MotVelDAssiMechPolarity
      ComponentPrototype_021: upstream-reference=ECU_Composition.CurrMeasCorrln, ecu-extract-reference=COMPOSITIONTYPE.CurrMeasCorrln
      ComponentPrototype_022: upstream-reference=ECU_Composition.CDD_CurrMeasArbn, ecu-extract-reference=COMPOSITIONTYPE.CDD_CurrMeasArbn
      ComponentPrototype_023: upstream-reference=ECU_Composition.CDD_CurrMeas, ecu-extract-reference=COMPOSITIONTYPE.CDD_CurrMeas
      AssemblySwConnector_111: ecu-extract-reference=CDD_CurrMeasDMotCurrEolCalStDCurrMeasCorrlnDMotCurrEolCalSt
      AssemblySwConnector_113: ecu-extract-reference=CDD_CurrMeasDCurrMeasWrmIninTestCmplDPwrUpSeqDCurrMeasWrmIninTestCmpl
      AssemblySwConnector_114: ecu-extract-reference=CDD_MotVelDMotVelMrfDCDD_CurrMeasDMotVelMrf
      AssemblySwConnector_115: ecu-extract-reference=DiagcMgrProxyAppl10DGetNtcQlfrSts10DCDD_CurrMeasDGetNtcQlfrSts
      AssemblySwConnector_116: ecu-extract-reference=DiagcMgrProxyAppl10DSetNtcSts10DCDD_CurrMeasDSetNtcSts
      AssemblySwConnector_117: ecu-extract-reference=FltInjDFltInj_f32DCDD_CurrMeasDFltInj_f32
      AssemblySwConnector_118: ecu-extract-reference=FltInjDFltInj_u08DCDD_CurrMeasDFltInj_u08
      AssemblySwConnector_119: ecu-extract-reference=FltInjDFltInj_u08DCurrMeasCorrlnDFltInj_u08
      AssemblySwConnector_120: ecu-extract-reference=PwrUpSeqDStrtUpStDCDD_CurrMeasDStrtUpSt
      AssemblySwConnector_121: ecu-extract-reference=SysStModDSysStDCDD_CurrMeasDSysSt
      AssemblySwConnector_122: ecu-extract-reference=SysStModDSysStDCurrMeasCorrlnDSysSt
      AssemblySwConnector_124: ecu-extract-reference=VehSigCdngDVehSpdVldDCDD_CurrMeasDVehSpdVld
      AssemblySwConnector_125: ecu-extract-reference=DiagcMgrProxyAppl10DGetNtcQlfrSts10DCurrMeasCorrlnDGetNtcQlfrSts
      AssemblySwConnector_126: ecu-extract-reference=DiagcMgrProxyAppl10DSetNtcSts10DCurrMeasCorrlnDSetNtcSts
      ComponentPrototype_024: upstream-reference=ECU_Composition.DualEcuIdn, ecu-extract-reference=COMPOSITIONTYPE.DualEcuIdn
      ComponentPrototype_025: upstream-reference=ECU_Composition.BattVltgCorrln, ecu-extract-reference=COMPOSITIONTYPE.BattVltgCorrln
      ComponentPrototype_026: upstream-reference=ECU_Composition.BattVltg, ecu-extract-reference=COMPOSITIONTYPE.BattVltg
      AssemblySwConnector_127: ecu-extract-reference=BattVltgDBrdgVltgDCDD_CurrMeasDBrdgVltg
      AssemblySwConnector_128: ecu-extract-reference=BattVltgDBrdgVltgDDiagcMgrDBrdgVltg
      AssemblySwConnector_129: ecu-extract-reference=BattVltgCorrlnDBattSwdVltgCorrlnStsDBattVltgDBattSwdVltgCorrlnSts
      AssemblySwConnector_148: ecu-extract-reference=CDD_FordT3T6McuCfgDBattVltgDBattVltgDBattVltg
      AssemblySwConnector_149: ecu-extract-reference=CDD_FordT3T6McuCfgDBattVltgSwd1DBattVltgDBattVltgSwd1
      AssemblySwConnector_150: ecu-extract-reference=CDD_FordT3T6McuCfgDBattVltgDBattVltgCorrlnDBattVltg
      AssemblySwConnector_151: ecu-extract-reference=CDD_FordT3T6McuCfgDBattVltgAdcFaildDBattVltgCorrlnDBattVltgAdcFaild
      AssemblySwConnector_152: ecu-extract-reference=CDD_FordT3T6McuCfgDBattVltgSwd1DBattVltgCorrlnDBattVltgSwd1
      AssemblySwConnector_153: ecu-extract-reference=CDD_FordT3T6McuCfgDBattVltgSwd1AdcFaildDBattVltgCorrlnDBattVltgSwd1AdcFaild
      AssemblySwConnector_154: ecu-extract-reference=DiagcMgrProxyAppl10DGetNtcQlfrSts10DBattVltgCorrlnDGetNtcQlfrSts
      AssemblySwConnector_155: ecu-extract-reference=DiagcMgrProxyAppl10DSetNtcSts10DBattVltgCorrlnDSetNtcSts
      AssemblySwConnector_156: ecu-extract-reference=DiagcMgrProxyAppl10DSetNtcSts10DDualEcuIdnDSetNtcSts
      AssemblySwConnector_157: ecu-extract-reference=DualEcuIdnDEcuIdDCDD_FordT3T6McuCfgDEcuId
      AssemblySwConnector_158: ecu-extract-reference=IoHwAbDGetGpioEcuIdnPin1DDualEcuIdnDIoHwAb_GetGpioEcuIdnPin1
      AssemblySwConnector_159: ecu-extract-reference=IoHwAbDGetGpioEcuIdnPin2DDualEcuIdnDIoHwAb_GetGpioEcuIdnPin2
      AssemblySwConnector_160: ecu-extract-reference=PwrUpSeqDStrtUpStDBattVltgCorrlnDStrtUpSt
      AssemblySwConnector_161: ecu-extract-reference=SysStModDSysStDBattVltgCorrlnDSysSt
      ComponentPrototype_027: upstream-reference=ECU_Composition.MotQuadDetn, ecu-extract-reference=COMPOSITIONTYPE.MotQuadDetn
      ComponentPrototype_028: upstream-reference=ECU_Composition.MotCtrlPrmEstimn, ecu-extract-reference=COMPOSITIONTYPE.MotCtrlPrmEstimn
      ComponentPrototype_029: upstream-reference=ECU_Composition.HwAgSysArbn, ecu-extract-reference=COMPOSITIONTYPE.HwAgSysArbn
      ComponentPrototype_030: upstream-reference=ECU_Composition.HwAgSnsrls, ecu-extract-reference=COMPOSITIONTYPE.HwAgSnsrls
      AssemblySwConnector_235: ecu-extract-reference=CDD_MotAgCmpDMotAgCumvAlgndCrfDHwAgSnsrlsDMotAgCumvAlgndCrf
      AssemblySwConnector_236: ecu-extract-reference=CDD_MotAgCmpDMotAgCumvAlgndVldDHwAgSnsrlsDMotAgCumvAlgndVld
      AssemblySwConnector_237: ecu-extract-reference=CDD_MotAgCmpDMotAgCumvAlgndMrfDMotQuadDetnDMotAgCumvAlgndMrf
      AssemblySwConnector_240: ecu-extract-reference=DiagcMgrProxyAppl10DGetNtcQlfrSts10DHwAgSnsrlsDGetNtcQlfrSts
      AssemblySwConnector_241: ecu-extract-reference=DiagcMgrProxyAppl10DSetNtcSts10DHwAgSysArbnDSetNtcSts
      AssemblySwConnector_242: ecu-extract-reference=FltInjDFltInj_f32DHwAgSysArbnDFltInj_f32
      AssemblySwConnector_243: ecu-extract-reference=HwAgSnsrlsDHwAgSnsrlsDHwAgSysArbnDHwAgSnsrls
      AssemblySwConnector_244: ecu-extract-reference=HwAgSnsrlsDHwAgSnsrlsConfDHwAgSysArbnDHwAgSnsrlsConf
      AssemblySwConnector_245: ecu-extract-reference=HwAgSysArbnDHwVelDFltInjDHwVel
      AssemblySwConnector_246: ecu-extract-reference=HwAgSysArbnDPinionAgDHwAgSnsrlsDPinionAg
      AssemblySwConnector_247: ecu-extract-reference=HwAgSysArbnDPinionAgConfDHwAgSnsrlsDPinionAgConf
      AssemblySwConnector_249: ecu-extract-reference=VehSigCdngDVehSpdVldDHwAgSnsrlsDVehSpdVld
      AssemblySwConnector_250: ecu-extract-reference=VehSigCdngDVehYawRateDHwAgSnsrlsDVehYawRate
      ComponentPrototype_032: upstream-reference=ECU_Composition.CDD_DmaCfgAndUse, ecu-extract-reference=COMPOSITIONTYPE.CDD_DmaCfgAndUse
      ComponentPrototype_033: upstream-reference=ECU_Composition.CDD_Adcf0CfgAndUse, ecu-extract-reference=COMPOSITIONTYPE.CDD_Adcf0CfgAndUse
      ComponentPrototype_034: upstream-reference=ECU_Composition.Adcf1CfgAndUse, ecu-extract-reference=COMPOSITIONTYPE.Adcf1CfgAndUse
      AssemblySwConnector_251: ecu-extract-reference=Adcf1CfgAndUseDAdcf1EnaCnvnDCDD_DmaCfgAndUseDAdc1CfgAndUseAdc1EnaCnvn
      ComponentPrototype_031: upstream-reference=ECU_Composition.PwrDiscnct, ecu-extract-reference=COMPOSITIONTYPE.PwrDiscnct
      AssemblySwConnector_252: ecu-extract-reference=DiagcMgrDCnvSnpshtData_f32DPwrDiscnctDCnvSnpshtData_f32
      AssemblySwConnector_253: ecu-extract-reference=DiagcMgrProxyAppl10DSetNtcStsAndSnpshtData10DPwrDiscnctDSetNtcStsAndSnpshtData
      AssemblySwConnector_254: ecu-extract-reference=PwrDiscnctDPwrDiscnctATestCmplDPwrUpSeqDPwrDiscnctATestCmpl
      AssemblySwConnector_255: ecu-extract-reference=PwrDiscnctDPwrDiscnctBTestCmplDPwrUpSeqDPwrDiscnctBTestCmpl
      AssemblySwConnector_256: ecu-extract-reference=PwrUpSeqDStrtUpStDPwrDiscnctDStrtUpSt
      AssemblySwConnector_257: ecu-extract-reference=SysStModDSysStDPwrDiscnctDSysSt
      AssemblySwConnector_259: ecu-extract-reference=CDD_FordT3T6McuCfgDBattVltgAdcFaildDPwrDiscnctDBattVltgAdcFaild
      AssemblySwConnector_260: ecu-extract-reference=CDD_FordT3T6McuCfgDBattVltgSwd1DPwrDiscnctDBattVltgSwd1
      AssemblySwConnector_261: ecu-extract-reference=CDD_FordT3T6McuCfgDChrgPmpDiagDPwrDiscnctDChrgPmpDiag
      AssemblySwConnector_262: ecu-extract-reference=CDD_FordT3T6McuCfgDChrgPmpDiagAdcFaildDPwrDiscnctDChrgPmpDiagAdcFaild
      AssemblySwConnector_263: ecu-extract-reference=CDD_FordT3T6McuCfgDPwrDiscnctSwtDiagDPwrDiscnctDPwrDiscnctSwtDiag
      AssemblySwConnector_264: ecu-extract-reference=CDD_MotVelDMotVelMrfDPwrDiscnctDMotVelMrf
      AssemblySwConnector_258: ecu-extract-reference=CDD_FordT3T6McuCfgDBattVltgDPwrDiscnctDBattVltg
      ComponentPrototype_035: upstream-reference=ECU_Composition.StabyCmp, ecu-extract-reference=COMPOSITIONTYPE.StabyCmp
      ComponentPrototype_036: upstream-reference=ECU_Composition.RtnPahFwl, ecu-extract-reference=COMPOSITIONTYPE.RtnPahFwl
      ComponentPrototype_037: upstream-reference=ECU_Composition.Rtn, ecu-extract-reference=COMPOSITIONTYPE.Rtn
      ComponentPrototype_038: upstream-reference=ECU_Composition.InertiaCmpVel, ecu-extract-reference=COMPOSITIONTYPE.InertiaCmpVel
      ComponentPrototype_039: upstream-reference=ECU_Composition.DampgPahSum, ecu-extract-reference=COMPOSITIONTYPE.DampgPahSum
      ComponentPrototype_040: upstream-reference=ECU_Composition.Dampg, ecu-extract-reference=COMPOSITIONTYPE.Dampg
      ComponentPrototype_042: upstream-reference=ECU_Composition.AssiSumLim, ecu-extract-reference=COMPOSITIONTYPE.AssiSumLim
      ComponentPrototype_043: upstream-reference=ECU_Composition.AssiPahSum, ecu-extract-reference=COMPOSITIONTYPE.AssiPahSum
      ComponentPrototype_044: upstream-reference=ECU_Composition.AssiHiFrq, ecu-extract-reference=COMPOSITIONTYPE.AssiHiFrq
      ComponentPrototype_045: upstream-reference=ECU_Composition.Assi, ecu-extract-reference=COMPOSITIONTYPE.Assi
      AssemblySwConnector_282: ecu-extract-reference=AssiDAssiCmdBasDAssiPahSumDAssiCmdBas
      AssemblySwConnector_283: ecu-extract-reference=AssiDAssiCmdBasDDampgDAssiCmdBas
      AssemblySwConnector_284: ecu-extract-reference=AssiDAssiCmdBasDInertiaCmpVelDAssiCmdBas
      AssemblySwConnector_285: ecu-extract-reference=AssiHiFrqDAssiHiFrqCmdDAssiPahSumDAssiHiFrqCmd
      AssemblySwConnector_286: ecu-extract-reference=AssiPahSumDAssiCmdSumDStabyCmpDAssiCmdSum
      AssemblySwConnector_294: ecu-extract-reference=CalRegn01CmnGroupADDampgQuadHwTqBacklshDDampgDDampgQuadHwTqBacklsh
      AssemblySwConnector_295: ecu-extract-reference=CalRegn01CmnGroupADDampgQuadMotVelBacklshDDampgDDampgQuadMotVelBacklsh
      AssemblySwConnector_299: ecu-extract-reference=CalRegn01Inin00GroupADAssiPahSumHysCmpLimDAssiPahSumDAssiPahSumHysCmpLim
      AssemblySwConnector_308: ecu-extract-reference=CalRegn01Inin00GroupADDampgHydBasCoeff1DDampgDDampgHydBasCoeff1
      AssemblySwConnector_309: ecu-extract-reference=CalRegn01Inin00GroupADDampgHydBasCoeff2DDampgDDampgHydBasCoeff2
      AssemblySwConnector_310: ecu-extract-reference=CalRegn01Inin00GroupADDampgHydBasCoeff3DDampgDDampgHydBasCoeff3
      AssemblySwConnector_311: ecu-extract-reference=CalRegn01Inin00GroupADDampgHydBasCoeff4DDampgDDampgHydBasCoeff4
      AssemblySwConnector_312: ecu-extract-reference=CalRegn01Inin00GroupADDampgHydOutpLimDDampgDDampgHydOutpLim
      AssemblySwConnector_313: ecu-extract-reference=CalRegn01Inin00GroupADDampgMotVelLpFilFrqDDampgDDampgMotVelLpFilFrq
      AssemblySwConnector_314: ecu-extract-reference=CalRegn01Inin00GroupADDampgQuad13MplrDDampgDDampgQuad13Mplr
      AssemblySwConnector_315: ecu-extract-reference=CalRegn01Inin00GroupADDampgQuad24MplrDDampgDDampgQuad24Mplr
      AssemblySwConnector_316: ecu-extract-reference=CalRegn01Inin00GroupADDampgQuadHwTqLpFilFrqDDampgDDampgQuadHwTqLpFilFrq
      AssemblySwConnector_317: ecu-extract-reference=CalRegn01Inin00GroupADDampgQuadMotVelLpFilFrqDDampgDDampgQuadMotVelLpFilFrq
      AssemblySwConnector_318: ecu-extract-reference=CalRegn01Inin00GroupADDampgQuadScaLpFilFrqDDampgDDampgQuadScaLpFilFrq
      AssemblySwConnector_319: ecu-extract-reference=CalRegn01Inin00GroupADDampgTScaXDDampgDDampgTScaX
      AssemblySwConnector_320: ecu-extract-reference=CalRegn01Inin00GroupADDampgTScaYDDampgDDampgTScaY
      AssemblySwConnector_401: ecu-extract-reference=CDD_MotVelDMotVelMrfDAssiSumLimDMotVelMrf
      AssemblySwConnector_404: ecu-extract-reference=DampgDDampgCmdBasDDampgPahSumDDampgCmdBas
      AssemblySwConnector_405: ecu-extract-reference=DampgPahSumDDampgCmdDAssiSumLimDDampgCmd
      AssemblySwConnector_406: ecu-extract-reference=DiagcMgrProxyAppl10DGetNtcQlfrSts10DAssiSumLimDGetNtcQlfrSts
      AssemblySwConnector_407: ecu-extract-reference=DiagcMgrProxyAppl10DSetNtcSts10DAssiSumLimDSetNtcSts
      AssemblySwConnector_408: ecu-extract-reference=DiagcMgrProxyAppl10DSetNtcSts10DRtnPahFwlDSetNtcSts
      AssemblySwConnector_409: ecu-extract-reference=FltInjDFltInj_f32DAssiDFltInj_f32
      AssemblySwConnector_410: ecu-extract-reference=FltInjDFltInj_f32DDampgDFltInj_f32
      AssemblySwConnector_411: ecu-extract-reference=FltInjDFltInj_f32DInertiaCmpVelDFltInj_f32
      AssemblySwConnector_412: ecu-extract-reference=FltInjDFltInj_f32DRtnDFltInj_f32
      AssemblySwConnector_413: ecu-extract-reference=FltInjDFltInj_f32DStabyCmpDFltInj_f32
      AssemblySwConnector_414: ecu-extract-reference=HwAgSysArbnDHwVelDRtnDHwVel
      AssemblySwConnector_415: ecu-extract-reference=InertiaCmpVelDInertiaCmpVelCmdDDampgPahSumDInertiaCmpVelCmd
      AssemblySwConnector_416: ecu-extract-reference=RtnDRtnCmdDRtnPahFwlDRtnCmd
      AssemblySwConnector_417: ecu-extract-reference=RtnPahFwlDRtnCmdLimdDAssiSumLimDRtnCmd
      AssemblySwConnector_418: ecu-extract-reference=StabyCmpDAssiCmdDAssiSumLimDAssiCmd
      AssemblySwConnector_423: ecu-extract-reference=VehSigCdngDVehLgtADInertiaCmpVelDVehLgtA
      AssemblySwConnector_426: ecu-extract-reference=VehSigCdngDVehSpdVldDRtnDVehSpdVld
      ComponentPrototype_046: upstream-reference=ECU_Composition.VehSpdLimr, ecu-extract-reference=COMPOSITIONTYPE.VehSpdLimr
      ComponentPrototype_047: upstream-reference=ECU_Composition.TqLoa, ecu-extract-reference=COMPOSITIONTYPE.TqLoa
      ComponentPrototype_048: upstream-reference=ECU_Composition.HysCmp, ecu-extract-reference=COMPOSITIONTYPE.HysCmp
      ComponentPrototype_049: upstream-reference=ECU_Composition.EotProtn, ecu-extract-reference=COMPOSITIONTYPE.EotProtn
      ComponentPrototype_050: upstream-reference=ECU_Composition.EotLrng, ecu-extract-reference=COMPOSITIONTYPE.EotLrng
      AssemblySwConnector_429: ecu-extract-reference=AssiDAssiCmdBasDHysCmpDAssiCmdBas
      AssemblySwConnector_527: ecu-extract-reference=DiagcMgrProxyAppl10DGetNtcQlfrSts10DEotLrngDGetNtcQlfrSts
      AssemblySwConnector_528: ecu-extract-reference=DiagcMgrProxyAppl10DSetNtcSts10DEotLrngDSetNtcSts
      AssemblySwConnector_529: ecu-extract-reference=EotLrngDHwAgCcwDetdDEotProtnDHwAgCcwDetd
      AssemblySwConnector_530: ecu-extract-reference=EotLrngDHwAgCwDetdDEotProtnDHwAgCwDetd
      AssemblySwConnector_531: ecu-extract-reference=EotLrngDHwAgEotCcwDEotProtnDHwAgEotCcw
      AssemblySwConnector_532: ecu-extract-reference=EotLrngDHwAgEotCwDEotProtnDHwAgEotCw
      AssemblySwConnector_533: ecu-extract-reference=EotLrngDHwAgEotCcwDVehSpdLimrDHwAgEotCcw
      AssemblySwConnector_534: ecu-extract-reference=EotLrngDHwAgEotCwDVehSpdLimrDHwAgEotCw
      AssemblySwConnector_539: ecu-extract-reference=FltInjDFltInj_f32DHysCmpDFltInj_f32
      AssemblySwConnector_541: ecu-extract-reference=HwAgSysArbnDPinionAgConfDTqLoaDPinionAgConf
      AssemblySwConnector_542: ecu-extract-reference=HysCmpDHysCmpCmdDAssiPahSumDHysCmpCmd
      AssemblySwConnector_543: ecu-extract-reference=TqLoaDTqLoaCmdDAssiSumLimDTqLoaCmd
      AssemblySwConnector_546: ecu-extract-reference=VehSigCdngDVehLatADTqLoaDVehLatA
      AssemblySwConnector_547: ecu-extract-reference=VehSigCdngDVehLatAVldDTqLoaDVehLatAVld
      AssemblySwConnector_549: ecu-extract-reference=VehSigCdngDVehSpdVldDTqLoaDVehSpdVld
      ComponentPrototype_051: upstream-reference=ECU_Composition.SysPrfmncSts, ecu-extract-reference=COMPOSITIONTYPE.SysPrfmncSts
      ComponentPrototype_052: upstream-reference=ECU_Composition.SysFricLrng, ecu-extract-reference=COMPOSITIONTYPE.SysFricLrng
      ComponentPrototype_053: upstream-reference=ECU_Composition.PosnTrakgServo, ecu-extract-reference=COMPOSITIONTYPE.PosnTrakgServo
      ComponentPrototype_054: upstream-reference=ECU_Composition.MotRplCoggCfg, ecu-extract-reference=COMPOSITIONTYPE.MotRplCoggCfg
      ComponentPrototype_055: upstream-reference=ECU_Composition.DrvrTqEstimn, ecu-extract-reference=COMPOSITIONTYPE.DrvrTqEstimn
      ComponentPrototype_056: upstream-reference=ECU_Composition.CmplncErr, ecu-extract-reference=COMPOSITIONTYPE.CmplncErr
      ComponentPrototype_057: upstream-reference=ECU_Composition.CDD_MotRplCoggCmd, ecu-extract-reference=COMPOSITIONTYPE.CDD_MotRplCoggCmd
      AssemblySwConnector_651: ecu-extract-reference=CDD_FordT3T6McuCfgDBattVltgDSysPrfmncStsDBattVltg
      AssemblySwConnector_653: ecu-extract-reference=CDD_MotVelDMotVelMrfDMotRplCoggCfgDMotVelMrf
      AssemblySwConnector_655: ecu-extract-reference=CmplncErrDCmplncErrMotToPinionDHwAgSnsrlsDCmplncErrMotToPinion
      AssemblySwConnector_656: ecu-extract-reference=CmplncErrDCmplncErrPinionToHwDHwAgSysArbnDCmplncErrPinionToHw
      AssemblySwConnector_657: ecu-extract-reference=DiagcMgrProxyAppl10DGetNtcQlfrSts10DSysFricLrngDGetNtcQlfrSts
      AssemblySwConnector_658: ecu-extract-reference=DiagcMgrProxyAppl10DSetNtcSts10DSysFricLrngDSetNtcSts
      AssemblySwConnector_659: ecu-extract-reference=DiagcMgrProxyAppl10DGetNtcQlfrSts10DSysPrfmncStsDGetNtcQlfrSts
      AssemblySwConnector_660: ecu-extract-reference=FltInjDFltInj_f32DSysFricLrngDFltInj_f32
      AssemblySwConnector_661: ecu-extract-reference=HwAgSysArbnDHwVelDSysFricLrngDHwVel
      AssemblySwConnector_662: ecu-extract-reference=MotCtrlPrmEstimnDMotBackEmfConEstimdDMotRplCoggCfgDMotBackEmfConEstimd
      AssemblySwConnector_663: ecu-extract-reference=MotCtrlPrmEstimnDMotInduDaxEstimdDMotRplCoggCfgDMotInduDaxEstimd
      AssemblySwConnector_664: ecu-extract-reference=MotCtrlPrmEstimnDMotInduQaxEstimdDMotRplCoggCfgDMotInduQaxEstimd
      AssemblySwConnector_665: ecu-extract-reference=PolarityCfgDAssiMechPolarityDDrvrTqEstimnDAssiMechPolarity
      AssemblySwConnector_666: ecu-extract-reference=SysFricLrngDSysFricOffsDHysCmpDSysFricOffs
      AssemblySwConnector_667: ecu-extract-reference=SysStModDSysStDSysPrfmncStsDSysSt
      AssemblySwConnector_669: ecu-extract-reference=VehSigCdngDVehLatADSysFricLrngDVehLatA
      AssemblySwConnector_671: ecu-extract-reference=VehSigCdngDVehSpdVldDSysFricLrngDVehSpdVld
      AssemblySwConnector_672: ecu-extract-reference=VehSigCdngDVehSpdVldDSysPrfmncStsDVehSpdVld
      ComponentPrototype_058: upstream-reference=ECU_Composition.CDD_MotCtrlMgr, ecu-extract-reference=COMPOSITIONTYPE.CDD_MotCtrlMgr
      AssemblySwConnector_673: ecu-extract-reference=BattVltgDBrdgVltgDCDD_MotCtrlMgrDBrdgVltg
      AssemblySwConnector_674: ecu-extract-reference=CDD_CurrMeasDCurrMeasWrmIninTestCmplDCDD_MotCtrlMgrDCurrMeasWrmIninTestCmpl
      AssemblySwConnector_675: ecu-extract-reference=CDD_CurrMeasDMotCurrQlfr1DCDD_MotCtrlMgrDMotCurrQlfr1
      AssemblySwConnector_678: ecu-extract-reference=CDD_FordT3T6McuCfgDMotCurrAdcVlyAAdcFaildDCDD_MotCtrlMgrDMotCurrAdcVlyAAdcFaild
      AssemblySwConnector_679: ecu-extract-reference=CDD_FordT3T6McuCfgDMotCurrAdcVlyBAdcFaildDCDD_MotCtrlMgrDMotCurrAdcVlyBAdcFaild
      AssemblySwConnector_680: ecu-extract-reference=CDD_FordT3T6McuCfgDMotCurrAdcVlyCAdcFaildDCDD_MotCtrlMgrDMotCurrAdcVlyCAdcFaild
      AssemblySwConnector_681: ecu-extract-reference=CDD_MotCtrlMgrDMotCurrAdcVlyADCDD_CurrMeasDMotCurrAdcVlyA
      AssemblySwConnector_682: ecu-extract-reference=CDD_MotCtrlMgrDMotCurrAdcVlyBDCDD_CurrMeasDMotCurrAdcVlyB
      AssemblySwConnector_683: ecu-extract-reference=CDD_MotCtrlMgrDMotCurrAdcVlyCDCDD_CurrMeasDMotCurrAdcVlyC
      AssemblySwConnector_684: ecu-extract-reference=CDD_MotCtrlMgrDNtc5DErrCntDCDD_CurrMeasDNtc5DErrCnt
      AssemblySwConnector_685: ecu-extract-reference=CDD_MotCtrlMgrDMotAgCumvAlgndMrfRevDCDD_MotAgCmpDMotAgCumvAlgndMrfRev
      AssemblySwConnector_686: ecu-extract-reference=CDD_MotCtrlMgrDMotAgCumvInidDCDD_MotAgCmpDMotAgCumvInid
      AssemblySwConnector_687: ecu-extract-reference=CDD_MotCtrlMgrDMotAgBufDCDD_MotVelDMotAgBuf
      AssemblySwConnector_688: ecu-extract-reference=CDD_MotCtrlMgrDMotAgBufIdxDCDD_MotVelDMotAgBufIdx
      AssemblySwConnector_689: ecu-extract-reference=CDD_MotCtrlMgrDMotAgTiBufDCDD_MotVelDMotAgTiBuf
      AssemblySwConnector_690: ecu-extract-reference=CDD_MotCtrlMgrDMotCurrCorrdADCurrMeasCorrlnDMotCurrCorrdA
      AssemblySwConnector_691: ecu-extract-reference=CDD_MotCtrlMgrDMotCurrCorrdBDCurrMeasCorrlnDMotCurrCorrdB
      AssemblySwConnector_692: ecu-extract-reference=CDD_MotCtrlMgrDMotCurrCorrdCDCurrMeasCorrlnDMotCurrCorrdC
      AssemblySwConnector_693: ecu-extract-reference=CDD_MotCtrlMgrDMotCurrRollgCntr1DCurrMeasCorrlnDMotCurrRollgCntr1
      AssemblySwConnector_694: ecu-extract-reference=CDD_MotVelDMotVelMrfDCDD_MotCtrlMgrDMotVelMrf
      AssemblySwConnector_695: ecu-extract-reference=CurrMeasCorrlnDCurrMeasCorrlnStsDCDD_MotCtrlMgrDCurrMeasCorrlnSts
      AssemblySwConnector_696: ecu-extract-reference=MotAgCorrlnDMotAgMeclCorrlnStDCDD_MotCtrlMgrDMotAgMeclCorrlnSt
      AssemblySwConnector_697: ecu-extract-reference=MotRplCoggCfgDMotAgElecDlyRplDCDD_MotCtrlMgrDMotAgElecDlyRpl
      AssemblySwConnector_698: ecu-extract-reference=MotRplCoggCfgDMotCurrQaxToMotTqGainDCDD_MotCtrlMgrDMotCurrQaxToMotTqGain
      AssemblySwConnector_699: ecu-extract-reference=MotRplCoggCfgDMotTqRplCoggOrder1MgnDCDD_MotCtrlMgrDMotTqRplCoggOrder1Mgn
      AssemblySwConnector_700: ecu-extract-reference=MotRplCoggCfgDMotTqRplCoggOrder1PhaDCDD_MotCtrlMgrDMotTqRplCoggOrder1Pha
      AssemblySwConnector_701: ecu-extract-reference=MotRplCoggCfgDMotTqRplCoggOrder2MgnDCDD_MotCtrlMgrDMotTqRplCoggOrder2Mgn
      AssemblySwConnector_702: ecu-extract-reference=MotRplCoggCfgDMotTqRplCoggOrder2PhaDCDD_MotCtrlMgrDMotTqRplCoggOrder2Pha
      AssemblySwConnector_703: ecu-extract-reference=MotRplCoggCfgDMotTqRplCoggOrder3MgnDCDD_MotCtrlMgrDMotTqRplCoggOrder3Mgn
      AssemblySwConnector_704: ecu-extract-reference=MotRplCoggCfgDMotTqRplCoggOrder3PhaDCDD_MotCtrlMgrDMotTqRplCoggOrder3Pha
      AssemblySwConnector_705: ecu-extract-reference=PolarityCfgDMotElecMeclPolarityDCDD_MotCtrlMgrDMotElecMeclPolarity
      AssemblySwConnector_706: ecu-extract-reference=SysStModDSysStDCDD_MotCtrlMgrDSysSt
      ComponentPrototype_059: upstream-reference=ECU_Composition.Swp, ecu-extract-reference=COMPOSITIONTYPE.Swp
      ComponentPrototype_060: upstream-reference=ECU_Composition.StOutpCtrl, ecu-extract-reference=COMPOSITIONTYPE.StOutpCtrl
      ComponentPrototype_061: upstream-reference=ECU_Composition.CDD_NxtrTi, ecu-extract-reference=COMPOSITIONTYPE.CDD_NxtrTi
      AssemblySwConnector_676: ecu-extract-reference=AssiSumLimDMotTqCmdDSwpDMotTqCmd
      AssemblySwConnector_677: ecu-extract-reference=CDD_DmaCfgAndUseDDmaEna2MilliSecToMotCtrlTrfDCDD_MotCtrlMgrDDmaEna2MilliSecToMotCtrlTrf
      AssemblySwConnector_707: ecu-extract-reference=CDD_DmaCfgAndUseDDmaWaitForMotCtrlTo2MilliSecTrfDCDD_MotCtrlMgrDDmaWaitForMotCtrlTo2MilliSecTrf
      AssemblySwConnector_708: ecu-extract-reference=CDD_NxtrTiDGetRefTmr1MicroSec32bitDCDD_DmaCfgAndUseDGetRefTmr1MicroSec32bit
      AssemblySwConnector_709: ecu-extract-reference=CDD_NxtrTiDGetTiSpan1MicroSec32bitDCDD_DmaCfgAndUseDGetTiSpan1MicroSec32bit
      AssemblySwConnector_710: ecu-extract-reference=CDD_NxtrTiDGetRefTmr1MicroSec32bitDCDD_FordT3T6McuCfgDGetRefTmr1MicroSec32bit
      AssemblySwConnector_711: ecu-extract-reference=CDD_NxtrTiDGetTiSpan1MicroSec32bitDCDD_FordT3T6McuCfgDGetTiSpan1MicroSec32bit
      AssemblySwConnector_712: ecu-extract-reference=CDD_NxtrTiDGetRefTmr100MicroSec32bitDEotLrngDGetRefTmr100MicroSec32bit
      AssemblySwConnector_713: ecu-extract-reference=CDD_NxtrTiDGetTiSpan100MicroSec32bitDEotLrngDGetTiSpan100MicroSec32bit
      AssemblySwConnector_714: ecu-extract-reference=CDD_NxtrTiDGetRefTmr100MicroSec32bitDFltInjDGetRefTmr100MicroSec32bit
      AssemblySwConnector_715: ecu-extract-reference=CDD_NxtrTiDGetTiSpan100MicroSec32bitDFltInjDGetTiSpan100MicroSec32bit
      AssemblySwConnector_716: ecu-extract-reference=CDD_NxtrTiDGetRefTmr100MicroSec32bitDHwAgSnsrlsDGetRefTmr100MicroSec32bit
      AssemblySwConnector_717: ecu-extract-reference=CDD_NxtrTiDGetTiSpan100MicroSec32bitDHwAgSnsrlsDGetTiSpan100MicroSec32bit
      AssemblySwConnector_718: ecu-extract-reference=CDD_NxtrTiDGetRefTmr100MicroSec32bitDHwAgSysArbnDGetRefTmr100MicroSec32bit
      AssemblySwConnector_719: ecu-extract-reference=CDD_NxtrTiDGetTiSpan100MicroSec32bitDHwAgSysArbnDGetTiSpan100MicroSec32bit
      AssemblySwConnector_720: ecu-extract-reference=CDD_NxtrTiDGetRefTmr100MicroSec32bitDSwpDGetRefTmr100MicroSec32bit
      AssemblySwConnector_721: ecu-extract-reference=CDD_NxtrTiDGetTiSpan100MicroSec32bitDSwpDGetTiSpan100MicroSec32bit
      AssemblySwConnector_722: ecu-extract-reference=CDD_NxtrTiDGetRefTmr100MicroSec32bitDSysFricLrngDGetRefTmr100MicroSec32bit
      AssemblySwConnector_723: ecu-extract-reference=CDD_NxtrTiDGetTiSpan100MicroSec32bitDSysFricLrngDGetTiSpan100MicroSec32bit
      AssemblySwConnector_724: ecu-extract-reference=DiagcMgrDDiagcStsCtrldShtDwnFltPrsntDStOutpCtrlDDiagcStsCtrldShtDwnFltPrsnt
      AssemblySwConnector_725: ecu-extract-reference=DiagcMgrDSysDiMotTqCmdScaDStOutpCtrlDSysDiMotTqCmdSca
      AssemblySwConnector_726: ecu-extract-reference=DiagcMgrDSysDiRampRateDStOutpCtrlDSysDiRampRate
      AssemblySwConnector_727: ecu-extract-reference=DiagcMgrProxyAppl10DSetNtcSts10DCDD_NxtrTiDSetNtcSts
      AssemblySwConnector_729: ecu-extract-reference=StOutpCtrlDSysMotTqCmdScaDEotProtnDSysMotTqCmdSca
      AssemblySwConnector_747: ecu-extract-reference=SwpDHwTqSwpDVehSigCdngDHwTq
      AssemblySwConnector_748: ecu-extract-reference=VehSigCdngDVehSpdDSwpDVehSpd
      AssemblySwConnector_749: ecu-extract-reference=VehSigCdngDVehSpdVldDSwpDVehSpdVld
      ComponentPrototype_062: upstream-reference=ECU_Composition.TunSelnAuthy, ecu-extract-reference=COMPOSITIONTYPE.TunSelnAuthy
      ComponentPrototype_063: upstream-reference=ECU_Composition.CDD_VrfyCritReg, ecu-extract-reference=COMPOSITIONTYPE.CDD_VrfyCritReg
      AssemblySwConnector_750: ecu-extract-reference=CalRegn01CmnGroupADTunSelnAuthyHwTqYDTunSelnAuthyDTunSelnAuthyHwTqY
      AssemblySwConnector_751: ecu-extract-reference=CalRegn01CmnGroupADTunSelnAuthyHwVelYDTunSelnAuthyDTunSelnAuthyHwVelY
      AssemblySwConnector_752: ecu-extract-reference=CalRegn01CmnGroupADTunSelnAuthyTunSelnRtDiCmdDTunSelnAuthyDTunSelnAuthyTunSelnRtDiCmd
      AssemblySwConnector_753: ecu-extract-reference=CalRegn01Inin00GroupADTunSelnAuthyVehSpdXDTunSelnAuthyDTunSelnAuthyVehSpdX
      AssemblySwConnector_754: ecu-extract-reference=DiagcMgrProxyAppl10DSetNtcSts10DCDD_VrfyCritRegDSetNtcSts
      AssemblySwConnector_755: ecu-extract-reference=HwAgSysArbnDHwVelDTunSelnAuthyDHwVel
      ComponentPrototype_064: upstream-reference=ECU_Composition.HwAg1Meas, ecu-extract-reference=COMPOSITIONTYPE.HwAg1Meas
      ComponentPrototype_065: upstream-reference=ECU_Composition.CDD_McuDiagc, ecu-extract-reference=COMPOSITIONTYPE.CDD_McuDiagc
      AssemblySwConnector_770: ecu-extract-reference=CDD_FordT3T6McuCfgDHwAg1SnsrTypDHwAg1MeasDHwAg1SnsrTyp
      AssemblySwConnector_771: ecu-extract-reference=CDD_McuDiagcDLoopCntr2MilliSecDCDD_MotCtrlMgrDLoopCntr2MilliSec
      AssemblySwConnector_772: ecu-extract-reference=CDD_MotCtrlMgrDFastLoopCntrDCDD_McuDiagcDFastLoopCntr
      AssemblySwConnector_773: ecu-extract-reference=CDD_MotCtrlMgrDSlowLoopCntrDCDD_McuDiagcDSlowLoopCntr
      AssemblySwConnector_774: ecu-extract-reference=CDD_NxtrTiDGetRefTmr1MicroSec32bitDHwAg1MeasDGetRefTmr1MicroSec32bit
      AssemblySwConnector_775: ecu-extract-reference=CDD_NxtrTiDGetTiSpan1MicroSec32bitDHwAg1MeasDGetTiSpan1MicroSec32bit
      AssemblySwConnector_776: ecu-extract-reference=DiagcMgrProxyAppl10DSetNtcSts10DCDD_McuDiagcDSetNtcSts
      AssemblySwConnector_777: ecu-extract-reference=DiagcMgrProxyAppl10DGetNtcQlfrSts10DHwAg1MeasDGetNtcQlfrSts
      AssemblySwConnector_778: ecu-extract-reference=DiagcMgrProxyAppl10DSetNtcSts10DHwAg1MeasDSetNtcSts
      AssemblySwConnector_779: ecu-extract-reference=IoHwAbDSetFctPrphlHwAg1DHwAg1MeasDIoHwAb_SetFctPrphlHwAg1
      AssemblySwConnector_780: ecu-extract-reference=PolarityCfgDHwAg1PolarityDHwAg1MeasDHwAg1Polarity
      ComponentPrototype_066: upstream-reference=ECU_Composition.MotRefMdl, ecu-extract-reference=COMPOSITIONTYPE.MotRefMdl
      ComponentPrototype_067: upstream-reference=ECU_Composition.MotCurrRegCfg, ecu-extract-reference=COMPOSITIONTYPE.MotCurrRegCfg
      ComponentPrototype_068: upstream-reference=ECU_Composition.MotCurrPeakEstimn, ecu-extract-reference=COMPOSITIONTYPE.MotCurrPeakEstimn
      ComponentPrototype_069: upstream-reference=ECU_Composition.CDD_MotCurrRegVltgLimr, ecu-extract-reference=COMPOSITIONTYPE.CDD_MotCurrRegVltgLimr
      AssemblySwConnector_781: ecu-extract-reference=BattVltgDBrdgVltgDMotRefMdlDBrdgVltg
      AssemblySwConnector_843: ecu-extract-reference=CDD_CurrMeasDMotCurrEolCalStDMotCurrRegCfgDMotCurrEolCalSt
      AssemblySwConnector_844: ecu-extract-reference=CDD_MotVelDMotVelMrfDMotCurrRegCfgDMotVelMrf
      AssemblySwConnector_845: ecu-extract-reference=CDD_MotVelDMotVelMrfDMotRefMdlDMotVelMrf
      AssemblySwConnector_846: ecu-extract-reference=MotCtrlPrmEstimnDMotInduDaxEstimdDMotCurrRegCfgDMotInduDaxEstimd
      AssemblySwConnector_847: ecu-extract-reference=MotCtrlPrmEstimnDMotInduQaxEstimdDMotCurrRegCfgDMotInduQaxEstimd
      AssemblySwConnector_848: ecu-extract-reference=MotCtrlPrmEstimnDMotREstimdDMotCurrRegCfgDMotREstimd
      AssemblySwConnector_849: ecu-extract-reference=MotCtrlPrmEstimnDMotBackEmfConEstimdDMotRefMdlDMotBackEmfConEstimd
      AssemblySwConnector_850: ecu-extract-reference=MotCtrlPrmEstimnDMotInduDaxEstimdDMotRefMdlDMotInduDaxEstimd
      AssemblySwConnector_851: ecu-extract-reference=MotCtrlPrmEstimnDMotInduQaxEstimdDMotRefMdlDMotInduQaxEstimd
      AssemblySwConnector_852: ecu-extract-reference=MotCtrlPrmEstimnDMotREstimdDMotRefMdlDMotREstimd
      AssemblySwConnector_853: ecu-extract-reference=MotQuadDetnDMotQuadDMotRefMdlDMotQuad
      AssemblySwConnector_854: ecu-extract-reference=MotRefMdlDMotCurrDaxCmdDMotCtrlPrmEstimnDMotCurrDaxCmd
      AssemblySwConnector_855: ecu-extract-reference=MotRefMdlDMotCurrQaxCmdDMotCtrlPrmEstimnDMotCurrQaxCmd
      AssemblySwConnector_856: ecu-extract-reference=MotRefMdlDMotCurrDaxCmdDMotCurrPeakEstimnDMotCurrDaxCmd
      AssemblySwConnector_857: ecu-extract-reference=MotRefMdlDMotCurrQaxCmdDMotCurrPeakEstimnDMotCurrQaxCmd
      AssemblySwConnector_858: ecu-extract-reference=MotRefMdlDMotCurrDaxCmdDMotRplCoggCfgDMotCurrDaxCmd
      AssemblySwConnector_859: ecu-extract-reference=MotRefMdlDMotCurrQaxCmdDMotRplCoggCfgDMotCurrQaxCmd
      AssemblySwConnector_861: ecu-extract-reference=CDD_MotCtrlMgrDMotCurrDaxDMotCurrPeakEstimnDMotCurrDax
      AssemblySwConnector_862: ecu-extract-reference=CDD_MotCtrlMgrDMotCurrQaxDMotCurrPeakEstimnDMotCurrQax
      AssemblySwConnector_863: ecu-extract-reference=MotCtrlPrmEstimnDMotInduDaxEstimdIvsDCDD_MotCtrlMgrDMotInduDaxEstimdIvs
      AssemblySwConnector_864: ecu-extract-reference=MotCtrlPrmEstimnDMotInduQaxEstimdIvsDCDD_MotCtrlMgrDMotInduQaxEstimdIvs
      AssemblySwConnector_865: ecu-extract-reference=MotCtrlPrmEstimnDMotREstimdDCDD_MotCtrlMgrDMotREstimd
      AssemblySwConnector_866: ecu-extract-reference=MotCurrRegCfgDMotAgElecDlyDCDD_MotCtrlMgrDMotAgElecDly
      AssemblySwConnector_867: ecu-extract-reference=MotCurrRegCfgDMotDampgDaxDCDD_MotCtrlMgrDMotDampgDax
      AssemblySwConnector_868: ecu-extract-reference=MotCurrRegCfgDMotDampgQaxDCDD_MotCtrlMgrDMotDampgQax
      AssemblySwConnector_869: ecu-extract-reference=MotCurrRegCfgDMotIntglGainDaxDCDD_MotCtrlMgrDMotIntglGainDax
      AssemblySwConnector_870: ecu-extract-reference=MotCurrRegCfgDMotIntglGainQaxDCDD_MotCtrlMgrDMotIntglGainQax
      AssemblySwConnector_871: ecu-extract-reference=MotCurrRegCfgDMotPropGainDaxDCDD_MotCtrlMgrDMotPropGainDax
      AssemblySwConnector_872: ecu-extract-reference=MotCurrRegCfgDMotPropGainQaxDCDD_MotCtrlMgrDMotPropGainQax
      AssemblySwConnector_873: ecu-extract-reference=MotRefMdlDMotBackEmfVltgDCDD_MotCtrlMgrDMotBackEmfVltg
      AssemblySwConnector_874: ecu-extract-reference=MotRefMdlDMotCurrDaxCmdDCDD_MotCtrlMgrDMotCurrDaxCmd
      AssemblySwConnector_875: ecu-extract-reference=MotRefMdlDMotCurrDaxMaxDCDD_MotCtrlMgrDMotCurrDaxMax
      AssemblySwConnector_876: ecu-extract-reference=MotRefMdlDMotCurrQaxCmdDCDD_MotCtrlMgrDMotCurrQaxCmd
      AssemblySwConnector_877: ecu-extract-reference=MotRefMdlDMotReacncDaxDCDD_MotCtrlMgrDMotReacncDax
      AssemblySwConnector_878: ecu-extract-reference=MotRefMdlDMotReacncQaxDCDD_MotCtrlMgrDMotReacncQax
      AssemblySwConnector_879: ecu-extract-reference=MotRefMdlDMotVltgDaxFfDCDD_MotCtrlMgrDMotVltgDaxFf
      AssemblySwConnector_880: ecu-extract-reference=MotRefMdlDMotVltgQaxFfDCDD_MotCtrlMgrDMotVltgQaxFf
      ComponentPrototype_070: upstream-reference=ECU_Composition.TmplMonr, ecu-extract-reference=COMPOSITIONTYPE.TmplMonr
      ComponentPrototype_071: upstream-reference=ECU_Composition.PwrSply, ecu-extract-reference=COMPOSITIONTYPE.PwrSply
      ComponentPrototype_072: upstream-reference=ECU_Composition.GateDrv0Ctrl, ecu-extract-reference=COMPOSITIONTYPE.GateDrv0Ctrl
      ComponentPrototype_073: upstream-reference=ECU_Composition.CDD_MotAg6Meas, ecu-extract-reference=COMPOSITIONTYPE.CDD_MotAg6Meas
      ComponentPrototype_074: upstream-reference=ECU_Composition.CDD_MotAg5Meas, ecu-extract-reference=COMPOSITIONTYPE.CDD_MotAg5Meas
      AssemblySwConnector_918: ecu-extract-reference=CDD_FordT3T6McuCfgDMotAg5CosAdcFaildDCDD_MotAg5MeasDMotAg5CosAdcFaild
      AssemblySwConnector_919: ecu-extract-reference=CDD_FordT3T6McuCfgDMotAg5SinAdcFaildDCDD_MotAg5MeasDMotAg5SinAdcFaild
      AssemblySwConnector_920: ecu-extract-reference=CDD_FordT3T6McuCfgDMotAg6CosAdcFaildDCDD_MotAg6MeasDMotAg6CosAdcFaild
      AssemblySwConnector_921: ecu-extract-reference=CDD_FordT3T6McuCfgDMotAg6SinAdcFaildDCDD_MotAg6MeasDMotAg6SinAdcFaild
      AssemblySwConnector_922: ecu-extract-reference=CDD_MotAg5MeasDMotAg5CosRtAmpRecprDCDD_MotCtrlMgrDMotAg5CosRtAmpRecpr
      AssemblySwConnector_923: ecu-extract-reference=CDD_MotAg5MeasDMotAg5CosRtOffsDCDD_MotCtrlMgrDMotAg5CosRtOffs
      AssemblySwConnector_924: ecu-extract-reference=CDD_MotAg5MeasDMotAg5MeclQlfrDCDD_MotCtrlMgrDMotAg5MeclQlfr
      AssemblySwConnector_925: ecu-extract-reference=CDD_MotAg5MeasDMotAg5SinRtAmpRecprDCDD_MotCtrlMgrDMotAg5SinRtAmpRecpr
      AssemblySwConnector_926: ecu-extract-reference=CDD_MotAg5MeasDMotAg5SinRtOffsDCDD_MotCtrlMgrDMotAg5SinRtOffs
      AssemblySwConnector_927: ecu-extract-reference=CDD_MotAg5MeasDMotAg5MeclQlfrDMotAgCorrlnDMotAgAMeclQlfr
      AssemblySwConnector_928: ecu-extract-reference=CDD_MotAg5MeasDMotAg5MeclRollgCntrDMotAgCorrlnDMotAgAMeclRollgCntr
      AssemblySwConnector_929: ecu-extract-reference=CDD_MotAg6MeasDMotAg6CosRtAmpRecprDCDD_MotCtrlMgrDMotAg6CosRtAmpRecpr
      AssemblySwConnector_930: ecu-extract-reference=CDD_MotAg6MeasDMotAg6CosRtOffsDCDD_MotCtrlMgrDMotAg6CosRtOffs
      AssemblySwConnector_931: ecu-extract-reference=CDD_MotAg6MeasDMotAg6MeclQlfrDCDD_MotCtrlMgrDMotAg6MeclQlfr
      AssemblySwConnector_932: ecu-extract-reference=CDD_MotAg6MeasDMotAg6SinRtAmpRecprDCDD_MotCtrlMgrDMotAg6SinRtAmpRecpr
      AssemblySwConnector_933: ecu-extract-reference=CDD_MotAg6MeasDMotAg6SinRtOffsDCDD_MotCtrlMgrDMotAg6SinRtOffs
      AssemblySwConnector_934: ecu-extract-reference=CDD_MotAg6MeasDMotAg6MeclQlfrDMotAgCorrlnDMotAgBMeclQlfr
      AssemblySwConnector_935: ecu-extract-reference=CDD_MotAg6MeasDMotAg6MeclRollgCntrDMotAgCorrlnDMotAgBMeclRollgCntr
      AssemblySwConnector_936: ecu-extract-reference=CDD_MotCtrlMgrDMotAg5CosDCDD_MotAg5MeasDMotAg5Cos
      AssemblySwConnector_938: ecu-extract-reference=CDD_MotCtrlMgrDMotAg5SinDCDD_MotAg5MeasDMotAg5Sin
      AssemblySwConnector_939: ecu-extract-reference=CDD_MotCtrlMgrDMotAg6CosDCDD_MotAg6MeasDMotAg6Cos
      AssemblySwConnector_941: ecu-extract-reference=CDD_MotCtrlMgrDMotAg6SinDCDD_MotAg6MeasDMotAg6Sin
      AssemblySwConnector_942: ecu-extract-reference=CDD_MotCtrlMgrDMotAg5MeclDMotAgCorrlnDMotAgAMecl
      AssemblySwConnector_944: ecu-extract-reference=CDD_MotCtrlMgrDMotAg6MeclDMotAgCorrlnDMotAgBMecl
      AssemblySwConnector_946: ecu-extract-reference=CDD_MotVelDMotVelMrfDCDD_MotAg5MeasDMotVelMrf
      AssemblySwConnector_947: ecu-extract-reference=CDD_MotVelDMotVelMrfDCDD_MotAg6MeasDMotVelMrf
      AssemblySwConnector_948: ecu-extract-reference=CDD_NxtrTiDGetRefTmr1MicroSec32bitDCDD_MotAg5MeasDGetRefTmr1MicroSec32bit
      AssemblySwConnector_949: ecu-extract-reference=CDD_NxtrTiDGetRefTmr1MicroSec32bitDTmplMonrDGetRefTmr1MicroSec32bit
      AssemblySwConnector_950: ecu-extract-reference=CDD_NxtrTiDGetTiSpan1MicroSec32bitDTmplMonrDGetTiSpan1MicroSec32bit
      AssemblySwConnector_951: ecu-extract-reference=DiagcMgrDCnvSnpshtData_f32DCDD_MotAg5MeasDCnvSnpshtData_f32
      AssemblySwConnector_952: ecu-extract-reference=DiagcMgrDCnvSnpshtData_loglDCDD_MotAg5MeasDCnvSnpshtData_logl
      AssemblySwConnector_953: ecu-extract-reference=DiagcMgrDCnvSnpshtData_f32DCDD_MotAg6MeasDCnvSnpshtData_f32
      AssemblySwConnector_954: ecu-extract-reference=DiagcMgrDCnvSnpshtData_loglDCDD_MotAg6MeasDCnvSnpshtData_logl
      AssemblySwConnector_955: ecu-extract-reference=DiagcMgrProxyAppl10DGetNtcQlfrSts10DCDD_MotAg5MeasDGetNtcQlfrSts
      AssemblySwConnector_956: ecu-extract-reference=DiagcMgrProxyAppl10DSetNtcStsAndSnpshtData10DCDD_MotAg5MeasDSetNtcStsAndSnpshtData
      AssemblySwConnector_957: ecu-extract-reference=DiagcMgrProxyAppl10DGetNtcQlfrSts10DCDD_MotAg6MeasDGetNtcQlfrSts
      AssemblySwConnector_958: ecu-extract-reference=DiagcMgrProxyAppl10DSetNtcStsAndSnpshtData10DCDD_MotAg6MeasDSetNtcStsAndSnpshtData
      AssemblySwConnector_959: ecu-extract-reference=DiagcMgrProxyAppl10DGetNtcQlfrSts10DGateDrv0CtrlDGetNtcQlfrSts
      AssemblySwConnector_960: ecu-extract-reference=DiagcMgrProxyAppl10DSetNtcSts10DGateDrv0CtrlDSetNtcSts
      AssemblySwConnector_961: ecu-extract-reference=DiagcMgrProxyAppl10DSetNtcSts10DPwrSplyDSetNtcSts
      AssemblySwConnector_962: ecu-extract-reference=DiagcMgrProxyAppl10DSetNtcSts10DTmplMonrDSetNtcSts
      AssemblySwConnector_963: ecu-extract-reference=GateDrv0CtrlDDiagcStsIvtr1InactvDBattVltgCorrlnDDiagcStsIvtr1Inactv
      AssemblySwConnector_964: ecu-extract-reference=GateDrv0CtrlDDiagcStsIvtr1InactvDCDD_CurrMeasDDiagcStsIvtr1Inactv
      AssemblySwConnector_965: ecu-extract-reference=GateDrv0CtrlDDiagcStsIvtr1InactvDCDD_MotCtrlMgrDDiagcStsIvtr1Inactv
      AssemblySwConnector_966: ecu-extract-reference=GateDrv0CtrlDDiagcStsIvtr1InactvDCurrMeasCorrlnDDiagcStsIvtr1Inactv
      AssemblySwConnector_967: ecu-extract-reference=GateDrv0CtrlDMotDrvr0IninTestCmplDPwrUpSeqDMotDrvr0IninTestCmpl
      AssemblySwConnector_968: ecu-extract-reference=GateDrv0CtrlDDiagcStsIvtr1InactvDShtdwnMechDDiagcStsIvtr1Inactv
      AssemblySwConnector_971: ecu-extract-reference=IoHwAbDSetGpioSysFlt2ADGateDrv0CtrlDIoHwAb_SetGpioSysFlt2A
      AssemblySwConnector_972: ecu-extract-reference=IoHwAbDGetGpioPwrOutpEnaFbDTmplMonrDIoHwAb_GetGpioPwrOutpEnaFb
      AssemblySwConnector_973: ecu-extract-reference=IoHwAbDSetGpioTmplMonrWdgDTmplMonrDIoHwAb_SetGpioTmplMonrWdg
      AssemblySwConnector_974: ecu-extract-reference=PwrUpSeqDStrtUpStDGateDrv0CtrlDStrtUpSt
      AssemblySwConnector_975: ecu-extract-reference=PwrUpSeqDStrtUpStDTmplMonrDStrtUpSt
      AssemblySwConnector_976: ecu-extract-reference=SysStModDSysStDGateDrv0CtrlDSysSt
      AssemblySwConnector_977: ecu-extract-reference=SysStModDSysStDPwrSplyDSysSt
      AssemblySwConnector_978: ecu-extract-reference=SysStModDSysStDTmplMonrDSysSt
      AssemblySwConnector_979: ecu-extract-reference=TmplMonrDTmplMonrIninTestCmplDPwrUpSeqDTmplMonIninTestCmpl
      AssemblySwConnector_943: ecu-extract-reference=CDD_MotAg5MeasDMotAg5MeclRollgCntrDCDD_MotCtrlMgrDMotAg5MeclRollgCntr
      AssemblySwConnector_945: ecu-extract-reference=CDD_MotAg6MeasDMotAg6MeclRollgCntrDCDD_MotCtrlMgrDMotAg6MeclRollgCntr
      AssemblySwConnector_980: ecu-extract-reference=SysStModDSysStDDiagcMgrDSysSt
      AssemblySwConnector_079: ecu-extract-reference=CDD_MotVelDMotVelVldDHwAgSysArbnDMotVelVld
      AssemblySwConnector_981: ecu-extract-reference=MotAgCorrlnDMotAgMeclIdptSigDCDD_MotVelDMotAgMeclIdptSig
      ComponentPrototype_076: upstream-reference=ECU_Composition.HwTqCorrln, ecu-extract-reference=COMPOSITIONTYPE.HwTqCorrln
      ComponentPrototype_077: upstream-reference=ECU_Composition.HwTqArbn, ecu-extract-reference=COMPOSITIONTYPE.HwTqArbn
      AssemblySwConnector_998: ecu-extract-reference=DiagcMgrProxyAppl10DGetNtcQlfrSts10DHwTqCorrlnDGetNtcQlfrSts
      AssemblySwConnector_999: ecu-extract-reference=DiagcMgrProxyAppl10DSetNtcSts10DHwTqCorrlnDSetNtcSts
      AssemblySwConnector_1000: ecu-extract-reference=FltInjDFltInj_u08DHwTqCorrlnDFltInj_u08
      AssemblySwConnector_1001: ecu-extract-reference=HwTqArbnDHwTqDSwpDHwTq
      AssemblySwConnector_1002: ecu-extract-reference=HwTqCorrlnDHwTqCorrlnStsDHwTqArbnDHwTqCorrlnSts
      ComponentPrototype_078: upstream-reference=ECU_Composition.TEstimn, ecu-extract-reference=COMPOSITIONTYPE.TEstimn
      ComponentPrototype_079: upstream-reference=ECU_Composition.PwrLimr, ecu-extract-reference=COMPOSITIONTYPE.PwrLimr
      ComponentPrototype_080: upstream-reference=ECU_Composition.LimrCdng, ecu-extract-reference=COMPOSITIONTYPE.LimrCdng
      ComponentPrototype_081: upstream-reference=ECU_Composition.HiLoadStallLimr, ecu-extract-reference=COMPOSITIONTYPE.HiLoadStallLimr
      ComponentPrototype_082: upstream-reference=ECU_Composition.EotProtnFwl, ecu-extract-reference=COMPOSITIONTYPE.EotProtnFwl
      ComponentPrototype_083: upstream-reference=ECU_Composition.DutyCycThermProtn, ecu-extract-reference=COMPOSITIONTYPE.DutyCycThermProtn
      AssemblySwConnector_535: ecu-extract-reference=AssiSumLimDMotTqCmdLimdPreStallDHiLoadStallLimrDMotTqCmdLimdPreStall
      AssemblySwConnector_536: ecu-extract-reference=BattVltgDBrdgVltgDPwrLimrDBrdgVltg
      AssemblySwConnector_1116: ecu-extract-reference=CDD_MotVelDMotVelMrfDPwrLimrDMotVelMrf
      AssemblySwConnector_1117: ecu-extract-reference=CDD_NxtrTiDGetRefTmr100MicroSec32bitDPwrLimrDGetRefTmr100MicroSec32bit
      AssemblySwConnector_1118: ecu-extract-reference=CDD_NxtrTiDGetTiSpan100MicroSec32bitDPwrLimrDGetTiSpan100MicroSec32bit
      AssemblySwConnector_1120: ecu-extract-reference=DiagcMgrDSysStFltOutpReqDiDStOutpCtrlDSysStFltOutpReqDi
      AssemblySwConnector_1121: ecu-extract-reference=DiagcMgrProxyAppl10DSetNtcSts10DDutyCycThermProtnDSetNtcSts
      AssemblySwConnector_1122: ecu-extract-reference=DiagcMgrProxyAppl10DSetNtcSts10DEotProtnFwlDSetNtcSts
      AssemblySwConnector_1123: ecu-extract-reference=DiagcMgrProxyAppl10DSetNtcSts10DPwrLimrDSetNtcSts
      AssemblySwConnector_1124: ecu-extract-reference=DutyCycThermProtnDThermLimSlowFilMaxDAssiDThermLimSlowFilMax
      AssemblySwConnector_1125: ecu-extract-reference=DutyCycThermProtnDThermRednFacDAssiSumLimDThermRednFac
      AssemblySwConnector_1126: ecu-extract-reference=DutyCycThermProtnDThermMotTqLimDLimrCdngDThermMotTqLim
      AssemblySwConnector_1127: ecu-extract-reference=DutyCycThermProtnDDutyCycThermProtnMaxOutpDSysPrfmncStsDDutyCycThermProtnMaxOutp
      AssemblySwConnector_1128: ecu-extract-reference=DutyCycThermProtnDThermDutyCycProtnLoadDptLimDSysPrfmncStsDThermDutyCycProtnLoadDptLim
      AssemblySwConnector_1129: ecu-extract-reference=DutyCycThermProtnDThermDutyCycProtnTDptLimDSysPrfmncStsDThermDutyCycProtnTDptLim
      AssemblySwConnector_1130: ecu-extract-reference=EotProtnDEotActvCmdDEotProtnFwlDEotActvCmd
      AssemblySwConnector_1131: ecu-extract-reference=EotProtnDEotAssiScaDLimrCdngDEotAssiSca
      AssemblySwConnector_1132: ecu-extract-reference=EotProtnDEotMotTqLimDLimrCdngDEotMotTqLim
      AssemblySwConnector_1133: ecu-extract-reference=EotProtnFwlDEotActvCmdLimdDAssiSumLimDEotActvCmd
      AssemblySwConnector_1134: ecu-extract-reference=EotProtnFwlDEotDampgCmdLimdDAssiSumLimDEotDampgCmd
      AssemblySwConnector_1135: ecu-extract-reference=FltInjDFltInj_f32DLimrCdngDFltInj_f32
      AssemblySwConnector_1136: ecu-extract-reference=HiLoadStallLimrDStallMotTqLimDLimrCdngDStallMotTqLim
      AssemblySwConnector_1137: ecu-extract-reference=HiLoadStallLimrDStallMotTqLimDSysPrfmncStsDStallMotTqLim
      AssemblySwConnector_1138: ecu-extract-reference=HwAgSysArbnDPinionAgConfDEotProtnFwlDPinionAgConf
      AssemblySwConnector_1139: ecu-extract-reference=HwAgSysArbnDHwVelDTEstimnDHwVel
      AssemblySwConnector_1140: ecu-extract-reference=LimrCdngDEotAssiScaCdndDAssiSumLimDEotAssiSca
      AssemblySwConnector_1141: ecu-extract-reference=LimrCdngDEotMotTqLimCdndDAssiSumLimDEotMotTqLim
      AssemblySwConnector_1142: ecu-extract-reference=LimrCdngDStallMotTqLimCdndDAssiSumLimDStallMotTqLim
      AssemblySwConnector_1143: ecu-extract-reference=LimrCdngDSysMotTqCmdScaCdndDAssiSumLimDSysMotTqCmdSca
      AssemblySwConnector_1144: ecu-extract-reference=LimrCdngDThermMotTqLimCdndDAssiSumLimDThermMotTqLim
      AssemblySwConnector_1145: ecu-extract-reference=LimrCdngDVehSpdMotTqLimCdndDAssiSumLimDVehSpdMotTqLim
      AssemblySwConnector_1146: ecu-extract-reference=MotCtrlPrmEstimnDMotBackEmfConEstimdDPwrLimrDMotBackEmfConEstimd
      AssemblySwConnector_1147: ecu-extract-reference=MotCurrPeakEstimnDMotCurrPeakEstimdDDutyCycThermProtnDMotCurrPeakEstimd
      AssemblySwConnector_1148: ecu-extract-reference=MotCurrPeakEstimnDMotCurrPeakEstimdFildDDutyCycThermProtnDMotCurrPeakEstimdFild
      AssemblySwConnector_1149: ecu-extract-reference=MotCurrPeakEstimnDMotCurrPeakEstimdDTEstimnDMotCurrPeakEstimd
      AssemblySwConnector_1150: ecu-extract-reference=PwrLimrDPwrLimrRednFacDAssiSumLimDPwrLimrRednFac
      AssemblySwConnector_1151: ecu-extract-reference=PwrLimrDMotTqCmdPwrLimdDDrvrTqEstimnDMotTqCmdPwrLimd
      AssemblySwConnector_1152: ecu-extract-reference=StOutpCtrlDSysMotTqCmdScaDLimrCdngDSysMotTqCmdSca
      AssemblySwConnector_1153: ecu-extract-reference=TEstimnDAssiMechTDDampgDAssiMechT
      AssemblySwConnector_1154: ecu-extract-reference=TEstimnDMotFetTDDutyCycThermProtnDMotFetT
      AssemblySwConnector_1155: ecu-extract-reference=TEstimnDMotMagTDDutyCycThermProtnDMotMagT
      AssemblySwConnector_1156: ecu-extract-reference=TEstimnDMotWidgTDDutyCycThermProtnDMotWidgT
      AssemblySwConnector_1157: ecu-extract-reference=TEstimnDAssiMechTDHysCmpDAssiMechT
      AssemblySwConnector_1158: ecu-extract-reference=TEstimnDMotFetTDMotCtrlPrmEstimnDMotFetT
      AssemblySwConnector_1159: ecu-extract-reference=TEstimnDMotMagTDMotCtrlPrmEstimnDMotMagT
      AssemblySwConnector_1160: ecu-extract-reference=TEstimnDMotWidgTDMotCtrlPrmEstimnDMotWidgT
      AssemblySwConnector_1161: ecu-extract-reference=TEstimnDAssiMechTDRtnDAssiMechT
      AssemblySwConnector_1162: ecu-extract-reference=TEstimnDAssiMechTDSysFricLrngDAssiMechT
      AssemblySwConnector_1165: ecu-extract-reference=VehSpdLimrDVehSpdMotTqLimDLimrCdngDVehSpdMotTqLim
      ComponentPrototype_084: upstream-reference=ECU_Composition.MotTqTranlDampg, ecu-extract-reference=COMPOSITIONTYPE.MotTqTranlDampg
      ComponentPrototype_085: upstream-reference=ECU_Composition.MotTqCmdSca, ecu-extract-reference=COMPOSITIONTYPE.MotTqCmdSca
      AssemblySwConnector_1195: ecu-extract-reference=CDD_NxtrTiDGetRefTmr100MicroSec32bitDMotTqTranlDampgDGetRefTmr100MicroSec32bit
      AssemblySwConnector_1196: ecu-extract-reference=CDD_NxtrTiDGetTiSpan100MicroSec32bitDMotTqTranlDampgDGetTiSpan100MicroSec32bit
      AssemblySwConnector_1197: ecu-extract-reference=DiagcMgrDDiagcStsCtrldShtDwnFltPrsntDMotTqTranlDampgDDiagcStsCtrldShtDwnFltPrsnt
      AssemblySwConnector_1201: ecu-extract-reference=MotTqCmdScaDMotTqCmdMrfScadDDiagcMgrDMotTqCmdMrfScad
      AssemblySwConnector_1202: ecu-extract-reference=MotTqCmdScaDMotTqCmdMrfScadDMotRefMdlDMotTqCmdMrfScad
      AssemblySwConnector_1203: ecu-extract-reference=MotTqCmdScaDMotTqCmdMrfScadDMotRplCoggCfgDMotTqCmdMrfScad
      AssemblySwConnector_1204: ecu-extract-reference=MotTqTranlDampgDMotTqCmdCrfDampdDCmplncErrDMotTqCmdCrf
      AssemblySwConnector_1205: ecu-extract-reference=MotTqTranlDampgDMotTqCmdCrfDampdDHwAgSnsrlsDMotTqCmdCrf
      AssemblySwConnector_1207: ecu-extract-reference=MotTqTranlDampgDMotTqCmdMrfDampdDPwrLimrDMotTqCmdMrf
      AssemblySwConnector_1208: ecu-extract-reference=MotTqTranlDampgDMotTqTranlDampgCmplDStOutpCtrlDMotTqTranlDampgCmpl
      AssemblySwConnector_1209: ecu-extract-reference=MotTqTranlDampgDMotTqCmdCrfDampdDSysFricLrngDMotTqCmdCrf
      AssemblySwConnector_1210: ecu-extract-reference=PolarityCfgDAssiMechPolarityDMotTqTranlDampgDAssiMechPolarity
      AssemblySwConnector_1212: ecu-extract-reference=SwpDMotTqCmdSwpDMotTqTranlDampgDMotTqCmdCrf
      AssemblySwConnector_1213: ecu-extract-reference=SysStModDSysStDMotTqTranlDampgDSysSt
      ComponentPrototype_087: upstream-reference=ECU_Composition.CmnMfgSrv, ecu-extract-reference=COMPOSITIONTYPE.CmnMfgSrv
      AssemblySwConnector_1219: ecu-extract-reference=AssiSumLimDSetManTqCmdDCmnMfgSrvDSetManTqCmd
      AssemblySwConnector_1220: ecu-extract-reference=BattVltgDBrdgVltgDCmnMfgSrvDBrdgVltg
      AssemblySwConnector_1223: ecu-extract-reference=CDD_CurrMeasDCurrMeasEolGainReqDCmnMfgSrvDCurrMeasEolGainReq
      AssemblySwConnector_1224: ecu-extract-reference=CDD_CurrMeasDCurrMeasEolGainStsReqDCmnMfgSrvDCurrMeasEolGainStReq
      AssemblySwConnector_1225: ecu-extract-reference=CDD_CurrMeasDCurrMeasEolOffsReqDCmnMfgSrvDCurrMeasEolOffsReq
      AssemblySwConnector_1226: ecu-extract-reference=CDD_CurrMeasDCurrMeasEolOffsStsReqDCmnMfgSrvDCurrMeasEolOffsStReq
      AssemblySwConnector_1227: ecu-extract-reference=CDD_MotAgCmpDMotAgCmpBackEmfReadDCmnMfgSrvDMotAgCmpBackEmfRead
      AssemblySwConnector_1228: ecu-extract-reference=CDD_MotAgCmpDMotAgCmpBackEmfWrDCmnMfgSrvDMotAgCmpBackEmfWr
      AssemblySwConnector_1229: ecu-extract-reference=CDD_MotAgCmpDMotAgCumvAlgndMrfDCmnMfgSrvDMotAgCumvAlgndMrf
      AssemblySwConnector_1230: ecu-extract-reference=CDD_MotCtrlMgrDMotCurrDaxDCmnMfgSrvDMotCurrDax
      AssemblySwConnector_1231: ecu-extract-reference=CDD_MotCtrlMgrDMotCurrQaxDCmnMfgSrvDMotCurrQax
      AssemblySwConnector_1232: ecu-extract-reference=CDD_MotRplCoggCmdDGetMotCoggCmdPrmDCmnMfgSrvDGetMotCoggCmdPrm
      AssemblySwConnector_1233: ecu-extract-reference=CDD_MotRplCoggCmdDSetMotCoggCmdPrmDCmnMfgSrvDSetMotCoggCmdPrm
      AssemblySwConnector_1234: ecu-extract-reference=CDD_MotVelDMotVelMrfDCmnMfgSrvDMotVelMrf
      AssemblySwConnector_1235: ecu-extract-reference=CDD_NxtrTiDGetRefTmr100MicroSec32bitDCmnMfgSrvDGetRefTmr100MicroSec32bit1
      AssemblySwConnector_1236: ecu-extract-reference=CDD_NxtrTiDGetTiSpan100MicroSec32bitDCmnMfgSrvDGetTiSpan100MicroSec32bit1
      AssemblySwConnector_1237: ecu-extract-reference=CmnMfgSrvDAssiLnrGainDAssiDAssiLnrGain
      AssemblySwConnector_1238: ecu-extract-reference=CmnMfgSrvDAssiLnrGainEnaDAssiDAssiLnrGainEna
      AssemblySwConnector_1239: ecu-extract-reference=CmnMfgSrvDDampgCmdBasDiDDampgDDampgCmdBasDi
      AssemblySwConnector_1240: ecu-extract-reference=CmnMfgSrvDIgnCntrDDiagcMgrDIgnCntr
      AssemblySwConnector_1241: ecu-extract-reference=CmnMfgSrvDMfgDiagcInhbDDiagcMgrDMfgDiagcInhb
      AssemblySwConnector_1242: ecu-extract-reference=CmnMfgSrvDMfgEnaStDDiagcMgrDMfgEnaSt
      AssemblySwConnector_1243: ecu-extract-reference=CmnMfgSrvDDutyCycThermProtnDiDDutyCycThermProtnDDutyCycThermProtnDi
      AssemblySwConnector_1244: ecu-extract-reference=CmnMfgSrvDEotProtnDiDEotProtnDEotProtnDi
      AssemblySwConnector_1245: ecu-extract-reference=CmnMfgSrvDEotProtnDiDEotProtnFwlDEotProtnDi
      AssemblySwConnector_1246: ecu-extract-reference=CmnMfgSrvDMfgEnaStDEotProtnFwlDMfgEnaSt
      AssemblySwConnector_1247: ecu-extract-reference=CmnMfgSrvDStallMotTqLimDiDHiLoadStallLimrDStallMotTqLimDi
      AssemblySwConnector_1248: ecu-extract-reference=CmnMfgSrvDHysCmpCmdDiDHysCmpDHysCmpCmdDi
      AssemblySwConnector_1249: ecu-extract-reference=CmnMfgSrvDInertiaCmpVelCmdDiDInertiaCmpVelDInertiaCmpVelCmdDi
      AssemblySwConnector_1250: ecu-extract-reference=CmnMfgSrvDRtnCmdDiDRtnDRtnCmdDi
      AssemblySwConnector_1251: ecu-extract-reference=CmnMfgSrvDMfgEnaStDRtnPahFwlDMfgEnaSt
      AssemblySwConnector_1252: ecu-extract-reference=CmnMfgSrvDRtnCmdDiDRtnPahFwlDRtnCmdDi
      AssemblySwConnector_1253: ecu-extract-reference=CmnMfgSrvDSysMotTqCmdRampRateDiDStOutpCtrlDSysMotTqCmdRampRateDi
      AssemblySwConnector_1254: ecu-extract-reference=CmnMfgSrvDFricLrngDiDSysFricLrngDFricLrngDi
      AssemblySwConnector_1255: ecu-extract-reference=CmnMfgSrvDSysStImdtTranReqOffDSysStModDSysStImdtTranReqOff
      AssemblySwConnector_1256: ecu-extract-reference=CmnMfgSrvDAssiMechTEstimnDiDTEstimnDAssiMechTEstimnDi
      AssemblySwConnector_1257: ecu-extract-reference=CmnMfgSrvDVehSpdOvrdDVehSigCdngDVehSpdOvrd
      AssemblySwConnector_1258: ecu-extract-reference=CmnMfgSrvDVehSpdOvrdEnaDVehSigCdngDVehSpdOvrdEna
      AssemblySwConnector_1259: ecu-extract-reference=DiagcMgrDClrAllDiagcDCmnMfgSrvDClrAllDiagc
      AssemblySwConnector_1260: ecu-extract-reference=DiagcMgrDClrSnpshtDataDCmnMfgSrvDClrSnpshtData
      AssemblySwConnector_1261: ecu-extract-reference=DiagcMgrDReadNtcFltAryDCmnMfgSrvDReadNtcFltAry
      AssemblySwConnector_1262: ecu-extract-reference=DiagcMgrDReadNtcInfoAndDebCntrDCmnMfgSrvDReadNtcInfoAndDebCntr
      AssemblySwConnector_1264: ecu-extract-reference=EotLrngDGetHwAgOverTrvlCntDCmnMfgSrvDGetHwAgOverTrvlCnt
      AssemblySwConnector_1265: ecu-extract-reference=EotLrngDRstHwAgOverTrvlCntDCmnMfgSrvDRstHwAgOverTrvlCnt
      AssemblySwConnector_1266: ecu-extract-reference=EotLrngDRstMaxHwAgCwAndCcwDCmnMfgSrvDRstMaxHwAgCwAndCcw
      AssemblySwConnector_1267: ecu-extract-reference=EotLrngDRtnMaxHwAgCwAndCcwDCmnMfgSrvDRtnMaxHwAgCwAndCcw
      AssemblySwConnector_1268: ecu-extract-reference=EotLrngDSerlComRstEotDCmnMfgSrvDSerlComRstEot
      AssemblySwConnector_1269: ecu-extract-reference=EotLrngDSetHwAgOverTrvlCntDCmnMfgSrvDSetHwAgOverTrvlCnt
      AssemblySwConnector_1270: ecu-extract-reference=HwAg1MeasDHwAg1DCmnMfgSrvDHwAg1
      AssemblySwConnector_1271: ecu-extract-reference=HwAg1MeasDHwAg1ClrLtchDCmnMfgSrvDHwAg1ClrLtch
      AssemblySwConnector_1272: ecu-extract-reference=HwAg1MeasDHwAg1ClrTrimDCmnMfgSrvDHwAg1MeasHwAg1ClrTrim
      AssemblySwConnector_1273: ecu-extract-reference=HwAg1MeasDHwAg1ReadTrimDCmnMfgSrvDHwAg1MeasHwAg1ReadTrim
      AssemblySwConnector_1274: ecu-extract-reference=HwAg1MeasDHwAg1TrimPrfmdStsDCmnMfgSrvDHwAg1MeasHwAg1TrimPrfmdSts
      AssemblySwConnector_1275: ecu-extract-reference=HwAg1MeasDHwAg1WrTrimDCmnMfgSrvDHwAg1MeasHwAg1WrTrim
      AssemblySwConnector_1276: ecu-extract-reference=HwAgSnsrlsDFSnsrlsHwCentrDCmnMfgSrvDFSnsrlsHwCentr
      AssemblySwConnector_1277: ecu-extract-reference=HwAgSnsrlsDRstSnsrlsHwCentrDCmnMfgSrvDRstSnsrlsHwCentr
      AssemblySwConnector_1278: ecu-extract-reference=HwAgSysArbnDPinionAgDCmnMfgSrvDPinionAg
      AssemblySwConnector_1279: ecu-extract-reference=MotAg2MeasDMotAg2MeclDCmnMfgSrvDMotAg2Mecl
      AssemblySwConnector_1280: ecu-extract-reference=MotCtrlPrmEstimnDGetMotPrmNomEolDCmnMfgSrvDGetMotPrmNomEol
      AssemblySwConnector_1281: ecu-extract-reference=MotCtrlPrmEstimnDSetMotPrmNomEolDCmnMfgSrvDSetMotPrmNomEol
      AssemblySwConnector_1282: ecu-extract-reference=MotRplCoggCfgDGetMotRplCoggPrmDCmnMfgSrvDGetMotRplCoggPrm
      AssemblySwConnector_1283: ecu-extract-reference=MotRplCoggCfgDSetMotRplCoggPrmDCmnMfgSrvDSetMotRplCoggPrm
      AssemblySwConnector_1284: ecu-extract-reference=MotTqCmdScaDGetMotTqCmdScaDCmnMfgSrvDGetMotTqCmdSca
      AssemblySwConnector_1285: ecu-extract-reference=MotTqCmdScaDSetMotTqCmdScaDCmnMfgSrvDSetMotTqCmdSca
      AssemblySwConnector_1286: ecu-extract-reference=PolarityCfgDPolarityCfgReadDCmnMfgSrvDPolarityCfgRead
      AssemblySwConnector_1287: ecu-extract-reference=PolarityCfgDPolarityCfgWrDCmnMfgSrvDPolarityCfgWr
      AssemblySwConnector_1288: ecu-extract-reference=SysFricLrngDClrFricLrngOperModDCmnMfgSrvDClrFricLrngOperMod
      AssemblySwConnector_1289: ecu-extract-reference=SysFricLrngDGetFricDataDCmnMfgSrvDGetFricData
      AssemblySwConnector_1290: ecu-extract-reference=SysFricLrngDGetFricLrngDataDCmnMfgSrvDGetFricLrngData
      AssemblySwConnector_1291: ecu-extract-reference=SysFricLrngDGetFricOffsOutpDiDCmnMfgSrvDGetFricOffsOutpDi
      AssemblySwConnector_1292: ecu-extract-reference=SysFricLrngDInitFricLrngTblDCmnMfgSrvDInitFricLrngTbl
      AssemblySwConnector_1293: ecu-extract-reference=SysFricLrngDSetFricDataDCmnMfgSrvDSetFricData
      AssemblySwConnector_1294: ecu-extract-reference=SysFricLrngDSetFricLrngDataDCmnMfgSrvDSetFricLrngData
      AssemblySwConnector_1295: ecu-extract-reference=SysFricLrngDSetFricOffsOutpDiDCmnMfgSrvDSetFricOffsOutpDi
      AssemblySwConnector_1296: ecu-extract-reference=SysStModDSysStDCmnMfgSrvDSysSt
      AssemblySwConnector_1297: ecu-extract-reference=DiagcMgrProxyAppl10DGetNtcSts10DCmnMfgSrvDGetNtcSts
      AssemblySwConnector_1298: ecu-extract-reference=HwAg1MeasDHwAg1AutTrimDCmnMfgSrvDHwAg1MeasHwAg1AutoTrim
      ComponentPrototype_088: upstream-reference=ECU_Composition.DiagSrv, ecu-extract-reference=COMPOSITIONTYPE.DiagSrv
      AssemblySwConnector_1299: ecu-extract-reference=CmnMfgSrvDCmnMfgSrvCmnMfgSrvMaiFctDDiagSrvDCmnMfgSrvCmnMfgSrvMaiFct
      ComponentPrototype_089: upstream-reference=ECU_Composition.TunSelnMngt, ecu-extract-reference=COMPOSITIONTYPE.TunSelnMngt
      ComponentPrototype_090: upstream-reference=ECU_Composition.NxtrSwIds, ecu-extract-reference=COMPOSITIONTYPE.NxtrSwIds
      AssemblySwConnector_1300: ecu-extract-reference=DiagcMgrProxyAppl10DSetNtcSts10DTunSelnMngtDSetNtcSts
      AssemblySwConnector_1301: ecu-extract-reference=NxtrSwIdsDNxtrSwIdsPsrInfoRdDCmnMfgSrvDNxtrSwIdsPsrInfoRd
      AssemblySwConnector_1302: ecu-extract-reference=NxtrSwIdsDNxtrSwIdsSwBuildDateTiRdDCmnMfgSrvDNxtrSwIdsSwBuildDateTiRd
      AssemblySwConnector_1303: ecu-extract-reference=NxtrSwIdsDNxtrSwIdsSwRelInfoRdDCmnMfgSrvDNxtrSwIdsSwRelInfoRd
      AssemblySwConnector_1304: ecu-extract-reference=NxtrSwIdsDNxtrSwIdsSwRelNrRdDCmnMfgSrvDNxtrSwIdsSwRelNrRd
      AssemblySwConnector_1305: ecu-extract-reference=NxtrSwIdsDNxtrSwIdsSwRelVerRdDCmnMfgSrvDNxtrSwIdsSwRelVerRd
      AssemblySwConnector_1306: ecu-extract-reference=TunSelnAuthyDRtCalChgReqDTunSelnMngtDRtCalChgReq
      ComponentPrototype_091: upstream-reference=ECU_Composition.CDD_XcpIf, ecu-extract-reference=COMPOSITIONTYPE.CDD_XcpIf
      AssemblySwConnector_1307: ecu-extract-reference=CmnMfgSrvDMfgEnaStDCDD_XcpIfDMfgEnaSt
      AssemblySwConnector_1308: ecu-extract-reference=TunSelnAuthyDXcpCalChgReqDCDD_XcpIfDXcpCalChgReq
      AssemblySwConnector_1309: ecu-extract-reference=TunSelnMngtDActvGroupDCDD_XcpIfDActvGroup
      AssemblySwConnector_1310: ecu-extract-reference=TunSelnMngtDActvIninIdxDCDD_XcpIfDActvIninIdx
      AssemblySwConnector_1311: ecu-extract-reference=TunSelnMngtDActvRtIdxDCDD_XcpIfDActvRtIdx
      AssemblySwConnector_1312: ecu-extract-reference=TunSelnMngtDCalCopyStsDCDD_XcpIfDCalCopySts
      AssemblySwConnector_1313: ecu-extract-reference=TunSelnMngtDCopyCalPageReqDCDD_XcpIfDCopyCalPageReq
      AssemblySwConnector_1314: ecu-extract-reference=TunSelnMngtDGetCalPageReqDCDD_XcpIfDGetCalPageReq
      AssemblySwConnector_1315: ecu-extract-reference=TunSelnMngtDGetSegInfoReqDCDD_XcpIfDGetSegInfoReq
      AssemblySwConnector_1316: ecu-extract-reference=TunSelnMngtDOnlineTunRamAdrMpgDCDD_XcpIfDOnlineTunRamAdrMpg
      AssemblySwConnector_1317: ecu-extract-reference=TunSelnMngtDSetCalPageReqDCDD_XcpIfDSetCalPageReq
      AssemblySwConnector_1319: ecu-extract-reference=CDD_FordT3T6McuCfgDMotDrvr1IninTestCmplDPwrUpSeqDMotDrvr1IninTestCmpl
      AssemblySwConnector_969: ecu-extract-reference=IoHwAbDGetGpioMotDrvr0DiagDGateDrv0CtrlDIoHwAb_GetGpioMotDrvr0Diag
      AssemblySwConnector_970: ecu-extract-reference=IoHwAbDSetGpioGateDrv0RstDGateDrv0CtrlDIoHwAb_SetGpioGateDrv0Rst
      ComponentPrototype_092: upstream-reference=ECU_Composition.ImcSigArbn, ecu-extract-reference=COMPOSITIONTYPE.ImcSigArbn
      ComponentPrototype_093: upstream-reference=ECU_Composition.ImcArbn, ecu-extract-reference=COMPOSITIONTYPE.ImcArbn
      ComponentPrototype_094: upstream-reference=ECU_Composition.CDD_Uart1CfgAndUse, ecu-extract-reference=COMPOSITIONTYPE.CDD_Uart1CfgAndUse
      ComponentPrototype_095: upstream-reference=ECU_Composition.CDD_Uart0CfgAndUse, ecu-extract-reference=COMPOSITIONTYPE.CDD_Uart0CfgAndUse
      AssemblySwConnector_1340: ecu-extract-reference=CalRegn01Inin00GroupADImcSigArbnPullCmpLongTermArbnOffsLimDImcSigArbnDImcSigArbnPullCmpLongTermArbnOffsLim
      AssemblySwConnector_1343: ecu-extract-reference=CalRegn01Inin00GroupADImcSigArbnPullCmpShoTermArbnOffsLimDImcSigArbnDImcSigArbnPullCmpShoTermArbnOffsLim
      AssemblySwConnector_1354: ecu-extract-reference=CDD_MotVelDMotVelCrfDImcSigArbnDMotVelCrf
      AssemblySwConnector_1355: ecu-extract-reference=CDD_NxtrTiDGetRefTmr100MicroSec32bitDImcArbnDGetRefTmr100MicroSec32bit
      AssemblySwConnector_1356: ecu-extract-reference=CDD_NxtrTiDGetTiSpan100MicroSec32bitDImcArbnDGetTiSpan100MicroSec32bit
      AssemblySwConnector_1357: ecu-extract-reference=CDD_NxtrTiDGetRefTmr100MicroSec32bitDImcSigArbnDGetRefTmr100MicroSec32bit
      AssemblySwConnector_1358: ecu-extract-reference=CDD_NxtrTiDGetTiSpan100MicroSec32bitDImcSigArbnDGetTiSpan100MicroSec32bit
      AssemblySwConnector_1359: ecu-extract-reference=DiagcMgrProxyAppl10DSetNtcSts10DImcArbnDSetNtcSts
      AssemblySwConnector_1360: ecu-extract-reference=DiagcMgrProxyAppl10DSetNtcSts10DImcSigArbnDSetNtcSts
      AssemblySwConnector_1361: ecu-extract-reference=DualEcuIdnDEcuIdDImcSigArbnDEcuIdn
      AssemblySwConnector_1363: ecu-extract-reference=ImcArbnDGetTxRateGroupDCDD_Uart0CfgAndUseDGetTxRateGroup
      AssemblySwConnector_1364: ecu-extract-reference=ImcArbnDSetRxSigGroupDCDD_Uart0CfgAndUseDSetRxSigGroup
      AssemblySwConnector_1365: ecu-extract-reference=ImcArbnDGetTxRateGroupDCDD_Uart1CfgAndUseDGetTxRateGroup
      AssemblySwConnector_1366: ecu-extract-reference=ImcArbnDSetRxSigGroupDCDD_Uart1CfgAndUseDSetRxSigGroup
      AssemblySwConnector_1367: ecu-extract-reference=ImcArbnDGetSigImcData_u08DDualEcuIdnDGetSigImcData_u08
      AssemblySwConnector_1368: ecu-extract-reference=ImcArbnDGetSigImcData_f32DImcSigArbnDGetImcSigData_f32
      AssemblySwConnector_1369: ecu-extract-reference=ImcArbnDGetSigImcData_loglDImcSigArbnDGetImcSigData_logl
      AssemblySwConnector_1370: ecu-extract-reference=ImcArbnDGetSigImcData_u08DImcSigArbnDGetImcSigData_u08
      AssemblySwConnector_1373: ecu-extract-reference=PosnTrakgServoDPosnServoIntgtrStDImcSigArbnDPosnServoIntgtrSt
      AssemblySwConnector_1374: ecu-extract-reference=VehSigCdngDVehSpdDImcSigArbnDVehSpd
      AssemblySwConnector_1376: ecu-extract-reference=DualEcuIdnDEcuIdDImcArbnDEcuIdn
      AssemblySwConnector_1377: ecu-extract-reference=SysStModDSysStDImcArbnDSysSt
      AssemblySwConnector_1378: ecu-extract-reference=VehSigCdngDVehSpdDImcArbnDVehSpd
      ComponentPrototype_096: upstream-reference=ECU_Composition.CDD_SinVltgGenn, ecu-extract-reference=COMPOSITIONTYPE.CDD_SinVltgGenn
      AssemblySwConnector_1381: ecu-extract-reference=PolarityCfgDMotElecMeclPolarityDCDD_SinVltgGennDMotElecMeclPolarity
      AssemblySwConnector_1382: ecu-extract-reference=CDD_MotCtrlMgrDPhaOnTiSumADGateDrv0CtrlDPhaOnTiSumA
      AssemblySwConnector_1383: ecu-extract-reference=CDD_MotCtrlMgrDPhaOnTiSumBDGateDrv0CtrlDPhaOnTiSumB
      AssemblySwConnector_1384: ecu-extract-reference=CDD_MotCtrlMgrDPhaOnTiSumCDGateDrv0CtrlDPhaOnTiSumC
      AssemblySwConnector_1385: ecu-extract-reference=VehSigCdngDVehSpdDCDD_MotCtrlMgrDVehSpd
      ComponentPrototype_097: upstream-reference=ECU_Composition.LoaMgr, ecu-extract-reference=COMPOSITIONTYPE.LoaMgr
      ComponentPrototype_098: upstream-reference=ECU_Composition.HwAgCorrln, ecu-extract-reference=COMPOSITIONTYPE.HwAgCorrln
      ComponentPrototype_099: upstream-reference=ECU_Composition.HwAgArbn, ecu-extract-reference=COMPOSITIONTYPE.HwAgArbn
      ComponentPrototype_100: upstream-reference=ECU_Composition.ElecPwrCns, ecu-extract-reference=COMPOSITIONTYPE.ElecPwrCns
      ComponentPrototype_101: upstream-reference=ECU_Composition.DualCtrlrOutpMgr, ecu-extract-reference=COMPOSITIONTYPE.DualCtrlrOutpMgr
      AssemblySwConnector_1386: ecu-extract-reference=BattVltgDBrdgVltgDElecPwrCnsDBrdgVltg
      AssemblySwConnector_1388: ecu-extract-reference=CalRegn01CmnGroupADElecPwrCnsPrstcPwrLossDElecPwrCnsDElecPwrCnsPrstcPwrLoss
      AssemblySwConnector_1439: ecu-extract-reference=CDD_MotCtrlMgrDMotCurrDaxDElecPwrCnsDMotCtrlMotCurrDax
      AssemblySwConnector_1440: ecu-extract-reference=CDD_MotCtrlMgrDMotCurrQaxDElecPwrCnsDMotCtrlMotCurrQax
      AssemblySwConnector_1441: ecu-extract-reference=CDD_NxtrTiDGetRefTmr100MicroSec32bitDDualCtrlrOutpMgrDGetRefTmr100MicroSec32bit
      AssemblySwConnector_1442: ecu-extract-reference=CDD_NxtrTiDGetTiSpan100MicroSec32bitDDualCtrlrOutpMgrDGetTiSpan100MicroSec32bit
      AssemblySwConnector_1443: ecu-extract-reference=CmnMfgSrvDLoaScaDiDLoaMgrDLoaScaDi
      AssemblySwConnector_1444: ecu-extract-reference=CurrMeasCorrlnDCurrMeasIdptSigDLoaMgrDCurrMeasIdptSig
      AssemblySwConnector_1445: ecu-extract-reference=DiagcMgrProxyAppl10DSetNtcSts10DLoaMgrDSetNtcSts
      AssemblySwConnector_1454: ecu-extract-reference=FltInjDFltInj_u08DHwAgCorrlnDFltInj_u08
      AssemblySwConnector_1455: ecu-extract-reference=GateDrv0CtrlDDiagcStsIvtr1InactvDLoaMgrDDiagcStsIvtr1Inactv
      AssemblySwConnector_1456: ecu-extract-reference=HwAg1MeasDHwAg1DHwAgArbnDHwAgA
      AssemblySwConnector_1457: ecu-extract-reference=HwAg1MeasDHwAg1QlfrDHwAgArbnDHwAgAQlfr
      AssemblySwConnector_1458: ecu-extract-reference=HwAg1MeasDHwAg1RollgCntrDHwAgArbnDHwAgARollgCntr
      AssemblySwConnector_1459: ecu-extract-reference=HwAg1MeasDHwAg1QlfrDHwAgCorrlnDHwAgAQlfr
      AssemblySwConnector_1460: ecu-extract-reference=HwAg1MeasDHwAg1RollgCntrDHwAgCorrlnDHwAgARollgCntr
      AssemblySwConnector_1462: ecu-extract-reference=HwAgCorrlnDHwAgCorrlnStDHwAgArbnDHwAgCorrlnSt
      AssemblySwConnector_1463: ecu-extract-reference=HwAgCorrlnDHwAgIdptSigDHwAgSysArbnDHwAgIdptSig
      AssemblySwConnector_1476: ecu-extract-reference=HwTqCorrlnDHwTqIdptSigDLoaMgrDHwTqIdptSig
      AssemblySwConnector_1477: ecu-extract-reference=ImcArbnDGetSigImcData_loglDDualCtrlrOutpMgrDGetSigImcData_logl
      AssemblySwConnector_1478: ecu-extract-reference=ImcSigArbnDImcSysStDDualCtrlrOutpMgrDImcSysSt
      AssemblySwConnector_1479: ecu-extract-reference=LoaMgrDHwTqLoaMtgtnEnaDAssiSumLimDHwTqLoaMtgtnEna
      AssemblySwConnector_1491: ecu-extract-reference=LoaMgrDLoaStDMotTqTranlDampgDLoaSt
      AssemblySwConnector_1493: ecu-extract-reference=LoaMgrDLoaRateLimDStOutpCtrlDLoaRateLim
      AssemblySwConnector_1494: ecu-extract-reference=LoaMgrDLoaScaDStOutpCtrlDLoaSca
      AssemblySwConnector_1495: ecu-extract-reference=LoaMgrDLoaStDSysPrfmncStsDLoaSt
      AssemblySwConnector_1496: ecu-extract-reference=LoaMgrDMotAgLoaMtgtnEnaDTqLoaDMotAgLoaMtgtnEna
      AssemblySwConnector_1497: ecu-extract-reference=MotAgCorrlnDMotAgMeclIdptSigDLoaMgrDMotAgMeclIdptSig
      AssemblySwConnector_1498: ecu-extract-reference=MotRefMdlDMotCurrDaxCmdDElecPwrCnsDMotCurrDaxCmd
      AssemblySwConnector_1499: ecu-extract-reference=MotRefMdlDMotCurrQaxCmdDElecPwrCnsDMotCurrQaxCmd
      AssemblySwConnector_1500: ecu-extract-reference=SysStModDSysStDDualCtrlrOutpMgrDSysSt
      AssemblySwConnector_1501: ecu-extract-reference=TqLoaDTqLoaAvlDLoaMgrDTqLoaAvl
      ComponentPrototype_102: upstream-reference=ECU_Composition.EcuTMeas, ecu-extract-reference=COMPOSITIONTYPE.EcuTMeas
      ComponentPrototype_103: upstream-reference=ECU_Composition.CDD_MotAgSwCal, ecu-extract-reference=COMPOSITIONTYPE.CDD_MotAgSwCal
      ComponentPrototype_104: upstream-reference=ECU_Composition.CDD_HwTq1Meas, ecu-extract-reference=COMPOSITIONTYPE.CDD_HwTq1Meas
      AssemblySwConnector_1506: ecu-extract-reference=CDD_FordT3T6McuCfgDEcuTDEcuTMeasDEcuT
      AssemblySwConnector_1507: ecu-extract-reference=CDD_FordT3T6McuCfgDEcuTAdcFaildDEcuTMeasDEcuTAdcFaild
      AssemblySwConnector_1520: ecu-extract-reference=CDD_NxtrTiDGetRefTmr1MicroSec32bitDCDD_HwTq1MeasDGetRefTmr1MicroSec32bit
      AssemblySwConnector_1521: ecu-extract-reference=CDD_NxtrTiDGetTiSpan1MicroSec32bitDCDD_HwTq1MeasDGetTiSpan1MicroSec32bit
      AssemblySwConnector_1522: ecu-extract-reference=DiagcMgrDCnvSnpshtData_f32DEcuTMeasDCnvSnpshtData_f32
      AssemblySwConnector_1523: ecu-extract-reference=DiagcMgrDCnvSnpshtData_loglDEcuTMeasDCnvSnpshtData_logl
      AssemblySwConnector_1524: ecu-extract-reference=DiagcMgrProxyAppl10DGetNtcQlfrSts10DCDD_HwTq1MeasDGetNtcQlfrSts
      AssemblySwConnector_1525: ecu-extract-reference=DiagcMgrProxyAppl10DSetNtcSts10DCDD_HwTq1MeasDSetNtcSts
      AssemblySwConnector_1526: ecu-extract-reference=DiagcMgrProxyAppl10DGetNtcActv10DEcuTMeasDGetNtcActv
      AssemblySwConnector_1527: ecu-extract-reference=DiagcMgrProxyAppl10DSetNtcStsAndSnpshtData10DEcuTMeasDSetNtcStsAndSnpshtData
      AssemblySwConnector_1528: ecu-extract-reference=DiagcMgrProxyAppl10DSetNtcStsAndSnpshtData10DGateDrv0CtrlDSetNtcStsAndSnpshtData
      AssemblySwConnector_1529: ecu-extract-reference=EcuTMeasDEcuTFildDCmnMfgSrvDEcuTFild
      AssemblySwConnector_1530: ecu-extract-reference=EcuTMeasDEcuTFildDDiagcMgrDEcuTFild
      AssemblySwConnector_1531: ecu-extract-reference=EcuTMeasDDiagcStsLimdTPrfmncDDutyCycThermProtnDDiagcStsLimdTPrfmnc
      AssemblySwConnector_1532: ecu-extract-reference=EcuTMeasDEcuTFildDDutyCycThermProtnDEcuTFild
      AssemblySwConnector_1533: ecu-extract-reference=EcuTMeasDEcuTFildDSysPrfmncStsDEcuTFild
      AssemblySwConnector_1534: ecu-extract-reference=EcuTMeasDEcuTFildDTEstimnDEcuTFild
      AssemblySwConnector_1537: ecu-extract-reference=CDD_FordT3T6McuCfgDMotAg2CosDCDD_MotCtrlMgrDMotAg2Cos
      AssemblySwConnector_1538: ecu-extract-reference=CDD_FordT3T6McuCfgDMotAg2CosAdcFaildDCDD_MotCtrlMgrDMotAg2CosAdcFaild
      AssemblySwConnector_1539: ecu-extract-reference=CDD_FordT3T6McuCfgDMotAg2SinDCDD_MotCtrlMgrDMotAg2Sin
      AssemblySwConnector_1540: ecu-extract-reference=CDD_FordT3T6McuCfgDMotAg2SinAdcFaildDCDD_MotCtrlMgrDMotAg2SinAdcFaild
      AssemblySwConnector_1541: ecu-extract-reference=CDD_FordT3T6McuCfgDMotAg5CosAdcFaildDCDD_MotCtrlMgrDMotAg5CosAdcFaild
      AssemblySwConnector_1542: ecu-extract-reference=CDD_FordT3T6McuCfgDMotAg5SinAdcFaildDCDD_MotCtrlMgrDMotAg5SinAdcFaild
      AssemblySwConnector_1543: ecu-extract-reference=CDD_FordT3T6McuCfgDMotAg6CosAdcFaildDCDD_MotCtrlMgrDMotAg6CosAdcFaild
      AssemblySwConnector_1544: ecu-extract-reference=CDD_FordT3T6McuCfgDMotAg6SinAdcFaildDCDD_MotCtrlMgrDMotAg6SinAdcFaild
      AssemblySwConnector_1552: ecu-extract-reference=EcuTMeasDEcuTFildDCDD_MotCtrlMgrDEcuTFild
      AssemblySwConnector_1553: ecu-extract-reference=GateDrv0CtrlDIvtrFetFltPhaDCDD_MotCtrlMgrDIvtrFetFltPha
      AssemblySwConnector_1554: ecu-extract-reference=GateDrv0CtrlDIvtrFetFltTypDCDD_MotCtrlMgrDIvtrFetFltTyp
      AssemblySwConnector_1508: ecu-extract-reference=CDD_CurrMeasDCurrMeasGainReadReqSngIvtrDCmnMfgSrvDCurrMeasGainReadReqSngIvtr
      AssemblySwConnector_1509: ecu-extract-reference=CDD_CurrMeasDCurrMeasGainWrReqSngIvtrDCmnMfgSrvDCurrMeasGainWrReqSngIvtr
      AssemblySwConnector_1510: ecu-extract-reference=CDD_CurrMeasDCurrMeasOffsReadReqSngIvtrDCmnMfgSrvDCurrMeasOffsReadReqSngIvtr
      AssemblySwConnector_1511: ecu-extract-reference=CDD_CurrMeasDCurrMeasOffsWrReqSngIvtrDCmnMfgSrvDCurrMeasOffsWrReqSngIvtr
      AssemblySwConnector_1560: ecu-extract-reference=CDD_MotAg5MeasDMotAg5EolPrmReadDCmnMfgSrvDMotAg5EolPrmRead
      AssemblySwConnector_1561: ecu-extract-reference=CDD_MotAg5MeasDMotAg5EolPrmWrDCmnMfgSrvDMotAg5EolPrmWr
      AssemblySwConnector_1562: ecu-extract-reference=CDD_MotAg6MeasDMotAg6EolPrmReadDCmnMfgSrvDMotAg6EolPrmRead
      AssemblySwConnector_1563: ecu-extract-reference=CDD_MotAg6MeasDMotAg6EolPrmWrDCmnMfgSrvDMotAg6EolPrmWr
      AssemblySwConnector_1564: ecu-extract-reference=CDD_MotAgSwCalDSwCalGetPrmDCmnMfgSrvDSwCalGetPrm
      AssemblySwConnector_1565: ecu-extract-reference=CDD_MotAgSwCalDSwCalSetPrmDCmnMfgSrvDSwCalSetPrm
      AssemblySwConnector_1566: ecu-extract-reference=CDD_MotAgSwCalDSwCalStopDCmnMfgSrvDSwCalStop
      AssemblySwConnector_1567: ecu-extract-reference=CDD_MotAgSwCalDSwCalStrtDCmnMfgSrvDSwCalStrt
      AssemblySwConnector_1568: ecu-extract-reference=CmnMfgSrvDSwCalStsCallBackDCDD_MotAgSwCalDSwCalStsCallBack
      ComponentPrototype_105: upstream-reference=ECU_Composition.MotVelCtrl, ecu-extract-reference=COMPOSITIONTYPE.MotVelCtrl
      AssemblySwConnector_1512: ecu-extract-reference=AssiSumLimDSetManTqCmdDMotVelCtrlDSetManTqCmd
      AssemblySwConnector_1557: ecu-extract-reference=CDD_NxtrTiDGetRefTmr100MicroSec32bitDMotVelCtrlDGetRefTmr100MicroSec32bit
      AssemblySwConnector_1558: ecu-extract-reference=CDD_NxtrTiDGetTiSpan100MicroSec32bitDMotVelCtrlDGetTiSpan100MicroSec32bit
      AssemblySwConnector_1559: ecu-extract-reference=MotAg2MeasDMotAg2MeasEolPrmReadDCmnMfgSrvDMotAgMeasEolPrmRead
      AssemblySwConnector_1569: ecu-extract-reference=MotAg2MeasDMotAg2MeasEolPrmWrDCmnMfgSrvDMotAgMeasEolPrmWr
      AssemblySwConnector_1570: ecu-extract-reference=MotVelCtrlDGetCtrlPrmDCmnMfgSrvDGetCtrlPrm
      AssemblySwConnector_1571: ecu-extract-reference=MotVelCtrlDSetCtrlPrmDCmnMfgSrvDSetCtrlPrm
      AssemblySwConnector_1572: ecu-extract-reference=MotVelCtrlDStopCtrlDCmnMfgSrvDStopCtrl
      AssemblySwConnector_1573: ecu-extract-reference=MotVelCtrlDStrtCtrlDCmnMfgSrvDStrtCtrl
      PPortPrototype: upstream-reference=Ford_DrvSte_Tq_Actl, ecu-extract-reference=Ford_DrvSte_Tq_Actl
      PPortPrototype_001: upstream-reference=Ford_DrvSteActv_B_Stat, ecu-extract-reference=Ford_DrvSteActv_B_Stat
      PPortPrototype_002: upstream-reference=Ford_EPAS_Failure, ecu-extract-reference=Ford_EPAS_Failure
      PPortPrototype_004: upstream-reference=Ford_LaActAvail_D_Actl, ecu-extract-reference=Ford_LaActAvail_D_Actl
      PPortPrototype_005: upstream-reference=Ford_LaActDeny_B_Actl, ecu-extract-reference=Ford_LaActDeny_B_Actl
      PPortPrototype_006: upstream-reference=Ford_LaHandsOff_B_Actl, ecu-extract-reference=Ford_LaHandsOff_B_Actl
      PPortPrototype_007: upstream-reference=Ford_LatCtlLim_D_Stat, ecu-extract-reference=Ford_LatCtlLim_D_Stat
      PPortPrototype_008: upstream-reference=Ford_LatCtlSte_D_Stat, ecu-extract-reference=Ford_LatCtlSte_D_Stat
      PPortPrototype_010: upstream-reference=Ford_LsmcBrkDecelEnbl_D_Rq, ecu-extract-reference=Ford_LsmcBrkDecelEnbl_D_Rq
      PPortPrototype_011: upstream-reference=Ford_SAPPAngleControlStat1, ecu-extract-reference=Ford_SAPPAngleControlStat1
      PPortPrototype_012: upstream-reference=Ford_SAPPAngleControlStat2, ecu-extract-reference=Ford_SAPPAngleControlStat2
      PPortPrototype_013: upstream-reference=Ford_SAPPAngleControlStat3, ecu-extract-reference=Ford_SAPPAngleControlStat3
      PPortPrototype_014: upstream-reference=Ford_SAPPAngleControlStat4, ecu-extract-reference=Ford_SAPPAngleControlStat4
      PPortPrototype_015: upstream-reference=Ford_SAPPAngleControlStat5, ecu-extract-reference=Ford_SAPPAngleControlStat5
      PPortPrototype_016: upstream-reference=Ford_SAPPAngleControlStat6, ecu-extract-reference=Ford_SAPPAngleControlStat6
      PPortPrototype_017: upstream-reference=Ford_SelDrvMdeSte_D_Stat, ecu-extract-reference=Ford_SelDrvMdeSte_D_Stat
      PPortPrototype_019: upstream-reference=Ford_SteeringColumnTorque, ecu-extract-reference=Ford_SteeringColumnTorque
      PPortPrototype_020: upstream-reference=Ford_SteMdule_D_Stat, ecu-extract-reference=Ford_SteMdule_D_Stat
      PPortPrototype_021: upstream-reference=Ford_SteMdule_I_Est, ecu-extract-reference=Ford_SteMdule_I_Est
      PPortPrototype_022: upstream-reference=Ford_SteMdule_U_Meas, ecu-extract-reference=Ford_SteMdule_U_Meas
      PPortPrototype_023: upstream-reference=Ford_StePinAn_No_Cnt, ecu-extract-reference=Ford_StePinAn_No_Cnt
      PPortPrototype_024: upstream-reference=Ford_StePinAn_No_Cs, ecu-extract-reference=Ford_StePinAn_No_Cs
      PPortPrototype_025: upstream-reference=Ford_StePinComp_An_Est, ecu-extract-reference=Ford_StePinComp_An_Est
      PPortPrototype_026: upstream-reference=Ford_StePinCompAnEst_D_Qf, ecu-extract-reference=Ford_StePinCompAnEst_D_Qf
      PPortPrototype_027: upstream-reference=Ford_StePinRelInit_An_Sns, ecu-extract-reference=Ford_StePinRelInit_An_Sns
      PPortPrototype_028: upstream-reference=Ford_StePw_B_Rq, ecu-extract-reference=Ford_StePw_B_Rq
      PPortPrototype_029: upstream-reference=Ford_TjaHandsOnCnfdnc_B_Est, ecu-extract-reference=Ford_TjaHandsOnCnfdnc_B_Est
      PPortPrototype_032: upstream-reference=Ford_TrlrHitchLamp_D_Rqst, ecu-extract-reference=Ford_TrlrHitchLamp_D_Rqst
      PPortPrototype_033: upstream-reference=Ford_Veh_V_RqMxTrlrAid, ecu-extract-reference=Ford_Veh_V_RqMxTrlrAid
      PPortPrototype_034: upstream-reference=Ford_VehVTrlrAid_B_Rq, ecu-extract-reference=Ford_VehVTrlrAid_B_Rq
      RPortPrototype: upstream-reference=Ford_AbsActv_B_Actl, ecu-extract-reference=Ford_AbsActv_B_Actl
      RPortPrototype_001: upstream-reference=Ford_ApedPos_Pc_ActlArb, ecu-extract-reference=Ford_ApedPos_Pc_ActlArb
      RPortPrototype_002: upstream-reference=Ford_ApedPosPcActl_D_Qf, ecu-extract-reference=Ford_ApedPosPcActl_D_Qf
      RPortPrototype_005: upstream-reference=Ford_BattULo_U_Actl, ecu-extract-reference=Ford_BattULo_U_Actl
      RPortPrototype_006: upstream-reference=Ford_BpedDrvAppl_D_Actl, ecu-extract-reference=Ford_BpedDrvAppl_D_Actl
      RPortPrototype_007: upstream-reference=Ford_BPedDrvAppl_D_QF, ecu-extract-reference=Ford_BPedDrvAppl_D_QF
      RPortPrototype_008: upstream-reference=Ford_BrkTot_Tq_Actl, ecu-extract-reference=Ford_BrkTot_Tq_Actl
      RPortPrototype_010: upstream-reference=Ford_CmbbBrkDis_B_Actl, ecu-extract-reference=Ford_CmbbBrkDis_B_Actl
      RPortPrototype_011: upstream-reference=Ford_CmbbDeny_B_ActlBrk, ecu-extract-reference=Ford_CmbbDeny_B_ActlBrk
      RPortPrototype_012: upstream-reference=Ford_CmbbObjClass_D_Stat, ecu-extract-reference=Ford_CmbbObjClass_D_Stat
      RPortPrototype_013: upstream-reference=Ford_CmbbObjColl_T_Actl, ecu-extract-reference=Ford_CmbbObjColl_T_Actl
      RPortPrototype_014: upstream-reference=Ford_CmbbObjConfdnc_D_Stat, ecu-extract-reference=Ford_CmbbObjConfdnc_D_Stat
      RPortPrototype_015: upstream-reference=Ford_CmbbObjDistLat_L_Actl, ecu-extract-reference=Ford_CmbbObjDistLat_L_Actl
      RPortPrototype_016: upstream-reference=Ford_CmbbObjDistLong_L_Actl, ecu-extract-reference=Ford_CmbbObjDistLong_L_Actl
      RPortPrototype_017: upstream-reference=Ford_CmbbObjRelLat_V_Actl, ecu-extract-reference=Ford_CmbbObjRelLat_V_Actl
      RPortPrototype_018: upstream-reference=Ford_CmbbObjRelLong_V_Actl, ecu-extract-reference=Ford_CmbbObjRelLong_V_Actl
      RPortPrototype_019: upstream-reference=Ford_DeliveryIdle, ecu-extract-reference=Ford_DeliveryIdle
      RPortPrototype_020: upstream-reference=Ford_DeliveryNumber, ecu-extract-reference=Ford_DeliveryNumber
      RPortPrototype_021: upstream-reference=Ford_DeliverySipNumber, ecu-extract-reference=Ford_DeliverySipNumber
      RPortPrototype_022: upstream-reference=Ford_DeliverySubProjectNumber, ecu-extract-reference=Ford_DeliverySubProjectNumber
      RPortPrototype_024: upstream-reference=Ford_DrvSte_D_Stat, ecu-extract-reference=Ford_DrvSte_D_Stat
      RPortPrototype_025: upstream-reference=Ford_DrvSte_Tq_Rq, ecu-extract-reference=Ford_DrvSte_Tq_Rq
      RPortPrototype_026: upstream-reference=Ford_ElPw_D_Stat, ecu-extract-reference=Ford_ElPw_D_Stat
      RPortPrototype_027: upstream-reference=Ford_ElPw_D_StatStrtStop, ecu-extract-reference=Ford_ElPw_D_StatStrtStop
      RPortPrototype_028: upstream-reference=Ford_EngAout_N_Actl, ecu-extract-reference=Ford_EngAout_N_Actl
      RPortPrototype_029: upstream-reference=Ford_EPASExtAngleStatReq, ecu-extract-reference=Ford_EPASExtAngleStatReq
      RPortPrototype_030: upstream-reference=Ford_EsaEnbl_D2_Rq, ecu-extract-reference=Ford_EsaEnbl_D2_Rq
      RPortPrototype_031: upstream-reference=Ford_EsaOn_B_Rq, ecu-extract-reference=Ford_EsaOn_B_Rq
      RPortPrototype_032: upstream-reference=Ford_ExtSteeringAngleReq2, ecu-extract-reference=Ford_ExtSteeringAngleReq2
      RPortPrototype_035: upstream-reference=Ford_FileVersionNumber, ecu-extract-reference=Ford_FileVersionNumber
      RPortPrototype_037: upstream-reference=Ford_GearLvrPos_D_Actl, ecu-extract-reference=Ford_GearLvrPos_D_Actl
      RPortPrototype_038: upstream-reference=Ford_GearRvrse_D_Actl, ecu-extract-reference=Ford_GearRvrse_D_Actl
      RPortPrototype_039: upstream-reference=Ford_HandsOffCnfm_B_Rq, ecu-extract-reference=Ford_HandsOffCnfm_B_Rq
      RPortPrototype_040: upstream-reference=Ford_Ignition_Status, ecu-extract-reference=Ford_Ignition_Status
      RPortPrototype_041: upstream-reference=Ford_LaCurvature_No_Calc, ecu-extract-reference=Ford_LaCurvature_No_Calc
      RPortPrototype_042: upstream-reference=Ford_LaRampType_B_Req, ecu-extract-reference=Ford_LaRampType_B_Req
      RPortPrototype_043: upstream-reference=Ford_LaRefAng_No_Req, ecu-extract-reference=Ford_LaRefAng_No_Req
      RPortPrototype_044: upstream-reference=Ford_LatCtl_D_Rq, ecu-extract-reference=Ford_LatCtl_D_Rq
      RPortPrototype_045: upstream-reference=Ford_LatCtlCurv_No_Actl, ecu-extract-reference=Ford_LatCtlCurv_No_Actl
      RPortPrototype_046: upstream-reference=Ford_LatCtlCurv_NoRate_Actl, ecu-extract-reference=Ford_LatCtlCurv_NoRate_Actl
      RPortPrototype_047: upstream-reference=Ford_LatCtlPath_An_Actl, ecu-extract-reference=Ford_LatCtlPath_An_Actl
      RPortPrototype_048: upstream-reference=Ford_LatCtlPathOffst_L_Actl, ecu-extract-reference=Ford_LatCtlPathOffst_L_Actl
      RPortPrototype_049: upstream-reference=Ford_LatCtlPrecision_D_Rq, ecu-extract-reference=Ford_LatCtlPrecision_D_Rq
      RPortPrototype_050: upstream-reference=Ford_LatCtlRampType_D_Rq, ecu-extract-reference=Ford_LatCtlRampType_D_Rq
      RPortPrototype_051: upstream-reference=Ford_LdwActvIntns_D_Req, ecu-extract-reference=Ford_LdwActvIntns_D_Req
      RPortPrototype_052: upstream-reference=Ford_LdwActvStats_D_Req, ecu-extract-reference=Ford_LdwActvStats_D_Req
      RPortPrototype_053: upstream-reference=Ford_LkaActvStats_D2_Req, ecu-extract-reference=Ford_LkaActvStats_D2_Req
      RPortPrototype_054: upstream-reference=Ford_LsmcBrkDecel_D_Stat, ecu-extract-reference=Ford_LsmcBrkDecel_D_Stat
      RPortPrototype_055: upstream-reference=Ford_OdometerMasterValue, ecu-extract-reference=Ford_OdometerMasterValue
      RPortPrototype_056: upstream-reference=Ford_Outside_Air_Temp_Stat, ecu-extract-reference=Ford_Outside_Air_Temp_Stat
      RPortPrototype_058: upstream-reference=Ford_PrplWhlTot2_Tq_Actl, ecu-extract-reference=Ford_PrplWhlTot2_Tq_Actl
      RPortPrototype_059: upstream-reference=Ford_PwPckTq_D_Stat, ecu-extract-reference=Ford_PwPckTq_D_Stat
      RPortPrototype_063: upstream-reference=Ford_StabCtlBrkActv_B_Actl, ecu-extract-reference=Ford_StabCtlBrkActv_B_Actl
      RPortPrototype_065: upstream-reference=Ford_StePinOffst_An_Est, ecu-extract-reference=Ford_StePinOffst_An_Est
      RPortPrototype_066: upstream-reference=Ford_StePinOffst_D_Stat, ecu-extract-reference=Ford_StePinOffst_D_Stat
      RPortPrototype_067: upstream-reference=Ford_SteWhlRelCalib_An_Sns, ecu-extract-reference=Ford_SteWhlRelCalib_An_Sns
      RPortPrototype_076: upstream-reference=Ford_TrlrAidCancl_B_Rq, ecu-extract-reference=Ford_TrlrAidCancl_B_Rq
      RPortPrototype_077: upstream-reference=Ford_TrlrAidCtl_U_RqDrv, ecu-extract-reference=Ford_TrlrAidCtl_U_RqDrv
      RPortPrototype_080: upstream-reference=Ford_TrlrAidSwtch_D_RqDrv, ecu-extract-reference=Ford_TrlrAidSwtch_D_RqDrv
      RPortPrototype_085: upstream-reference=Ford_TrlrAnOffstDir_D_Mem, ecu-extract-reference=Ford_TrlrAnOffstDir_D_Mem
      RPortPrototype_086: upstream-reference=Ford_TrlrAxleToBmpr_L_Actl, ecu-extract-reference=Ford_TrlrAxleToBmpr_L_Actl
      RPortPrototype_088: upstream-reference=Ford_TrlrBrkActCnnct_B_Actl, ecu-extract-reference=Ford_TrlrBrkActCnnct_B_Actl
      RPortPrototype_089: upstream-reference=Ford_TrlrId_No_Actl, ecu-extract-reference=Ford_TrlrId_No_Actl
      RPortPrototype_090: upstream-reference=Ford_TrlrLampCnnct_B_Actl, ecu-extract-reference=Ford_TrlrLampCnnct_B_Actl
      RPortPrototype_091: upstream-reference=Ford_TrlrTrgtAcquire_D_Stat, ecu-extract-reference=Ford_TrlrTrgtAcquire_D_Stat
      RPortPrototype_095: upstream-reference=Ford_TrnRng_D_Rq, ecu-extract-reference=Ford_TrnRng_D_Rq
      RPortPrototype_096: upstream-reference=Ford_TurnLghtSwtch_D_Stat, ecu-extract-reference=Ford_TurnLghtSwtch_D_Stat
      RPortPrototype_098: upstream-reference=Ford_Veh_V_ActlBrk, ecu-extract-reference=Ford_Veh_V_ActlBrk
      RPortPrototype_099: upstream-reference=Ford_Veh_V_ActlEng, ecu-extract-reference=Ford_Veh_V_ActlEng
      RPortPrototype_101: upstream-reference=Ford_VehicleGGCCData, ecu-extract-reference=Ford_VehicleGGCCData
      RPortPrototype_104: upstream-reference=Ford_VehLatComp_A_Actl, ecu-extract-reference=Ford_VehLatComp_A_Actl
      RPortPrototype_107: upstream-reference=Ford_VehLongComp_A_Actl, ecu-extract-reference=Ford_VehLongComp_A_Actl
      RPortPrototype_108: upstream-reference=Ford_VehOverGnd_V_Est, ecu-extract-reference=Ford_VehOverGnd_V_Est
      RPortPrototype_111: upstream-reference=Ford_VehVActlBrk_D_Qf, ecu-extract-reference=Ford_VehVActlBrk_D_Qf
      RPortPrototype_112: upstream-reference=Ford_VehVActlBrk_No_Cnt, ecu-extract-reference=Ford_VehVActlBrk_No_Cnt
      RPortPrototype_113: upstream-reference=Ford_VehVActlBrk_No_Cs, ecu-extract-reference=Ford_VehVActlBrk_No_Cs
      RPortPrototype_114: upstream-reference=Ford_VehVActlEng_D_Qf, ecu-extract-reference=Ford_VehVActlEng_D_Qf
      RPortPrototype_115: upstream-reference=Ford_VehVActlEng_No_Cnt, ecu-extract-reference=Ford_VehVActlEng_No_Cnt
      RPortPrototype_116: upstream-reference=Ford_VehVActlEng_No_Cs, ecu-extract-reference=Ford_VehVActlEng_No_Cs
      RPortPrototype_117: upstream-reference=Ford_VehVertComp_A_Actl, ecu-extract-reference=Ford_VehVertComp_A_Actl
      RPortPrototype_118: upstream-reference=Ford_VehVTrlrAid_B_Avail, ecu-extract-reference=Ford_VehVTrlrAid_B_Avail
      RPortPrototype_120: upstream-reference=Ford_VehYawComp_W_Actl, ecu-extract-reference=Ford_VehYawComp_W_Actl
      RPortPrototype_121: upstream-reference=Ford_WhlDirFl_D_Actl, ecu-extract-reference=Ford_WhlDirFl_D_Actl
      RPortPrototype_122: upstream-reference=Ford_WhlDirFr_D_Actl, ecu-extract-reference=Ford_WhlDirFr_D_Actl
      RPortPrototype_123: upstream-reference=Ford_WhlDirRl_D_Actl, ecu-extract-reference=Ford_WhlDirRl_D_Actl
      RPortPrototype_124: upstream-reference=Ford_WhlDirRr_D_Actl, ecu-extract-reference=Ford_WhlDirRr_D_Actl
      RPortPrototype_125: upstream-reference=Ford_WhlFl_W_Meas, ecu-extract-reference=Ford_WhlFl_W_Meas
      RPortPrototype_126: upstream-reference=Ford_WhlFr_W_Meas, ecu-extract-reference=Ford_WhlFr_W_Meas
      RPortPrototype_127: upstream-reference=Ford_WhlRl_W_Meas, ecu-extract-reference=Ford_WhlRl_W_Meas
      RPortPrototype_128: upstream-reference=Ford_WhlRotatFl_No_Cnt, ecu-extract-reference=Ford_WhlRotatFl_No_Cnt
      RPortPrototype_129: upstream-reference=Ford_WhlRotatFr_No_Cnt, ecu-extract-reference=Ford_WhlRotatFr_No_Cnt
      RPortPrototype_130: upstream-reference=Ford_WhlRotatRl_No_Cnt, ecu-extract-reference=Ford_WhlRotatRl_No_Cnt
      RPortPrototype_131: upstream-reference=Ford_WhlRotatRr_No_Cnt, ecu-extract-reference=Ford_WhlRotatRr_No_Cnt
      RPortPrototype_132: upstream-reference=Ford_WhlRr_W_Meas, ecu-extract-reference=Ford_WhlRr_W_Meas
      RPortPrototype_133: upstream-reference=Ford_YawStabilityIndex, ecu-extract-reference=Ford_YawStabilityIndex
      DataMapping: ecu-extract-reference=COMPOSITIONTYPE.Ford_PwPckTq_D_Stat.Ford_PwPckTq_D_Stat
      DataMapping_001: ecu-extract-reference=COMPOSITIONTYPE.Ford_Veh_V_ActlBrk.Ford_Veh_V_ActlBrk
      DataMapping_002: ecu-extract-reference=COMPOSITIONTYPE.Ford_SteMdule_D_Stat.Ford_SteMdule_D_Stat
      DataMapping_003: ecu-extract-reference=COMPOSITIONTYPE.Ford_SteeringColumnTorque.Ford_SteeringColumnTorque
      ComponentPrototype_106: upstream-reference=ECU_Composition.CDD_HwTq8Meas, ecu-extract-reference=COMPOSITIONTYPE.CDD_HwTq8Meas
      AssemblySwConnector_1582: ecu-extract-reference=CDD_NxtrTiDGetRefTmr1MicroSec32bitDCDD_HwTq8MeasDGetRefTmr1MicroSec32bit
      AssemblySwConnector_1583: ecu-extract-reference=CDD_NxtrTiDGetTiSpan1MicroSec32bitDCDD_HwTq8MeasDGetTiSpan1MicroSec32bit
      AssemblySwConnector_1584: ecu-extract-reference=DiagcMgrDCnvSnpshtData_u08DCDD_HwTq8MeasDCnvSnpshtData_u08
      AssemblySwConnector_1585: ecu-extract-reference=DiagcMgrProxyAppl10DGetNtcQlfrSts10DCDD_HwTq8MeasDGetNtcQlfrSts
      AssemblySwConnector_1586: ecu-extract-reference=DiagcMgrProxyAppl10DSetNtcStsAndSnpshtData10DCDD_HwTq8MeasDSetNtcStsAndSnpshtData
      AssemblySwConnector_1587: ecu-extract-reference=FltInjDFltInj_f32DCDD_HwTq8MeasDFltInj_f32
      AssemblySwConnector_1588: ecu-extract-reference=FltInjDFltInj_u08DCDD_HwTq8MeasDFltInj_u08
      AssemblySwConnector_1467: ecu-extract-reference=HwAgSysArbnDPinionAgConfDEotLrngDHwAgAuthy
      AssemblySwConnector_1475: ecu-extract-reference=HwAgSysArbnDPinionAgConfDEotProtnDHwAgAuthy
      AssemblySwConnector_1600: ecu-extract-reference=HwAgSysArbnDPinionAgConfDRtnDHwAgAuthySca
      AssemblySwConnector_1601: ecu-extract-reference=HwAgSysArbnDPinionAgConfDSysFricLrngDHwAgAuthy
      AssemblySwConnector_1602: ecu-extract-reference=HwAgSysArbnDPinionAgConfDVehSpdLimrDHwAgAuthy
      AssemblySwConnector_1464: ecu-extract-reference=HwAgSysArbnDHwAgFinalDCmnMfgSrvDHwAg
      AssemblySwConnector_1206: ecu-extract-reference=PwrLimrDMotTqCmdPwrLimdDMotTqCmdScaDMotTqCmdMrf
      ComponentPrototype_107: upstream-reference=ECU_Composition.CDD_GtmCfgAndUse, ecu-extract-reference=COMPOSITIONTYPE.CDD_GtmCfgAndUse
      AssemblySwConnector_1616: ecu-extract-reference=CDD_CurrMeasDMotCurrEolCalStDCDD_GtmCfgAndUseDMotCurrEolCalSt
      AssemblySwConnector_1617: ecu-extract-reference=CDD_GtmCfgAndUseDPhaOnTiMeasdADGateDrv0CtrlDPhaOnTiMeasdA
      AssemblySwConnector_1618: ecu-extract-reference=CDD_GtmCfgAndUseDPhaOnTiMeasdBDGateDrv0CtrlDPhaOnTiMeasdB
      AssemblySwConnector_1619: ecu-extract-reference=CDD_GtmCfgAndUseDPhaOnTiMeasdCDGateDrv0CtrlDPhaOnTiMeasdC
      AssemblySwConnector_1620: ecu-extract-reference=IoHwAbDSetFctGpioPhaALowrCmdDCDD_GtmCfgAndUseDIoHwAb_SetFctGpioPhaALowrCmd
      AssemblySwConnector_1621: ecu-extract-reference=IoHwAbDSetFctGpioPhaAUpprCmdDCDD_GtmCfgAndUseDIoHwAb_SetFctGpioPhaAUpprCmd
      AssemblySwConnector_1622: ecu-extract-reference=IoHwAbDSetFctGpioPhaBLowrCmdDCDD_GtmCfgAndUseDIoHwAb_SetFctGpioPhaBLowrCmd
      AssemblySwConnector_1623: ecu-extract-reference=IoHwAbDSetFctGpioPhaBUpprCmdDCDD_GtmCfgAndUseDIoHwAb_SetFctGpioPhaBUpprCmd
      AssemblySwConnector_1624: ecu-extract-reference=IoHwAbDSetFctGpioPhaCLowrCmdDCDD_GtmCfgAndUseDIoHwAb_SetFctGpioPhaCLowrCmd
      AssemblySwConnector_1625: ecu-extract-reference=IoHwAbDSetFctGpioPhaCUpprCmdDCDD_GtmCfgAndUseDIoHwAb_SetFctGpioPhaCUpprCmd
      AssemblySwConnector_1626: ecu-extract-reference=IoHwAbDSetFctPeriphPhaALowrCmdDCDD_GtmCfgAndUseDIoHwAb_SetFctPeriphPhaALowrCmd
      AssemblySwConnector_1627: ecu-extract-reference=IoHwAbDSetFctPeriphPhaAUpprCmdDCDD_GtmCfgAndUseDIoHwAb_SetFctPeriphPhaAUpprCmd
      AssemblySwConnector_1628: ecu-extract-reference=IoHwAbDSetFctPeriphPhaBLowrCmdDCDD_GtmCfgAndUseDIoHwAb_SetFctPeriphPhaBLowrCmd
      AssemblySwConnector_1629: ecu-extract-reference=IoHwAbDSetFctPeriphPhaBUpprCmdDCDD_GtmCfgAndUseDIoHwAb_SetFctPeriphPhaBUpprCmd
      AssemblySwConnector_1630: ecu-extract-reference=IoHwAbDSetFctPeriphPhaCLowrCmdDCDD_GtmCfgAndUseDIoHwAb_SetFctPeriphPhaCLowrCmd
      AssemblySwConnector_1631: ecu-extract-reference=IoHwAbDSetFctPeriphPhaCUpprCmdDCDD_GtmCfgAndUseDIoHwAb_SetFctPeriphPhaCUpprCmd
      AssemblySwConnector_1632: ecu-extract-reference=IoHwAbDSetGpioPhaALowrCmdDCDD_GtmCfgAndUseDIoHwAb_SetGpioPhaALowrCmd
      AssemblySwConnector_1633: ecu-extract-reference=IoHwAbDSetGpioPhaAUpprCmdDCDD_GtmCfgAndUseDIoHwAb_SetGpioPhaAUpprCmd
      AssemblySwConnector_1634: ecu-extract-reference=IoHwAbDSetGpioPhaBLowrCmdDCDD_GtmCfgAndUseDIoHwAb_SetGpioPhaBLowrCmd
      AssemblySwConnector_1635: ecu-extract-reference=IoHwAbDSetGpioPhaBUpprCmdDCDD_GtmCfgAndUseDIoHwAb_SetGpioPhaBUpprCmd
      AssemblySwConnector_1636: ecu-extract-reference=IoHwAbDSetGpioPhaCLowrCmdDCDD_GtmCfgAndUseDIoHwAb_SetGpioPhaCLowrCmd
      AssemblySwConnector_1637: ecu-extract-reference=IoHwAbDSetGpioPhaCUpprCmdDCDD_GtmCfgAndUseDIoHwAb_SetGpioPhaCUpprCmd
      AssemblySwConnector_1638: ecu-extract-reference=SysStModDSysStDCDD_GtmCfgAndUseDSysSt
      AssemblySwConnector_1639: ecu-extract-reference=CDD_CurrMeasDMotCurrEolCalStDCDD_MotCtrlMgrDMotCurrEolCalSt
      AssemblySwConnector_1640: ecu-extract-reference=PolarityCfgDMotAgMecl5PolarityDCDD_MotCtrlMgrDMotAgMecl5Polarity
      AssemblySwConnector_1641: ecu-extract-reference=PolarityCfgDMotAgMecl6PolarityDCDD_MotCtrlMgrDMotAgMecl6Polarity
      AssemblySwConnector_730: ecu-extract-reference=StOutpCtrlDSysStReqDiDSysStModDSysStReqDi
      AssemblySwConnector_1642: ecu-extract-reference=EotProtnDEotDampgCmdDEotProtnFwlDEotDampgCmd
      AssemblySwConnector_1480: ecu-extract-reference=GateDrv0CtrlDIvtrFetFltTypDLoaMgrDIvtrFetFltTyp
      AssemblySwConnector_1481: ecu-extract-reference=LoaMgrDMotAndThermProtnLoaModDDualCtrlrOutpMgrDMotAndThermProtnLoaMod
      AssemblySwConnector_1654: ecu-extract-reference=CDD_MotCtrlMgrDMotVltgDaxDElecPwrCnsDMotVltgDax
      AssemblySwConnector_1655: ecu-extract-reference=CDD_MotCtrlMgrDMotVltgQaxDElecPwrCnsDMotVltgQax
      AssemblySwConnector_1657: ecu-extract-reference=LoaMgrDMotAndThermProtnLoaModDCDD_MotCtrlMgrDMotAndThermProtnLoaMod
      AssemblySwConnector_1658: ecu-extract-reference=LoaMgrDMotAndThermProtnLoaModDDutyCycThermProtnDMotAndThermProtnLoaMod
      AssemblySwConnector_1659: ecu-extract-reference=LoaMgrDMotAndThermProtnLoaModDElecPwrCnsDMotAndThermProtnLoaMod
      AssemblySwConnector_1660: ecu-extract-reference=LoaMgrDMotAndThermProtnLoaModDHiLoadStallLimrDMotAndThermProtnLoaMod
      AssemblySwConnector_1661: ecu-extract-reference=LoaMgrDMotAndThermProtnLoaModDMotCtrlPrmEstimnDMotAndThermProtnLoaMod
      AssemblySwConnector_1662: ecu-extract-reference=LoaMgrDMotAndThermProtnLoaModDMotCurrPeakEstimnDMotAndThermProtnLoaMod
      AssemblySwConnector_1663: ecu-extract-reference=LoaMgrDMotAndThermProtnLoaModDMotCurrRegCfgDMotAndThermProtnLoaMod
      AssemblySwConnector_1664: ecu-extract-reference=LoaMgrDMotAndThermProtnLoaModDMotRefMdlDMotAndThermProtnLoaMod
      AssemblySwConnector_1665: ecu-extract-reference=LoaMgrDMotAndThermProtnLoaModDPwrLimrDMotAndThermProtnLoaMod
      ComponentPrototype_108: upstream-reference=ECU_Composition.FordMsg5B5BusHiSpd, ecu-extract-reference=COMPOSITIONTYPE.FordMsg5B5BusHiSpd
      ComponentPrototype_109: upstream-reference=ECU_Composition.FordMsg430BusHiSpd, ecu-extract-reference=COMPOSITIONTYPE.FordMsg430BusHiSpd
      ComponentPrototype_110: upstream-reference=ECU_Composition.FordMsg41EBusHiSpd, ecu-extract-reference=COMPOSITIONTYPE.FordMsg41EBusHiSpd
      ComponentPrototype_111: upstream-reference=ECU_Composition.FordMsg41ABusHiSpd, ecu-extract-reference=COMPOSITIONTYPE.FordMsg41ABusHiSpd
      ComponentPrototype_112: upstream-reference=ECU_Composition.FordMsg417BusHiSpd, ecu-extract-reference=COMPOSITIONTYPE.FordMsg417BusHiSpd
      ComponentPrototype_113: upstream-reference=ECU_Composition.FordMsg415BusHiSpd, ecu-extract-reference=COMPOSITIONTYPE.FordMsg415BusHiSpd
      ComponentPrototype_114: upstream-reference=ECU_Composition.FordMsg40ABusHiSpd, ecu-extract-reference=COMPOSITIONTYPE.FordMsg40ABusHiSpd
      ComponentPrototype_115: upstream-reference=ECU_Composition.FordMsg3B3BusHiSpd, ecu-extract-reference=COMPOSITIONTYPE.FordMsg3B3BusHiSpd
      ComponentPrototype_116: upstream-reference=ECU_Composition.FordMsg217BusHiSpd, ecu-extract-reference=COMPOSITIONTYPE.FordMsg217BusHiSpd
      ComponentPrototype_117: upstream-reference=ECU_Composition.FordMsg167BusHiSpd, ecu-extract-reference=COMPOSITIONTYPE.FordMsg167BusHiSpd
      ComponentPrototype_118: upstream-reference=ECU_Composition.FordMsg082BusHiSpd, ecu-extract-reference=COMPOSITIONTYPE.FordMsg082BusHiSpd
      ComponentPrototype_119: upstream-reference=ECU_Composition.FordMsg07EBusHiSpd, ecu-extract-reference=COMPOSITIONTYPE.FordMsg07EBusHiSpd
      AssemblySwConnector_1731: ecu-extract-reference=CDD_NxtrTiDGetRefTmr100MicroSec32bitDFordMsg167BusHiSpdDGetRefTmr100MicroSec32bit
      AssemblySwConnector_1732: ecu-extract-reference=CDD_NxtrTiDGetTiSpan100MicroSec32bitDFordMsg167BusHiSpdDGetTiSpan100MicroSec32bit
      AssemblySwConnector_1733: ecu-extract-reference=CDD_NxtrTiDGetRefTmr100MicroSec32bitDFordMsg217BusHiSpdDGetRefTmr100MicroSec32bit
      AssemblySwConnector_1734: ecu-extract-reference=CDD_NxtrTiDGetTiSpan100MicroSec32bitDFordMsg217BusHiSpdDGetTiSpan100MicroSec32bit
      AssemblySwConnector_1735: ecu-extract-reference=CDD_NxtrTiDGetRefTmr100MicroSec32bitDFordMsg3B3BusHiSpdDGetRefTmr100MicroSec32bit
      AssemblySwConnector_1736: ecu-extract-reference=CDD_NxtrTiDGetTiSpan100MicroSec32bitDFordMsg3B3BusHiSpdDGetTiSpan100MicroSec32bit
      AssemblySwConnector_1737: ecu-extract-reference=CDD_NxtrTiDGetRefTmr100MicroSec32bitDFordMsg40ABusHiSpdDGetRefTmr100MicroSec32bit
      AssemblySwConnector_1738: ecu-extract-reference=CDD_NxtrTiDGetTiSpan100MicroSec32bitDFordMsg40ABusHiSpdDGetTiSpan100MicroSec32bit
      AssemblySwConnector_1739: ecu-extract-reference=CDD_NxtrTiDGetRefTmr100MicroSec32bitDFordMsg415BusHiSpdDGetRefTmr100MicroSec32bit
      AssemblySwConnector_1740: ecu-extract-reference=CDD_NxtrTiDGetTiSpan100MicroSec32bitDFordMsg415BusHiSpdDGetTiSpan100MicroSec32bit
      AssemblySwConnector_1741: ecu-extract-reference=CDD_NxtrTiDGetRefTmr100MicroSec32bitDFordMsg41ABusHiSpdDGetRefTmr100MicroSec32bit
      AssemblySwConnector_1742: ecu-extract-reference=CDD_NxtrTiDGetTiSpan100MicroSec32bitDFordMsg41ABusHiSpdDGetTiSpan100MicroSec32bit
      AssemblySwConnector_1743: ecu-extract-reference=CDD_NxtrTiDGetRefTmr100MicroSec32bitDFordMsg41EBusHiSpdDGetRefTmr100MicroSec32bit
      AssemblySwConnector_1744: ecu-extract-reference=CDD_NxtrTiDGetTiSpan100MicroSec32bitDFordMsg41EBusHiSpdDGetTiSpan100MicroSec32bit
      AssemblySwConnector_1745: ecu-extract-reference=CDD_NxtrTiDGetRefTmr100MicroSec32bitDFordMsg430BusHiSpdDGetRefTmr100MicroSec32bit
      AssemblySwConnector_1746: ecu-extract-reference=CDD_NxtrTiDGetTiSpan100MicroSec32bitDFordMsg430BusHiSpdDGetTiSpan100MicroSec32bit
      AssemblySwConnector_1747: ecu-extract-reference=DiagcMgrDClrDiagcFlgProxyDFordMsg167BusHiSpdDClrDiagcFlgProxy
      AssemblySwConnector_1748: ecu-extract-reference=DiagcMgrDClrDiagcFlgProxyDFordMsg217BusHiSpdDClrDiagcFlgProxy
      AssemblySwConnector_1749: ecu-extract-reference=DiagcMgrDClrDiagcFlgProxyDFordMsg3B3BusHiSpdDClrDiagcFlgProxy
      AssemblySwConnector_1750: ecu-extract-reference=DiagcMgrDClrDiagcFlgProxyDFordMsg40ABusHiSpdDClrDiagcFlgProxy
      AssemblySwConnector_1751: ecu-extract-reference=DiagcMgrDClrDiagcFlgProxyDFordMsg415BusHiSpdDClrDiagcFlgProxy
      AssemblySwConnector_1752: ecu-extract-reference=DiagcMgrDClrDiagcFlgProxyDFordMsg41ABusHiSpdDClrDiagcFlgProxy
      AssemblySwConnector_1753: ecu-extract-reference=DiagcMgrDClrDiagcFlgProxyDFordMsg41EBusHiSpdDClrDiagcFlgProxy
      AssemblySwConnector_1754: ecu-extract-reference=DiagcMgrProxyAppl10DSetNtcSts10DFordMsg167BusHiSpdDSetNtcSts
      AssemblySwConnector_1755: ecu-extract-reference=DiagcMgrProxyAppl10DSetNtcSts10DFordMsg217BusHiSpdDSetNtcSts
      AssemblySwConnector_1756: ecu-extract-reference=DiagcMgrProxyAppl10DSetNtcSts10DFordMsg3B3BusHiSpdDSetNtcSts
      AssemblySwConnector_1757: ecu-extract-reference=DiagcMgrProxyAppl10DSetNtcSts10DFordMsg40ABusHiSpdDSetNtcSts
      AssemblySwConnector_1758: ecu-extract-reference=DiagcMgrProxyAppl10DSetNtcSts10DFordMsg415BusHiSpdDSetNtcSts
      AssemblySwConnector_1759: ecu-extract-reference=DiagcMgrProxyAppl10DSetNtcSts10DFordMsg41ABusHiSpdDSetNtcSts
      AssemblySwConnector_1760: ecu-extract-reference=DiagcMgrProxyAppl10DSetNtcSts10DFordMsg41EBusHiSpdDSetNtcSts
      AssemblySwConnector_1761: ecu-extract-reference=DiagcMgrProxyAppl10DSetNtcSts10DFordMsg430BusHiSpdDSetNtcSts
      DelegationSwConnector: ecu-extract-reference=Ford_DrvSteActv_B_StatDDFordMsg082BusHiSpdDFord_DrvSteActv_B_Stat1
      DelegationSwConnector_001: ecu-extract-reference=Ford_ElPw_D_StatDDFordMsg167BusHiSpdDFord_ElPw_D_Stat1
      DelegationSwConnector_002: ecu-extract-reference=Ford_ElPw_D_StatStrtStopDDFordMsg167BusHiSpdDFord_ElPw_D_StatStrtStop1
      DelegationSwConnector_003: ecu-extract-reference=Ford_EPAS_FailureDDFordMsg082BusHiSpdDFord_EPAS_Failure1
      DelegationSwConnector_004: ecu-extract-reference=Ford_EsaOn_B_StatDDFordMsg417BusHiSpdDFord_EsaOn_B_Stat1
      DelegationSwConnector_005: ecu-extract-reference=Ford_Ignition_StatusDDFordMsg3B3BusHiSpdDFord_Ignition_Status1
      DelegationSwConnector_006: ecu-extract-reference=Ford_LatCtlLim_D_StatDDFordMsg417BusHiSpdDFord_LatCtlLim_D_Stat1
      DelegationSwConnector_007: ecu-extract-reference=Ford_LatCtlSte_D_StatDDFordMsg417BusHiSpdDFord_LatCtlSte_D_Stat1
      DelegationSwConnector_008: ecu-extract-reference=Ford_LsmcBrkDecel_D_StatDDFordMsg415BusHiSpdDFord_LsmcBrkDecel_D_Stat1
      DelegationSwConnector_009: ecu-extract-reference=Ford_PrplWhlTot2_Tq_ActlDDFordMsg167BusHiSpdDFord_PrplWhlTot2_Tq_Actl
      DelegationSwConnector_010: ecu-extract-reference=Ford_PwPckTq_D_StatDDFordMsg167BusHiSpdDFord_PwPckTq_D_Stat1
      DelegationSwConnector_011: ecu-extract-reference=Ford_SAPPAngleControlStat1DDFordMsg082BusHiSpdDFord_SAPPAngleControlStat1_1
      DelegationSwConnector_012: ecu-extract-reference=Ford_SAPPAngleControlStat2DDFordMsg082BusHiSpdDFord_SAPPAngleControlStat2_1
      DelegationSwConnector_013: ecu-extract-reference=Ford_SAPPAngleControlStat3DDFordMsg082BusHiSpdDFord_SAPPAngleControlStat3_1
      DelegationSwConnector_014: ecu-extract-reference=Ford_SAPPAngleControlStat4DDFordMsg082BusHiSpdDFord_SAPPAngleControlStat4_1
      DelegationSwConnector_015: ecu-extract-reference=Ford_SAPPAngleControlStat5DDFordMsg082BusHiSpdDFord_SAPPAngleControlStat5_1
      DelegationSwConnector_016: ecu-extract-reference=Ford_SAPPAngleControlStat6DDFordMsg082BusHiSpdDFord_SAPPAngleControlStat6_1
      DelegationSwConnector_017: ecu-extract-reference=Ford_SelDrvMdeSte_D_StatDDFordMsg417BusHiSpdDFord_SelDrvMdeSte_D_Stat1
      DelegationSwConnector_018: ecu-extract-reference=Ford_SteeringColumnTorqueDDFordMsg082BusHiSpdDFord_SteeringColumnTorque
      DelegationSwConnector_019: ecu-extract-reference=Ford_SteMdule_D_StatDDFordMsg082BusHiSpdDFord_SteMdule_D_Stat1
      DelegationSwConnector_020: ecu-extract-reference=Ford_SteMdule_I_EstDDFordMsg082BusHiSpdDFord_SteMdule_I_Est
      DelegationSwConnector_021: ecu-extract-reference=Ford_SteMdule_U_MeasDDFordMsg082BusHiSpdDFord_SteMdule_U_Meas
      DelegationSwConnector_022: ecu-extract-reference=Ford_StePinAn_No_CntDDFordMsg07EBusHiSpdDFord_StePinAn_No_Cnt
      DelegationSwConnector_023: ecu-extract-reference=Ford_StePinAn_No_CsDDFordMsg07EBusHiSpdDFord_StePinAn_No_Cs
      DelegationSwConnector_024: ecu-extract-reference=Ford_StePinComp_An_EstDDFordMsg07EBusHiSpdDFord_StePinComp_An_Est
      DelegationSwConnector_025: ecu-extract-reference=Ford_StePinCompAnEst_D_QfDDFordMsg07EBusHiSpdDFord_StePinCompAnEst_D_Qf1
      DelegationSwConnector_026: ecu-extract-reference=Ford_StePinRelInit_An_SnsDDFordMsg07EBusHiSpdDFord_StePinRelInit_An_Sns
      DelegationSwConnector_027: ecu-extract-reference=Ford_StePw_B_RqDDFordMsg07EBusHiSpdDFord_StePw_B_Rq1
      DelegationSwConnector_028: ecu-extract-reference=Ford_TrlrHitchLamp_D_RqstDDFordMsg082BusHiSpdDFord_TrlrHitchLamp_D_Rqst1
      DelegationSwConnector_029: ecu-extract-reference=Ford_Veh_V_ActlBrkDDFordMsg415BusHiSpdDFord_Veh_V_ActlBrk
      DelegationSwConnector_030: ecu-extract-reference=Ford_Veh_V_RqMxTrlrAidDDFordMsg082BusHiSpdDFord_Veh_V_RqMxTrlrAid
      DelegationSwConnector_031: ecu-extract-reference=Ford_VehVActlBrk_D_QfDDFordMsg415BusHiSpdDFord_VehVActlBrk_D_Qf1
      DelegationSwConnector_032: ecu-extract-reference=Ford_VehVActlBrk_No_CntDDFordMsg415BusHiSpdDFord_VehVActlBrk_No_Cnt
      DelegationSwConnector_033: ecu-extract-reference=Ford_VehVActlBrk_No_CsDDFordMsg415BusHiSpdDFord_VehVActlBrk_No_Cs
      DelegationSwConnector_034: ecu-extract-reference=Ford_VehVTrlrAid_B_RqDDFordMsg082BusHiSpdDFord_VehVTrlrAid_B_Rq1
      DataMapping_004: ecu-extract-reference=COMPOSITIONTYPE.Ford_VehVActlBrk_No_Cs.Ford_VehVActlBrk_No_Cs
      DataMapping_005: ecu-extract-reference=COMPOSITIONTYPE.Ford_EPAS_Failure.Ford_EPAS_Failure
      DataMapping_006: ecu-extract-reference=COMPOSITIONTYPE.Ford_TrlrHitchLamp_D_Rqst.Ford_TrlrHitchLamp_D_Rqst
      DataMapping_007: ecu-extract-reference=COMPOSITIONTYPE.Ford_SAPPAngleControlStat2.Ford_SAPPAngleControlStat2
      DataMapping_008: ecu-extract-reference=COMPOSITIONTYPE.Ford_StePinComp_An_Est.Ford_StePinComp_An_Est
      DataMapping_009: ecu-extract-reference=COMPOSITIONTYPE.Ford_ElPw_D_Stat.Ford_ElPw_D_Stat
      DataMapping_011: ecu-extract-reference=COMPOSITIONTYPE.Ford_Ignition_Status.Ford_Ignition_Status
      DataMapping_012: ecu-extract-reference=COMPOSITIONTYPE.Ford_VehVActlBrk_No_Cnt.Ford_VehVActlBrk_No_Cnt
      DataMapping_013: ecu-extract-reference=COMPOSITIONTYPE.Ford_StePinCompAnEst_D_Qf.Ford_StePinCompAnEst_D_Qf
      DataMapping_014: ecu-extract-reference=COMPOSITIONTYPE.Ford_VehVTrlrAid_B_Rq.Ford_VehVTrlrAid_B_Rq
      DataMapping_015: ecu-extract-reference=COMPOSITIONTYPE.Ford_LsmcBrkDecel_D_Stat.Ford_LsmcBrkDecel_D_Stat
      DataMapping_016: ecu-extract-reference=COMPOSITIONTYPE.Ford_SteMdule_U_Meas.Ford_SteMdule_U_Meas
      DataMapping_017: ecu-extract-reference=COMPOSITIONTYPE.Ford_StePinAn_No_Cnt.Ford_StePinAn_No_Cnt
      DataMapping_018: ecu-extract-reference=COMPOSITIONTYPE.Ford_StePinRelInit_An_Sns.Ford_StePinRelInit_An_Sns
      DataMapping_019: ecu-extract-reference=COMPOSITIONTYPE.Ford_StePinAn_No_Cs.Ford_StePinAn_No_Cs
      DataMapping_020: ecu-extract-reference=COMPOSITIONTYPE.Ford_Veh_V_RqMxTrlrAid.Ford_Veh_V_RqMxTrlrAid
      DataMapping_021: ecu-extract-reference=COMPOSITIONTYPE.Ford_SAPPAngleControlStat5.Ford_SAPPAngleControlStat5
      DataMapping_022: ecu-extract-reference=COMPOSITIONTYPE.Ford_LatCtlSte_D_Stat.Ford_LatCtlSte_D_Stat
      DataMapping_023: ecu-extract-reference=COMPOSITIONTYPE.Ford_StePw_B_Rq.Ford_StePw_B_Rq
      DataMapping_024: ecu-extract-reference=COMPOSITIONTYPE.Ford_DrvSteActv_B_Stat.Ford_DrvSteActv_B_Stat
      DataMapping_025: ecu-extract-reference=COMPOSITIONTYPE.Ford_VehVActlBrk_D_Qf.Ford_VehVActlBrk_D_Qf
      DataMapping_026: ecu-extract-reference=COMPOSITIONTYPE.Ford_ElPw_D_StatStrtStop.Ford_ElPw_D_StatStrtStop
      DataMapping_027: ecu-extract-reference=COMPOSITIONTYPE.Ford_LatCtlLim_D_Stat.Ford_LatCtlLim_D_Stat
      DataMapping_028: ecu-extract-reference=COMPOSITIONTYPE.Ford_SteMdule_I_Est.Ford_SteMdule_I_Est
      DataMapping_029: ecu-extract-reference=COMPOSITIONTYPE.Ford_SAPPAngleControlStat4.Ford_SAPPAngleControlStat4
      DataMapping_030: ecu-extract-reference=COMPOSITIONTYPE.Ford_PrplWhlTot2_Tq_Actl.Ford_PrplWhlTot2_Tq_Actl
      DataMapping_032: ecu-extract-reference=COMPOSITIONTYPE.Ford_SAPPAngleControlStat6.Ford_SAPPAngleControlStat6
      DataMapping_033: ecu-extract-reference=COMPOSITIONTYPE.Ford_SAPPAngleControlStat3.Ford_SAPPAngleControlStat3
      DataMapping_034: ecu-extract-reference=COMPOSITIONTYPE.Ford_SelDrvMdeSte_D_Stat.Ford_SelDrvMdeSte_D_Stat
      DataMapping_035: ecu-extract-reference=COMPOSITIONTYPE.Ford_SAPPAngleControlStat1.Ford_SAPPAngleControlStat1
      ComponentPrototype_120: upstream-reference=ECU_Composition.CDD_SyncCrc, ecu-extract-reference=COMPOSITIONTYPE.CDD_SyncCrc
      ComponentPrototype_121: upstream-reference=ECU_Composition.CDD_RamMem, ecu-extract-reference=COMPOSITIONTYPE.CDD_RamMem
      ComponentPrototype_122: upstream-reference=ECU_Composition.CDD_McuCoreCfgAndDiagc, ecu-extract-reference=COMPOSITIONTYPE.CDD_McuCoreCfgAndDiagc
      ComponentPrototype_123: upstream-reference=ECU_Composition.CDD_GuardCfgAndDiagc, ecu-extract-reference=COMPOSITIONTYPE.CDD_GuardCfgAndDiagc
      ComponentPrototype_124: upstream-reference=ECU_Composition.CDD_FlsMem, ecu-extract-reference=COMPOSITIONTYPE.CDD_FlsMem
      ComponentPrototype_125: upstream-reference=ECU_Composition.CDD_ExcpnHndlg, ecu-extract-reference=COMPOSITIONTYPE.CDD_ExcpnHndlg
      ComponentPrototype_126: upstream-reference=ECU_Composition.CDD_EcmOutpAndDiagc, ecu-extract-reference=COMPOSITIONTYPE.CDD_EcmOutpAndDiagc
      AssemblySwConnector_1447: ecu-extract-reference=CDD_EcmOutpAndDiagcDCtrlErrOutDTmplMonrDCtrlErrOut
      AssemblySwConnector_1764: ecu-extract-reference=CDD_ExcpnHndlgDGetMcuDiagcSpplDataDDiagcMgrDGetMcuDiagcSpplData
      AssemblySwConnector_1765: ecu-extract-reference=CDD_FlsMemDSwApplCrcDDiagcMgrDSwApplCrc
      AssemblySwConnector_1766: ecu-extract-reference=CDD_FlsMemDCodFlsCrcChkCmplDPwrUpSeqDCodFlsCrcChkCmpl
      AssemblySwConnector_1767: ecu-extract-reference=CDD_NxtrTiDGetTiSpan100MicroSec32bitDCDD_FlsMemDGetTiSpan100MicroSec32bit
      AssemblySwConnector_1768: ecu-extract-reference=CDD_SyncCrcDResvCrcHwUnitDCDD_FlsMemDResvCrcHwUnit
      AssemblySwConnector_1769: ecu-extract-reference=DiagcMgrProxyAppl10DSetNtcSts10DCDD_ExcpnHndlgDSetNtcSts
      AssemblySwConnector_1770: ecu-extract-reference=DiagcMgrProxyAppl10DSetNtcStsAndSnpshtData10DCDD_ExcpnHndlgDSetNtcStsAndSnpshtData
      AssemblySwConnector_1771: ecu-extract-reference=DiagcMgrProxyAppl10DSetNtcSts10DCDD_FlsMemDSetNtcSts
      AssemblySwConnector_1772: ecu-extract-reference=DiagcMgrProxyAppl10DSetNtcSts10DCDD_RamMemDSetNtcSts
      ComponentPrototype_127: upstream-reference=ECU_Composition.CDD_ClkCfgAndMon, ecu-extract-reference=COMPOSITIONTYPE.CDD_ClkCfgAndMon
      AssemblySwConnector_1782: ecu-extract-reference=LoaMgrDMotAndThermProtnLoaModDTEstimnDMotAndThermProtnLoaMod
      PPortPrototype_009: upstream-reference=Ford_HitchToTrlrAxle_L_Calc, ecu-extract-reference=Ford_HitchToTrlrAxle_L_Calc
      PPortPrototype_018: upstream-reference=Ford_LsmcBrk_Tq_Rq, ecu-extract-reference=Ford_LsmcBrk_Tq_Rq
      PPortPrototype_030: upstream-reference=Ford_TrlrAidEnbl_D2_Stat, ecu-extract-reference=Ford_TrlrAidEnbl_D2_Stat
      PPortPrototype_031: upstream-reference=Ford_TrlrAidMsgTxt_D2_Rq, ecu-extract-reference=Ford_TrlrAidMsgTxt_D2_Rq
      PPortPrototype_035: upstream-reference=Ford_TrlrAidSetup_D2_Stat, ecu-extract-reference=Ford_TrlrAidSetup_D2_Stat
      PPortPrototype_036: upstream-reference=Ford_TrlrAidTrgtId_No_Rq, ecu-extract-reference=Ford_TrlrAidTrgtId_No_Rq
      PPortPrototype_037: upstream-reference=Ford_TrlrAidTrlrId_No_Rq, ecu-extract-reference=Ford_TrlrAidTrlrId_No_Rq
      PPortPrototype_038: upstream-reference=Ford_TrlrAn_An_MxCalc, ecu-extract-reference=Ford_TrlrAn_An_MxCalc
      PPortPrototype_039: upstream-reference=Ford_TrlrAn_An_TrgtCalc, ecu-extract-reference=Ford_TrlrAn_An_TrgtCalc
      PPortPrototype_040: upstream-reference=Ford_TrlrAn_An_WarnCalc, ecu-extract-reference=Ford_TrlrAn_An_WarnCalc
      PPortPrototype_041: upstream-reference=Ford_TrlrAnOffst_An2_Calc, ecu-extract-reference=Ford_TrlrAnOffst_An2_Calc
      RPortPrototype_003: upstream-reference=Ford_ApaSys_D_Stat, ecu-extract-reference=Ford_ApaSys_D_Stat
      RPortPrototype_004: upstream-reference=Ford_GearPos_D_Actl, ecu-extract-reference=Ford_GearPos_D_Actl
      RPortPrototype_009: upstream-reference=Ford_HitchToVehAxle_L_Calc, ecu-extract-reference=Ford_HitchToVehAxle_L_Calc
      RPortPrototype_023: upstream-reference=Ford_LatCtlRng_L_Max, ecu-extract-reference=Ford_LatCtlRng_L_Max
      RPortPrototype_033: upstream-reference=Ford_LifeCycMde_D_Actl, ecu-extract-reference=Ford_LifeCycMde_D_Actl
      RPortPrototype_034: upstream-reference=Ford_LkaDrvOvrrd_D_Rq, ecu-extract-reference=Ford_LkaDrvOvrrd_D_Rq
      RPortPrototype_036: upstream-reference=Ford_SelDrvMdeChassis2_D_Rq, ecu-extract-reference=Ford_SelDrvMdeChassis2_D_Rq
      RPortPrototype_057: upstream-reference=Ford_StePinOffst_No_Cnt, ecu-extract-reference=Ford_StePinOffst_No_Cnt
      RPortPrototype_060: upstream-reference=Ford_StePinOffst_No_Cs, ecu-extract-reference=Ford_StePinOffst_No_Cs
      RPortPrototype_061: upstream-reference=Ford_TrlrAid_An3_Actl, ecu-extract-reference=Ford_TrlrAid_An3_Actl
      RPortPrototype_062: upstream-reference=Ford_TrlrAid_AnRate2_Actl, ecu-extract-reference=Ford_TrlrAid_AnRate2_Actl
      RPortPrototype_064: upstream-reference=Ford_TrlrAid_D2_Stat, ecu-extract-reference=Ford_TrlrAid_D2_Stat
      RPortPrototype_068: upstream-reference=Ford_TrlrAidEnbl_D2_Rq, ecu-extract-reference=Ford_TrlrAidEnbl_D2_Rq
      RPortPrototype_069: upstream-reference=Ford_TrlrAidMde_D_Rq, ecu-extract-reference=Ford_TrlrAidMde_D_Rq
      RPortPrototype_070: upstream-reference=Ford_TrlrAidSetup_D2_Rq, ecu-extract-reference=Ford_TrlrAidSetup_D2_Rq
      RPortPrototype_071: upstream-reference=Ford_TrlrAidTrgtId_No_Actl, ecu-extract-reference=Ford_TrlrAidTrgtId_No_Actl
      RPortPrototype_072: upstream-reference=Ford_TrlrHitchYaw_An_Actl, ecu-extract-reference=Ford_TrlrHitchYaw_An_Actl
      RPortPrototype_073: upstream-reference=Ford_TrlrHitchYaw_D_Stat, ecu-extract-reference=Ford_TrlrHitchYaw_D_Stat
      RPortPrototype_074: upstream-reference=Ford_TrlrHitYaw_AnRate_Actl, ecu-extract-reference=Ford_TrlrHitYaw_AnRate_Actl
      RPortPrototype_075: upstream-reference=Ford_TrlrIdType_D_Stat, ecu-extract-reference=Ford_TrlrIdType_D_Stat
      RPortPrototype_078: upstream-reference=Ford_TrlrRvrse_D_Stat, ecu-extract-reference=Ford_TrlrRvrse_D_Stat
      RPortPrototype_079: upstream-reference=Ford_TrlrRvrseCancl_B_Rq, ecu-extract-reference=Ford_TrlrRvrseCancl_B_Rq
      RPortPrototype_081: upstream-reference=Ford_TrlrRvrseEnbl_D2_Stat, ecu-extract-reference=Ford_TrlrRvrseEnbl_D2_Stat
      RPortPrototype_082: upstream-reference=Ford_TrlrRvrseMsgTxt_D2_Rq, ecu-extract-reference=Ford_TrlrRvrseMsgTxt_D2_Rq
      RPortPrototype_083: upstream-reference=Ford_TrlrSnsId_No_Actl, ecu-extract-reference=Ford_TrlrSnsId_No_Actl
      RPortPrototype_084: upstream-reference=Ford_TrlrYaw_W_Actl, ecu-extract-reference=Ford_TrlrYaw_W_Actl
      RPortPrototype_087: upstream-reference=Ford_TrlrYawWActl_D_Qf, ecu-extract-reference=Ford_TrlrYawWActl_D_Qf
      RPortPrototype_092: upstream-reference=Ford_FileVersionDay, ecu-extract-reference=Ford_FileVersionDay
      RPortPrototype_093: upstream-reference=Ford_FileVersionMonth, ecu-extract-reference=Ford_FileVersionMonth
      RPortPrototype_094: upstream-reference=Ford_FileVersionYear, ecu-extract-reference=Ford_FileVersionYear
      ComponentPrototype_128: upstream-reference=ECU_Composition.FordMsg414BusHiSpd, ecu-extract-reference=COMPOSITIONTYPE.FordMsg414BusHiSpd
      ComponentPrototype_129: upstream-reference=ECU_Composition.FordMsg202BusHiSpd, ecu-extract-reference=COMPOSITIONTYPE.FordMsg202BusHiSpd
      AssemblySwConnector_1803: ecu-extract-reference=CDD_NxtrTiDGetRefTmr100MicroSec32bitDFordMsg202BusHiSpdDGetRefTmr100MicroSec32bit
      AssemblySwConnector_1804: ecu-extract-reference=CDD_NxtrTiDGetTiSpan100MicroSec32bitDFordMsg202BusHiSpdDGetTiSpan100MicroSec32bit
      AssemblySwConnector_1805: ecu-extract-reference=CDD_NxtrTiDGetRefTmr100MicroSec32bitDFordMsg414BusHiSpdDGetRefTmr100MicroSec32bit
      AssemblySwConnector_1806: ecu-extract-reference=CDD_NxtrTiDGetTiSpan100MicroSec32bitDFordMsg414BusHiSpdDGetTiSpan100MicroSec32bit
      AssemblySwConnector_1807: ecu-extract-reference=DiagcMgrDClrDiagcFlgProxyDFordMsg202BusHiSpdDClrDiagcFlgProxy
      AssemblySwConnector_1808: ecu-extract-reference=DiagcMgrProxyAppl10DSetNtcSts10DFordMsg202BusHiSpdDSetNtcSts
      DelegationSwConnector_035: ecu-extract-reference=Ford_DrvSte_Tq_ActlDDFordMsg082BusHiSpdDFord_DrvSte_Tq_Actl
      DelegationSwConnector_036: ecu-extract-reference=Ford_GearRvrse_D_ActlDDFordMsg202BusHiSpdDFord_GearRvrse_D_Actl1
      DelegationSwConnector_037: ecu-extract-reference=Ford_LifeCycMde_D_ActlDDFordMsg3B3BusHiSpdDFord_LifeCycMde_D_Actl1
      DelegationSwConnector_038: ecu-extract-reference=Ford_OdometerMasterValueDDFordMsg430BusHiSpdDFord_OdometerMasterValue
      DelegationSwConnector_039: ecu-extract-reference=Ford_SelDrvMdeChassis2_D_RqDDFordMsg41EBusHiSpdDFord_SelDrvMdeChassis2_D_Rq1
      DelegationSwConnector_040: ecu-extract-reference=Ford_StePinOffst_An_EstDDFordMsg414BusHiSpdDFord_StePinOffst_An_Est
      DelegationSwConnector_041: ecu-extract-reference=Ford_StePinOffst_D_StatDDFordMsg414BusHiSpdDFord_StePinOffst_D_Stat1
      DelegationSwConnector_042: ecu-extract-reference=Ford_StePinOffst_No_CntDDFordMsg414BusHiSpdDFord_StePinOffst_No_Cnt
      DelegationSwConnector_043: ecu-extract-reference=Ford_StePinOffst_No_CsDDFordMsg414BusHiSpdDFord_StePinOffst_No_Cs
      DelegationSwConnector_044: ecu-extract-reference=Ford_TrlrAidEnbl_D2_StatDDFordMsg417BusHiSpdDFord_TrlrAidEnbl_D2_Stat1
      DelegationSwConnector_045: ecu-extract-reference=Ford_TrlrAidMsgTxt_D2_RqDDFordMsg417BusHiSpdDFord_TrlrAidMsgTxt_D2_Rq1
      DelegationSwConnector_046: ecu-extract-reference=Ford_Veh_V_ActlEngDDFordMsg202BusHiSpdDFord_Veh_V_ActlEng
      DelegationSwConnector_047: ecu-extract-reference=Ford_VehicleGGCCDataDDFordMsg40ABusHiSpdDFord_VehGGCCData
      DelegationSwConnector_048: ecu-extract-reference=Ford_VehVActlEng_D_QfDDFordMsg202BusHiSpdDFord_VehVActlEng_D_Qf1
      DelegationSwConnector_049: ecu-extract-reference=Ford_VehVActlEng_No_CntDDFordMsg202BusHiSpdDFord_VehVActlEng_No_Cnt
      DelegationSwConnector_050: ecu-extract-reference=Ford_VehVActlEng_No_CsDDFordMsg202BusHiSpdDFord_VehVActlEng_No_Cs
      DelegationSwConnector_051: ecu-extract-reference=Ford_VehVTrlrAid_B_AvailDDFordMsg202BusHiSpdDFord_VehVTrlrAid_B_Avail1
      DelegationSwConnector_052: ecu-extract-reference=Ford_WhlFl_W_MeasDDFordMsg217BusHiSpdDFord_WhlFl_W_Meas
      DelegationSwConnector_053: ecu-extract-reference=Ford_WhlFr_W_MeasDDFordMsg217BusHiSpdDFord_WhlFr_W_Meas
      DelegationSwConnector_054: ecu-extract-reference=Ford_WhlRl_W_MeasDDFordMsg217BusHiSpdDFord_WhlRl_W_Meas
      DelegationSwConnector_055: ecu-extract-reference=Ford_WhlRr_W_MeasDDFordMsg217BusHiSpdDFord_WhlRr_W_Meas
      DataMapping_010: ecu-extract-reference=COMPOSITIONTYPE.Ford_BrkTot_Tq_Actl.Ford_BrkTot_Tq_Actl
      DataMapping_036: ecu-extract-reference=COMPOSITIONTYPE.Ford_TrlrAidCancl_B_Rq.Ford_TrlrAidCancl_B_Rq
      DataMapping_037: ecu-extract-reference=COMPOSITIONTYPE.Ford_LaHandsOff_B_Actl.Ford_LaHandsOff_B_Actl
      DataMapping_038: ecu-extract-reference=COMPOSITIONTYPE.Ford_CmbbObjDistLong_L_Actl.Ford_CmbbObjDistLong_L_Actl
      DataMapping_039: ecu-extract-reference=COMPOSITIONTYPE.Ford_TrlrAidSetup_D2_Stat.Ford_TrlrAidSetup_D2_Stat
      DataMapping_040: ecu-extract-reference=COMPOSITIONTYPE.Ford_TrlrAidMsgTxt_D2_Rq.Ford_TrlrAidMsgTxt_D2_Rq
      DataMapping_041: ecu-extract-reference=COMPOSITIONTYPE.Ford_DrvSte_Tq_Actl.Ford_DrvSte_Tq_Actl
      DataMapping_042: ecu-extract-reference=COMPOSITIONTYPE.Ford_SelDrvMdeChassis2_D_Rq.Ford_SelDrvMdeChassis2_D_Rq
      DataMapping_043: ecu-extract-reference=COMPOSITIONTYPE.Ford_FileVersionNumber.Ford_FileVersionNumber
      DataMapping_044: ecu-extract-reference=COMPOSITIONTYPE.Ford_LatCtlPath_An_Actl.Ford_LatCtlPath_An_Actl
      DataMapping_045: ecu-extract-reference=COMPOSITIONTYPE.Ford_TrlrLampCnnct_B_Actl.Ford_TrlrLampCnnct_B_Actl
      DataMapping_046: ecu-extract-reference=COMPOSITIONTYPE.Ford_WhlFr_W_Meas.Ford_WhlFr_W_Meas
      DataMapping_047: ecu-extract-reference=COMPOSITIONTYPE.Ford_WhlRotatFl_No_Cnt.Ford_WhlRotatFl_No_Cnt
      DataMapping_048: ecu-extract-reference=COMPOSITIONTYPE.Ford_Outside_Air_Temp_Stat.Ford_Outside_Air_Temp_Stat
      DataMapping_049: ecu-extract-reference=COMPOSITIONTYPE.Ford_VehVertComp_A_Actl.Ford_VehVertComp_A_Actl
      DataMapping_050: ecu-extract-reference=COMPOSITIONTYPE.Ford_TrlrAidEnbl_D2_Rq.Ford_TrlrAidEnbl_D2_Rq
      DataMapping_051: ecu-extract-reference=COMPOSITIONTYPE.Ford_WhlRotatFr_No_Cnt.Ford_WhlRotatFr_No_Cnt
      DataMapping_052: ecu-extract-reference=COMPOSITIONTYPE.Ford_TurnLghtSwtch_D_Stat.Ford_TurnLghtSwtch_D_Stat
      DataMapping_053: ecu-extract-reference=COMPOSITIONTYPE.Ford_CmbbObjRelLat_V_Actl.Ford_CmbbObjRelLat_V_Actl
      DataMapping_054: ecu-extract-reference=COMPOSITIONTYPE.Ford_TrlrIdType_D_Stat.Ford_TrlrIdType_D_Stat
      DataMapping_055: ecu-extract-reference=COMPOSITIONTYPE.Ford_ApedPos_Pc_ActlArb.Ford_ApedPos_Pc_ActlArb
      DataMapping_056: ecu-extract-reference=COMPOSITIONTYPE.Ford_StePinOffst_An_Est.Ford_StePinOffst_An_Est
      DataMapping_057: ecu-extract-reference=COMPOSITIONTYPE.Ford_LsmcBrkDecelEnbl_D_Rq.Ford_LsmcBrkDecelEnbl_D_Rq
      DataMapping_058: ecu-extract-reference=COMPOSITIONTYPE.Ford_TrlrHitchYaw_An_Actl.Ford_TrlrHitchYaw_An_Actl
      DataMapping_059: ecu-extract-reference=COMPOSITIONTYPE.Ford_StePinOffst_D_Stat.Ford_StePinOffst_D_Stat
      DataMapping_060: ecu-extract-reference=COMPOSITIONTYPE.Ford_CmbbBrkDis_B_Actl.Ford_CmbbBrkDis_B_Actl
      DataMapping_061: ecu-extract-reference=COMPOSITIONTYPE.Ford_TrlrAidSetup_D2_Rq.Ford_TrlrAidSetup_D2_Rq
      DataMapping_062: ecu-extract-reference=COMPOSITIONTYPE.Ford_Veh_V_ActlEng.Ford_Veh_V_ActlEng
      DataMapping_063: ecu-extract-reference=COMPOSITIONTYPE.Ford_YawStabilityIndex.Ford_YawStabilityIndex
      DataMapping_064: ecu-extract-reference=COMPOSITIONTYPE.Ford_TrlrTrgtAcquire_D_Stat.Ford_TrlrTrgtAcquire_D_Stat
      DataMapping_065: ecu-extract-reference=COMPOSITIONTYPE.Ford_CmbbObjDistLat_L_Actl.Ford_CmbbObjDistLat_L_Actl
      DataMapping_066: ecu-extract-reference=COMPOSITIONTYPE.Ford_TrlrId_No_Actl.Ford_TrlrId_No_Actl
      DataMapping_067: ecu-extract-reference=COMPOSITIONTYPE.Ford_TrlrYaw_W_Actl.Ford_TrlrYaw_W_Actl
      DataMapping_068: ecu-extract-reference=COMPOSITIONTYPE.Ford_BattULo_U_Actl.Ford_BattULo_U_Actl
      DataMapping_069: ecu-extract-reference=COMPOSITIONTYPE.Ford_DeliverySubProjectNumber.Ford_DeliverySubProjectNumber
      DataMapping_070: ecu-extract-reference=COMPOSITIONTYPE.Ford_TrlrBrkActCnnct_B_Actl.Ford_TrlrBrkActCnnct_B_Actl
      DataMapping_071: ecu-extract-reference=COMPOSITIONTYPE.Ford_FileVersionYear.Ford_FileVersionYear
      DataMapping_072: ecu-extract-reference=COMPOSITIONTYPE.Ford_FileVersionMonth.Ford_FileVersionMonth
      DataMapping_073: ecu-extract-reference=COMPOSITIONTYPE.Ford_EsaEnbl_D2_Rq.Ford_EsaEnbl_D2_Rq
      DataMapping_074: ecu-extract-reference=COMPOSITIONTYPE.Ford_StePinOffst_No_Cnt.Ford_StePinOffst_No_Cnt
      DataMapping_075: ecu-extract-reference=COMPOSITIONTYPE.Ford_TrlrAidTrgtId_No_Rq.Ford_TrlrAidTrgtId_No_Rq
      DataMapping_076: ecu-extract-reference=COMPOSITIONTYPE.Ford_GearRvrse_D_Actl.Ford_GearRvrse_D_Actl
      DataMapping_077: ecu-extract-reference=COMPOSITIONTYPE.Ford_TrlrAid_An3_Actl.Ford_TrlrAid_An3_Actl
      DataMapping_078: ecu-extract-reference=COMPOSITIONTYPE.Ford_LdwActvStats_D_Req.Ford_LdwActvStats_D_Req
      DataMapping_079: ecu-extract-reference=COMPOSITIONTYPE.Ford_LsmcBrk_Tq_Rq.Ford_LsmcBrk_Tq_Rq
      DataMapping_080: ecu-extract-reference=COMPOSITIONTYPE.Ford_VehVActlEng_No_Cs.Ford_VehVActlEng_No_Cs
      DataMapping_081: ecu-extract-reference=COMPOSITIONTYPE.Ford_LaActDeny_B_Actl.Ford_LaActDeny_B_Actl
      DataMapping_082: ecu-extract-reference=COMPOSITIONTYPE.Ford_VehVActlEng_D_Qf.Ford_VehVActlEng_D_Qf
      DataMapping_083: ecu-extract-reference=COMPOSITIONTYPE.Ford_TrnRng_D_Rq.Ford_TrnRng_D_Rq
      DataMapping_084: ecu-extract-reference=COMPOSITIONTYPE.Ford_TrlrAnOffstDir_D_Mem.Ford_TrlrAnOffstDir_D_Mem
      DataMapping_085: ecu-extract-reference=COMPOSITIONTYPE.Ford_WhlRotatRr_No_Cnt.Ford_WhlRotatRr_No_Cnt
      DataMapping_086: ecu-extract-reference=COMPOSITIONTYPE.Ford_GearLvrPos_D_Actl.Ford_GearLvrPos_D_Actl
      DataMapping_087: ecu-extract-reference=COMPOSITIONTYPE.Ford_TrlrYawWActl_D_Qf.Ford_TrlrYawWActl_D_Qf
      DataMapping_088: ecu-extract-reference=COMPOSITIONTYPE.Ford_TrlrRvrse_D_Stat.Ford_TrlrRvrse_D_Stat
      DataMapping_089: ecu-extract-reference=COMPOSITIONTYPE.Ford_LatCtlCurv_No_Actl.Ford_LatCtlCurv_No_Actl
      DataMapping_090: ecu-extract-reference=COMPOSITIONTYPE.Ford_TrlrAn_An_WarnCalc.Ford_TrlrAn_An_WarnCalc
      DataMapping_091: ecu-extract-reference=COMPOSITIONTYPE.Ford_StePinOffst_No_Cs.Ford_StePinOffst_No_Cs
      DataMapping_092: ecu-extract-reference=COMPOSITIONTYPE.Ford_BPedDrvAppl_D_QF.Ford_BPedDrvAppl_D_QF
      DataMapping_093: ecu-extract-reference=COMPOSITIONTYPE.Ford_DeliverySipNumber.Ford_DeliverySipNumber
      DataMapping_094: ecu-extract-reference=COMPOSITIONTYPE.Ford_LatCtlCurv_NoRate_Actl.Ford_LatCtlCurv_NoRate_Actl
      DataMapping_095: ecu-extract-reference=COMPOSITIONTYPE.Ford_LatCtlRng_L_Max.Ford_LatCtlRng_L_Max
      DataMapping_096: ecu-extract-reference=COMPOSITIONTYPE.Ford_TrlrRvrseCancl_B_Rq.Ford_TrlrRvrseCancl_B_Rq
      DataMapping_098: ecu-extract-reference=COMPOSITIONTYPE.Ford_LaActAvail_D_Actl.Ford_LaActAvail_D_Actl
      DataMapping_099: ecu-extract-reference=COMPOSITIONTYPE.Ford_TrlrAidSwtch_D_RqDrv.Ford_TrlrAidSwtch_D_RqDrv
      DataMapping_100: ecu-extract-reference=COMPOSITIONTYPE.Ford_TrlrRvrseMsgTxt_D2_Rq.Ford_TrlrRvrseMsgTxt_D2_Rq
      DataMapping_101: ecu-extract-reference=COMPOSITIONTYPE.Ford_VehLatComp_A_Actl.Ford_VehLatComp_A_Actl
      DataMapping_102: ecu-extract-reference=COMPOSITIONTYPE.Ford_DrvSte_D_Stat.Ford_DrvSte_D_Stat
      DataMapping_103: ecu-extract-reference=COMPOSITIONTYPE.Ford_TrlrSnsId_No_Actl.Ford_TrlrSnsId_No_Actl
      DataMapping_104: ecu-extract-reference=COMPOSITIONTYPE.Ford_TrlrAidEnbl_D2_Stat.Ford_TrlrAidEnbl_D2_Stat
      DataMapping_105: ecu-extract-reference=COMPOSITIONTYPE.Ford_GearPos_D_Actl.Ford_GearPos_D_Actl
      DataMapping_106: ecu-extract-reference=COMPOSITIONTYPE.Ford_VehYawComp_W_Actl.Ford_VehYawComp_W_Actl
      DataMapping_107: ecu-extract-reference=COMPOSITIONTYPE.Ford_VehicleGGCCData.Ford_VehicleGGCCData
      DataMapping_108: ecu-extract-reference=COMPOSITIONTYPE.Ford_LkaDrvOvrrd_D_Rq.Ford_LkaDrvOvrrd_D_Rq
      DataMapping_109: ecu-extract-reference=COMPOSITIONTYPE.Ford_TrlrHitYaw_AnRate_Actl.Ford_TrlrHitYaw_AnRate_Actl
      DataMapping_110: ecu-extract-reference=COMPOSITIONTYPE.Ford_CmbbDeny_B_ActlBrk.Ford_CmbbDeny_B_ActlBrk
      DataMapping_111: ecu-extract-reference=COMPOSITIONTYPE.Ford_OdometerMasterValue.Ford_OdometerMasterValue
      DataMapping_112: ecu-extract-reference=COMPOSITIONTYPE.Ford_DrvSte_Tq_Rq.Ford_DrvSte_Tq_Rq
      DataMapping_113: ecu-extract-reference=COMPOSITIONTYPE.Ford_WhlFl_W_Meas.Ford_WhlFl_W_Meas
      DataMapping_114: ecu-extract-reference=COMPOSITIONTYPE.Ford_TrlrAidTrgtId_No_Actl.Ford_TrlrAidTrgtId_No_Actl
      DataMapping_115: ecu-extract-reference=COMPOSITIONTYPE.Ford_HandsOffCnfm_B_Rq.Ford_HandsOffCnfm_B_Rq
      DataMapping_116: ecu-extract-reference=COMPOSITIONTYPE.Ford_TrlrAid_D2_Stat.Ford_TrlrAid_D2_Stat
      DataMapping_117: ecu-extract-reference=COMPOSITIONTYPE.Ford_CmbbObjColl_T_Actl.Ford_CmbbObjColl_T_Actl
      DataMapping_118: ecu-extract-reference=COMPOSITIONTYPE.Ford_VehLongComp_A_Actl.Ford_VehLongComp_A_Actl
      DataMapping_119: ecu-extract-reference=COMPOSITIONTYPE.Ford_TrlrHitchYaw_D_Stat.Ford_TrlrHitchYaw_D_Stat
      DataMapping_120: ecu-extract-reference=COMPOSITIONTYPE.Ford_TrlrAidCtl_U_RqDrv.Ford_TrlrAidCtl_U_RqDrv
      DataMapping_121: ecu-extract-reference=COMPOSITIONTYPE.Ford_VehOverGnd_V_Est.Ford_VehOverGnd_V_Est
      DataMapping_122: ecu-extract-reference=COMPOSITIONTYPE.Ford_WhlRotatRl_No_Cnt.Ford_WhlRotatRl_No_Cnt
      DataMapping_123: ecu-extract-reference=COMPOSITIONTYPE.Ford_EPASExtAngleStatReq.Ford_EPASExtAngleStatReq
      DataMapping_124: ecu-extract-reference=COMPOSITIONTYPE.Ford_WhlRl_W_Meas.Ford_WhlRl_W_Meas
      DataMapping_125: ecu-extract-reference=COMPOSITIONTYPE.Ford_WhlDirRr_D_Actl.Ford_WhlDirRr_D_Actl
      DataMapping_126: ecu-extract-reference=COMPOSITIONTYPE.Ford_TrlrAn_An_MxCalc.Ford_TrlrAn_An_MxCalc
      DataMapping_127: ecu-extract-reference=COMPOSITIONTYPE.Ford_EsaOn_B_Rq.Ford_EsaOn_B_Rq
      DataMapping_128: ecu-extract-reference=COMPOSITIONTYPE.Ford_ExtSteeringAngleReq2.Ford_ExtSteeringAngleReq2
      DataMapping_129: ecu-extract-reference=COMPOSITIONTYPE.Ford_WhlDirRl_D_Actl.Ford_WhlDirRl_D_Actl
      DataMapping_130: ecu-extract-reference=COMPOSITIONTYPE.Ford_VehVTrlrAid_B_Avail.Ford_VehVTrlrAid_B_Avail
      DataMapping_131: ecu-extract-reference=COMPOSITIONTYPE.Ford_LatCtlRampType_D_Rq.Ford_LatCtlRampType_D_Rq
      DataMapping_132: ecu-extract-reference=COMPOSITIONTYPE.Ford_AbsActv_B_Actl.Ford_AbsActv_B_Actl
      DataMapping_133: ecu-extract-reference=COMPOSITIONTYPE.Ford_CmbbObjConfdnc_D_Stat.Ford_CmbbObjConfdnc_D_Stat
      DataMapping_134: ecu-extract-reference=COMPOSITIONTYPE.Ford_EngAout_N_Actl.Ford_EngAout_N_Actl
      DataMapping_135: ecu-extract-reference=COMPOSITIONTYPE.Ford_LatCtlPathOffst_L_Actl.Ford_LatCtlPathOffst_L_Actl
      DataMapping_136: ecu-extract-reference=COMPOSITIONTYPE.Ford_DeliveryNumber.Ford_DeliveryNumber
      DataMapping_137: ecu-extract-reference=COMPOSITIONTYPE.Ford_LifeCycMde_D_Actl.Ford_LifeCycMde_D_Actl
      DataMapping_138: ecu-extract-reference=COMPOSITIONTYPE.Ford_SteWhlRelCalib_An_Sns.Ford_SteWhlRelCalib_An_Sns
      DataMapping_139: ecu-extract-reference=COMPOSITIONTYPE.Ford_BpedDrvAppl_D_Actl.Ford_BpedDrvAppl_D_Actl
      DataMapping_140: ecu-extract-reference=COMPOSITIONTYPE.Ford_LaRefAng_No_Req.Ford_LaRefAng_No_Req
      DataMapping_141: ecu-extract-reference=COMPOSITIONTYPE.Ford_TrlrAn_An_TrgtCalc.Ford_TrlrAn_An_TrgtCalc
      DataMapping_142: ecu-extract-reference=COMPOSITIONTYPE.Ford_StabCtlBrkActv_B_Actl.Ford_StabCtlBrkActv_B_Actl
      DataMapping_143: ecu-extract-reference=COMPOSITIONTYPE.Ford_TrlrAidTrlrId_No_Rq.Ford_TrlrAidTrlrId_No_Rq
      DataMapping_144: ecu-extract-reference=COMPOSITIONTYPE.Ford_TrlrAnOffst_An2_Calc.Ford_TrlrAnOffst_An2_Calc
      DataMapping_145: ecu-extract-reference=COMPOSITIONTYPE.Ford_WhlDirFl_D_Actl.Ford_WhlDirFl_D_Actl
      DataMapping_146: ecu-extract-reference=COMPOSITIONTYPE.Ford_LaCurvature_No_Calc.Ford_LaCurvature_No_Calc
      DataMapping_147: ecu-extract-reference=COMPOSITIONTYPE.Ford_VehVActlEng_No_Cnt.Ford_VehVActlEng_No_Cnt
      DataMapping_148: ecu-extract-reference=COMPOSITIONTYPE.Ford_DeliveryIdle.Ford_DeliveryIdle
      DataMapping_149: ecu-extract-reference=COMPOSITIONTYPE.Ford_ApaSys_D_Stat.Ford_ApaSys_D_Stat
      DataMapping_150: ecu-extract-reference=COMPOSITIONTYPE.Ford_LdwActvIntns_D_Req.Ford_LdwActvIntns_D_Req
      DataMapping_151: ecu-extract-reference=COMPOSITIONTYPE.Ford_TrlrAidMde_D_Rq.Ford_TrlrAidMde_D_Rq
      DataMapping_152: ecu-extract-reference=COMPOSITIONTYPE.Ford_FileVersionDay.Ford_FileVersionDay
      DataMapping_153: ecu-extract-reference=COMPOSITIONTYPE.Ford_HitchToVehAxle_L_Calc.Ford_HitchToVehAxle_L_Calc
      DataMapping_154: ecu-extract-reference=COMPOSITIONTYPE.Ford_CmbbObjClass_D_Stat.Ford_CmbbObjClass_D_Stat
      DataMapping_155: ecu-extract-reference=COMPOSITIONTYPE.Ford_WhlDirFr_D_Actl.Ford_WhlDirFr_D_Actl
      DataMapping_156: ecu-extract-reference=COMPOSITIONTYPE.Ford_LaRampType_B_Req.Ford_LaRampType_B_Req
      DataMapping_157: ecu-extract-reference=COMPOSITIONTYPE.Ford_LkaActvStats_D2_Req.Ford_LkaActvStats_D2_Req
      DataMapping_158: ecu-extract-reference=COMPOSITIONTYPE.Ford_TrlrAid_AnRate2_Actl.Ford_TrlrAid_AnRate2_Actl
      DataMapping_159: ecu-extract-reference=COMPOSITIONTYPE.Ford_HitchToTrlrAxle_L_Calc.Ford_HitchToTrlrAxle_L_Calc
      DataMapping_160: ecu-extract-reference=COMPOSITIONTYPE.Ford_WhlRr_W_Meas.Ford_WhlRr_W_Meas
      DataMapping_161: ecu-extract-reference=COMPOSITIONTYPE.Ford_TrlrRvrseEnbl_D2_Stat.Ford_TrlrRvrseEnbl_D2_Stat
      DataMapping_162: ecu-extract-reference=COMPOSITIONTYPE.Ford_LatCtl_D_Rq.Ford_LatCtl_D_Rq
      DataMapping_163: ecu-extract-reference=COMPOSITIONTYPE.Ford_CmbbObjRelLong_V_Actl.Ford_CmbbObjRelLong_V_Actl
      DataMapping_164: ecu-extract-reference=COMPOSITIONTYPE.Ford_TjaHandsOnCnfdnc_B_Est.Ford_TjaHandsOnCnfdnc_B_Est
      DataMapping_165: ecu-extract-reference=COMPOSITIONTYPE.Ford_ApedPosPcActl_D_Qf.Ford_ApedPosPcActl_D_Qf
      DataMapping_166: ecu-extract-reference=COMPOSITIONTYPE.Ford_LatCtlPrecision_D_Rq.Ford_LatCtlPrecision_D_Rq
      DataMapping_167: ecu-extract-reference=COMPOSITIONTYPE.Ford_TrlrAxleToBmpr_L_Actl.Ford_TrlrAxleToBmpr_L_Actl
      ComponentPrototype_130: upstream-reference=ECU_Composition.HwTq9Meas, ecu-extract-reference=COMPOSITIONTYPE.HwTq9Meas
      ComponentPrototype_131: upstream-reference=ECU_Composition.HwTq10Meas, ecu-extract-reference=COMPOSITIONTYPE.HwTq10Meas
      AssemblySwConnector_990: ecu-extract-reference=CDD_GtmCfgAndUseDGtmGetSent1DataDHwTq10MeasDGtmGetSent1Data
      AssemblySwConnector_991: ecu-extract-reference=CDD_GtmCfgAndUseDGtmGetSent0DataDHwTq9MeasDGtmGetSent0Data
      AssemblySwConnector_992: ecu-extract-reference=DiagcMgrProxyAppl10DGetNtcQlfrSts10DHwTq10MeasDGetNtcQlfrSts
      AssemblySwConnector_993: ecu-extract-reference=DiagcMgrProxyAppl10DSetNtcSts10DHwTq10MeasDSetNtcSts
      AssemblySwConnector_994: ecu-extract-reference=DiagcMgrProxyAppl10DSetNtcStsAndSnpshtData10DHwTq10MeasDSetNtcStsAndSnpshtData
      AssemblySwConnector_995: ecu-extract-reference=DiagcMgrProxyAppl10DGetNtcQlfrSts10DHwTq9MeasDGetNtcQlfrSts
      AssemblySwConnector_996: ecu-extract-reference=DiagcMgrProxyAppl10DSetNtcSts10DHwTq9MeasDSetNtcSts
      AssemblySwConnector_997: ecu-extract-reference=DiagcMgrProxyAppl10DSetNtcStsAndSnpshtData10DHwTq9MeasDSetNtcStsAndSnpshtData
      AssemblySwConnector_1762: ecu-extract-reference=HwTq10MeasDHwTq10DHwTqArbnDHwTqD
      AssemblySwConnector_1763: ecu-extract-reference=HwTq10MeasDHwTq10QlfrDHwTqArbnDHwTqDQlfr
      AssemblySwConnector_1809: ecu-extract-reference=HwTq10MeasDHwTq10RollgCntrDHwTqArbnDHwTqDRollgCntr
      AssemblySwConnector_1810: ecu-extract-reference=HwTq10MeasDHwTq10DHwTqCorrlnDHwTqD
      AssemblySwConnector_1811: ecu-extract-reference=HwTq10MeasDHwTq10QlfrDHwTqCorrlnDHwTqDQlfr
      AssemblySwConnector_1812: ecu-extract-reference=HwTq10MeasDHwTq10RollgCntrDHwTqCorrlnDHwTqDRollgCntr
      AssemblySwConnector_1814: ecu-extract-reference=HwTq9MeasDHwTq9DHwTqArbnDHwTqC
      AssemblySwConnector_1815: ecu-extract-reference=HwTq9MeasDHwTq9QlfrDHwTqArbnDHwTqCQlfr
      AssemblySwConnector_1816: ecu-extract-reference=HwTq9MeasDHwTq9RollgCntrDHwTqArbnDHwTqCRollgCntr
      AssemblySwConnector_1817: ecu-extract-reference=HwTq9MeasDHwTq9DHwTqCorrlnDHwTqC
      AssemblySwConnector_1818: ecu-extract-reference=HwTq9MeasDHwTq9QlfrDHwTqCorrlnDHwTqCQlfr
      AssemblySwConnector_1819: ecu-extract-reference=HwTq9MeasDHwTq9RollgCntrDHwTqCorrlnDHwTqCRollgCntr
      AssemblySwConnector_1820: ecu-extract-reference=PolarityCfgDHwTq3PolarityDHwTq10MeasDHwTq10Polarity
      AssemblySwConnector_1821: ecu-extract-reference=PolarityCfgDHwTq2PolarityDHwTq9MeasDHwTq9Polarity
      AssemblySwConnector_1813: ecu-extract-reference=CDD_HwTq1MeasDHwTq1DCmnMfgSrvDHwTq1
      AssemblySwConnector_1822: ecu-extract-reference=CDD_HwTq1MeasDHwTq1MeasHwTq1AutTrimDCmnMfgSrvDHwTq1MeasHwTq1AutTrim
      AssemblySwConnector_1825: ecu-extract-reference=CDD_HwTq1MeasDHwTq1MeasHwTq1ClrTrimDCmnMfgSrvDHwTq1MeasHwTq1ClrTrim
      AssemblySwConnector_1827: ecu-extract-reference=CDD_HwTq1MeasDHwTq1MeasHwTq1ReadTrimDCmnMfgSrvDHwTq1MeasHwTq1ReadTrim
      AssemblySwConnector_1828: ecu-extract-reference=CDD_HwTq1MeasDHwTq1MeasHwTq1TrimPrfmdStsDCmnMfgSrvDHwTq1MeasHwTq1TrimPrfmdSts
      AssemblySwConnector_1829: ecu-extract-reference=CDD_HwTq1MeasDHwTq1MeasHwTq1WrTrimDCmnMfgSrvDHwTq1MeasHwTq1WrTrim
      AssemblySwConnector_1830: ecu-extract-reference=CDD_HwTq1MeasDRackLimrEotSig1AvlDEotLrngDHwAgEotSig1Avl
      AssemblySwConnector_1831: ecu-extract-reference=CDD_HwTq1MeasDRackLimrCcwEotSig1DEotLrngDHwAgEotSig1Ccw
      AssemblySwConnector_1832: ecu-extract-reference=CDD_HwTq1MeasDRackLimrCwEotSig1DEotLrngDHwAgEotSig1Cw
      AssemblySwConnector_1833: ecu-extract-reference=CDD_HwTq1MeasDHwTq1DHwTqArbnDHwTqB
      AssemblySwConnector_1834: ecu-extract-reference=CDD_HwTq1MeasDHwTq1QlfrDHwTqArbnDHwTqBQlfr
      AssemblySwConnector_1835: ecu-extract-reference=CDD_HwTq1MeasDHwTq1RollgCntrDHwTqArbnDHwTqBRollgCntr
      AssemblySwConnector_1836: ecu-extract-reference=CDD_HwTq1MeasDHwTq1DHwTqCorrlnDHwTqB
      AssemblySwConnector_1837: ecu-extract-reference=CDD_HwTq1MeasDHwTq1QlfrDHwTqCorrlnDHwTqBQlfr
      AssemblySwConnector_1838: ecu-extract-reference=CDD_HwTq1MeasDHwTq1RollgCntrDHwTqCorrlnDHwTqBRollgCntr
      AssemblySwConnector_1839: ecu-extract-reference=CDD_HwTq8MeasDHwTq8DCmnMfgSrvDHwTq0
      AssemblySwConnector_1840: ecu-extract-reference=CDD_HwTq8MeasDHwTq8AutTrimDCmnMfgSrvDHwTq0MeasHwTq0AutTrim
      AssemblySwConnector_1841: ecu-extract-reference=CDD_HwTq8MeasDHwTq8ClrTrimDCmnMfgSrvDHwTq0MeasHwTq0ClrTrim
      AssemblySwConnector_1842: ecu-extract-reference=CDD_HwTq8MeasDHwTq8ReadTrimDCmnMfgSrvDHwTq0MeasHwTq0ReadTrim
      AssemblySwConnector_1843: ecu-extract-reference=CDD_HwTq8MeasDHwTq8TrimPrfmdStsDCmnMfgSrvDHwTq0MeasHwTq0TrimPrfmdSts
      AssemblySwConnector_1844: ecu-extract-reference=CDD_HwTq8MeasDHwTq8WrTrimDCmnMfgSrvDHwTq0MeasHwTq0WrTrim
      AssemblySwConnector_1845: ecu-extract-reference=CDD_HwTq8MeasDRackLimrEotSig8AvlDEotLrngDHwAgEotSig0Avl
      AssemblySwConnector_1846: ecu-extract-reference=CDD_HwTq8MeasDRackLimrCcwEotSig8DEotLrngDHwAgEotSig0Ccw
      AssemblySwConnector_1847: ecu-extract-reference=CDD_HwTq8MeasDRackLimrCwEotSig8DEotLrngDHwAgEotSig0Cw
      AssemblySwConnector_1848: ecu-extract-reference=CDD_HwTq8MeasDHwTq8DHwTqArbnDHwTqA
      AssemblySwConnector_1849: ecu-extract-reference=CDD_HwTq8MeasDHwTq8QlfrDHwTqArbnDHwTqAQlfr
      AssemblySwConnector_1850: ecu-extract-reference=CDD_HwTq8MeasDHwTq8RollgCntrDHwTqArbnDHwTqARollgCntr
      AssemblySwConnector_1851: ecu-extract-reference=CDD_HwTq8MeasDHwTq8DHwTqCorrlnDHwTqA
      AssemblySwConnector_1852: ecu-extract-reference=CDD_HwTq8MeasDHwTq8QlfrDHwTqCorrlnDHwTqAQlfr
      AssemblySwConnector_1853: ecu-extract-reference=CDD_HwTq8MeasDHwTq8RollgCntrDHwTqCorrlnDHwTqARollgCntr
      AssemblySwConnector_1854: ecu-extract-reference=CDD_MotVelDMotVelCrfDImcArbnDMotVel
      AssemblySwConnector_1855: ecu-extract-reference=CDD_SyncCrcDCalc32BitCrc_u32DTunSelnMngtDCalc32BitCrc_u32
      AssemblySwConnector_1856: ecu-extract-reference=DiagcMgrDDiagcStsNonRcvrlReqDiFltPrsntDImcArbnDDiagcStsNonRcrvlReqDiFltPrsnt
      AssemblySwConnector_1857: ecu-extract-reference=DualCtrlrOutpMgrDDualEcuMotCtrlMtgtnEnaDImcArbnDDualEcuMotCtrlMtgtnEna
      AssemblySwConnector_1860: ecu-extract-reference=HwTq10MeasDHwTq10DCmnMfgSrvDHwTq3
      AssemblySwConnector_1861: ecu-extract-reference=HwTq10MeasDHwTq10MeasHwTq10AutTrimDCmnMfgSrvDHwTq3MeasHwTq3AutTrim
      AssemblySwConnector_1862: ecu-extract-reference=HwTq10MeasDHwTq10MeasHwTq10ClrTrimDCmnMfgSrvDHwTq3MeasHwTq3ClrTrim
      AssemblySwConnector_1863: ecu-extract-reference=HwTq10MeasDHwTq10MeasHwTq10ReadTrimDCmnMfgSrvDHwTq3MeasHwTq3ReadTrim
      AssemblySwConnector_1864: ecu-extract-reference=HwTq10MeasDHwTq10MeasHwTq10TrimPrfmdStsDCmnMfgSrvDHwTq3MeasHwTq3TrimPrfmdSts
      AssemblySwConnector_1865: ecu-extract-reference=HwTq10MeasDHwTq10MeasHwTq10WrTrimDCmnMfgSrvDHwTq3MeasHwTq3WrTrim
      AssemblySwConnector_1866: ecu-extract-reference=HwTq9MeasDHwTq9DCmnMfgSrvDHwTq2
      AssemblySwConnector_1867: ecu-extract-reference=HwTq9MeasDHwTq9MeasHwTq9AutTrimDCmnMfgSrvDHwTq2MeasHwTq2AutTrim
      AssemblySwConnector_1868: ecu-extract-reference=HwTq9MeasDHwTq9MeasHwTq9ClrTrimDCmnMfgSrvDHwTq2MeasHwTq2ClrTrim
      AssemblySwConnector_1869: ecu-extract-reference=HwTq9MeasDHwTq9MeasHwTq9ReadTrimDCmnMfgSrvDHwTq2MeasHwTq2ReadTrim
      AssemblySwConnector_1870: ecu-extract-reference=HwTq9MeasDHwTq9MeasHwTq9TrimPrfmdStsDCmnMfgSrvDHwTq2MeasHwTq2TrimPrfmdSts
      AssemblySwConnector_1871: ecu-extract-reference=HwTq9MeasDHwTq9MeasHwTq9WrTrimDCmnMfgSrvDHwTq2MeasHwTq2WrTrim
      AssemblySwConnector_1872: ecu-extract-reference=ImcSigArbnDHwTqImcCorrdDAssiDHwTq
      AssemblySwConnector_1873: ecu-extract-reference=ImcSigArbnDVehSpdImcCorrdDAssiDVehSpd
      AssemblySwConnector_1874: ecu-extract-reference=ImcSigArbnDHwTqImcCorrdDAssiHiFrqDHwTq
      AssemblySwConnector_1875: ecu-extract-reference=ImcSigArbnDVehSpdImcCorrdDAssiHiFrqDVehSpd
      AssemblySwConnector_1876: ecu-extract-reference=ImcSigArbnDVehSpdImcCorrdDAssiSumLimDVehSpd
      AssemblySwConnector_1877: ecu-extract-reference=ImcSigArbnDVehSpdImcCorrdDCDD_CurrMeasDVehSpd
      AssemblySwConnector_1878: ecu-extract-reference=ImcSigArbnDHwTqImcCorrdDCmnMfgSrvDHwTq
      AssemblySwConnector_1879: ecu-extract-reference=ImcSigArbnDHwTqImcCorrdDCmplncErrDHwTq
      AssemblySwConnector_1880: ecu-extract-reference=ImcSigArbnDHwTqImcCorrdDDampgDHwTq
      AssemblySwConnector_1881: ecu-extract-reference=ImcSigArbnDMotVelCrfImcCorrdDDampgDMotVelCrf
      AssemblySwConnector_1882: ecu-extract-reference=ImcSigArbnDVehSpdImcCorrdDDampgDVehSpd
      AssemblySwConnector_1883: ecu-extract-reference=ImcSigArbnDHwTqImcCorrdDDiagcMgrDHwTq
      AssemblySwConnector_1884: ecu-extract-reference=ImcSigArbnDHwTqImcCorrdDDrvrTqEstimnDHwTq
      AssemblySwConnector_1885: ecu-extract-reference=ImcSigArbnDMotVelCrfImcCorrdDDrvrTqEstimnDMotVelCrf
      AssemblySwConnector_1886: ecu-extract-reference=ImcSigArbnDVehSpdImcCorrdDDualCtrlrOutpMgrDVehSpd
      AssemblySwConnector_1887: ecu-extract-reference=ImcSigArbnDMotVelCrfImcCorrdDDutyCycThermProtnDMotVelCrf
      AssemblySwConnector_1888: ecu-extract-reference=ImcSigArbnDHwTqImcCorrdDEotLrngDHwTq
      AssemblySwConnector_1889: ecu-extract-reference=ImcSigArbnDMotVelCrfImcCorrdDEotLrngDMotVelCrf
      AssemblySwConnector_1890: ecu-extract-reference=ImcSigArbnDHwTqImcCorrdDEotProtnDHwTq
      AssemblySwConnector_1891: ecu-extract-reference=ImcSigArbnDMotVelCrfImcCorrdDEotProtnDMotVelCrf
      AssemblySwConnector_1892: ecu-extract-reference=ImcSigArbnDVehSpdImcCorrdDEotProtnDVehSpd
      AssemblySwConnector_1893: ecu-extract-reference=ImcSigArbnDMotVelCrfImcCorrdDEotProtnFwlDMotVelCrf
      AssemblySwConnector_1894: ecu-extract-reference=ImcSigArbnDVehSpdImcCorrdDEotProtnFwlDVehSpd
      AssemblySwConnector_1895: ecu-extract-reference=ImcSigArbnDMotVelCrfImcCorrdDHiLoadStallLimrDMotVelCrf
      AssemblySwConnector_1896: ecu-extract-reference=ImcSigArbnDHwTqImcCorrdDHwAgSnsrlsDHwTq
      AssemblySwConnector_1897: ecu-extract-reference=ImcSigArbnDMotVelCrfImcCorrdDHwAgSnsrlsDMotVelCrf
      AssemblySwConnector_1898: ecu-extract-reference=ImcSigArbnDVehSpdImcCorrdDHwAgSnsrlsDVehSpd
      AssemblySwConnector_1900: ecu-extract-reference=ImcSigArbnDHwTqImcCorrdDHwAgSysArbnDHwTq
      AssemblySwConnector_1901: ecu-extract-reference=ImcSigArbnDMotVelCrfImcCorrdDHwAgSysArbnDMotVelCrf
      AssemblySwConnector_1902: ecu-extract-reference=ImcSigArbnDHwTqImcCorrdDHysCmpDHwTq
      AssemblySwConnector_1903: ecu-extract-reference=ImcSigArbnDVehSpdImcCorrdDHysCmpDVehSpd
      AssemblySwConnector_1904: ecu-extract-reference=ImcSigArbnDHwTqImcCorrdDInertiaCmpVelDHwTq
      AssemblySwConnector_1905: ecu-extract-reference=ImcSigArbnDMotVelCrfImcCorrdDInertiaCmpVelDMotVelCrf
      AssemblySwConnector_1906: ecu-extract-reference=ImcSigArbnDVehSpdImcCorrdDInertiaCmpVelDVehSpd
      AssemblySwConnector_1907: ecu-extract-reference=ImcSigArbnDVehSpdImcCorrdDLimrCdngDVehSpd
      AssemblySwConnector_1908: ecu-extract-reference=ImcSigArbnDVehSpdImcCorrdDMotCurrRegCfgDVehSpd
      AssemblySwConnector_1909: ecu-extract-reference=ImcSigArbnDMotVelCrfImcCorrdDMotTqTranlDampgDMotVelCrf
      AssemblySwConnector_1910: ecu-extract-reference=ImcSigArbnDVehSpdImcCorrdDMotTqTranlDampgDVehSpd
      AssemblySwConnector_1911: ecu-extract-reference=ImcSigArbnDMotVelCrfImcCorrdDMotVelCtrlDMotVelCrf
      AssemblySwConnector_1912: ecu-extract-reference=ImcSigArbnDHwTqImcCorrdDPosnTrakgServoDHwTq
      AssemblySwConnector_1913: ecu-extract-reference=ImcSigArbnDMotVelCrfImcCorrdDPosnTrakgServoDMotVelCrf
      AssemblySwConnector_1914: ecu-extract-reference=ImcSigArbnDVehSpdImcCorrdDPosnTrakgServoDVehSpd
      AssemblySwConnector_1915: ecu-extract-reference=ImcSigArbnDHwTqImcCorrdDRtnDHwTq
      AssemblySwConnector_1916: ecu-extract-reference=ImcSigArbnDVehSpdImcCorrdDRtnDVehSpd
      AssemblySwConnector_1917: ecu-extract-reference=ImcSigArbnDVehSpdImcCorrdDRtnPahFwlDVehSpd
      AssemblySwConnector_1918: ecu-extract-reference=ImcSigArbnDHwTqImcCorrdDStabyCmpDHwTq
      AssemblySwConnector_1919: ecu-extract-reference=ImcSigArbnDVehSpdImcCorrdDStabyCmpDVehSpd
      AssemblySwConnector_1920: ecu-extract-reference=ImcSigArbnDHwTqImcCorrdDSysFricLrngDHwTq
      AssemblySwConnector_1921: ecu-extract-reference=ImcSigArbnDVehSpdImcCorrdDSysFricLrngDVehSpd
      AssemblySwConnector_1922: ecu-extract-reference=ImcSigArbnDMotVelCrfImcCorrdDTqLoaDMotVelCrf
      AssemblySwConnector_1923: ecu-extract-reference=ImcSigArbnDVehSpdImcCorrdDTqLoaDVehSpd
      AssemblySwConnector_1924: ecu-extract-reference=ImcSigArbnDHwTqImcCorrdDTunSelnAuthyDHwTq
      AssemblySwConnector_1925: ecu-extract-reference=ImcSigArbnDVehSpdImcCorrdDTunSelnAuthyDVehSpd
      AssemblySwConnector_1926: ecu-extract-reference=ImcSigArbnDVehSpdImcCorrdDVehSpdLimrDVehSpd
      AssemblySwConnector_1927: ecu-extract-reference=PolarityCfgDHwTq1PolarityDCDD_HwTq1MeasDHwTq1Polarity
      AssemblySwConnector_1928: ecu-extract-reference=PolarityCfgDHwTq0PolarityDCDD_HwTq8MeasDHwTq8Polarity
      AssemblySwConnector_1929: ecu-extract-reference=PosnTrakgServoDPosnServoIntgtrStDImcArbnDPosnServoIntgtrSt
      AssemblySwConnector_1931: ecu-extract-reference=SwpDHwTqSwpDImcArbnDHwTq
      AssemblySwConnector_1932: ecu-extract-reference=SwpDHwTqSwpDImcSigArbnDHwTq
