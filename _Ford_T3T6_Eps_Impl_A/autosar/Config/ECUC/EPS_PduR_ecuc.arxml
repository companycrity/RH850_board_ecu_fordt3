AUTOSAR XML (schema 4-2-1)
package /ActiveEcuC
  module config PduR: implementation-config-variant=VARIANT-PRE-COMPILE, module-description=PduR_Impl
    PduRGeneral: PduRDevErrorDetect=true, PduRVersionInfoApi=false, PduRMetaDataSupport=false, PduRPduCallback=false, PduRSwitching=false
      PduRGeneration:
        PduROutOfBoundsWriteProtectionStrategy = NONE
        PduROutOfBoundsWriteSanitizer = false
        PduROutOfBoundsReadSanitizer = false
        PduRNumericalDataTypeMinimizationStrategy = WITH_CAST
        PduRReduceConstantData2Define = false
        PduRBoolDataInArrayOfStructStrategy = BITMASKING
        PduRDeduplicateIndirectedData = true
        PduRDataDeduplicationStrategy = WITH_CAST
        PduRReduceBoolDataByNegationThreshold = 2
        PduRReduceBoolDataByNumericalComparisonThreshold = 2
        PduRReduceBoolDataByNumericalRelationThreshold = 2
        PduRReduceBoolDataByNumericalOperandStrategy = WITH_ANY_VALUE
        PduRReduceNumericalDataByOffsetThreshold = 2
        PduRReduceNumericalDataByArraySubtractionThreshold = 2
        PduRReduceDataByStreaming = false
        PduRShortSymbols = false
        PduRInterfacesForDeactivatedData = false
        PduRReferringKeysInComments = false
    PduRRoutingTables: PduRConfigurationId=0
      PduRRoutingTable
        50 x PduRRoutingPath:
          Can_PT_Steering_Data_FD1_3290b631: PduRRoutingPathCommunicationType=COMMUNICATION_INTERFACE
            SRC_Can_PT_Steering_Data_FD1_3290b631 (PduRSrcPdu):
              PduRSourcePduHandleId = 26
              PduRSrcPduDirection = RECEIVE
              PduRSrcPduRef = PT_Steering_Data_FD1_PP_Steering_Data_FD1_Rx_3290b631_3cf8f7d5
              PduRSrcPduPduRBswModulesRef = CanIf
            DST_Can_PT_Steering_Data_FD1_3290b631 (PduRDestPdu):
              PduRDestPduHandleId = 26
              PduRDestPduDirection = RECEIVE
              PduRDestPduRoutingType = API_FORWARDING
              PduRTransmissionConfirmation = false
              PduRDestPduRef = PT_Steering_Data_FD1_PP_Steering_Data_FD1_Rx_3290b631_3cf8f7d5
              PduRDestPduPduRBswModulesRef = Com
          Can_PT_TrailerAid_Data2_FD1_3290b631: PduRRoutingPathCommunicationType=COMMUNICATION_INTERFACE
            DST_Can_PT_TrailerAid_Data2_FD1_3290b631 (PduRDestPdu):
              PduRDestPduHandleId = 3
              PduRDestPduDirection = TRANSMIT
              PduRDestPduRoutingType = API_FORWARDING
              PduRTransmissionConfirmation = true
              PduRDestPduDataProvision = PDUR_DIRECT
              PduRDestPduRef = PT_TrailerAid_Data2_FD1_PP_TrailerAid_Data2_FD1_Tx_3290b631_3cf8f7d5
              PduRDestPduPduRBswModulesRef = CanIf
            SRC_Can_PT_TrailerAid_Data2_FD1_3290b631 (PduRSrcPdu):
              PduRSourcePduHandleId = 5
              PduRSrcPduDirection = TRANSMIT
              PduRSrcPduRef = PT_TrailerAid_Data2_FD1_PP_TrailerAid_Data2_FD1_Tx_3290b631_3cf8f7d5
              PduRSrcPduPduRBswModulesRef = Com
          Can_PT_BrakeSnData_6_FD1_3290b631: PduRRoutingPathCommunicationType=COMMUNICATION_INTERFACE
            SRC_Can_PT_BrakeSnData_6_FD1_3290b631 (PduRSrcPdu):
              PduRSourcePduHandleId = 9
              PduRSrcPduDirection = RECEIVE
              PduRSrcPduRef = PT_BrakeSnData_6_FD1_PP_BrakeSnData_6_FD1_Rx_3290b631_3cf8f7d5
              PduRSrcPduPduRBswModulesRef = CanIf
            DST_Can_PT_BrakeSnData_6_FD1_3290b631 (PduRDestPdu):
              PduRDestPduHandleId = 9
              PduRDestPduDirection = RECEIVE
              PduRDestPduRoutingType = API_FORWARDING
              PduRTransmissionConfirmation = false
              PduRDestPduRef = PT_BrakeSnData_6_FD1_PP_BrakeSnData_6_FD1_Rx_3290b631_3cf8f7d5
              PduRDestPduPduRBswModulesRef = Com
          Can_PT_WheelSpeed_FD1_3290b631: PduRRoutingPathCommunicationType=COMMUNICATION_INTERFACE
            SRC_Can_PT_WheelSpeed_FD1_3290b631 (PduRSrcPdu):
              PduRSourcePduHandleId = 38
              PduRSrcPduDirection = RECEIVE
              PduRSrcPduRef = PT_WheelSpeed_FD1_PP_WheelSpeed_FD1_Rx_3290b631_3cf8f7d5
              PduRSrcPduPduRBswModulesRef = CanIf
            DST_Can_PT_WheelSpeed_FD1_3290b631 (PduRDestPdu):
              PduRDestPduHandleId = 38
              PduRDestPduDirection = RECEIVE
              PduRDestPduRoutingType = API_FORWARDING
              PduRTransmissionConfirmation = false
              PduRDestPduRef = PT_WheelSpeed_FD1_PP_WheelSpeed_FD1_Rx_3290b631_3cf8f7d5
              PduRDestPduPduRBswModulesRef = Com
          Can_PT_TesterFunctionalReq_FD1_20_3290b631: PduRRoutingPathCommunicationType=TRANSPORT_PROTOCOL
            DST_Can_PT_TesterFunctionalReq_FD1_20_3290b631 (PduRDestPdu):
              PduRDestPduHandleId = 0
              PduRDestPduDirection = RECEIVE
              PduRDestPduRoutingType = API_FORWARDING
              PduRDestPduRef = PT_TesterFunctionalReq_FD1_20_PP_TesterFunctionalReq_FD1_Rx_20_3290b631_3cf8f7d5
              PduRDestPduPduRBswModulesRef = Dcm
            SRC_Can_PT_TesterFunctionalReq_FD1_20_3290b631 (PduRSrcPdu):
              PduRSourcePduHandleId = 0
              PduRSrcPduDirection = RECEIVE
              PduRSrcPduRef = PT_TesterFunctionalReq_FD1_20_PP_TesterFunctionalReq_FD1_Rx_20_3290b631_3cf8f7d5
              PduRSrcPduPduRBswModulesRef = CanTp
          Can_PT_Yaw_Data_FD1_3290b631: PduRRoutingPathCommunicationType=COMMUNICATION_INTERFACE
            DST_Can_PT_Yaw_Data_FD1_3290b631 (PduRDestPdu):
              PduRDestPduHandleId = 39
              PduRDestPduDirection = RECEIVE
              PduRDestPduRoutingType = API_FORWARDING
              PduRTransmissionConfirmation = false
              PduRDestPduRef = PT_Yaw_Data_FD1_PP_Yaw_Data_FD1_Rx_3290b631_3cf8f7d5
              PduRDestPduPduRBswModulesRef = Com
            SRC_Can_PT_Yaw_Data_FD1_3290b631 (PduRSrcPdu):
              PduRSourcePduHandleId = 39
              PduRSrcPduDirection = RECEIVE
              PduRSrcPduRef = PT_Yaw_Data_FD1_PP_Yaw_Data_FD1_Rx_3290b631_3cf8f7d5
              PduRSrcPduPduRBswModulesRef = CanIf
          Can_PT_Cluster_Info1_FD1_3290b631: PduRRoutingPathCommunicationType=COMMUNICATION_INTERFACE
            DST_Can_PT_Cluster_Info1_FD1_3290b631 (PduRDestPdu):
              PduRDestPduHandleId = 13
              PduRDestPduDirection = RECEIVE
              PduRDestPduRoutingType = API_FORWARDING
              PduRTransmissionConfirmation = false
              PduRDestPduRef = PT_Cluster_Info1_FD1_PP_Cluster_Info1_FD1_Rx_3290b631_3cf8f7d5
              PduRDestPduPduRBswModulesRef = Com
            SRC_Can_PT_Cluster_Info1_FD1_3290b631 (PduRSrcPdu):
              PduRSourcePduHandleId = 13
              PduRSrcPduDirection = RECEIVE
              PduRSrcPduRef = PT_Cluster_Info1_FD1_PP_Cluster_Info1_FD1_Rx_3290b631_3cf8f7d5
              PduRSrcPduPduRBswModulesRef = CanIf
          Can_PT_WheelData_FD1_3290b631: PduRRoutingPathCommunicationType=COMMUNICATION_INTERFACE
            DST_Can_PT_WheelData_FD1_3290b631 (PduRDestPdu):
              PduRDestPduHandleId = 37
              PduRDestPduDirection = RECEIVE
              PduRDestPduRoutingType = API_FORWARDING
              PduRTransmissionConfirmation = false
              PduRDestPduRef = PT_WheelData_FD1_PP_WheelData_FD1_Rx_3290b631_3cf8f7d5
              PduRDestPduPduRBswModulesRef = Com
            SRC_Can_PT_WheelData_FD1_3290b631 (PduRSrcPdu):
              PduRSourcePduHandleId = 37
              PduRSrcPduDirection = RECEIVE
              PduRSrcPduRef = PT_WheelData_FD1_PP_WheelData_FD1_Rx_3290b631_3cf8f7d5
              PduRSrcPduPduRBswModulesRef = CanIf
          Can_PT_PowertrainData_10_FD1_3290b631: PduRRoutingPathCommunicationType=COMMUNICATION_INTERFACE
            SRC_Can_PT_PowertrainData_10_FD1_3290b631 (PduRSrcPdu):
              PduRSourcePduHandleId = 24
              PduRSrcPduDirection = RECEIVE
              PduRSrcPduRef = PT_PowertrainData_10_FD1_PP_PowertrainData_10_FD1_Rx_3290b631_3cf8f7d5
              PduRSrcPduPduRBswModulesRef = CanIf
            DST_Can_PT_PowertrainData_10_FD1_3290b631 (PduRDestPdu):
              PduRDestPduHandleId = 24
              PduRDestPduDirection = RECEIVE
              PduRDestPduRoutingType = API_FORWARDING
              PduRTransmissionConfirmation = false
              PduRDestPduRef = PT_PowertrainData_10_FD1_PP_PowertrainData_10_FD1_Rx_3290b631_3cf8f7d5
              PduRDestPduPduRBswModulesRef = Com
          Can_PT_APIM_Send_Signals_2_FD1_3290b631: PduRRoutingPathCommunicationType=COMMUNICATION_INTERFACE
            SRC_Can_PT_APIM_Send_Signals_2_FD1_3290b631 (PduRSrcPdu):
              PduRSourcePduHandleId = 2
              PduRSrcPduDirection = RECEIVE
              PduRSrcPduRef = PT_APIM_Send_Signals_2_FD1_PP_APIM_Send_Signals_2_FD1_Rx_3290b631_3cf8f7d5
              PduRSrcPduPduRBswModulesRef = CanIf
            DST_Can_PT_APIM_Send_Signals_2_FD1_3290b631 (PduRDestPdu):
              PduRDestPduHandleId = 2
              PduRDestPduDirection = RECEIVE
              PduRDestPduRoutingType = API_FORWARDING
              PduRTransmissionConfirmation = false
              PduRDestPduRef = PT_APIM_Send_Signals_2_FD1_PP_APIM_Send_Signals_2_FD1_Rx_3290b631_3cf8f7d5
              PduRDestPduPduRBswModulesRef = Com
          Can_PT_TrailerInfo_FD1_3290b631: PduRRoutingPathCommunicationType=COMMUNICATION_INTERFACE
            SRC_Can_PT_TrailerInfo_FD1_3290b631 (PduRSrcPdu):
              PduRSourcePduHandleId = 34
              PduRSrcPduDirection = RECEIVE
              PduRSrcPduRef = PT_TrailerInfo_FD1_PP_TrailerInfo_FD1_Rx_3290b631_3cf8f7d5
              PduRSrcPduPduRBswModulesRef = CanIf
            DST_Can_PT_TrailerInfo_FD1_3290b631 (PduRDestPdu):
              PduRDestPduHandleId = 34
              PduRDestPduDirection = RECEIVE
              PduRDestPduRoutingType = API_FORWARDING
              PduRTransmissionConfirmation = false
              PduRDestPduRef = PT_TrailerInfo_FD1_PP_TrailerInfo_FD1_Rx_3290b631_3cf8f7d5
              PduRDestPduPduRBswModulesRef = Com
          Can_PT_EngBrakeData_FD1_3290b631: PduRRoutingPathCommunicationType=COMMUNICATION_INTERFACE
            DST_Can_PT_EngBrakeData_FD1_3290b631 (PduRDestPdu):
              PduRDestPduHandleId = 15
              PduRDestPduDirection = RECEIVE
              PduRDestPduRoutingType = API_FORWARDING
              PduRTransmissionConfirmation = false
              PduRDestPduRef = PT_EngBrakeData_FD1_PP_EngBrakeData_FD1_Rx_3290b631_3cf8f7d5
              PduRDestPduPduRBswModulesRef = Com
            SRC_Can_PT_EngBrakeData_FD1_3290b631 (PduRSrcPdu):
              PduRSourcePduHandleId = 15
              PduRSrcPduDirection = RECEIVE
              PduRSrcPduRef = PT_EngBrakeData_FD1_PP_EngBrakeData_FD1_Rx_3290b631_3cf8f7d5
              PduRSrcPduPduRBswModulesRef = CanIf
          Can_PT_ParkAid_Data_FD1_3290b631: PduRRoutingPathCommunicationType=COMMUNICATION_INTERFACE
            DST_Can_PT_ParkAid_Data_FD1_3290b631 (PduRDestPdu):
              PduRDestPduHandleId = 23
              PduRDestPduDirection = RECEIVE
              PduRDestPduRoutingType = API_FORWARDING
              PduRTransmissionConfirmation = false
              PduRDestPduRef = PT_ParkAid_Data_FD1_PP_ParkAid_Data_FD1_Rx_3290b631_3cf8f7d5
              PduRDestPduPduRBswModulesRef = Com
            SRC_Can_PT_ParkAid_Data_FD1_3290b631 (PduRSrcPdu):
              PduRSourcePduHandleId = 23
              PduRSrcPduDirection = RECEIVE
              PduRSrcPduRef = PT_ParkAid_Data_FD1_PP_ParkAid_Data_FD1_Rx_3290b631_3cf8f7d5
              PduRSrcPduPduRBswModulesRef = CanIf
          Can_PT_TrailerAid_Data_FD1_3290b631: PduRRoutingPathCommunicationType=COMMUNICATION_INTERFACE
            DST_Can_PT_TrailerAid_Data_FD1_3290b631 (PduRDestPdu):
              PduRDestPduHandleId = 28
              PduRDestPduDirection = RECEIVE
              PduRDestPduRoutingType = API_FORWARDING
              PduRTransmissionConfirmation = false
              PduRDestPduRef = PT_TrailerAid_Data_FD1_PP_TrailerAid_Data_FD1_Rx_3290b631_3cf8f7d5
              PduRDestPduPduRBswModulesRef = Com
            SRC_Can_PT_TrailerAid_Data_FD1_3290b631 (PduRSrcPdu):
              PduRSourcePduHandleId = 28
              PduRSrcPduDirection = RECEIVE
              PduRSrcPduRef = PT_TrailerAid_Data_FD1_PP_TrailerAid_Data_FD1_Rx_3290b631_3cf8f7d5
              PduRSrcPduPduRBswModulesRef = CanIf
          Can_PT_BrakeSysFeatures_FD1_3290b631: PduRRoutingPathCommunicationType=COMMUNICATION_INTERFACE
            SRC_Can_PT_BrakeSysFeatures_FD1_3290b631 (PduRSrcPdu):
              PduRSourcePduHandleId = 11
              PduRSrcPduDirection = RECEIVE
              PduRSrcPduRef = PT_BrakeSysFeatures_FD1_PP_BrakeSysFeatures_FD1_Rx_3290b631_3cf8f7d5
              PduRSrcPduPduRBswModulesRef = CanIf
            DST_Can_PT_BrakeSysFeatures_FD1_3290b631 (PduRDestPdu):
              PduRDestPduHandleId = 11
              PduRDestPduDirection = RECEIVE
              PduRDestPduRoutingType = API_FORWARDING
              PduRTransmissionConfirmation = false
              PduRDestPduRef = PT_BrakeSysFeatures_FD1_PP_BrakeSysFeatures_FD1_Rx_3290b631_3cf8f7d5
              PduRDestPduPduRBswModulesRef = Com
          Can_PT_ABS_BrkBst_Data_FD1_3290b631: PduRRoutingPathCommunicationType=COMMUNICATION_INTERFACE
            DST_Can_PT_ABS_BrkBst_Data_FD1_3290b631 (PduRDestPdu):
              PduRDestPduHandleId = 0
              PduRDestPduDirection = RECEIVE
              PduRDestPduRoutingType = API_FORWARDING
              PduRTransmissionConfirmation = false
              PduRDestPduRef = PT_ABS_BrkBst_Data_FD1_PP_ABS_BrkBst_Data_FD1_Rx_3290b631_3cf8f7d5
              PduRDestPduPduRBswModulesRef = Com
            SRC_Can_PT_ABS_BrkBst_Data_FD1_3290b631 (PduRSrcPdu):
              PduRSourcePduHandleId = 0
              PduRSrcPduDirection = RECEIVE
              PduRSrcPduRef = PT_ABS_BrkBst_Data_FD1_PP_ABS_BrkBst_Data_FD1_Rx_3290b631_3cf8f7d5
              PduRSrcPduPduRBswModulesRef = CanIf
          Can_PT_TesterFunctionalReq_FD1_3290b631: PduRRoutingPathCommunicationType=TRANSPORT_PROTOCOL
            DST_Can_PT_TesterFunctionalReq_FD1_3290b631 (PduRDestPdu):
              PduRDestPduHandleId = 1
              PduRDestPduDirection = RECEIVE
              PduRDestPduRoutingType = API_FORWARDING
              PduRDestPduRef = PT_TesterFunctionalReq_FD1_PP_TesterFunctionalReq_FD1_Rx_3290b631_3cf8f7d5
              PduRDestPduPduRBswModulesRef = Dcm
            SRC_Can_PT_TesterFunctionalReq_FD1_3290b631 (PduRSrcPdu):
              PduRSourcePduHandleId = 1
              PduRSrcPduDirection = RECEIVE
              PduRSrcPduRef = PT_TesterFunctionalReq_FD1_PP_TesterFunctionalReq_FD1_Rx_3290b631_3cf8f7d5
              PduRSrcPduPduRBswModulesRef = CanTp
          Can_PT_TrailerBrakeInfo_FD1_3290b631: PduRRoutingPathCommunicationType=COMMUNICATION_INTERFACE
            SRC_Can_PT_TrailerBrakeInfo_FD1_3290b631 (PduRSrcPdu):
              PduRSourcePduHandleId = 32
              PduRSrcPduDirection = RECEIVE
              PduRSrcPduRef = PT_TrailerBrakeInfo_FD1_PP_TrailerBrakeInfo_FD1_Rx_3290b631_3cf8f7d5
              PduRSrcPduPduRBswModulesRef = CanIf
            DST_Can_PT_TrailerBrakeInfo_FD1_3290b631 (PduRDestPdu):
              PduRDestPduHandleId = 32
              PduRDestPduDirection = RECEIVE
              PduRDestPduRoutingType = API_FORWARDING
              PduRTransmissionConfirmation = false
              PduRDestPduRef = PT_TrailerBrakeInfo_FD1_PP_TrailerBrakeInfo_FD1_Rx_3290b631_3cf8f7d5
              PduRDestPduPduRBswModulesRef = Com
          Can_PT_LateralMotionControl_FD1_3290b631: PduRRoutingPathCommunicationType=COMMUNICATION_INTERFACE
            SRC_Can_PT_LateralMotionControl_FD1_3290b631 (PduRSrcPdu):
              PduRSourcePduHandleId = 21
              PduRSrcPduDirection = RECEIVE
              PduRSrcPduRef = PT_LateralMotionControl_FD1_PP_LateralMotionControl_FD1_Rx_3290b631_3cf8f7d5
              PduRSrcPduPduRBswModulesRef = CanIf
            DST_Can_PT_LateralMotionControl_FD1_3290b631 (PduRDestPdu):
              PduRDestPduHandleId = 21
              PduRDestPduDirection = RECEIVE
              PduRDestPduRoutingType = API_FORWARDING
              PduRTransmissionConfirmation = false
              PduRDestPduRef = PT_LateralMotionControl_FD1_PP_LateralMotionControl_FD1_Rx_3290b631_3cf8f7d5
              PduRDestPduPduRBswModulesRef = Com
          Can_PT_EPAS_INFO_FD1_3290b631: PduRRoutingPathCommunicationType=COMMUNICATION_INTERFACE
            SRC_Can_PT_EPAS_INFO_FD1_3290b631 (PduRSrcPdu):
              PduRSourcePduHandleId = 0
              PduRSrcPduDirection = TRANSMIT
              PduRSrcPduRef = PT_EPAS_INFO_FD1_PP_EPAS_INFO_FD1_Tx_3290b631_3cf8f7d5
              PduRSrcPduPduRBswModulesRef = Com
            DST_Can_PT_EPAS_INFO_FD1_3290b631 (PduRDestPdu):
              PduRDestPduHandleId = 0
              PduRDestPduDirection = TRANSMIT
              PduRDestPduRoutingType = API_FORWARDING
              PduRTransmissionConfirmation = true
              PduRDestPduDataProvision = PDUR_DIRECT
              PduRDestPduRef = PT_EPAS_INFO_FD1_PP_EPAS_INFO_FD1_Tx_3290b631_3cf8f7d5
              PduRDestPduPduRBswModulesRef = CanIf
          Can_PT_Climate_Control_Data_FD1_3290b631: PduRRoutingPathCommunicationType=COMMUNICATION_INTERFACE
            SRC_Can_PT_Climate_Control_Data_FD1_3290b631 (PduRSrcPdu):
              PduRSourcePduHandleId = 12
              PduRSrcPduDirection = RECEIVE
              PduRSrcPduRef = PT_Climate_Control_Data_FD1_PP_Climate_Control_Data_FD1_Rx_3290b631_3cf8f7d5
              PduRSrcPduPduRBswModulesRef = CanIf
            DST_Can_PT_Climate_Control_Data_FD1_3290b631 (PduRDestPdu):
              PduRDestPduHandleId = 12
              PduRDestPduDirection = RECEIVE
              PduRDestPduRoutingType = API_FORWARDING
              PduRTransmissionConfirmation = false
              PduRDestPduRef = PT_Climate_Control_Data_FD1_PP_Climate_Control_Data_FD1_Rx_3290b631_3cf8f7d5
              PduRDestPduPduRBswModulesRef = Com
          Can_PT_GGCC_Config_Mgmt_ID_1_FD1_3290b631: PduRRoutingPathCommunicationType=COMMUNICATION_INTERFACE
            SRC_Can_PT_GGCC_Config_Mgmt_ID_1_FD1_3290b631 (PduRSrcPdu):
              PduRSourcePduHandleId = 18
              PduRSrcPduDirection = RECEIVE
              PduRSrcPduRef = PT_GGCC_Config_Mgmt_ID_1_FD1_PP_GGCC_Config_Mgmt_ID_1_FD1_Rx_3290b631_3cf8f7d5
              PduRSrcPduPduRBswModulesRef = CanIf
            DST_Can_PT_GGCC_Config_Mgmt_ID_1_FD1_3290b631 (PduRDestPdu):
              PduRDestPduHandleId = 18
              PduRDestPduDirection = RECEIVE
              PduRDestPduRoutingType = API_FORWARDING
              PduRTransmissionConfirmation = false
              PduRDestPduRef = PT_GGCC_Config_Mgmt_ID_1_FD1_PP_GGCC_Config_Mgmt_ID_1_FD1_Rx_3290b631_3cf8f7d5
              PduRDestPduPduRBswModulesRef = Com
          Can_PT_Body_Info_4_FD1_3290b631: PduRRoutingPathCommunicationType=COMMUNICATION_INTERFACE
            DST_Can_PT_Body_Info_4_FD1_3290b631 (PduRDestPdu):
              PduRDestPduHandleId = 5
              PduRDestPduDirection = RECEIVE
              PduRDestPduRoutingType = API_FORWARDING
              PduRTransmissionConfirmation = false
              PduRDestPduRef = PT_Body_Info_4_FD1_PP_Body_Info_4_FD1_Rx_3290b631_3cf8f7d5
              PduRDestPduPduRBswModulesRef = Com
            SRC_Can_PT_Body_Info_4_FD1_3290b631 (PduRSrcPdu):
              PduRSourcePduHandleId = 5
              PduRSrcPduDirection = RECEIVE
              PduRSrcPduRef = PT_Body_Info_4_FD1_PP_Body_Info_4_FD1_Rx_3290b631_3cf8f7d5
              PduRSrcPduPduRBswModulesRef = CanIf
          Can_PT_DesiredTorqBrk_FD1_3290b631: PduRRoutingPathCommunicationType=COMMUNICATION_INTERFACE
            DST_Can_PT_DesiredTorqBrk_FD1_3290b631 (PduRDestPdu):
              PduRDestPduHandleId = 14
              PduRDestPduDirection = RECEIVE
              PduRDestPduRoutingType = API_FORWARDING
              PduRTransmissionConfirmation = false
              PduRDestPduRef = PT_DesiredTorqBrk_FD1_PP_DesiredTorqBrk_FD1_Rx_3290b631_3cf8f7d5
              PduRDestPduPduRBswModulesRef = Com
            SRC_Can_PT_DesiredTorqBrk_FD1_3290b631 (PduRSrcPdu):
              PduRSourcePduHandleId = 14
              PduRSrcPduDirection = RECEIVE
              PduRSrcPduRef = PT_DesiredTorqBrk_FD1_PP_DesiredTorqBrk_FD1_Rx_3290b631_3cf8f7d5
              PduRSrcPduPduRBswModulesRef = CanIf
          Can_PT_TesterPhysicalReqPSCM_FD1_3290b631: PduRRoutingPathCommunicationType=TRANSPORT_PROTOCOL
            DST_Can_PT_TesterPhysicalReqPSCM_FD1_3290b631 (PduRDestPdu):
              PduRDestPduHandleId = 3
              PduRDestPduDirection = RECEIVE
              PduRDestPduRoutingType = API_FORWARDING
              PduRDestPduRef = PT_TesterPhysicalReqPSCM_FD1_PP_TesterPhysicalReqPSCM_FD1_Rx_3290b631_3cf8f7d5
              PduRDestPduPduRBswModulesRef = Dcm
            SRC_Can_PT_TesterPhysicalReqPSCM_FD1_3290b631 (PduRSrcPdu):
              PduRSourcePduHandleId = 3
              PduRSrcPduDirection = RECEIVE
              PduRSrcPduRef = PT_TesterPhysicalReqPSCM_FD1_PP_TesterPhysicalReqPSCM_FD1_Rx_3290b631_3cf8f7d5
              PduRSrcPduPduRBswModulesRef = CanTp
          Can_PT_TrailerInfo_2_FD1_3290b631: PduRRoutingPathCommunicationType=COMMUNICATION_INTERFACE
            DST_Can_PT_TrailerInfo_2_FD1_3290b631 (PduRDestPdu):
              PduRDestPduHandleId = 33
              PduRDestPduDirection = RECEIVE
              PduRDestPduRoutingType = API_FORWARDING
              PduRTransmissionConfirmation = false
              PduRDestPduRef = PT_TrailerInfo_2_FD1_PP_TrailerInfo_2_FD1_Rx_3290b631_3cf8f7d5
              PduRDestPduPduRBswModulesRef = Com
            SRC_Can_PT_TrailerInfo_2_FD1_3290b631 (PduRSrcPdu):
              PduRSourcePduHandleId = 33
              PduRSrcPduDirection = RECEIVE
              PduRSrcPduRef = PT_TrailerInfo_2_FD1_PP_TrailerInfo_2_FD1_Rx_3290b631_3cf8f7d5
              PduRSrcPduPduRBswModulesRef = CanIf
          Can_PT_VehicleOperatingModes_FD1_3290b631: PduRRoutingPathCommunicationType=COMMUNICATION_INTERFACE
            DST_Can_PT_VehicleOperatingModes_FD1_3290b631 (PduRDestPdu):
              PduRDestPduHandleId = 36
              PduRDestPduDirection = RECEIVE
              PduRDestPduRoutingType = API_FORWARDING
              PduRTransmissionConfirmation = false
              PduRDestPduRef = PT_VehicleOperatingModes_FD1_PP_VehicleOperatingModes_FD1_Rx_3290b631_3cf8f7d5
              PduRDestPduPduRBswModulesRef = Com
            SRC_Can_PT_VehicleOperatingModes_FD1_3290b631 (PduRSrcPdu):
              PduRSourcePduHandleId = 36
              PduRSrcPduDirection = RECEIVE
              PduRSrcPduRef = PT_VehicleOperatingModes_FD1_PP_VehicleOperatingModes_FD1_Rx_3290b631_3cf8f7d5
              PduRSrcPduPduRBswModulesRef = CanIf
          Can_PT_BrakeSysFeatures_3_3290b631: PduRRoutingPathCommunicationType=COMMUNICATION_INTERFACE
            SRC_Can_PT_BrakeSysFeatures_3_3290b631 (PduRSrcPdu):
              PduRSourcePduHandleId = 10
              PduRSrcPduDirection = RECEIVE
              PduRSrcPduRef = PT_BrakeSysFeatures_3_PP_BrakeSysFeatures_3_Rx_3290b631_3cf8f7d5
              PduRSrcPduPduRBswModulesRef = CanIf
            DST_Can_PT_BrakeSysFeatures_3_3290b631 (PduRDestPdu):
              PduRDestPduHandleId = 10
              PduRDestPduDirection = RECEIVE
              PduRDestPduRoutingType = API_FORWARDING
              PduRTransmissionConfirmation = false
              PduRDestPduRef = PT_BrakeSysFeatures_3_PP_BrakeSysFeatures_3_Rx_3290b631_3cf8f7d5
              PduRDestPduPduRBswModulesRef = Com
          Can_PT_EngVehicleSpThrottle2_FD1_3290b631: PduRRoutingPathCommunicationType=COMMUNICATION_INTERFACE
            DST_Can_PT_EngVehicleSpThrottle2_FD1_3290b631 (PduRDestPdu):
              PduRDestPduHandleId = 16
              PduRDestPduDirection = RECEIVE
              PduRDestPduRoutingType = API_FORWARDING
              PduRTransmissionConfirmation = false
              PduRDestPduRef = PT_EngVehicleSpThrottle2_FD1_PP_EngVehicleSpThrottle2_FD1_Rx_3290b631_3cf8f7d5
              PduRDestPduPduRBswModulesRef = Com
            SRC_Can_PT_EngVehicleSpThrottle2_FD1_3290b631 (PduRSrcPdu):
              PduRSourcePduHandleId = 16
              PduRSrcPduDirection = RECEIVE
              PduRSrcPduRef = PT_EngVehicleSpThrottle2_FD1_PP_EngVehicleSpThrottle2_FD1_Rx_3290b631_3cf8f7d5
              PduRSrcPduPduRBswModulesRef = CanIf
          Can_PT_Image_Processing_Data_FD1_3290b631: PduRRoutingPathCommunicationType=COMMUNICATION_INTERFACE
            DST_Can_PT_Image_Processing_Data_FD1_3290b631 (PduRDestPdu):
              PduRDestPduHandleId = 19
              PduRDestPduDirection = RECEIVE
              PduRDestPduRoutingType = API_FORWARDING
              PduRTransmissionConfirmation = false
              PduRDestPduRef = PT_Image_Processing_Data_FD1_PP_Image_Processing_Data_FD1_Rx_3290b631_3cf8f7d5
              PduRDestPduPduRBswModulesRef = Com
            SRC_Can_PT_Image_Processing_Data_FD1_3290b631 (PduRSrcPdu):
              PduRSourcePduHandleId = 19
              PduRSrcPduDirection = RECEIVE
              PduRSrcPduRef = PT_Image_Processing_Data_FD1_PP_Image_Processing_Data_FD1_Rx_3290b631_3cf8f7d5
              PduRSrcPduPduRBswModulesRef = CanIf
          Can_PT_TransGearData_FD1_3290b631: PduRRoutingPathCommunicationType=COMMUNICATION_INTERFACE
            DST_Can_PT_TransGearData_FD1_3290b631 (PduRDestPdu):
              PduRDestPduHandleId = 35
              PduRDestPduDirection = RECEIVE
              PduRDestPduRoutingType = API_FORWARDING
              PduRTransmissionConfirmation = false
              PduRDestPduRef = PT_TransGearData_FD1_PP_TransGearData_FD1_Rx_3290b631_3cf8f7d5
              PduRDestPduPduRBswModulesRef = Com
            SRC_Can_PT_TransGearData_FD1_3290b631 (PduRSrcPdu):
              PduRSourcePduHandleId = 35
              PduRSrcPduDirection = RECEIVE
              PduRSrcPduRef = PT_TransGearData_FD1_PP_TransGearData_FD1_Rx_3290b631_3cf8f7d5
              PduRSrcPduPduRBswModulesRef = CanIf
          Can_PT_TrailerAid_Data3_FD1_3290b631: PduRRoutingPathCommunicationType=COMMUNICATION_INTERFACE
            DST_Can_PT_TrailerAid_Data3_FD1_3290b631 (PduRDestPdu):
              PduRDestPduHandleId = 27
              PduRDestPduDirection = RECEIVE
              PduRDestPduRoutingType = API_FORWARDING
              PduRTransmissionConfirmation = false
              PduRDestPduRef = PT_TrailerAid_Data3_FD1_PP_TrailerAid_Data3_FD1_Rx_3290b631_3cf8f7d5
              PduRDestPduPduRBswModulesRef = Com
            SRC_Can_PT_TrailerAid_Data3_FD1_3290b631 (PduRSrcPdu):
              PduRSourcePduHandleId = 27
              PduRSrcPduDirection = RECEIVE
              PduRSrcPduRef = PT_TrailerAid_Data3_FD1_PP_TrailerAid_Data3_FD1_Rx_3290b631_3cf8f7d5
              PduRSrcPduPduRBswModulesRef = CanIf
          Can_PT_TesterPhysicalResPSCM_FD1_3290b631: PduRRoutingPathCommunicationType=TRANSPORT_PROTOCOL
            SRC_Can_PT_TesterPhysicalResPSCM_FD1_3290b631 (PduRSrcPdu):
              PduRSourcePduHandleId = 4
              PduRSrcPduDirection = TRANSMIT
              PduRSrcPduRef = PT_TesterPhysicalResPSCM_FD1_PP_TesterPhysicalResPSCM_FD1_Tx_3290b631_3cf8f7d5
              PduRSrcPduPduRBswModulesRef = Dcm
            DST_Can_PT_TesterPhysicalResPSCM_FD1_3290b631 (PduRDestPdu):
              PduRDestPduHandleId = 1
              PduRDestPduDirection = TRANSMIT
              PduRDestPduRoutingType = API_FORWARDING
              PduRDestPduRef = PT_TesterPhysicalResPSCM_FD1_PP_TesterPhysicalResPSCM_FD1_Tx_3290b631_3cf8f7d5
              PduRDestPduPduRBswModulesRef = CanTp
          Can_PT_APIM_Send_Signals1_FD1_3290b631: PduRRoutingPathCommunicationType=COMMUNICATION_INTERFACE
            SRC_Can_PT_APIM_Send_Signals1_FD1_3290b631 (PduRSrcPdu):
              PduRSourcePduHandleId = 1
              PduRSrcPduDirection = RECEIVE
              PduRSrcPduRef = PT_APIM_Send_Signals1_FD1_PP_APIM_Send_Signals1_FD1_Rx_3290b631_3cf8f7d5
              PduRSrcPduPduRBswModulesRef = CanIf
            DST_Can_PT_APIM_Send_Signals1_FD1_3290b631 (PduRDestPdu):
              PduRDestPduHandleId = 1
              PduRDestPduDirection = RECEIVE
              PduRDestPduRoutingType = API_FORWARDING
              PduRTransmissionConfirmation = false
              PduRDestPduRef = PT_APIM_Send_Signals1_FD1_PP_APIM_Send_Signals1_FD1_Rx_3290b631_3cf8f7d5
              PduRDestPduPduRBswModulesRef = Com
          Can_PT_ActiveFrontStrg_Stat2_FD1_3290b631: PduRRoutingPathCommunicationType=COMMUNICATION_INTERFACE
            SRC_Can_PT_ActiveFrontStrg_Stat2_FD1_3290b631 (PduRSrcPdu):
              PduRSourcePduHandleId = 3
              PduRSrcPduDirection = RECEIVE
              PduRSrcPduRef = PT_ActiveFrontStrg_Stat2_FD1_PP_ActiveFrontStrg_Stat2_FD1_Rx_3290b631_3cf8f7d5
              PduRSrcPduPduRBswModulesRef = CanIf
            DST_Can_PT_ActiveFrontStrg_Stat2_FD1_3290b631 (PduRDestPdu):
              PduRDestPduHandleId = 3
              PduRDestPduDirection = RECEIVE
              PduRDestPduRoutingType = API_FORWARDING
              PduRTransmissionConfirmation = false
              PduRDestPduRef = PT_ActiveFrontStrg_Stat2_FD1_PP_ActiveFrontStrg_Stat2_FD1_Rx_3290b631_3cf8f7d5
              PduRDestPduPduRBswModulesRef = Com
          Can_PT_TesterPhysicalResPSCM_FD1_20_3290b631: PduRRoutingPathCommunicationType=TRANSPORT_PROTOCOL
            SRC_Can_PT_TesterPhysicalResPSCM_FD1_20_3290b631 (PduRSrcPdu):
              PduRSourcePduHandleId = 3
              PduRSrcPduDirection = TRANSMIT
              PduRSrcPduRef = PT_TesterPhysicalResPSCM_FD1_20_PP_TesterPhysicalResPSCM_FD1_Tx_20_3290b631_3cf8f7d5
              PduRSrcPduPduRBswModulesRef = Dcm
            DST_Can_PT_TesterPhysicalResPSCM_FD1_20_3290b631 (PduRDestPdu):
              PduRDestPduHandleId = 0
              PduRDestPduDirection = TRANSMIT
              PduRDestPduRoutingType = API_FORWARDING
              PduRDestPduRef = PT_TesterPhysicalResPSCM_FD1_20_PP_TesterPhysicalResPSCM_FD1_Tx_20_3290b631_3cf8f7d5
              PduRDestPduPduRBswModulesRef = CanTp
          Can_PT_EngVehicleSpThrottle_FD1_3290b631: PduRRoutingPathCommunicationType=COMMUNICATION_INTERFACE
            SRC_Can_PT_EngVehicleSpThrottle_FD1_3290b631 (PduRSrcPdu):
              PduRSourcePduHandleId = 17
              PduRSrcPduDirection = RECEIVE
              PduRSrcPduRef = PT_EngVehicleSpThrottle_FD1_PP_EngVehicleSpThrottle_FD1_Rx_3290b631_3cf8f7d5
              PduRSrcPduPduRBswModulesRef = CanIf
            DST_Can_PT_EngVehicleSpThrottle_FD1_3290b631 (PduRDestPdu):
              PduRDestPduHandleId = 17
              PduRDestPduDirection = RECEIVE
              PduRDestPduRoutingType = API_FORWARDING
              PduRTransmissionConfirmation = false
              PduRDestPduRef = PT_EngVehicleSpThrottle_FD1_PP_EngVehicleSpThrottle_FD1_Rx_3290b631_3cf8f7d5
              PduRDestPduPduRBswModulesRef = Com
          Can_PT_TesterPhysicalReqPSCM_FD1_20_3290b631: PduRRoutingPathCommunicationType=TRANSPORT_PROTOCOL
            SRC_Can_PT_TesterPhysicalReqPSCM_FD1_20_3290b631 (PduRSrcPdu):
              PduRSourcePduHandleId = 2
              PduRSrcPduDirection = RECEIVE
              PduRSrcPduRef = PT_TesterPhysicalReqPSCM_FD1_20_PP_TesterPhysicalReqPSCM_FD1_Rx_20_3290b631_3cf8f7d5
              PduRSrcPduPduRBswModulesRef = CanTp
            DST_Can_PT_TesterPhysicalReqPSCM_FD1_20_3290b631 (PduRDestPdu):
              PduRDestPduHandleId = 2
              PduRDestPduDirection = RECEIVE
              PduRDestPduRoutingType = API_FORWARDING
              PduRDestPduRef = PT_TesterPhysicalReqPSCM_FD1_20_PP_TesterPhysicalReqPSCM_FD1_Rx_20_3290b631_3cf8f7d5
              PduRDestPduPduRBswModulesRef = Dcm
          Can_PT_Steer_Assist_Data_FD1_3290b631: PduRRoutingPathCommunicationType=COMMUNICATION_INTERFACE
            DST_Can_PT_Steer_Assist_Data_FD1_3290b631 (PduRDestPdu):
              PduRDestPduHandleId = 25
              PduRDestPduDirection = RECEIVE
              PduRDestPduRoutingType = API_FORWARDING
              PduRTransmissionConfirmation = false
              PduRDestPduRef = PT_Steer_Assist_Data_FD1_PP_Steer_Assist_Data_FD1_Rx_3290b631_3cf8f7d5
              PduRDestPduPduRBswModulesRef = Com
            SRC_Can_PT_Steer_Assist_Data_FD1_3290b631 (PduRSrcPdu):
              PduRSourcePduHandleId = 25
              PduRSrcPduDirection = RECEIVE
              PduRSrcPduRef = PT_Steer_Assist_Data_FD1_PP_Steer_Assist_Data_FD1_Rx_3290b631_3cf8f7d5
              PduRSrcPduPduRBswModulesRef = CanIf
          Can_PT_BodyInfo_3_FD1_3290b631: PduRRoutingPathCommunicationType=COMMUNICATION_INTERFACE
            DST_Can_PT_BodyInfo_3_FD1_3290b631 (PduRDestPdu):
              PduRDestPduHandleId = 4
              PduRDestPduDirection = RECEIVE
              PduRDestPduRoutingType = API_FORWARDING
              PduRTransmissionConfirmation = false
              PduRDestPduRef = PT_BodyInfo_3_FD1_PP_BodyInfo_3_FD1_Rx_3290b631_3cf8f7d5
              PduRDestPduPduRBswModulesRef = Com
            SRC_Can_PT_BodyInfo_3_FD1_3290b631 (PduRSrcPdu):
              PduRSourcePduHandleId = 4
              PduRSrcPduDirection = RECEIVE
              PduRSrcPduRef = PT_BodyInfo_3_FD1_PP_BodyInfo_3_FD1_Rx_3290b631_3cf8f7d5
              PduRSrcPduPduRBswModulesRef = CanIf
          Can_PT_Mc_Send_Signals_2_FD1_3290b631: PduRRoutingPathCommunicationType=COMMUNICATION_INTERFACE
            DST_Can_PT_Mc_Send_Signals_2_FD1_3290b631 (PduRDestPdu):
              PduRDestPduHandleId = 22
              PduRDestPduDirection = RECEIVE
              PduRDestPduRoutingType = API_FORWARDING
              PduRTransmissionConfirmation = false
              PduRDestPduRef = PT_Mc_Send_Signals_2_FD1_PP_Mc_Send_Signals_2_FD1_Rx_3290b631_3cf8f7d5
              PduRDestPduPduRBswModulesRef = Com
            SRC_Can_PT_Mc_Send_Signals_2_FD1_3290b631 (PduRSrcPdu):
              PduRSourcePduHandleId = 22
              PduRSrcPduDirection = RECEIVE
              PduRSrcPduRef = PT_Mc_Send_Signals_2_FD1_PP_Mc_Send_Signals_2_FD1_Rx_3290b631_3cf8f7d5
              PduRSrcPduPduRBswModulesRef = CanIf
          Can_PT_BrakeSnData_4_FD1_3290b631: PduRRoutingPathCommunicationType=COMMUNICATION_INTERFACE
            DST_Can_PT_BrakeSnData_4_FD1_3290b631 (PduRDestPdu):
              PduRDestPduHandleId = 7
              PduRDestPduDirection = RECEIVE
              PduRDestPduRoutingType = API_FORWARDING
              PduRTransmissionConfirmation = false
              PduRDestPduRef = PT_BrakeSnData_4_FD1_PP_BrakeSnData_4_FD1_Rx_3290b631_3cf8f7d5
              PduRDestPduPduRBswModulesRef = Com
            SRC_Can_PT_BrakeSnData_4_FD1_3290b631 (PduRSrcPdu):
              PduRSourcePduHandleId = 7
              PduRSrcPduDirection = RECEIVE
              PduRSrcPduRef = PT_BrakeSnData_4_FD1_PP_BrakeSnData_4_FD1_Rx_3290b631_3cf8f7d5
              PduRSrcPduPduRBswModulesRef = CanIf
          Can_PT_BrakeSnData_5_FD1_3290b631: PduRRoutingPathCommunicationType=COMMUNICATION_INTERFACE
            SRC_Can_PT_BrakeSnData_5_FD1_3290b631 (PduRSrcPdu):
              PduRSourcePduHandleId = 8
              PduRSrcPduDirection = RECEIVE
              PduRSrcPduRef = PT_BrakeSnData_5_FD1_PP_BrakeSnData_5_FD1_Rx_3290b631_3cf8f7d5
              PduRSrcPduPduRBswModulesRef = CanIf
            DST_Can_PT_BrakeSnData_5_FD1_3290b631 (PduRDestPdu):
              PduRDestPduHandleId = 8
              PduRDestPduDirection = RECEIVE
              PduRDestPduRoutingType = API_FORWARDING
              PduRTransmissionConfirmation = false
              PduRDestPduRef = PT_BrakeSnData_5_FD1_PP_BrakeSnData_5_FD1_Rx_3290b631_3cf8f7d5
              PduRDestPduPduRBswModulesRef = Com
          Can_PT_Lane_Assist_Data1_FD1_3290b631: PduRRoutingPathCommunicationType=COMMUNICATION_INTERFACE
            SRC_Can_PT_Lane_Assist_Data1_FD1_3290b631 (PduRSrcPdu):
              PduRSourcePduHandleId = 20
              PduRSrcPduDirection = RECEIVE
              PduRSrcPduRef = PT_Lane_Assist_Data1_FD1_PP_Lane_Assist_Data1_FD1_Rx_3290b631_3cf8f7d5
              PduRSrcPduPduRBswModulesRef = CanIf
            DST_Can_PT_Lane_Assist_Data1_FD1_3290b631 (PduRDestPdu):
              PduRDestPduHandleId = 20
              PduRDestPduDirection = RECEIVE
              PduRDestPduRoutingType = API_FORWARDING
              PduRTransmissionConfirmation = false
              PduRDestPduRef = PT_Lane_Assist_Data1_FD1_PP_Lane_Assist_Data1_FD1_Rx_3290b631_3cf8f7d5
              PduRDestPduPduRBswModulesRef = Com
          Can_PT_SteeringPinion_Data_FD1_3290b631: PduRRoutingPathCommunicationType=COMMUNICATION_INTERFACE
            SRC_Can_PT_SteeringPinion_Data_FD1_3290b631 (PduRSrcPdu):
              PduRSourcePduHandleId = 2
              PduRSrcPduDirection = TRANSMIT
              PduRSrcPduRef = PT_SteeringPinion_Data_FD1_PP_SteeringPinion_Data_FD1_Tx_3290b631_3cf8f7d5
              PduRSrcPduPduRBswModulesRef = Com
            DST_Can_PT_SteeringPinion_Data_FD1_3290b631 (PduRDestPdu):
              PduRDestPduHandleId = 2
              PduRDestPduDirection = TRANSMIT
              PduRDestPduRoutingType = API_FORWARDING
              PduRTransmissionConfirmation = false
              PduRDestPduDataProvision = PDUR_DIRECT
              PduRDestPduRef = PT_SteeringPinion_Data_FD1_PP_SteeringPinion_Data_FD1_Tx_3290b631_3cf8f7d5
              PduRDestPduPduRBswModulesRef = CanIf
          Can_PT_TrailerAid_Stat3_FD1_3290b631: PduRRoutingPathCommunicationType=COMMUNICATION_INTERFACE
            DST_Can_PT_TrailerAid_Stat3_FD1_3290b631 (PduRDestPdu):
              PduRDestPduHandleId = 31
              PduRDestPduDirection = RECEIVE
              PduRDestPduRoutingType = API_FORWARDING
              PduRTransmissionConfirmation = false
              PduRDestPduRef = PT_TrailerAid_Stat3_FD1_PP_TrailerAid_Stat3_FD1_Rx_3290b631_3cf8f7d5
              PduRDestPduPduRBswModulesRef = Com
            SRC_Can_PT_TrailerAid_Stat3_FD1_3290b631 (PduRSrcPdu):
              PduRSourcePduHandleId = 31
              PduRSrcPduDirection = RECEIVE
              PduRSrcPduRef = PT_TrailerAid_Stat3_FD1_PP_TrailerAid_Stat3_FD1_Rx_3290b631_3cf8f7d5
              PduRSrcPduPduRBswModulesRef = CanIf
          Can_PT_BrakeSnData_3_FD1_3290b631: PduRRoutingPathCommunicationType=COMMUNICATION_INTERFACE
            DST_Can_PT_BrakeSnData_3_FD1_3290b631 (PduRDestPdu):
              PduRDestPduHandleId = 6
              PduRDestPduDirection = RECEIVE
              PduRDestPduRoutingType = API_FORWARDING
              PduRTransmissionConfirmation = false
              PduRDestPduRef = PT_BrakeSnData_3_FD1_PP_BrakeSnData_3_FD1_Rx_3290b631_3cf8f7d5
              PduRDestPduPduRBswModulesRef = Com
            SRC_Can_PT_BrakeSnData_3_FD1_3290b631 (PduRSrcPdu):
              PduRSourcePduHandleId = 6
              PduRSrcPduDirection = RECEIVE
              PduRSrcPduRef = PT_BrakeSnData_3_FD1_PP_BrakeSnData_3_FD1_Rx_3290b631_3cf8f7d5
              PduRSrcPduPduRBswModulesRef = CanIf
          Can_PT_TrailerAid_Stat1_FD1_3290b631: PduRRoutingPathCommunicationType=COMMUNICATION_INTERFACE
            SRC_Can_PT_TrailerAid_Stat1_FD1_3290b631 (PduRSrcPdu):
              PduRSourcePduHandleId = 29
              PduRSrcPduDirection = RECEIVE
              PduRSrcPduRef = PT_TrailerAid_Stat1_FD1_PP_TrailerAid_Stat1_FD1_Rx_3290b631_3cf8f7d5
              PduRSrcPduPduRBswModulesRef = CanIf
            DST_Can_PT_TrailerAid_Stat1_FD1_3290b631 (PduRDestPdu):
              PduRDestPduHandleId = 29
              PduRDestPduDirection = RECEIVE
              PduRDestPduRoutingType = API_FORWARDING
              PduRTransmissionConfirmation = false
              PduRDestPduRef = PT_TrailerAid_Stat1_FD1_PP_TrailerAid_Stat1_FD1_Rx_3290b631_3cf8f7d5
              PduRDestPduPduRBswModulesRef = Com
          Can_PT_Lane_Assist_Data3_FD1_3290b631: PduRRoutingPathCommunicationType=COMMUNICATION_INTERFACE
            SRC_Can_PT_Lane_Assist_Data3_FD1_3290b631 (PduRSrcPdu):
              PduRSourcePduHandleId = 1
              PduRSrcPduDirection = TRANSMIT
              PduRSrcPduRef = PT_Lane_Assist_Data3_FD1_PP_Lane_Assist_Data3_FD1_Tx_3290b631_3cf8f7d5
              PduRSrcPduPduRBswModulesRef = Com
            DST_Can_PT_Lane_Assist_Data3_FD1_3290b631 (PduRDestPdu):
              PduRDestPduHandleId = 1
              PduRDestPduDirection = TRANSMIT
              PduRDestPduRoutingType = API_FORWARDING
              PduRTransmissionConfirmation = true
              PduRDestPduDataProvision = PDUR_DIRECT
              PduRDestPduRef = PT_Lane_Assist_Data3_FD1_PP_Lane_Assist_Data3_FD1_Tx_3290b631_3cf8f7d5
              PduRDestPduPduRBswModulesRef = CanIf
          Can_PT_TrailerAid_Stat2_FD1_3290b631: PduRRoutingPathCommunicationType=COMMUNICATION_INTERFACE
            SRC_Can_PT_TrailerAid_Stat2_FD1_3290b631 (PduRSrcPdu):
              PduRSourcePduHandleId = 30
              PduRSrcPduDirection = RECEIVE
              PduRSrcPduRef = PT_TrailerAid_Stat2_FD1_PP_TrailerAid_Stat2_FD1_Rx_3290b631_3cf8f7d5
              PduRSrcPduPduRBswModulesRef = CanIf
            DST_Can_PT_TrailerAid_Stat2_FD1_3290b631 (PduRDestPdu):
              PduRDestPduHandleId = 30
              PduRDestPduDirection = RECEIVE
              PduRDestPduRoutingType = API_FORWARDING
              PduRTransmissionConfirmation = false
              PduRDestPduRef = PT_TrailerAid_Stat2_FD1_PP_TrailerAid_Stat2_FD1_Rx_3290b631_3cf8f7d5
              PduRDestPduPduRBswModulesRef = Com
    4 x PduRBswModules, all with PduRCancelReceive=false, PduRCancelTransmit=false, PduRChangeParameterRequestApi=false, PduRTriggertransmit=false:
      CanIf: PduRCommunicationInterface=true, PduRLowerModule=true, PduRTransportProtocol=false, PduRTxConfirmation=true, PduRUpperModule=false, PduRUseTag=false, PduRBswModuleRef=CanIf
      Com: PduRCommunicationInterface=true, PduRLowerModule=false, PduRTransportProtocol=false, PduRTxConfirmation=true, PduRUpperModule=true, PduRUseTag=false, PduRBswModuleRef=Com
      CanTp: PduRCommunicationInterface=false, PduRLowerModule=true, PduRTransportProtocol=true, PduRTxConfirmation=false, PduRUpperModule=false, PduRUseTag=false, PduRBswModuleRef=CanTp
      Dcm: PduRCommunicationInterface=false, PduRLowerModule=false, PduRTransportProtocol=true, PduRTxConfirmation=false, PduRUpperModule=true, PduRUseTag=true, PduRBswModuleRef=Dcm
