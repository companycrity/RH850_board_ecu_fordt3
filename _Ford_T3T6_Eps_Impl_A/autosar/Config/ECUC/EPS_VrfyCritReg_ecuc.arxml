AUTOSAR XML (schema 4-2-1)
package /ActiveEcuC
  module config VrfyCritReg: implementation-config-variant=VARIANT-PRE-COMPILE
    VrfyCritReg8bitInitSignallist: Address=4291625008, Value=255, Mask=255
    VrfyCritReg8bitPerSignallist: Address=4291625008, Value=255, Mask=255
    OPBT0 (VrfyCritReg32bitPerSignallist): Address=4291625008, Value=2147483135, Mask=4294967295
    OPBT1 (VrfyCritReg32bitPerSignallist): Address=4291625012, Value=3221211608, Mask=4294967295
    VrfyCritReg16bitInitSignallist: Address=4291625008, Value=65023, Mask=65535
    VrfyCritReg16bitPerSignallist: Address=4291625008, Value=65023, Mask=65535
    VrfyCritReg32bitInitSignallist: Address=4291625008, Value=2147483135, Mask=4294967295
    4 x VrfyCritReg32bitPerSignallist:
      OPBT2: Address=4291625016, Value=1073741823, Mask=2147483647
      OPBT13: Address=4291625060, Value=262143, Mask=262143
      OPBT14: Address=4291625064, Value=4294966526, Mask=4294967295
      OPBT15: Address=4291625068, Value=110, Mask=127
