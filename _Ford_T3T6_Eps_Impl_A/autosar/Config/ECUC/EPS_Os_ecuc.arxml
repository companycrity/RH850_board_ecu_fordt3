AUTOSAR XML (schema 4-2-1)
package /ActiveEcuC
  module config Os: implementation-config-variant=VARIANT-PRE-COMPILE, module-description=Os_Impl
    OsCounter:
      OsCounterMaxAllowedValue = 1073741823
      OsCounterMinCycle = 1
      OsCounterType = HARDWARE
      OsSecondsPerTick = 1.25E-8
      OsCounterTicksPerBase = 1
      OsCounterAccessingApplication = SystemApplication_OsCore_CORE0
      OsDriver: OsDriverHighResolution=true, OsDriverHardwareTimerChannelRef=STM0/STM0, OsDriverIsrRef=CounterIsr_SystemTimer
    OsOS:
      OsStackMonitoring = true
      OsStatus = EXTENDED
      OsUseGetServiceId = false
      OsUseParameterAccess = false
      OsUseResScheduler = false
      OsForcibleTermination = true
      OsGenerateCalloutStubs = true
      OsGenerateMemMap = COMPLETE
      OsGenerateMemMapForThreads = false
      OsServiceProtection = false
      OsStackUsageMeasurement = true
      OsUseXSignalAsyncApiCalls = false
      OsScalabilityClass = SC3
      OsMasterCore = OsCore_CORE0
      OsHooks: OsErrorHook=true, OsPostTaskHook=false, OsPreTaskHook=false, OsShutdownHook=true, OsStartupHook=true, OsProtectionHook=true
    OSDEFAULTAPPMODE (OsAppMode)
    OS_APPMODE_ANY (OsAppMode)
    OsPublishedInformation: OsKernelVersion=7, OsPlatformName=Rh850
      RH850P1MC (OsDerivativeInformation):
        OsMpuAlignment = 4
        OsStackAlignment = 4
        OsExceptionVectorTableAlignment = 512
        OsInterruptVectorTableAlignment = 512
        OsHardwareManuals = RH850/P1x-C Group Users Manual: Hardware Rev.1.10 Jul 2016 RH850G3M Users Manual: Software Rev.1.30 Jun 2016
        CORE0 (OsPhysicalCore):
          OsPhysicalCoreId = 0
          OsPhysicalCoreType = G3M
          OsPhysicalCoreExceptionSources = 16
          OsPhysicalCoreIsAutostart = true
          OsPhysicalCoreMasterStartAllowed = false
          OsPhysicalCorePrivelegedHwAccess = true
          MPU_CORE0 (OsPhysicalCoreMpu): OsPhysicalCoreMpuId=0, OsPhysicalCoreMpuMaxRegions=16, OsPhysicalCoreMpuType=CoreMpu
        STM0 (OsHardwareTimer):
          OsHardwareTimerBaseAddress = 4292706304
          OsHardwareTimerHighResPossible = true
          OsHardwareTimerUnit = STM
          OsHardwareTimerSize = 32
          OsHardwareTimerId = 0
          OsHardwareTimerType = STM
          STM0 (OsHardwareTimerChannel): OsHardwareTimerChannelIntSource=41, OsHardwareTimerChannelOffset=0, OsHardwareTimerChannelId=0
        INTC (OsSystemIntCtrl): OsSystemIntCtrlBaseAddress=4294896128, OsSystemIntCtrlMaxPrios=16, OsSystemIntCtrlMaxSources=512, OsSystemIntCtrlPrioOrder=DESC
          5 x OsSystemIntCtrlAddress:
            INTC1: OsSystemIntCtrlAddressValue=4294896128
            INTC2: OsSystemIntCtrlAddressValue=4294946816
            EIBD1: OsSystemIntCtrlAddressValue=4294896384
            EIBD2: OsSystemIntCtrlAddressValue=4294948864
            IPIR: OsSystemIntCtrlAddressValue=4294896772
        MPAT (OsMemoryRegionSpecifics)
          6 x OsMemoryRegionAccess:
            SR: OsMemoryRegionAccessRights=R, OsMemoryRegionAccessType=SUPERVISOR
            SW: OsMemoryRegionAccessRights=W, OsMemoryRegionAccessType=SUPERVISOR
            SX: OsMemoryRegionAccessRights=X, OsMemoryRegionAccessType=SUPERVISOR
            UR: OsMemoryRegionAccessRights=R, OsMemoryRegionAccessType=USER
            UW: OsMemoryRegionAccessRights=W, OsMemoryRegionAccessType=USER
            UX: OsMemoryRegionAccessRights=X, OsMemoryRegionAccessType=USER
    OsCore_CORE0 (OsCore):
      OsCoreIsAutosar = true
      OsCorePhysicalCoreRef = CORE0
      OsCoreIdleTask = IdleTask_OsCore_CORE0
      OsCoreSystemApplication = SystemApplication_OsCore_CORE0
      OsCoreEcucCoreRef = Core0
      OsCorePreStartTask = Task_PreStart_CORE0
      OsCoreStacks: OsCoreKernelStackSize=2048, OsCoreStartupStackSize=256, OsCoreShutdownStackSize=512, OsCoreErrorStackSize=256, OsCoreProtectionStackSize=256
    InitResource (OsResource): OsResourceProperty=STANDARD, OsResourceAccessingApplication=SystemApplication_OsCore_CORE0, OsResourceAccessingApplication=Appl10
    OsResource: OsResourceProperty=STANDARD, OsResourceAccessingApplication=SystemApplication_OsCore_CORE0, OsResourceAccessingApplication=Appl10
    IdleTask_OsCore_CORE0 (OsTask):
      OsTaskActivation = 1
      OsTaskPriority = 4294967295
      OsTaskSchedule = FULL
      OsTaskStackSharing = false
      OsTaskStackSize = 1024
      OsTaskType = AUTO
      OsTaskAccessingApplication = SystemApplication_OsCore_CORE0
      OsTaskAutostart: OsTaskAppModeRef=OS_APPMODE_ANY
    SystemApplication_OsCore_CORE0 (OsApplication):
      OsTrusted = true
      OsTrustedApplicationDelayTimingViolationCall = false
      OsTrustedApplicationWithProtection = false
      OsApplicationIsPrivileged = true
      OsAppUseTrustedFunctionStubs = false
      OsAppTaskRef = IdleTask_OsCore_CORE0
      OsApplicationCoreRef = Core0
      OsAppIsrRef = CounterIsr_SystemTimer
      OsAppTaskRef = Task_PreStart_CORE0
      OsApplicationHooks: OsAppErrorHook=false, OsAppShutdownHook=false, OsAppStartupHook=false
    CounterIsr_SystemTimer (OsIsr):
      OsIsrCategory = CATEGORY_2
      OsIsrInterruptType = EXTERNAL
      OsIsrInterruptSource = 41
      OsIsrInterruptPriority = 4
      OsIsrStackSize = 1024
      OsIsrEnableNesting = true
      OsIsrSpecialFunctionName = Os_TimerHrtIsr
    5 x OsTask, all with OsTaskActivation=1, OsTaskSchedule=FULL, OsTaskStackSharing=false, OsTaskType=AUTO, OsTaskAccessingApplication=SystemApplication_OsCore_CORE0:
      Task_2ms_Appl10: OsTaskPriority=83, OsTaskStackSize=3072, OsTaskResourceRef=SHUTDOWN_ONGOING
      Task_4ms_Appl10: OsTaskPriority=73, OsTaskStackSize=2048, OsTaskResourceRef=SHUTDOWN_ONGOING
      Task_4msBsw_Appl10: OsTaskPriority=90, OsTaskStackSize=2048, OsTaskResourceRef=OsResource
      Task_10ms_Appl10: OsTaskPriority=63, OsTaskStackSize=3072, OsTaskResourceRef=SHUTDOWN_ONGOING
      Task_10msBsw_Appl10: OsTaskPriority=60, OsTaskStackSize=3072, OsTaskResourceRef=SHUTDOWN_ONGOING
    Appl0 (OsApplication):
      OsTrusted = true
      OsTrustedApplicationDelayTimingViolationCall = false
      OsTrustedApplicationWithProtection = false
      OsApplicationIsPrivileged = true
      OsAppUseTrustedFunctionStubs = true
      OsAppCalloutStubsIncludeHeader = TrustedFunction.h
      OsApplicationCoreRef = Core0
      OsAppIsrRef = WDG_59_DRIVERA_TRIGGERFUNCTION_ISR
      OsAppIsrRef = MCU_FEINT_ISR
      OsAppIsrRef = MotCtrlMgrIrq
      OsAppIsrRef = SysErrIrq
      OsAppIsrRef = FpuErrIrq
      OsAppIsrRef = MCU_ECM_EIC_CAT2_ISR
      OsApplicationHooks: OsAppErrorHook=false, OsAppShutdownHook=false, OsAppStartupHook=false
      14 x OsApplicationTrustedFunction:
        NvM_MainFunction: OsTrustedFunctionName=NvM_MainFunction, OsTrustedFunctionReturnType=void
        Fls_MainFunction: OsTrustedFunctionName=Fls_MainFunction, OsTrustedFunctionReturnType=void
        DmaRegInin: OsTrustedFunctionName=DmaRegInin, OsTrustedFunctionReturnType=void
        Adcf0OutpInin: OsTrustedFunctionName=Adcf0OutpInin, OsTrustedFunctionReturnType=void
        CritRegInitChk: OsTrustedFunctionName=CritRegInitChk, OsTrustedFunctionReturnType=uint8
        CritRegPerChk: OsTrustedFunctionName=CritRegPerChk, OsTrustedFunctionReturnType=uint8
        Spi_AsyncTransmit: OsTrustedFunctionName=Spi_AsyncTransmit, OsTrustedFunctionReturnType=Std_ReturnType
          Sequence (OsTrustedFunctionParam): OsTrustedFunctionParamId=1, OsTrustedFunctionParamDataType=Spi_SequenceType, OsTrustedFunctionParamDirection=IN
        Trusted_EcuM_ShutdownOS: OsTrustedFunctionName=Trusted_EcuM_ShutdownOS, OsTrustedFunctionReturnType=void
          ErrCode (OsTrustedFunctionParam): OsTrustedFunctionParamId=1, OsTrustedFunctionParamDataType=Std_ReturnType, OsTrustedFunctionParamDirection=IN
        ApplXcpWrCmn: OsTrustedFunctionName=ApplXcpWrCmn, OsTrustedFunctionReturnType=void
          3 x OsTrustedFunctionParam, all with OsTrustedFunctionParamDirection=IN:
            addr: OsTrustedFunctionParamId=1, OsTrustedFunctionParamDataType=MTABYTEPTR
            size: OsTrustedFunctionParamId=2, OsTrustedFunctionParamDataType=vuint8
            data: OsTrustedFunctionParamId=3, OsTrustedFunctionParamDataType=const BYTEPTR
        Uart0CfgAndUseInin: OsTrustedFunctionName=Uart0CfgAndUseInin, OsTrustedFunctionReturnType=void
        Uart1CfgAndUseInin: OsTrustedFunctionName=Uart1CfgAndUseInin, OsTrustedFunctionReturnType=void
        IpgInin: OsTrustedFunctionName=IpgInin, OsTrustedFunctionReturnType=void
        DtsInin: OsTrustedFunctionName=DtsInin, OsTrustedFunctionReturnType=void
          CrcHwIdxInReg (OsTrustedFunctionParam): OsTrustedFunctionParamId=1, OsTrustedFunctionParamDataType=uint32, OsTrustedFunctionParamDirection=IN
          CrcHwIdxOutReg (OsTrustedFunctionParam): OsTrustedFunctionParamId=2, OsTrustedFunctionParamDataType=uint32, OsTrustedFunctionParamDirection=IN
        DtsClnUp: OsTrustedFunctionName=DtsClnUp, OsTrustedFunctionReturnType=void
    Appl10 (OsApplication):
      OsTrusted = false
      OsTrustedApplicationDelayTimingViolationCall = false
      OsTrustedApplicationWithProtection = false
      OsApplicationIsPrivileged = false
      OsAppUseTrustedFunctionStubs = false
      OsApplicationCoreRef = Core0
      OsAppTaskRef = Task_2ms_Appl10
      OsAppTaskRef = Task_4ms_Appl10
      OsAppTaskRef = Task_4msBsw_Appl10
      OsAppTaskRef = Task_10ms_Appl10
      OsAppTaskRef = Task_10msBsw_Appl10
      OsAppTaskRef = Task_Init_Appl10
      OsAppTaskRef = Task_InitBsw_Appl10
      OsAppAlarmRef = Rte_Al_TE2_Task_4msBsw_Appl10_0_4ms
      OsAppAlarmRef = Rte_Al_TE_Task_4ms_Appl10_0_4ms
      OsAppAlarmRef = Rte_Al_TE2_Task_10msBsw_Appl10_0_10ms
      OsAppAlarmRef = Rte_Al_TE_Task_2ms_Appl10_0_2ms
      OsAppAlarmRef = Rte_Al_TE_Task_10ms_Appl10_0_10ms
      OsAppCounterRef = OsCounter
      OsAppTaskRef = Task_100ms_Appl10
      OsAppAlarmRef = Rte_Al_TE_Task_100ms_Appl10_0_100ms
      OsAppAlarmRef = Rte_Al_TE_CanTp_CanTp_MainFunction
      OsAppTaskRef = Task_5msBsw_Appl10
      OsAppIsrRef = CanIsr_1
      OsAppIsrRef = SPI_CSIH0_TIC_CAT2_ISR
      OsAppIsrRef = SPI_CSIH0_TIRE_CAT2_ISR
      OsAppTaskRef = Task_2msTmplMonr_Appl10
      OsAppAlarmRef = Rte_Al_TE_Task_2msTmplMonr_Appl10_0_2ms
      OsApplicationHooks: OsAppErrorHook=false, OsAppShutdownHook=false, OsAppStartupHook=false
      14 x OsApplicationNonTrustedFunction, all with OsNonTrustedFunctionStacks=1:
        NtWrapS_NvM_EraseNvBlock: OsNonTrustedFunctionName=NtWrapS_NvM_EraseNvBlock, OsNonTrustedFunctionStackSize=512
        NtWrapS_NvM_GetDataIndex: OsNonTrustedFunctionName=NtWrapS_NvM_GetDataIndex, OsNonTrustedFunctionStackSize=512
        NtWrapS_NvM_GetErrorStatus: OsNonTrustedFunctionName=NtWrapS_NvM_GetErrorStatus, OsNonTrustedFunctionStackSize=512
        NtWrapS_NvM_InvalidateNvBlock: OsNonTrustedFunctionName=NtWrapS_NvM_InvalidateNvBlock, OsNonTrustedFunctionStackSize=512
        NtWrapS_NvM_ReadBlock: OsNonTrustedFunctionName=NtWrapS_NvM_ReadBlock, OsNonTrustedFunctionStackSize=512
        NtWrapS_NvM_SetBlockProtection: OsNonTrustedFunctionName=NtWrapS_NvM_SetBlockProtection, OsNonTrustedFunctionStackSize=512
        NtWrapS_NvM_SetDataIndex: OsNonTrustedFunctionName=NtWrapS_NvM_SetDataIndex, OsNonTrustedFunctionStackSize=512
        NtWrapS_NvM_SetRamBlockStatus: OsNonTrustedFunctionName=NtWrapS_NvM_SetRamBlockStatus, OsNonTrustedFunctionStackSize=512
        NtWrapS_NvM_WriteBlock: OsNonTrustedFunctionName=NtWrapS_NvM_WriteBlock, OsNonTrustedFunctionStackSize=512
        NtWrapS_CmnMfgSrv_CallSvc10: OsNonTrustedFunctionName=NtWrapS_CmnMfgSrv_CallSvc10, OsNonTrustedFunctionStackSize=1024
        NtWrapS_Rte_Call_CopyCalPageReq_Oper: OsNonTrustedFunctionName=NtWrapS_Rte_Call_CopyCalPageReq_Oper, OsNonTrustedFunctionStackSize=512
        NtWrapS_Rte_Call_SetCalPageReq_Oper: OsNonTrustedFunctionName=NtWrapS_Rte_Call_SetCalPageReq_Oper, OsNonTrustedFunctionStackSize=512
        NtWrapS_SyncCrc_GetAvlCrcHwUnit: OsNonTrustedFunctionName=NtWrapS_SyncCrc_GetAvlCrcHwUnit, OsNonTrustedFunctionStackSize=512
        NtWrapS_SyncCrc_RelsCrcHwUnit: OsNonTrustedFunctionName=NtWrapS_SyncCrc_RelsCrcHwUnit, OsNonTrustedFunctionStackSize=512
    Task_Init_Appl10 (OsTask):
      OsTaskActivation = 1
      OsTaskPriority = 98
      OsTaskSchedule = FULL
      OsTaskStackSharing = false
      OsTaskStackSize = 1024
      OsTaskType = AUTO
      OsTaskAccessingApplication = SystemApplication_OsCore_CORE0
      OsTaskResourceRef = InitResource
    Task_InitBsw_Appl10 (OsTask):
      OsTaskActivation = 1
      OsTaskPriority = 96
      OsTaskSchedule = FULL
      OsTaskStackSharing = false
      OsTaskStackSize = 2048
      OsTaskType = AUTO
      OsTaskAccessingApplication = SystemApplication_OsCore_CORE0
      OsTaskResourceRef = InitResource
      OsTaskAutostart: OsTaskAppModeRef=OSDEFAULTAPPMODE
    OsMemoryProtection
      6 x OsMemoryRegion, all with OsMemoryRegionProtectionUnit=MPU_CORE0:
        Appl10RAM_UW: OsMemoryRegionStartAddress=OS_Appl10_VAR_ALL_START, OsMemoryRegionEndAddress=OS_Appl10_VAR_ALL_END, OsMemoryRegionAccessRights=UW, OsMemoryRegionOwner=Appl10
        CodeFlash_SX_SR_UX_UR: OsMemoryRegionStartAddress=0x0, OsMemoryRegionEndAddress=0x1FFFFF, OsMemoryRegionAccessRights=SR, OsMemoryRegionAccessRights=SX, OsMemoryRegionAccessRights=UR, OsMemoryRegionAccessRights=UX
        GeneralRAM_SW_SR_UR: OsMemoryRegionStartAddress=GeneralRam_StartAddr, OsMemoryRegionEndAddress=GeneralRam_EndAddr, OsMemoryRegionAccessRights=SR, OsMemoryRegionAccessRights=UR, OsMemoryRegionAccessRights=SW
        GlobalSharedRAM_SW_SR_UW_UR: OsMemoryRegionStartAddress=OS_GLOBALSHARED_VAR_START, OsMemoryRegionEndAddress=OS_GLOBALSHARED_VAR_FAST_ZERO_INIT_END, OsMemoryRegionAccessRights=SR, OsMemoryRegionAccessRights=UR, OsMemoryRegionAccessRights=SW, OsMemoryRegionAccessRights=UW
        Registers_SW_SR_UW_UR: OsMemoryRegionStartAddress=0xFF000000, OsMemoryRegionEndAddress=0xFFFFFFFF, OsMemoryRegionAccessRights=SR, OsMemoryRegionAccessRights=UR, OsMemoryRegionAccessRights=SW, OsMemoryRegionAccessRights=UW
        StackRAM_SR_UR: OsMemoryRegionStartAddress=_OS_CORE0_STACKS_START, OsMemoryRegionEndAddress=_OS_CORE0_STACKS_END, OsMemoryRegionAccessRights=SR, OsMemoryRegionAccessRights=UR
      InterruptController (OsPeripheralRegion):
        OsPeripheralRegionStartAddress = 0xFFFEEA00
        OsPeripheralRegionEndAddress = 0xFFFFF000
        OsPeripheralRegionAccessingApp = SystemApplication_OsCore_CORE0
        OsPeripheralRegionAccessingApp = Appl10
      BackUpRAM_SR_SW_UR_UW (OsMemoryRegion):
        OsMemoryRegionStartAddress = 0xFEBFFC00
        OsMemoryRegionEndAddress = 0xFEBFFFFF
        OsMemoryRegionProtectionUnit = MPU_CORE0
        OsMemoryRegionAccessRights = SR
        OsMemoryRegionAccessRights = SW
        OsMemoryRegionAccessRights = UR
        OsMemoryRegionAccessRights = UW
    5 x OsAlarm, all with OsAlarmCounterRef=OsCounter, OsAlarmAccessingApplication=SystemApplication_OsCore_CORE0:
      Rte_Al_TE2_Task_4msBsw_Appl10_0_4ms
        OsAlarmAction
          OsAlarmActivateTask: OsAlarmActivateTaskRef=Task_4msBsw_Appl10
      Rte_Al_TE_Task_4ms_Appl10_0_4ms
        OsAlarmAction
          OsAlarmActivateTask: OsAlarmActivateTaskRef=Task_4ms_Appl10
      Rte_Al_TE_Task_2ms_Appl10_0_2ms
        OsAlarmAction
          OsAlarmActivateTask: OsAlarmActivateTaskRef=Task_2ms_Appl10
      Rte_Al_TE2_Task_10msBsw_Appl10_0_10ms
        OsAlarmAction
          OsAlarmActivateTask: OsAlarmActivateTaskRef=Task_10msBsw_Appl10
      Rte_Al_TE_Task_10ms_Appl10_0_10ms
        OsAlarmAction
          OsAlarmActivateTask: OsAlarmActivateTaskRef=Task_10ms_Appl10
    Task_PreStart_CORE0 (OsTask):
      OsTaskActivation = 1
      OsTaskPriority = 99
      OsTaskSchedule = FULL
      OsTaskStackSharing = false
      OsTaskStackSize = 512
      OsTaskType = AUTO
      OsTaskAccessingApplication = SystemApplication_OsCore_CORE0
    Task_100ms_Appl10 (OsTask):
      OsTaskActivation = 1
      OsTaskPriority = 53
      OsTaskSchedule = FULL
      OsTaskStackSharing = false
      OsTaskStackSize = 2048
      OsTaskType = AUTO
      OsTaskAccessingApplication = SystemApplication_OsCore_CORE0
      OsTaskResourceRef = SHUTDOWN_ONGOING
    Rte_Al_TE_Task_100ms_Appl10_0_100ms (OsAlarm): OsAlarmCounterRef=OsCounter, OsAlarmAccessingApplication=SystemApplication_OsCore_CORE0
      OsAlarmAction
        OsAlarmActivateTask: OsAlarmActivateTaskRef=Task_100ms_Appl10
    WDG_59_DRIVERA_TRIGGERFUNCTION_ISR (OsIsr): OsIsrCategory=CATEGORY_1, OsIsrInterruptType=EXTERNAL, OsIsrInterruptSource=8, OsIsrInterruptPriority=2, OsIsrStackSize=0, OsIsrEnableNesting=false
    Rte_Al_TE_CanTp_CanTp_MainFunction (OsAlarm): OsAlarmCounterRef=OsCounter, OsAlarmAccessingApplication=SystemApplication_OsCore_CORE0
      OsAlarmAction
        OsAlarmActivateTask: OsAlarmActivateTaskRef=Task_5msBsw_Appl10
    Task_5msBsw_Appl10 (OsTask):
      OsTaskActivation = 1
      OsTaskPriority = 62
      OsTaskSchedule = FULL
      OsTaskStackSharing = false
      OsTaskStackSize = 1024
      OsTaskType = AUTO
      OsTaskAccessingApplication = SystemApplication_OsCore_CORE0
      OsTaskResourceRef = SHUTDOWN_ONGOING
    CanIsr_1 (OsIsr):  # Os Interrupt Service Routine PLAIN_TEXT Can messages event (for a specific controllers)
      OsIsrCategory = CATEGORY_2
      OsIsrInterruptType = EXTERNAL
      OsIsrInterruptSource = 175
      OsIsrInterruptPriority = 15
      OsIsrStackSize = 2048
      OsIsrEnableNesting = true
    MCU_FEINT_ISR (OsIsr): OsIsrCategory=CATEGORY_1, OsIsrInterruptType=EXCEPTION, OsIsrInterruptSource=15, OsIsrInterruptPriority=0, OsIsrStackSize=0, OsIsrEnableNesting=false
    SHUTDOWN_ONGOING (OsResource):
      OsResourceProperty = STANDARD
      OsResourceAccessingApplication = SystemApplication_OsCore_CORE0
      OsResourceAccessingApplication = Appl10
      OsResourceAccessingApplication = Appl0
    3 x OsIsr, all with OsIsrInterruptType=EXTERNAL:
      MotCtrlMgrIrq: OsIsrCategory=CATEGORY_1, OsIsrInterruptSource=17, OsIsrInterruptPriority=1, OsIsrStackSize=0, OsIsrEnableNesting=false
      SPI_CSIH0_TIC_CAT2_ISR: OsIsrCategory=CATEGORY_2, OsIsrInterruptSource=88, OsIsrInterruptPriority=14, OsIsrStackSize=1024, OsIsrEnableNesting=true
      SPI_CSIH0_TIRE_CAT2_ISR: OsIsrCategory=CATEGORY_2, OsIsrInterruptSource=86, OsIsrInterruptPriority=14, OsIsrStackSize=1024, OsIsrEnableNesting=true
    Task_2msTmplMonr_Appl10 (OsTask):
      OsTaskActivation = 1
      OsTaskPriority = 84
      OsTaskSchedule = FULL
      OsTaskStackSharing = false
      OsTaskStackSize = 2048
      OsTaskType = AUTO
      OsTaskAccessingApplication = SystemApplication_OsCore_CORE0
    Rte_Al_TE_Task_2msTmplMonr_Appl10_0_2ms (OsAlarm): OsAlarmCounterRef=OsCounter, OsAlarmAccessingApplication=SystemApplication_OsCore_CORE0
      OsAlarmAction
        OsAlarmActivateTask: OsAlarmActivateTaskRef=Task_2msTmplMonr_Appl10
    3 x OsIsr:
      SysErrIrq: OsIsrCategory=CATEGORY_1, OsIsrInterruptType=EXCEPTION, OsIsrInterruptSource=1, OsIsrInterruptPriority=0, OsIsrStackSize=0, OsIsrEnableNesting=false, OsIsrSpecialFunctionName=Patched_SysErrIrq
      FpuErrIrq: OsIsrCategory=CATEGORY_1, OsIsrInterruptType=EXCEPTION, OsIsrInterruptSource=7, OsIsrInterruptPriority=0, OsIsrStackSize=0, OsIsrEnableNesting=false, OsIsrSpecialFunctionName=Patched_FpuErrIrq
      MCU_ECM_EIC_CAT2_ISR: OsIsrCategory=CATEGORY_2, OsIsrInterruptType=EXTERNAL, OsIsrInterruptSource=0, OsIsrInterruptPriority=3, OsIsrStackSize=512, OsIsrEnableNesting=true
