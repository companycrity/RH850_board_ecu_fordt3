AUTOSAR XML (schema 4-2-1)
package /ActiveEcuC
  module config CanNm: implementation-config-variant=VARIANT-PRE-COMPILE, module-description=CanNm_Impl
    CanNmGlobalConfig:
      CanNmBusSynchronizationEnabled = false
      CanNmImmediateRestartEnabled = false
      CanNmPduRxIndicationEnabled = false
      CanNmStateChangeIndEnabled = true
      CanNmRemoteSleepIndEnabled = true
      CanNmBusLoadReductionEnabled = false
      CanNmNodeDetectionEnabled = false
      CanNmPassiveModeEnabled = false
      CanNmPnEiraCalcEnabled = false
      CanNmRepeatMsgIndEnabled = false
      CanNmImmediateTxconfEnabled = false
      CanNmCanIfRangeConfigDLCCheck = true
      CanNmUserDataEnabled = true
      CanNmComUserDataSupport = false
      CanNmComControlEnabled = true
      CanNmCoordinatorSyncSupport = false
      CanNmDevErrorDetect = true
      CanNmMainFunctionPeriod = 0.01
      CanNmVersionInfoApi = false
      CanNmDisableTxErrReport = true
      CanNmApiOptimization = false
      CanNmNodeIdEnabled = false
      CanNmRuntimeMeasurementSupport = false
      CanNmGeneration: CanNmOutOfBoundsWriteSanitizer=false, CanNmOutOfBoundsReadSanitizer=false, CanNmInterfacesForDeactivatedData=false
      CanNmChannelConfig:
        CanNmTimeoutTime = 3
        CanNmWaitBusSleepTime = 1.5
        CanNmActiveWakeupBitEnabled = true
        CanNmBusLoadReductionActive = false
        CanNmMsgTimeoutTime = 0.9
        CanNmPduCbvPosition = CANNM_PDU_BYTE_1
        CanNmPduNidPosition = CANNM_PDU_BYTE_0
        CanNmRemoteSleepIndTime = 1.5
        CanNmRepeatMessageTime = 0
        CanNmUserDataLength = 6
        CanNmPnEnabled = false
        CanNmPnEraCalcEnabled = false
        CanNmPnHandleMultipleNetworkRequests = false
        CanNmCarWakeUpRxEnabled = false
        CanNmMsgCycleOffset = 0
        CanNmMsgCycleTime = 1
        CanNmMsgReducedTime = 0.8
        CanNmImmediateNmTransmissions = 0
        CanNmNodeId = 0
        CanNmComMNetworkHandleRef = FD1_CAN_f26020e5
        CanNmRxPdu: CanNmRxPduId=0, CanNmRxPduRef=Pdu_NmRx_Dummy
        CanNmTxPdu: CanNmTxConfirmationPduId=0, CanNmTxPduRef=PSCM_AutoSar_NetwrkMgt_FD1_9b1e365c
