AUTOSAR XML (schema 4-2-1)
package /ActiveEcuC
  module config Fee: implementation-config-variant=VARIANT-PRE-COMPILE, module-description=Fee_Impl
    FeeConfigBlock (FeeBlockConfiguration):
      FeeBlockNumber = 2
      FeeBlockSize = 4
      FeeImmediateData = false
      FeeNumberOfWriteCycles = 10000
      FeeNumberOfDatasets = 1
      FeeNumberOfInstances = 1
      FeeVerifyWrittenData = false
      FeeBlockId = 0
      FeeDeviceIndex = FlsGeneral
      FeePartition = FEE0
    FeeGeneral:
      FeeDevErrorDetect = true
      FeeIndex = 0
      FeeNvmJobEndNotification = NULL_PTR
      FeeNvmJobErrorNotification = NULL_PTR
      FeePollingMode = true
      FeeSetModeSupported = true
      FeeVersionInfoApi = false
      FeeVirtualPageSize = 8
      FeeMainFunctionPeriod = 0.01
      FeeMainFunctionTriggering = FixedCycleTime
      FeeCorrectSingleBitFlips = false
      FeeSafeBswChecks = false
      FeeFlsApi:
        FeeFlsIncludeFile = Fls.h
        FeeFlsSetMode = Fls_SetMode
        FeeFlsRead = Fls_Read
        FeeFlsWrite = Fls_Write
        FeeFlsCancel = Fls_Cancel
        FeeFlsGetStatus = Fls_GetStatus
        FeeFlsGetJobResult = Fls_GetJobResult
        FeeFlsErase = Fls_Erase
        FeeFlsCompare = Fls_Compare
        FeeFlsBlankCheck = Fls_BlankCheck
        FeeFlsDeviceIndex = FlsGeneral
    FeePublishedInformation: FeeBlockOverhead=2, FeeMaximumBlockingTime=1, FeePageOverhead=0
    FEE0 (FeePartitionConfiguration):
      FeePartitionStartAddress = 0
      FeePartitionSize = 64832
      FeePartitionAddressAlignment = 64
      FeePartitionWriteAlignment = 4
      FeePartitionReadAlignment = 1
      FeeFlsBlankCheckApi = true
      FeePartitionDevice = FlsConfigSet
    144 x FeeBlockConfiguration, all with FeeImmediateData=false, FeeNumberOfWriteCycles=10000, FeeNumberOfDatasets=1, FeeNumberOfInstances=1, FeeVerifyWrittenData=false, FeeDeviceIndex=FlsGeneral, FeePartition=FEE0:
      FeeDemAdminDataBlock: FeeBlockNumber=4, FeeBlockSize=1, FeeBlockId=1
      FeeDemStatusDataBlock: FeeBlockNumber=6, FeeBlockSize=1, FeeBlockId=2
      FeeDemPrimaryDataBlock0: FeeBlockNumber=8, FeeBlockSize=1, FeeBlockId=3
      FeeDemPrimaryDataBlock1: FeeBlockNumber=10, FeeBlockSize=1, FeeBlockId=4
      FeeDemPrimaryDataBlock2: FeeBlockNumber=12, FeeBlockSize=1, FeeBlockId=5
      FeeDemPrimaryDataBlock3: FeeBlockNumber=14, FeeBlockSize=1, FeeBlockId=6
      FeeDemPrimaryDataBlock4: FeeBlockNumber=16, FeeBlockSize=1, FeeBlockId=7
      FeeDemPrimaryDataBlock5: FeeBlockNumber=18, FeeBlockSize=1, FeeBlockId=8
      FeeDemPrimaryDataBlock6: FeeBlockNumber=20, FeeBlockSize=1, FeeBlockId=9
      FeeDemPrimaryDataBlock7: FeeBlockNumber=22, FeeBlockSize=1, FeeBlockId=10
      FeeDemSecondaryDataBlock0: FeeBlockNumber=24, FeeBlockSize=1, FeeBlockId=11
      FeeDemSecondaryDataBlock1: FeeBlockNumber=26, FeeBlockSize=1, FeeBlockId=12
      FeeDemSecondaryDataBlock2: FeeBlockNumber=28, FeeBlockSize=1, FeeBlockId=13
      FeeDemSecondaryDataBlock3: FeeBlockNumber=30, FeeBlockSize=1, FeeBlockId=14
      FeeDemSecondaryDataBlock4: FeeBlockNumber=32, FeeBlockSize=1, FeeBlockId=15
      FeeDemSecondaryDataBlock5: FeeBlockNumber=34, FeeBlockSize=1, FeeBlockId=16
      FeeDemSecondaryDataBlock6: FeeBlockNumber=36, FeeBlockSize=1, FeeBlockId=17
      FeeDemSecondaryDataBlock7: FeeBlockNumber=38, FeeBlockSize=1, FeeBlockId=18
      FeeDemSecondaryDataBlock8: FeeBlockNumber=40, FeeBlockSize=1, FeeBlockId=19
      FeeDemSecondaryDataBlock9: FeeBlockNumber=42, FeeBlockSize=1, FeeBlockId=20
      FeeDemSecondaryDataBlock10: FeeBlockNumber=44, FeeBlockSize=1, FeeBlockId=21
      FeeDemSecondaryDataBlock11: FeeBlockNumber=46, FeeBlockSize=1, FeeBlockId=22
      FeeDemSecondaryDataBlock12: FeeBlockNumber=48, FeeBlockSize=1, FeeBlockId=23
      FeeDemSecondaryDataBlock13: FeeBlockNumber=50, FeeBlockSize=1, FeeBlockId=24
      FeeDemSecondaryDataBlock14: FeeBlockNumber=52, FeeBlockSize=1, FeeBlockId=25
      FeeDemSecondaryDataBlock15: FeeBlockNumber=54, FeeBlockSize=1, FeeBlockId=26
      FeeDemSecondaryDataBlock16: FeeBlockNumber=56, FeeBlockSize=1, FeeBlockId=27
      FeeDemSecondaryDataBlock17: FeeBlockNumber=58, FeeBlockSize=1, FeeBlockId=28
      FeeDemSecondaryDataBlock18: FeeBlockNumber=60, FeeBlockSize=1, FeeBlockId=29
      FeeDemSecondaryDataBlock19: FeeBlockNumber=62, FeeBlockSize=1, FeeBlockId=30
      FeeDemSecondaryDataBlock20: FeeBlockNumber=64, FeeBlockSize=1, FeeBlockId=31
      FeeDemSecondaryDataBlock21: FeeBlockNumber=66, FeeBlockSize=1, FeeBlockId=32
      FeeDemSecondaryDataBlock22: FeeBlockNumber=68, FeeBlockSize=1, FeeBlockId=33
      FeeDemSecondaryDataBlock23: FeeBlockNumber=70, FeeBlockSize=1, FeeBlockId=34
      FeeDemSecondaryDataBlock24: FeeBlockNumber=72, FeeBlockSize=1, FeeBlockId=35
      FeeDemSecondaryDataBlock25: FeeBlockNumber=74, FeeBlockSize=1, FeeBlockId=36
      FeeDemSecondaryDataBlock26: FeeBlockNumber=76, FeeBlockSize=1, FeeBlockId=37
      FeeDemSecondaryDataBlock27: FeeBlockNumber=78, FeeBlockSize=1, FeeBlockId=38
      FeeDemSecondaryDataBlock28: FeeBlockNumber=80, FeeBlockSize=1, FeeBlockId=39
      FeeDemSecondaryDataBlock29: FeeBlockNumber=82, FeeBlockSize=1, FeeBlockId=40
      FeeDemSecondaryDataBlock30: FeeBlockNumber=84, FeeBlockSize=1, FeeBlockId=41
      FeeDemSecondaryDataBlock31: FeeBlockNumber=86, FeeBlockSize=1, FeeBlockId=42
      FeeDemSecondaryDataBlock32: FeeBlockNumber=88, FeeBlockSize=1, FeeBlockId=43
      FeeDemSecondaryDataBlock33: FeeBlockNumber=90, FeeBlockSize=1, FeeBlockId=44
      FeeDemSecondaryDataBlock34: FeeBlockNumber=92, FeeBlockSize=1, FeeBlockId=45
      FeeDemSecondaryDataBlock35: FeeBlockNumber=94, FeeBlockSize=1, FeeBlockId=46
      FeeDemSecondaryDataBlock36: FeeBlockNumber=96, FeeBlockSize=1, FeeBlockId=47
      FeeDemSecondaryDataBlock37: FeeBlockNumber=98, FeeBlockSize=1, FeeBlockId=48
      FeeDemSecondaryDataBlock38: FeeBlockNumber=100, FeeBlockSize=1, FeeBlockId=49
      FeeDemSecondaryDataBlock39: FeeBlockNumber=102, FeeBlockSize=1, FeeBlockId=50
      FeeRte_NvmBlock_CDD_NvMProxy_ShtdwnClsChk: FeeBlockNumber=104, FeeBlockSize=6, FeeBlockId=51
      FeeRte_NvmBlock_DiagcMgr_DiagcMgrApplCrc: FeeBlockNumber=106, FeeBlockSize=6, FeeBlockId=52
      FeeRte_NvmBlock_DiagcMgr_DiagcMgrLtchCntrAry: FeeBlockNumber=108, FeeBlockSize=22, FeeBlockId=53
      FeeRte_NvmBlock_DiagcMgr_DiagcMgrNtcFltAry: FeeBlockNumber=110, FeeBlockSize=82, FeeBlockId=54
      FeeBlockDescriptor: FeeBlockNumber=112, FeeBlockSize=258, FeeBlockId=55
      FeeRte_NvmBlock_CDD_MotAgCmp_MotAgCmpMotAgBackEmf: FeeBlockNumber=114, FeeBlockSize=4, FeeBlockId=56
      FeeRte_NvmBlock_MotAg2Meas_MotAg2EolPrm: FeeBlockNumber=116, FeeBlockSize=22, FeeBlockId=57
      FeeRte_NvmBlock_PolarityCfg_PolarityCfgSaved: FeeBlockNumber=118, FeeBlockSize=6, FeeBlockId=58
      FeeRte_NvmBlock_CDD_CurrMeas_CurrMeasEolGainCalSetABC: FeeBlockNumber=120, FeeBlockSize=14, FeeBlockId=59
      FeeRte_NvmBlock_CDD_CurrMeas_CurrMeasEolOffsCalSetABC: FeeBlockNumber=122, FeeBlockSize=30, FeeBlockId=60
      FeeRte_NvmBlock_HwAgSnsrls_StordLstPrm: FeeBlockNumber=124, FeeBlockSize=10, FeeBlockId=61
      FeeRte_NvmBlock_EotLrng_EotNvmData: FeeBlockNumber=126, FeeBlockSize=14, FeeBlockId=62
      FeeRte_NvmBlock_EotLrng_MaxHwAgCwAndCcw: FeeBlockNumber=128, FeeBlockSize=14, FeeBlockId=63
      FeeRte_NvmBlock_CDD_MotRplCoggCmd_MotCoggCmdY: FeeBlockNumber=130, FeeBlockSize=1026, FeeBlockId=64
      FeeRte_NvmBlock_MotRplCoggCfg_MotRplCoggPrm: FeeBlockNumber=132, FeeBlockSize=20, FeeBlockId=65
      FeeRte_NvmBlock_SysFricLrng_FricNonLrngData: FeeBlockNumber=134, FeeBlockSize=10, FeeBlockId=66
      FeeRte_NvmBlock_SysFricLrng_FricLrngData: FeeBlockNumber=136, FeeBlockSize=218, FeeBlockId=67
      FeeRte_NvmBlock_CDD_VrfyCritReg_MCalReadVrfyCritRegFltNvmInfo: FeeBlockNumber=138, FeeBlockSize=6, FeeBlockId=68
      FeeRte_NvmBlock_HwAg1Meas_HwAg1IfFltLtch: FeeBlockNumber=140, FeeBlockSize=3, FeeBlockId=69
      FeeRte_NvmBlock_HwAg1Meas_HwAg1Offs: FeeBlockNumber=142, FeeBlockSize=10, FeeBlockId=70
      FeeRte_NvmBlock_CDD_MotAg5Meas_MotAg5EolPrm: FeeBlockNumber=144, FeeBlockSize=310, FeeBlockId=71
      FeeRte_NvmBlock_CDD_MotAg5Meas_MotAg5StVari: FeeBlockNumber=146, FeeBlockSize=18, FeeBlockId=72
      FeeRte_NvmBlock_CDD_MotAg6Meas_MotAg6EolPrm: FeeBlockNumber=148, FeeBlockSize=310, FeeBlockId=73
      FeeRte_NvmBlock_CDD_MotAg6Meas_MotAg6StVari: FeeBlockNumber=150, FeeBlockSize=18, FeeBlockId=74
      FeeRte_NvmBlock_MotCtrlPrmEstimn_MotPrmNom: FeeBlockNumber=152, FeeBlockSize=10, FeeBlockId=75
      FeeRte_NvmBlock_HwTqCorrln_HwTqChACmnModCmpLpFilSt: FeeBlockNumber=154, FeeBlockSize=6, FeeBlockId=76
      FeeRte_NvmBlock_MotTqCmdSca_MotTqScaFac: FeeBlockNumber=156, FeeBlockSize=6, FeeBlockId=77
      FeeRte_NvmBlock_DutyCycThermProtn_FilStVal: FeeBlockNumber=158, FeeBlockSize=6, FeeBlockId=78
      FeeRte_NvmBlock_CmnMfgSrv_CcaHwPartNr: FeeBlockNumber=160, FeeBlockSize=22, FeeBlockId=79
      FeeRte_NvmBlock_CmnMfgSrv_CcaSerlNr: FeeBlockNumber=162, FeeBlockSize=22, FeeBlockId=80
      FeeRte_NvmBlock_CmnMfgSrv_DiRestore: FeeBlockNumber=164, FeeBlockSize=10, FeeBlockId=81
      FeeRte_NvmBlock_CmnMfgSrv_EpsSysSerlNr: FeeBlockNumber=166, FeeBlockSize=22, FeeBlockId=82
      FeeRte_NvmBlock_CmnMfgSrv_IgnCntr: FeeBlockNumber=168, FeeBlockSize=6, FeeBlockId=83
      FeeRte_NvmBlock_CmnMfgSrv_MfgTmpBuf0: FeeBlockNumber=170, FeeBlockSize=18, FeeBlockId=84
      FeeRte_NvmBlock_CmnMfgSrv_MfgTmpBuf1: FeeBlockNumber=172, FeeBlockSize=18, FeeBlockId=85
      FeeRte_NvmBlock_CmnMfgSrv_MfgTmpBuf2: FeeBlockNumber=174, FeeBlockSize=18, FeeBlockId=86
      FeeRte_NvmBlock_CmnMfgSrv_MfgTmpBuf3: FeeBlockNumber=176, FeeBlockSize=18, FeeBlockId=87
      FeeRte_NvmBlock_CmnMfgSrv_MfgTmpBuf4: FeeBlockNumber=178, FeeBlockSize=18, FeeBlockId=88
      FeeRte_NvmBlock_CmnMfgSrv_NxtrMfgEnaCntr: FeeBlockNumber=180, FeeBlockSize=3, FeeBlockId=89
      FeeRte_NvmBlock_CmnMfgSrv_SeedKey: FeeBlockNumber=182, FeeBlockSize=10, FeeBlockId=90
      FeeRte_NvmBlock_CDD_HwTq1Meas_HwTq1Offs: FeeBlockNumber=184, FeeBlockSize=10, FeeBlockId=91
      FeeRte_NvmBlock_CDD_HwTq8Meas_HwTq8Offs: FeeBlockNumber=186, FeeBlockSize=10, FeeBlockId=92
      FeeRte_NvmBlock_TEstimn_TFilStVal: FeeBlockNumber=188, FeeBlockSize=34, FeeBlockId=93
      FeeRte_NvmBlock_HwTq9Meas_HwTq9Offs: FeeBlockNumber=190, FeeBlockSize=10, FeeBlockId=94
      FeeRte_NvmBlock_HwTq10Meas_HwTq10Offs: FeeBlockNumber=192, FeeBlockSize=10, FeeBlockId=95
      FeeRte_NvmBlock_CustDiag_DidDE00: FeeBlockNumber=194, FeeBlockSize=26, FeeBlockId=96
      FeeRte_NvmBlock_CustDiag_DidDE01: FeeBlockNumber=196, FeeBlockSize=26, FeeBlockId=97
      FeeRte_NvmBlock_CustDiag_DidDE02: FeeBlockNumber=198, FeeBlockSize=26, FeeBlockId=98
      FeeRte_NvmBlock_CustDiag_DidDE03: FeeBlockNumber=200, FeeBlockSize=66, FeeBlockId=99
      FeeRte_NvmBlock_CustDiag_DidDE04: FeeBlockNumber=202, FeeBlockSize=4, FeeBlockId=100
      FeeRte_NvmBlock_CustDiag_Did3003: FeeBlockNumber=204, FeeBlockSize=26, FeeBlockId=101
      FeeRte_NvmBlock_CustDiag_DidEE01: FeeBlockNumber=206, FeeBlockSize=3, FeeBlockId=102
      FeeRte_NvmBlock_CustDiag_DidEE02: FeeBlockNumber=208, FeeBlockSize=3, FeeBlockId=103
      FeeRte_NvmBlock_CustDiag_DidF111: FeeBlockNumber=210, FeeBlockSize=26, FeeBlockId=104
      FeeRte_NvmBlock_CustDiag_DidF113: FeeBlockNumber=212, FeeBlockSize=26, FeeBlockId=105
      FeeRte_NvmBlock_FordHwAgArbn_PrevIgnCycVal: FeeBlockNumber=214, FeeBlockSize=6, FeeBlockId=106
      FeeRte_NvmBlock_FordHwAgArbn_NonAbsOffsVldFlg: FeeBlockNumber=216, FeeBlockSize=3, FeeBlockId=107
      FeeRte_NvmBlock_FordHwAgArbn_NonAbsOffs: FeeBlockNumber=218, FeeBlockSize=6, FeeBlockId=108
      FeeRte_NvmBlock_FordVehSpdArbn_FordVehTireCircum: FeeBlockNumber=220, FeeBlockSize=4, FeeBlockId=109
      FeeRte_NvmBlock_CustDiag_DidEE87: FeeBlockNumber=222, FeeBlockSize=6, FeeBlockId=110
      FeeRte_NvmBlock_CustDiag_DidF110: FeeBlockNumber=224, FeeBlockSize=26, FeeBlockId=111
      FeeRte_NvmBlock_CustDiag_DidF163: FeeBlockNumber=226, FeeBlockSize=3, FeeBlockId=112
      FeeRte_NvmBlock_CustDiag_DidF18C: FeeBlockNumber=228, FeeBlockSize=18, FeeBlockId=113
      FeeRte_NvmBlock_CustDiag_Did205B: FeeBlockNumber=230, FeeBlockSize=4, FeeBlockId=114
      FeeRte_NvmBlock_CustDiag_DidEE00: FeeBlockNumber=232, FeeBlockSize=5, FeeBlockId=115
      FeeRte_NvmBlock_CustDiag_DidDE05: FeeBlockNumber=234, FeeBlockSize=26, FeeBlockId=116
      FeeRte_NvmBlock_CustDiag_DidEE40: FeeBlockNumber=236, FeeBlockSize=5, FeeBlockId=117
      FeeRte_NvmBlock_CustDiag_DidF18A: FeeBlockNumber=238, FeeBlockSize=26, FeeBlockId=118
      FeeRte_NvmBlock_CustDiag_DidEE84: FeeBlockNumber=240, FeeBlockSize=6, FeeBlockId=119
      FeeRte_NvmBlock_CustDiag_DidF15F: FeeBlockNumber=242, FeeBlockSize=12, FeeBlockId=120
      FeeRte_NvmBlock_CustDiag_DidF166: FeeBlockNumber=244, FeeBlockSize=6, FeeBlockId=121
      FeeRte_NvmBlock_CustDiag_DidF162: FeeBlockNumber=246, FeeBlockSize=3, FeeBlockId=122
      FeeRte_NvmBlock_CustDiag_DidEE82: FeeBlockNumber=248, FeeBlockSize=6, FeeBlockId=123
      FeeRte_NvmBlock_CustDiag_DidEE86: FeeBlockNumber=250, FeeBlockSize=6, FeeBlockId=124
      FeeRte_NvmBlock_CustDiag_DidEE88: FeeBlockNumber=252, FeeBlockSize=6, FeeBlockId=125
      FeeRte_NvmBlock_CustDiag_DidEE85: FeeBlockNumber=254, FeeBlockSize=6, FeeBlockId=126
      FeeRte_NvmBlock_CustDiag_Did205A: FeeBlockNumber=256, FeeBlockSize=4, FeeBlockId=127
      FeeRte_NvmBlock_CustDiag_DidEE81: FeeBlockNumber=258, FeeBlockSize=6, FeeBlockId=128
      FeeRte_NvmBlock_CustDiag_Did301A: FeeBlockNumber=260, FeeBlockSize=4, FeeBlockId=129
      FeeRte_NvmBlock_CustDiag_DidEE41: FeeBlockNumber=262, FeeBlockSize=3, FeeBlockId=130
      FeeRte_NvmBlock_CustDiag_DidEE83: FeeBlockNumber=264, FeeBlockSize=6, FeeBlockId=131
      FeeRte_NvmBlock_CustDiag_DidEED0: FeeBlockNumber=266, FeeBlockSize=3, FeeBlockId=132
      FeeRte_NvmBlock_CustDiag_DidEE21: FeeBlockNumber=268, FeeBlockSize=22, FeeBlockId=133
      FeeRte_NvmBlock_CustDiag_Did630F: FeeBlockNumber=270, FeeBlockSize=26, FeeBlockId=134
      FeeRte_NvmBlock_CustDiag_DidEE22: FeeBlockNumber=272, FeeBlockSize=42, FeeBlockId=135
      FeeRte_NvmBlock_CustDiag_DidEE23: FeeBlockNumber=274, FeeBlockSize=42, FeeBlockId=136
      FeeRte_NvmBlock_CustDiag_Did630FChk: FeeBlockNumber=276, FeeBlockSize=3, FeeBlockId=137
      FeeRte_NvmBlock_CustDiag_DidF190: FeeBlockNumber=278, FeeBlockSize=26, FeeBlockId=138
      FeeRte_NvmBlock_StackMeas_StackMeasRes: FeeBlockNumber=280, FeeBlockSize=50, FeeBlockId=139
      FeeRte_NvmBlock_StackMeas_StackMeasCntr: FeeBlockNumber=282, FeeBlockSize=6, FeeBlockId=140
      FeeRte_NvmBlock_CDD_FordBlaBoxIfCmp1_LaneAssi: FeeBlockNumber=284, FeeBlockSize=258, FeeBlockId=141
      FeeRte_NvmBlock_CDD_FordBlaBoxIfCmp1_ActvNiblCtrl: FeeBlockNumber=286, FeeBlockSize=130, FeeBlockId=142
      FeeRte_NvmBlock_CDD_FordBlaBoxIfCmp1_TrlrBackupAssi: FeeBlockNumber=288, FeeBlockSize=514, FeeBlockId=143
      FeeRte_NvmBlock_CDD_FordBlaBoxIfCmp1_PullDriftCmp: FeeBlockNumber=290, FeeBlockSize=130, FeeBlockId=144
