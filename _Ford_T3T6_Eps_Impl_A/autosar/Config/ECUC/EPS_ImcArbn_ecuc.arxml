AUTOSAR XML (schema 4-2-1)
package /ActiveEcuC
  module config ImcArbn: implementation-config-variant=VARIANT-PRE-COMPILE
    EcuId (ImcArbnSignal): SignalName=EcuId, DestSize=8, DataType=uint8, ImcArbnSigUsersRef=DualEcuIdnSecdryEcuIdn
    Imc00SignalGroup (ImcArbnSignalGroup)
      ImcArbnSGAttributes: PrimarySrcOnlySignalGroup=false, ImcArbnGroupTxRate=IMCARBN_10MS_GROUP
      5 x ImcArbnSigRef:
        DiagcStsNonRcrvlReqDiFltPrsnt: StartBit=11, ImcArbnSigNameRef=ImcArbn/DiagcStsNonRcrvlReqDiFltPrsnt
        DualEcuMotCtrlMtgtnEna: StartBit=8, ImcArbnSigNameRef=ImcArbn/DualEcuMotCtrlMtgtnEna
        EcuId: StartBit=12, ImcArbnSigNameRef=ImcArbn/EcuId
        SysSt: StartBit=0, ImcArbnSigNameRef=ImcArbn/SysSt
        VehSpdVld: StartBit=9, ImcArbnSigNameRef=ImcArbn/VehSpdVld
    Imc01SignalGroup (ImcArbnSignalGroup)
      ImcArbnSGAttributes: PrimarySrcOnlySignalGroup=false, ImcArbnGroupTxRate=IMCARBN_10MS_GROUP
      HwAg (ImcArbnSigRef): StartBit=0, ImcArbnSigNameRef=ImcArbn/HwAg
    ImcSigArbnVehSpd (ImcArbnSignalUserGroups): FddName=ImcSigArbn, ReceiverSideSignalName=VehSpd, DataType=float32
    VehSpd (ImcArbnSignal): SignalName=VehSpd, DestSize=32, DataType=float32, ImcArbnSigUsersRef=ImcSigArbnVehSpd
    Imc02SignalGroup (ImcArbnSignalGroup)
      ImcArbnSGAttributes: PrimarySrcOnlySignalGroup=false, ImcArbnGroupTxRate=IMCARBN_10MS_GROUP
      HwTq (ImcArbnSigRef): StartBit=0, ImcArbnSigNameRef=ImcArbn/HwTq
    6 x ImcArbnSignalUserGroups, all with FddName=ImcSigArbn:
      ImcSigArbnHwAg: ReceiverSideSignalName=HwAg, DataType=float32
      ImcSigArbnHwTq: ReceiverSideSignalName=HwTq, DataType=float32
      ImcSigArbnMotVel: ReceiverSideSignalName=MotVel, DataType=float32
      ImcSigArbnPosnServoIntgtrSt: ReceiverSideSignalName=PosnServoIntgtrSt, DataType=float32
      ImcSigArbnSysSt: ReceiverSideSignalName=SysSt, DataType=uint8
      ImcSigArbnVehSpdVld: ReceiverSideSignalName=VehSpdVld, DataType=boolean
    RstReq (ImcArbnSignal): SignalName=RstReq, DestSize=8, DataType=uint8, ImcArbnSigUsersRef=CustDiagcRstReq
    CustDiagcRstReq (ImcArbnSignalUserGroups): FddName=CustDiagc, ReceiverSideSignalName=RstReq, DataType=uint8
    DiagcStsNonRcrvlReqDiFltPrsnt (ImcArbnSignal): SignalName=DiagcStsNonRcrvlReqDiFltPrsnt, DestSize=1, DataType=boolean, ImcArbnSigUsersRef=DualCtrlrOutpMgrDiagcStsNonRcrvlReqDiFltPrsnt
    3 x ImcArbnSignalUserGroups:
      DualCtrlrOutpMgrDiagcStsNonRcrvlReqDiFltPrsnt: FddName=DualCtrlrOutpMgr, ReceiverSideSignalName=DiagcStsNonRcrvlReqDiFltPrsnt, DataType=boolean
      DualCtrlrOutpMgrDualEcuMotCtrlMtgtnEna: FddName=DualCtrlrOutpMgr, ReceiverSideSignalName=DualEcuMotCtrlMtgtnEna, DataType=boolean
      DualEcuIdnSecdryEcuIdn: FddName=DualEcuIdn, ReceiverSideSignalName=SecdryEcuIdn, DataType=uint8
    3 x ImcArbnSignal:
      DualEcuMotCtrlMtgtnEna: SignalName=DualEcuMotCtrlMtgtnEna, DestSize=1, DataType=boolean, ImcArbnSigUsersRef=DualCtrlrOutpMgrDualEcuMotCtrlMtgtnEna
      HwAg: SignalName=HwAg, DestSize=32, DataType=float32, ImcArbnSigUsersRef=ImcSigArbnHwAg
      HwTq: SignalName=HwTq, DestSize=32, DataType=float32, ImcArbnSigUsersRef=ImcSigArbnHwTq
    6 x ImcArbnSignalGroup:
      Imc03SignalGroup
        MotVel (ImcArbnSigRef): StartBit=0, ImcArbnSigNameRef=ImcArbn/MotVel
        ImcArbnSGAttributes: PrimarySrcOnlySignalGroup=false, ImcArbnGroupTxRate=IMCARBN_10MS_GROUP
      Imc04SignalGroup
        HwTq (ImcArbnSigRef): StartBit=0, ImcArbnSigNameRef=ImcArbn/HwTq
        ImcArbnSGAttributes: PrimarySrcOnlySignalGroup=false, ImcArbnGroupTxRate=IMCARBN_10MS_GROUP
      Imc05SignalGroup
        VehSpd (ImcArbnSigRef): StartBit=0, ImcArbnSigNameRef=ImcArbn/VehSpd
        ImcArbnSGAttributes: PrimarySrcOnlySignalGroup=false, ImcArbnGroupTxRate=IMCARBN_10MS_GROUP
      Imc06SignalGroup
        HwTq (ImcArbnSigRef): StartBit=0, ImcArbnSigNameRef=ImcArbn/HwTq
        ImcArbnSGAttributes: PrimarySrcOnlySignalGroup=false, ImcArbnGroupTxRate=IMCARBN_10MS_GROUP
      Imc07SignalGroup
        PosnServoIntgtrSt (ImcArbnSigRef): StartBit=0, ImcArbnSigNameRef=ImcArbn/PosnServoIntgtrSt
        ImcArbnSGAttributes: PrimarySrcOnlySignalGroup=false, ImcArbnGroupTxRate=IMCARBN_10MS_GROUP
      Imc08SignalGroup
        HwTq (ImcArbnSigRef): StartBit=0, ImcArbnSigNameRef=ImcArbn/HwTq
        ImcArbnSGAttributes: PrimarySrcOnlySignalGroup=false, ImcArbnGroupTxRate=IMCARBN_10MS_GROUP
    4 x ImcArbnSignal:
      MotVel: SignalName=MotVel, DestSize=32, DataType=float32, ImcArbnSigUsersRef=ImcSigArbnMotVel
      PosnServoIntgtrSt: SignalName=PosnServoIntgtrSt, DestSize=32, DataType=float32, ImcArbnSigUsersRef=ImcSigArbnPosnServoIntgtrSt
      SysSt: SignalName=SysSt, DestSize=8, DataType=uint8, ImcArbnSigUsersRef=ImcSigArbnSysSt
      VehSpdVld: SignalName=VehSpdVld, DestSize=1, DataType=boolean, ImcArbnSigUsersRef=ImcSigArbnVehSpdVld
    ImcArbnSignalGroupCustDiagcEcuConfDid (ImcArbnSignalGroup)
      ImcArbnSGAttributes: PrimarySrcOnlySignalGroup=false, ImcArbnGroupTxRate=IMCARBN_100MS_GROUP
      10 x ImcArbnSigRef:
        FordAbsPrsnt: StartBit=0, ImcArbnSigNameRef=ImcArbn/FordAbsPrsnt
        FordEscPrsnt: StartBit=1, ImcArbnSigNameRef=ImcArbn/FordEscPrsnt
        FordAfsEquid: StartBit=2, ImcArbnSigNameRef=ImcArbn/FordAfsEquid
        FordEngTqClass: StartBit=3, ImcArbnSigNameRef=ImcArbn/FordEngTqClass
        FordActvParkAssiEnad: StartBit=6, ImcArbnSigNameRef=ImcArbn/FordActvParkAssiEnad
        FordActvRtnEnad: StartBit=7, ImcArbnSigNameRef=ImcArbn/FordActvRtnEnad
        FordSoftEndStopEnad: StartBit=8, ImcArbnSigNameRef=ImcArbn/FordSoftEndStopEnad
        FordStrtStopSt: StartBit=9, ImcArbnSigNameRef=ImcArbn/FordStrtStopSt
        FordSelDrvModEnad: StartBit=11, ImcArbnSigNameRef=ImcArbn/FordSelDrvModEnad
        FordDrvrSteerRecomEnad: StartBit=12, ImcArbnSigNameRef=FordDrvrSteerRcmdnEnad
    FordDualEcuFltDiagcFordCtcIdx (ImcArbnSignalUserGroups): FddName=FordDualEcuFltDiagc, ReceiverSideSignalName=FordCtcIdx, DataType=uint8
    FordDualEcuFltDiagcFordCtcSts (ImcArbnSignalUserGroups): FddName=FordDualEcuFltDiagc, ReceiverSideSignalName=FordCtcSts, DataType=uint8
    FordCtcIdx (ImcArbnSignal): SignalName=FordCtcIdx, DestSize=8, DataType=uint8, ImcArbnSigUsersRef=FordDualEcuFltDiagcFordCtcIdx
    FordCtcSts (ImcArbnSignal): SignalName=FordCtcSts, DestSize=8, DataType=uint8, ImcArbnSigUsersRef=FordDualEcuFltDiagcFordCtcSts
    ImcArbnSignalGroupFordDualEcuFltDiagc (ImcArbnSignalGroup)
      FordCtcIdx (ImcArbnSigRef): StartBit=0, ImcArbnSigNameRef=ImcArbn/FordCtcIdx
      ImcArbnSGAttributes: PrimarySrcOnlySignalGroup=false, ImcArbnGroupTxRate=IMCARBN_100MS_GROUP
      FordCtcSts (ImcArbnSigRef): StartBit=8, ImcArbnSigNameRef=ImcArbn/FordCtcSts
    10 x ImcArbnSignalUserGroups, all with FddName=CustDiagc:
      CustDiagcFordAbsPrsnt: ReceiverSideSignalName=FordAbsPrsnt, DataType=boolean
      CustDiagcFordEscPrsnt: ReceiverSideSignalName=FordEscPrsnt, DataType=boolean
      CustDiagcFordEngTqClass: ReceiverSideSignalName=FordEngTqClass, DataType=uint8
      CustDiagcFordActvRtnEnad: ReceiverSideSignalName=FordActvRtnEnad, DataType=boolean
      CustDiagcFordActvParkAssiEnad: ReceiverSideSignalName=FordActvParkAssiEnad, DataType=boolean
      CustDiagcFordSoftEndStopEnad: ReceiverSideSignalName=FordSoftEndStopEnad, DataType=boolean
      CustDiagcFordDrvrSteerRcmdnEnad: ReceiverSideSignalName=FordDrvrSteerRcmdnEnad, DataType=boolean
      CustDiagcFordStrtStopSt: ReceiverSideSignalName=FordStrtStopSt, DataType=uint8
      CustDiagcFordSelDrvModEnad: ReceiverSideSignalName=FordSelDrvModEnad, DataType=boolean
      CustDiagcFordAfsEquid: ReceiverSideSignalName=FordAfsEquid, DataType=boolean
    10 x ImcArbnSignal:
      FordAbsPrsnt: SignalName=FordAbsPrsnt, DestSize=1, DataType=boolean, ImcArbnSigUsersRef=CustDiagcFordAbsPrsnt
      FordActvParkAssiEnad: SignalName=FordActvParkAssiEnad, DestSize=1, DataType=boolean, ImcArbnSigUsersRef=CustDiagcFordActvParkAssiEnad
      FordActvRtnEnad: SignalName=FordActvRtnEnad, DestSize=1, DataType=boolean, ImcArbnSigUsersRef=CustDiagcFordActvRtnEnad
      FordAfsEquid: SignalName=FordAfsEquid, DestSize=1, DataType=boolean, ImcArbnSigUsersRef=CustDiagcFordAfsEquid
      FordEngTqClass: SignalName=FordEngTqClass, DestSize=3, DataType=uint8, ImcArbnSigUsersRef=CustDiagcFordEngTqClass
      FordEscPrsnt: SignalName=FordEscPrsnt, DestSize=1, DataType=boolean, ImcArbnSigUsersRef=CustDiagcFordEscPrsnt
      FordSelDrvModEnad: SignalName=FordSelDrvModEnad, DestSize=1, DataType=boolean, ImcArbnSigUsersRef=CustDiagcFordSelDrvModEnad
      FordSoftEndStopEnad: SignalName=FordSoftEndStopEnad, DestSize=1, DataType=boolean, ImcArbnSigUsersRef=CustDiagcFordSoftEndStopEnad
      FordStrtStopSt: SignalName=FordStrtStopSt, DestSize=2, DataType=uint8, ImcArbnSigUsersRef=CustDiagcFordStrtStopSt
      FordDrvrSteerRcmdnEnad: SignalName=FordDrvrSteerRcmdnEnad, DestSize=1, DataType=boolean, ImcArbnSigUsersRef=CustDiagcFordDrvrSteerRcmdnEnad
    CustDiagcClrDiagcReq (ImcArbnSignalUserGroups): FddName=CustDiagc, ReceiverSideSignalName=ClrDiagcReq, DataType=boolean
    CustDiagcRtnDC00Req (ImcArbnSignalUserGroups): FddName=CustDiagc, ReceiverSideSignalName=RtnDC00Req, DataType=boolean
    RtnDC00Req (ImcArbnSignal): SignalName=RtnDC00Req, DestSize=1, DataType=uint8, ImcArbnSigUsersRef=CustDiagcRtnDC00Req
    ClrDiagcReq (ImcArbnSignal): SignalName=ClrDiagcReq, DestSize=1, DataType=uint8, ImcArbnSigUsersRef=CustDiagcClrDiagcReq
    ImcArbnSignalGroupCustDiagcReq (ImcArbnSignalGroup)
      RstReq (ImcArbnSigRef): StartBit=0, ImcArbnSigNameRef=ImcArbn/RstReq
      ImcArbnSGAttributes: PrimarySrcOnlySignalGroup=false, ImcArbnGroupTxRate=IMCARBN_10MS_GROUP
      ClrDiagcReq (ImcArbnSigRef): StartBit=2, ImcArbnSigNameRef=ImcArbn/ClrDiagcReq
      RtnDC00Req (ImcArbnSigRef): StartBit=3, ImcArbnSigNameRef=ImcArbn/RtnDC00Req
    4 x ImcArbnSignalUserGroups, all with DataType=float32:
      HwAgSnsrlsPinionAg: FddName=HwAgSnsrls, ReceiverSideSignalName=PinionAg
      HwAgSnsrlsPinionAgConf: FddName=HwAgSnsrls, ReceiverSideSignalName=PinionAgConf
      HwAgSysArbnPinionAg: FddName=HwAgSysArbn, ReceiverSideSignalName=PinionAg
      HwAgSysArbnPinionAgConf: FddName=HwAgSysArbn, ReceiverSideSignalName=PinionAgConf
    Imc09SignalGroup (ImcArbnSignalGroup)
      PinionAgConf (ImcArbnSigRef): StartBit=0, ImcArbnSigNameRef=ImcArbn/PinionAgConf
      ImcArbnSGAttributes: PrimarySrcOnlySignalGroup=false, ImcArbnGroupTxRate=IMCARBN_10MS_GROUP
    Imc10SignalGroup (ImcArbnSignalGroup)
      PinionAg (ImcArbnSigRef): StartBit=0, ImcArbnSigNameRef=ImcArbn/PinionAg
      ImcArbnSGAttributes: PrimarySrcOnlySignalGroup=false, ImcArbnGroupTxRate=IMCARBN_10MS_GROUP
    PinionAg (ImcArbnSignal): SignalName=PinionAg, DestSize=32, DataType=float32, ImcArbnSigUsersRef=HwAgSnsrlsPinionAg, ImcArbnSigUsersRef=HwAgSysArbnPinionAg
    PinionAgConf (ImcArbnSignal): SignalName=PinionAgConf, DestSize=32, DataType=float32, ImcArbnSigUsersRef=HwAgSnsrlsPinionAgConf, ImcArbnSigUsersRef=HwAgSysArbnPinionAgConf
    HwAgSysArbnHwAgToMotAgCorrlnFltFld (ImcArbnSignalUserGroups): FddName=HwAgSysArbn, ReceiverSideSignalName=HwAgToMotAgCorrlnFltFld, DataType=boolean
    HwAgToMotAgCorrlnFltFld (ImcArbnSignal): SignalName=HwAgToMotAgCorrlnFltFld, DestSize=1, DataType=boolean, ImcArbnSigUsersRef=HwAgSysArbnHwAgToMotAgCorrlnFltFld
    Imc11SignalGroup (ImcArbnSignalGroup)
      HwAgToMotAgCorrlnFltFld (ImcArbnSigRef): StartBit=0, ImcArbnSigNameRef=ImcArbn/HwAgToMotAgCorrlnFltFld
      ImcArbnSGAttributes: PrimarySrcOnlySignalGroup=false, ImcArbnGroupTxRate=IMCARBN_10MS_GROUP
    FordHwTqCmdOvrlLimrFordColTqOvrl (ImcArbnSignalUserGroups): FddName=FordHwTqCmdOvrlLimr, ReceiverSideSignalName=FordColTqOvrl, DataType=float32
    FordColTqOvrl (ImcArbnSignal): SignalName=FordColTqOvrl, DestSize=32, DataType=float32, ImcArbnSigUsersRef=FordHwTqCmdOvrlLimrFordColTqOvrl
    4 x ImcArbnSignalGroup:
      ImcArbnSignalGroupFordHwTqCmdOvrlLimr
        FordColTqOvrl (ImcArbnSigRef): StartBit=0, ImcArbnSigNameRef=ImcArbn/FordColTqOvrl
        ImcArbnSGAttributes: PrimarySrcOnlySignalGroup=false, ImcArbnGroupTxRate=IMCARBN_10MS_GROUP
      ImcArbnSignalGroupFordMotTqCmdOvrlLimr
        FordDrvrSteerRcmdnTqReq (ImcArbnSigRef): StartBit=0, ImcArbnSigNameRef=FordMotTqCmdOvrl
        ImcArbnSGAttributes: PrimarySrcOnlySignalGroup=false, ImcArbnGroupTxRate=IMCARBN_10MS_GROUP
      ImcArbnSignalGroupFordCmdArbn1
        ImcArbnSGAttributes: PrimarySrcOnlySignalGroup=false, ImcArbnGroupTxRate=IMCARBN_10MS_GROUP
        4 x ImcArbnSigRef:
          FordActvNiblCtrlArbnCmd: StartBit=0, ImcArbnSigNameRef=ImcArbn/FordActvNiblCtrlArbnCmd
          FordDrvrSteerRcmdnArbnCmd: StartBit=8, ImcArbnSigNameRef=ImcArbn/FordDrvrSteerRcmdnArbnCmd
          FordEvasSteerAssiArbnCmd: StartBit=16, ImcArbnSigNameRef=ImcArbn/FordEvasSteerAssiArbnCmd
          FordExtAgCtrlArbnCmd: StartBit=24, ImcArbnSigNameRef=ImcArbn/FordExtAgCtrlArbnCmd
      ImcArbnSignalGroupFordCmdArbn2
        ImcArbnSGAttributes: PrimarySrcOnlySignalGroup=false, ImcArbnGroupTxRate=IMCARBN_10MS_GROUP
        4 x ImcArbnSigRef:
          FordLaneDprtrWarnArbnCmd: StartBit=0, ImcArbnSigNameRef=ImcArbn/FordLaneDprtrWarnArbnCmd
          FordLaneKeepAssiArbnCmd: StartBit=8, ImcArbnSigNameRef=ImcArbn/FordLaneKeepAssiArbnCmd
          FordLatCtrlArbnCmd: StartBit=16, ImcArbnSigNameRef=ImcArbn/FordLatCtrlArbnCmd
          FordPullDriftCmpArbnCmd: StartBit=24, ImcArbnSigNameRef=ImcArbn/FordPullDriftCmpArbnCmd
    FordVltgIfBattRtnCurr (ImcArbnSignalUserGroups): FddName=FordVltgIf, ReceiverSideSignalName=BattRtnCurr, DataType=float32
    FordVltgIfBattVltg (ImcArbnSignalUserGroups): FddName=FordVltgIf, ReceiverSideSignalName=BattVltg, DataType=float32
    BattVltg (ImcArbnSignal): SignalName=BattVltg, DestSize=32, DataType=float32, ImcArbnSigUsersRef=FordVltgIfBattVltg
    BattRtnCurr (ImcArbnSignal): SignalName=BattRtnCurr, DestSize=32, DataType=float32, ImcArbnSigUsersRef=FordVltgIfBattRtnCurr
    ImcArbnSignalGroupFordVltgIf1 (ImcArbnSignalGroup)
      BattRtnCurr (ImcArbnSigRef): StartBit=0, ImcArbnSigNameRef=ImcArbn/BattRtnCurr
      ImcArbnSGAttributes: PrimarySrcOnlySignalGroup=false, ImcArbnGroupTxRate=IMCARBN_10MS_GROUP
    ImcArbnSignalGroupFordVltgIf2 (ImcArbnSignalGroup)
      BattVltg (ImcArbnSigRef): StartBit=0, ImcArbnSigNameRef=ImcArbn/BattVltg
      ImcArbnSGAttributes: PrimarySrcOnlySignalGroup=false, ImcArbnGroupTxRate=IMCARBN_10MS_GROUP
    FordMotTqCmdOvrlLimrFordMotTqCmdOvrl (ImcArbnSignalUserGroups): FddName=FordMotTqCmdOvrlLimr, ReceiverSideSignalName=FordMotTqCmdOvrl, DataType=float32
    FordMotTqCmdOvrl (ImcArbnSignal): SignalName=FordMotTqCmdOvrl, DestSize=32, DataType=float32, ImcArbnSigUsersRef=FordMotTqCmdOvrlLimrFordMotTqCmdOvrl
    13 x ImcArbnSignalUserGroups, all with FddName=FordCmdArbn, DataType=uint8:
      FordCmdArbnFordActvNiblCtrlArbnCmd: ReceiverSideSignalName=FordActvNiblCtrlArbnCmd
      FordCmdArbnFordDrvrSteerRcmdnArbnCmd: ReceiverSideSignalName=FordDrvrSteerRcmdnArbnCmd
      FordCmdArbnFordEvasSteerAssiArbnCmd: ReceiverSideSignalName=FordEvasSteerAssiArbnCmd
      FordCmdArbnFordExtAgCtrlArbnCmd: ReceiverSideSignalName=FordExtAgCtrlArbnCmd
      FordCmdArbnFordLaneDprtrWarnArbnCmd: ReceiverSideSignalName=FordLaneDprtrWarnArbnCmd
      FordCmdArbnFordLaneKeepAssiArbnCmd: ReceiverSideSignalName=FordLaneKeepAssiArbnCmd
      FordCmdArbnFordLatCtrlArbnCmd: ReceiverSideSignalName=FordLatCtrlArbnCmd
      FordCmdArbnFordPullDriftCmpArbnCmd: ReceiverSideSignalName=FordPullDriftCmpArbnCmd
      FordCmdArbnFordPullDriftCmpLrngArbnCmd: ReceiverSideSignalName=FordPullDriftCmpLrngArbnCmd
      FordCmdArbnFordSpare{1..3}ArbnCmd: ReceiverSideSignalName=FordSpare{1..3}ArbnCmd
      FordCmdArbnFordSteerTqDstbcRejctnArbnCmd: ReceiverSideSignalName=FordSteerTqDstbcRejctnArbnCmd
    13 x ImcArbnSignal, all with DestSize=8, DataType=uint8:
      FordSteerTqDstbcRejctnArbnCmd: SignalName=FordSteerTqDstbcRejctnArbnCmd, ImcArbnSigUsersRef=FordCmdArbnFordSteerTqDstbcRejctnArbnCmd
      FordSpare3ArbnCmd: SignalName=FordSpare3ArbnCmd, ImcArbnSigUsersRef=FordCmdArbnFordSpare3ArbnCmd
      FordSpare2ArbnCmd: SignalName=FordSpare2ArbnCmd, ImcArbnSigUsersRef=FordCmdArbnFordSpare2ArbnCmd
      FordSpare1ArbnCmd: SignalName=FordSpare1ArbnCmd, ImcArbnSigUsersRef=FordCmdArbnFordSpare1ArbnCmd
      FordPullDriftCmpLrngArbnCmd: SignalName=FordPullDriftCmpLrngArbnCmd, ImcArbnSigUsersRef=FordCmdArbnFordPullDriftCmpLrngArbnCmd
      FordPullDriftCmpArbnCmd: SignalName=FordPullDriftCmpArbnCmd, ImcArbnSigUsersRef=FordCmdArbnFordPullDriftCmpArbnCmd
      FordLatCtrlArbnCmd: SignalName=FordLatCtrlArbnCmd, ImcArbnSigUsersRef=FordCmdArbnFordLatCtrlArbnCmd
      FordLaneKeepAssiArbnCmd: SignalName=FordLaneKeepAssiArbnCmd, ImcArbnSigUsersRef=FordCmdArbnFordLaneKeepAssiArbnCmd
      FordLaneDprtrWarnArbnCmd: SignalName=FordLaneDprtrWarnArbnCmd, ImcArbnSigUsersRef=FordCmdArbnFordLaneDprtrWarnArbnCmd
      FordExtAgCtrlArbnCmd: SignalName=FordExtAgCtrlArbnCmd, ImcArbnSigUsersRef=FordCmdArbnFordExtAgCtrlArbnCmd
      FordEvasSteerAssiArbnCmd: SignalName=FordEvasSteerAssiArbnCmd, ImcArbnSigUsersRef=FordCmdArbnFordEvasSteerAssiArbnCmd
      FordDrvrSteerRcmdnArbnCmd: SignalName=FordDrvrSteerRcmdnArbnCmd, ImcArbnSigUsersRef=FordCmdArbnFordDrvrSteerRcmdnArbnCmd
      FordActvNiblCtrlArbnCmd: SignalName=FordActvNiblCtrlArbnCmd, ImcArbnSigUsersRef=FordCmdArbnFordActvNiblCtrlArbnCmd
    ImcArbnSignalGroupFordCmdArbn3 (ImcArbnSignalGroup)
      ImcArbnSGAttributes: PrimarySrcOnlySignalGroup=false, ImcArbnGroupTxRate=IMCARBN_10MS_GROUP
      FordSteerTqDstbcRejctnArbnCmd (ImcArbnSigRef): StartBit=0, ImcArbnSigNameRef=ImcArbn/FordSteerTqDstbcRejctnArbnCmd
    ImcArbnSignalGroupFordCmdArbn4 (ImcArbnSignalGroup)
      ImcArbnSGAttributes: PrimarySrcOnlySignalGroup=false, ImcArbnGroupTxRate=IMCARBN_10MS_GROUP
      4 x ImcArbnSigRef:
        FordLaneDprtrWarnArbnCmd: StartBit=0, ImcArbnSigNameRef=ImcArbn/FordLaneDprtrWarnArbnCmd
        FordLaneKeepAssiArbnCmd: StartBit=8, ImcArbnSigNameRef=ImcArbn/FordLaneKeepAssiArbnCmd
        FordLatCtrlArbnCmd: StartBit=16, ImcArbnSigNameRef=ImcArbn/FordLatCtrlArbnCmd
        FordPullDriftCmpArbnCmd: StartBit=24, ImcArbnSigNameRef=ImcArbn/FordPullDriftCmpArbnCmd
