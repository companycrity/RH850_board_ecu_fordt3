AUTOSAR XML (schema 4-2-1)
package /ActiveEcuC
  module config EcuTMeas: implementation-config-variant=VARIANT-PRE-COMPILE
    EcuTMeasGeneral: DftTemp=60, FilTau=2
    EcuTMeasConversionTables:
      EcuTx = 0.42
      EcuTx = 0.59580325
      EcuTx = 0.80377957
      EcuTx = 1.20174112
      EcuTx = 1.60220368
      EcuTx = 2.00441773
      EcuTx = 2.39713092
      EcuTx = 2.626
      EcuTy = 150
      EcuTy = 135
      EcuTy = 117
      EcuTy = 82
      EcuTy = 46
      EcuTy = 9
      EcuTy = -28
      EcuTy = -50
    EcuTMeasDiagc: Ntc0x045FailStep=3000, Ntc0x045PassStep=3000, MaxTLim=125, MinTLim=-40
