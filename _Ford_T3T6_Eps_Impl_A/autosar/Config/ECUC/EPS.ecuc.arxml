AUTOSAR XML (schema 4-2-1)
package /ActiveEcuC
  ecuc value collection ActiveEcuC: ecu-extract=SYSTEM
    ecuc-values:
      Dem
      Det
      Mcu
      Os
      Rte
      NvM
      Fee
      Dio
      Port
      Crc
      MemIf
      WdgIf
      WdgM
      ChkPt
      CanSM
      Spi
      Fls
      Wdg
      Xcp
      NvMProxy
      DiagcMgr
      ElecGlbPrm
      IoHwAb
      MotCtrlMgr
      VrfyCritReg
      HwAg1Meas
      MotAg5Meas
      MotAg6Meas
      NxtrMfgSrv
      NxtrSwIds
      TunSelnMngt
      XcpIf
      ImcArbn
      Adcf0CfgAndUse
      EcuTMeas
      GateDrv0Ctrl
      HwTq8Meas
      ExcpnHndlg
      FlsMem
      SyncCrc
      CanNm
      ComM
      EcuM
      Com
      Can
      CanIf
      PduR
      CanTp
      EcuC
      Nm
      HwTq9Meas
      HwTq10Meas
      HwTqCorrln
      Dcm
      FordDualEcuFltDiagcCom
      BswM
      HwTq1Meas
