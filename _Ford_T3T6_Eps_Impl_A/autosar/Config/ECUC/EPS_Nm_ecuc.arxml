AUTOSAR XML (schema 4-2-1)
package /ActiveEcuC
  module config Nm: implementation-config-variant=VARIANT-PRE-COMPILE, module-description=Nm_Impl
    NmGlobalConfig
      NmGlobalFeatures:
        NmRemoteSleepIndEnabled = true
        NmRepeatMsgIndEnabled = false
        NmStateChangeIndEnabled = true
        NmNodeDetectionEnabled = false
        NmBusSynchronizationEnabled = false
        NmNodeIdEnabled = false
        NmCarWakeUpRxEnabled = false
        NmUserDataEnabled = true
        NmComUserDataSupport = false
        NmComControlEnabled = true
        NmCoordinatorSupportEnabled = false
        NmPduRxIndicationEnabled = false
        NmMacroLayerEnabled = false
        NmCoordinatorSyncSupport = false
        NmRuntimeMeasurementSupport = false
        NmCoordinatorRequestChannelsInBusSleep = false
        NmCoordinatorPassiveStartUpForwarding = false
      NmGlobalConstants
      NmGlobalProperties: NmDevErrorDetect=true, NmVersionInfoApi=false, NmCycletimeMainFunction=0.01
      NmGeneration:
        NmOutOfBoundsWriteSanitizer = false
        NmOutOfBoundsReadSanitizer = false
        NmShortSymbols = false
        NmInterfacesForDeactivatedData = false
        NmReferringKeysInComments = false
    NmChannelConfig:
      NmPassiveModeEnabled = false
      NmShutdownDelayTimer = 0
      NmStateReportEnabled = false
      NmChannelSleepMaster = false
      NmChannelId = 0
      NmSynchronizingNetwork = false
      NmComMChannelRef = FD1_CAN_f26020e5
      NmBusType
        NmStandardBusNmConfig: NmStandardBusType=NM_BUSNM_CANNM
