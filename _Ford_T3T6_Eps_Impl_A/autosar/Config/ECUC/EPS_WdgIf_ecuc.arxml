AUTOSAR XML (schema 4-2-1)
package /ActiveEcuC
  module config WdgIf: implementation-config-variant=VARIANT-PRE-COMPILE, module-description=WdgIf_Impl
    WdgIfGeneral: WdgIfUseAutosarDrvApi=true, WdgIfDevErrorDetect=true, WdgIfVersionInfoApi=false, WdgIfUseStateCombiner=false
    WdgIfDevice: WdgIfDeviceIndex=0, WdgIfDriverRef=WdgGeneral
