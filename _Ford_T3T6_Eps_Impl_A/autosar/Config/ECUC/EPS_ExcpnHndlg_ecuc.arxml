AUTOSAR XML (schema 4-2-1)
package /ActiveEcuC
  module config ExcpnHndlg: implementation-config-variant=VARIANT-PRE-COMPILE
    ExcpnHndlgCfg: WdgMCfgStr=WdgMConfig_Mode0_core0
