AUTOSAR XML (schema 4-2-1)
package /ActiveEcuC
  module config Com: implementation-config-variant=VARIANT-PRE-COMPILE, module-description=Com_Impl
    ComConfig: ComConfigurationId=0, ComRxDeferredNotificationCacheSize=0, ComRxImmediateNotificationCacheSize=0
      ComTimeBase: ComRxTimeBase=0.01, ComTxTimeBase=0.01, ComGwTimeBase=0.01
      BrakeSnData_3_FD1_oFD1_CAN_3abd61be (ComIPdu):
        ComIPduDirection = RECEIVE
        ComIPduType = NORMAL
        ComIPduHandleId = 6
        ComIPduSignalProcessing = DEFERRED
        ComIPduCancellationSupport = false
        ComIPduCallout = ComIPduCallout_BrakeSnData_3_FD1_Oper
        ComIPduGroupRef = PSCM_FD_oFD1_CAN_Rx_fcef2243
        ComIPduSignalRef = VehLatComp_A_Actl_470bb112
        ComIPduSignalRef = VehLongComp_A_Actl_470bb112
        ComIPduSignalRef = VehOverGnd_V_Est_470bb112
        ComIPduSignalRef = VehYawComp_W_Actl_470bb112
        ComPduIdRef = PT_BrakeSnData_3_FD1_PP_BrakeSnData_3_FD1_Rx_3290b631_3cf8f7d5
      5 x ComSignal, all with ComSignalEndianness=BIG_ENDIAN, ComSignalAccess=ACCESS_NEEDED_BY_SWC_OR_COM:
        LatCtlPathOffst_L_Actl_5abef978: ComBitPosition=47, ComBitSize=10, ComSignalInitValue=512, ComSignalType=UINT16, ComTimeout=0, ComHandleId=45, ComSystemTemplateSystemSignalRef=LatCtlPathOffst_L_Actl
        SAPPAngleControlStat5_635efcb3: ComBitPosition=14, ComBitSize=1, ComSignalInitValue=0, ComSignalType=BOOLEAN, ComTransferProperty=PENDING, ComHandleId=16, ComSystemTemplateSystemSignalRef=SAPPAngleControlStat5
        TrlrAidSwtch_D_RqDrv_372f28fe: ComBitPosition=35, ComBitSize=2, ComSignalInitValue=0, ComSignalType=UINT8, ComTimeout=0.06, ComHandleId=73, ComTimeoutNotification=ComTimeoutNotification_TrlrAidSwtch_D_RqDrv, ComFirstTimeout=0.06, ComSystemTemplateSystemSignalRef=TrlrAidSwtch_D_RqDrv
        LifeCycMde_D_Actl_3c341b34: ComBitPosition=53, ComBitSize=4, ComSignalInitValue=0, ComSignalType=UINT8, ComTimeout=0, ComHandleId=53, ComSystemTemplateSystemSignalRef=LifeCycMde_D_Actl
        TrlrHitYaw_AnRate_Actl_96fdcdb8: ComBitPosition=27, ComBitSize=12, ComSignalInitValue=4094, ComSignalType=UINT16, ComTimeout=0, ComHandleId=81, ComSystemTemplateSystemSignalRef=TrlrHitYaw_AnRate_Actl
      FileVersion_oFD1_CAN_3abd61be (ComIPdu):
        ComIPduDirection = RECEIVE
        ComIPduType = NORMAL
        ComIPduHandleId = 19
        ComIPduSignalProcessing = DEFERRED
        ComIPduCancellationSupport = false
        ComIPduGroupRef = PSCM_FD_oFD1_CAN_Rx_fcef2243
        ComIPduSignalRef = FileVersionDay_216bb0c2
        ComIPduSignalRef = FileVersionMonth_216bb0c2
        ComIPduSignalRef = FileVersionNumber_216bb0c2
        ComIPduSignalRef = FileVersionYear_216bb0c2
        ComPduIdRef = PT_FileVersion_PP_FileVersion_Rx_3290b631_3cf8f7d5
      EsaOn_B_Stat_51142c79 (ComSignal):
        ComBitPosition = 23
        ComBitSize = 1
        ComSignalEndianness = BIG_ENDIAN
        ComSignalInitValue = 1
        ComSignalType = BOOLEAN
        ComTransferProperty = TRIGGERED_ON_CHANGE_WITHOUT_REPETITION
        ComSignalAccess = ACCESS_NEEDED_BY_SWC_OR_COM
        ComHandleId = 3
        ComSystemTemplateSystemSignalRef = EsaOn_B_Stat
      ParkAid_Data_FD1_oFD1_CAN_3abd61be (ComIPdu):
        ComIPduDirection = RECEIVE
        ComIPduType = NORMAL
        ComIPduHandleId = 25
        ComIPduSignalProcessing = DEFERRED
        ComIPduCancellationSupport = false
        ComIPduGroupRef = PSCM_FD_oFD1_CAN_Rx_fcef2243
        ComIPduSignalRef = ApaSys_D_Stat_ef286bfc
        ComIPduSignalRef = EPASExtAngleStatReq_ef286bfc
        ComIPduSignalRef = ExtSteeringAngleReq2_ef286bfc
        ComPduIdRef = PT_ParkAid_Data_FD1_PP_ParkAid_Data_FD1_Rx_3290b631_3cf8f7d5
      6 x ComSignal, all with ComSignalAccess=ACCESS_NEEDED_BY_SWC_OR_COM:
        LaHandsOff_B_Actl_3724073d: ComBitPosition=7, ComBitSize=1, ComSignalEndianness=BIG_ENDIAN, ComSignalInitValue=1, ComSignalType=BOOLEAN, ComTransferProperty=PENDING, ComHandleId=7, ComSystemTemplateSystemSignalRef=LaHandsOff_B_Actl
        VehVActlBrk_No_Cs_9f750b9f: ComBitPosition=31, ComBitSize=8, ComSignalEndianness=BIG_ENDIAN, ComSignalInitValue=0, ComSignalType=UINT8, ComTimeout=0, ComHandleId=102, ComSystemTemplateSystemSignalRef=VehVActlBrk_No_Cs
        FileVersionNumber_216bb0c2: ComBitPosition=24, ComBitSize=8, ComSignalEndianness=LITTLE_ENDIAN, ComSignalInitValue=5, ComSignalType=UINT8, ComHandleId=32, ComSystemTemplateSystemSignalRef=FileVersionNumber
        DrvSte_D_Stat_bfc9faa4: ComBitPosition=19, ComBitSize=4, ComSignalEndianness=BIG_ENDIAN, ComSignalInitValue=0, ComSignalType=UINT8, ComTimeout=0, ComHandleId=21, ComSystemTemplateSystemSignalRef=DrvSte_D_Stat
        FileVersionDay_216bb0c2: ComBitPosition=16, ComBitSize=8, ComSignalEndianness=LITTLE_ENDIAN, ComSignalInitValue=48, ComSignalType=UINT8, ComHandleId=30, ComSystemTemplateSystemSignalRef=FileVersionDay
        TrlrAidMde_D_Rq_a35cbfab: ComBitPosition=5, ComBitSize=2, ComSignalEndianness=BIG_ENDIAN, ComSignalInitValue=0, ComSignalType=UINT8, ComTimeout=1.01, ComHandleId=71, ComTimeoutNotification=ComTimeoutNotification_TrlrAidMde_D_Rq_Oper, ComFirstTimeout=1.01, ComSystemTemplateSystemSignalRef=TrlrAidMde_D_Rq
      TrailerAid_Data3_FD1_oFD1_CAN_3abd61be (ComIPdu):
        ComIPduDirection = RECEIVE
        ComIPduType = NORMAL
        ComIPduHandleId = 29
        ComIPduSignalProcessing = DEFERRED
        ComIPduCancellationSupport = false
        ComIPduGroupRef = PSCM_FD_oFD1_CAN_Rx_fcef2243
        ComIPduSignalRef = TrlrAidEnbl_D2_Rq_cc1bcd0f
        ComIPduSignalRef = TrlrAidSetup_D2_Rq_cc1bcd0f
        ComPduIdRef = PT_TrailerAid_Data3_FD1_PP_TrailerAid_Data3_FD1_Rx_3290b631_3cf8f7d5
      21 x ComSignal, all with ComSignalAccess=ACCESS_NEEDED_BY_SWC_OR_COM:
        TrlrAidSetup_D2_Stat_51142c79: ComBitPosition=47, ComBitSize=3, ComSignalEndianness=BIG_ENDIAN, ComSignalInitValue=0, ComSignalType=UINT8, ComTransferProperty=PENDING, ComHandleId=32, ComSystemTemplateSystemSignalRef=TrlrAidSetup_D2_Stat
        ApedPosPcActl_D_Qf_a3d34b0d: ComBitPosition=7, ComBitSize=2, ComSignalEndianness=BIG_ENDIAN, ComSignalInitValue=1, ComSignalType=UINT8, ComTimeout=0, ComHandleId=2, ComSystemTemplateSystemSignalRef=ApedPosPcActl_D_Qf
        TrlrAidSetup_D2_Rq_cc1bcd0f: ComBitPosition=4, ComBitSize=4, ComSignalEndianness=BIG_ENDIAN, ComSignalInitValue=0, ComSignalType=UINT8, ComTimeout=0, ComHandleId=72, ComSystemTemplateSystemSignalRef=TrlrAidSetup_D2_Rq
        StePinRelInit_An_Sns_837112cd: ComBitPosition=7, ComBitSize=16, ComSignalEndianness=BIG_ENDIAN, ComSignalInitValue=65535, ComSignalType=UINT16, ComTransferProperty=PENDING, ComHandleId=26, ComSystemTemplateSystemSignalRef=StePinRelInit_An_Sns
        ElPw_D_StatStrtStop_e6deed9e: ComBitPosition=31, ComBitSize=4, ComSignalEndianness=BIG_ENDIAN, ComSignalInitValue=0, ComSignalType=UINT8, ComTimeout=0, ComHandleId=24, ComSystemTemplateSystemSignalRef=ElPw_D_StatStrtStop
        LatCtlRng_L_Max_5abef978: ComBitPosition=63, ComBitSize=6, ComSignalEndianness=BIG_ENDIAN, ComSignalInitValue=0, ComSignalType=UINT8, ComTimeout=0, ComHandleId=49, ComSystemTemplateSystemSignalRef=LatCtlRng_L_Max
        GearLvrPos_D_Actl_8c4ca771: ComBitPosition=12, ComBitSize=4, ComSignalEndianness=BIG_ENDIAN, ComSignalInitValue=14, ComSignalType=UINT8, ComTimeout=0.03, ComHandleId=34, ComTimeoutNotification=ComTimeoutNotification_GearLvrPos_D_Actl_Oper, ComFirstTimeout=0.03, ComSystemTemplateSystemSignalRef=GearLvrPos_D_Actl
        SteMdule_I_Est_635efcb3: ComBitPosition=21, ComBitSize=12, ComSignalEndianness=BIG_ENDIAN, ComSignalInitValue=4095, ComSignalType=UINT16, ComTransferProperty=PENDING, ComHandleId=20, ComSystemTemplateSystemSignalRef=SteMdule_I_Est
        EngAout_N_Actl_a3d34b0d: ComBitPosition=28, ComBitSize=13, ComSignalEndianness=BIG_ENDIAN, ComSignalInitValue=0, ComSignalType=UINT16, ComTimeout=0, ComHandleId=26, ComSystemTemplateSystemSignalRef=EngAout_N_Actl
        LkaDrvOvrrd_D_Rq_d64ac390: ComBitPosition=38, ComBitSize=2, ComSignalEndianness=BIG_ENDIAN, ComSignalInitValue=0, ComSignalType=UINT8, ComTimeout=0, ComHandleId=55, ComSystemTemplateSystemSignalRef=LkaDrvOvrrd_D_Rq
        TrlrIdType_D_Stat_0edbb78e: ComBitPosition=33, ComBitSize=2, ComSignalEndianness=BIG_ENDIAN, ComSignalInitValue=0, ComSignalType=UINT8, ComTimeout=0, ComHandleId=84, ComSystemTemplateSystemSignalRef=TrlrIdType_D_Stat
        SteMdule_D_Stat_635efcb3: ComBitPosition=55, ComBitSize=3, ComSignalEndianness=BIG_ENDIAN, ComSignalInitValue=0, ComSignalType=UINT8, ComTransferProperty=PENDING, ComHandleId=19, ComSystemTemplateSystemSignalRef=SteMdule_D_Stat
        LaRefAng_No_Req_d64ac390: ComBitPosition=19, ComBitSize=12, ComSignalEndianness=BIG_ENDIAN, ComSignalInitValue=2048, ComSignalType=UINT16, ComTimeout=0, ComHandleId=42, ComSystemTemplateSystemSignalRef=LaRefAng_No_Req
        VehVActlBrk_D_Qf_9f750b9f: ComBitPosition=23, ComBitSize=2, ComSignalEndianness=BIG_ENDIAN, ComSignalInitValue=0, ComSignalType=UINT8, ComTimeout=0, ComHandleId=100, ComSystemTemplateSystemSignalRef=VehVActlBrk_D_Qf
        ApedPos_Pc_ActlArb_a3d34b0d: ComBitPosition=1, ComBitSize=10, ComSignalEndianness=BIG_ENDIAN, ComSignalInitValue=0, ComSignalType=UINT16, ComTimeout=0, ComHandleId=3, ComSystemTemplateSystemSignalRef=ApedPos_Pc_ActlArb
        TrlrHitchYaw_An_Actl_96fdcdb8: ComBitPosition=23, ComBitSize=12, ComSignalEndianness=BIG_ENDIAN, ComSignalInitValue=4094, ComSignalType=UINT16, ComTimeout=0, ComHandleId=82, ComSystemTemplateSystemSignalRef=TrlrHitchYaw_An_Actl
        CmbbBrkDis_B_Actl_eaa4779a: ComBitPosition=56, ComBitSize=1, ComSignalEndianness=BIG_ENDIAN, ComSignalInitValue=0, ComSignalType=BOOLEAN, ComTimeout=0, ComHandleId=8, ComSystemTemplateSystemSignalRef=CmbbBrkDis_B_Actl
        LdwActvIntns_D_Req_d64ac390: ComBitPosition=1, ComBitSize=2, ComSignalEndianness=BIG_ENDIAN, ComSignalInitValue=0, ComSignalType=UINT8, ComTimeout=0, ComHandleId=51, ComSystemTemplateSystemSignalRef=LdwActvIntns_D_Req
        TrlrAid_AnRate2_Actl_0bf22cce: ComBitPosition=22, ComBitSize=10, ComSignalEndianness=BIG_ENDIAN, ComSignalInitValue=400, ComSignalType=UINT16, ComTimeout=0, ComHandleId=76, ComSystemTemplateSystemSignalRef=TrlrAid_AnRate2_Actl
        WhlDirFr_D_Actl_91fa0768: ComBitPosition=37, ComBitSize=2, ComSignalEndianness=BIG_ENDIAN, ComSignalInitValue=0, ComSignalType=UINT8, ComTimeout=0, ComHandleId=114, ComSystemTemplateSystemSignalRef=WhlDirFr_D_Actl
        FileVersionYear_216bb0c2: ComBitPosition=0, ComBitSize=8, ComSignalEndianness=LITTLE_ENDIAN, ComSignalInitValue=23, ComSignalType=UINT8, ComHandleId=33, ComSystemTemplateSystemSignalRef=FileVersionYear
      BodyInfo_3_FD1_oFD1_CAN_3abd61be (ComIPdu):
        ComIPduDirection = RECEIVE
        ComIPduType = NORMAL
        ComIPduHandleId = 4
        ComIPduSignalProcessing = DEFERRED
        ComIPduCancellationSupport = false
        ComIPduCallout = ComIPduCallout_BodyInfo_3_HS2_Oper
        ComIPduGroupRef = PSCM_FD_oFD1_CAN_Rx_fcef2243
        ComIPduSignalRef = Ignition_Status_3c341b34
        ComIPduSignalRef = LifeCycMde_D_Actl_3c341b34
        ComPduIdRef = PT_BodyInfo_3_FD1_PP_BodyInfo_3_FD1_Rx_3290b631_3cf8f7d5
      HandsOffCnfm_B_Rq_5abef978 (ComSignal):
        ComBitPosition = 51
        ComBitSize = 1
        ComSignalEndianness = BIG_ENDIAN
        ComSignalInitValue = 0
        ComSignalType = BOOLEAN
        ComTimeout = 0
        ComSignalAccess = ACCESS_NEEDED_BY_SWC_OR_COM
        ComHandleId = 37
        ComSystemTemplateSystemSignalRef = HandsOffCnfm_B_Rq
      TrlrSnsId_No_Actl_ea9ce863 (ComSignal):
        ComBitPosition = 0
        ComSignalEndianness = opaque
        ComSignalInitValue = 0 0 0 0 0 0
        ComSignalLength = 6
        ComSignalType = UINT8_N
        ComTimeout = 0
        ComSignalAccess = ACCESS_NEEDED_BY_SWC_OR_COM
        ComHandleId = 91
        ComSystemTemplateSystemSignalRef = TrlrSnsId_No_Actl
      TrailerInfo_2_FD1_oFD1_CAN_3abd61be (ComIPdu):
        ComIPduDirection = RECEIVE
        ComIPduType = NORMAL
        ComIPduHandleId = 35
        ComIPduSignalProcessing = DEFERRED
        ComIPduCancellationSupport = false
        ComIPduCallout = ComIPduCallout_TrailerInfo_2_FD1
        ComIPduGroupRef = PSCM_FD_oFD1_CAN_Rx_fcef2243
        ComIPduSignalRef = TrlrAidCtl_U_RqDrv_372f28fe
        ComIPduSignalRef = TrlrAidSwtch_D_RqDrv_372f28fe
        ComPduIdRef = PT_TrailerInfo_2_FD1_PP_TrailerInfo_2_FD1_Rx_3290b631_3cf8f7d5
      VehVertComp_A_Actl_22c61bd2 (ComSignal):
        ComBitPosition = 45
        ComBitSize = 10
        ComSignalEndianness = BIG_ENDIAN
        ComSignalInitValue = 1022
        ComSignalType = UINT16
        ComTimeout = 0
        ComSignalAccess = ACCESS_NEEDED_BY_SWC_OR_COM
        ComHandleId = 107
        ComSystemTemplateSystemSignalRef = VehVertComp_A_Actl
      YawStabilityIndex_706a037f (ComSignal):
        ComBitPosition = 0
        ComBitSize = 9
        ComSignalEndianness = BIG_ENDIAN
        ComSignalInitValue = 256
        ComSignalType = UINT16
        ComTimeout = 0.03
        ComSignalAccess = ACCESS_NEEDED_BY_SWC_OR_COM
        ComHandleId = 125
        ComTimeoutNotification = ComTimeoutNotification_YawStabilityIndex_Oper
        ComFirstTimeout = 0.03
        ComSystemTemplateSystemSignalRef = YawStabilityIndex
      BrakeSnData_5_FD1_oFD1_CAN_3abd61be (ComIPdu):
        ComIPduDirection = RECEIVE
        ComIPduType = NORMAL
        ComIPduHandleId = 8
        ComIPduSignalProcessing = DEFERRED
        ComIPduCancellationSupport = false
        ComIPduGroupRef = PSCM_FD_oFD1_CAN_Rx_fcef2243
        ComIPduSignalRef = DrvSte_D_Stat_bfc9faa4
        ComIPduSignalRef = DrvSte_Tq_Rq_bfc9faa4
        ComPduIdRef = PT_BrakeSnData_5_FD1_PP_BrakeSnData_5_FD1_Rx_3290b631_3cf8f7d5
      3 x ComSignal, all with ComSignalEndianness=BIG_ENDIAN, ComSignalType=UINT8, ComTimeout=0, ComSignalAccess=ACCESS_NEEDED_BY_SWC_OR_COM:
        TrnRng_D_Rq_1e331f99: ComBitPosition=27, ComBitSize=4, ComSignalInitValue=14, ComHandleId=95, ComSystemTemplateSystemSignalRef=TrnRng_D_Rq
        TrlrAidTrgtId_No_Actl_0bf22cce: ComBitPosition=47, ComBitSize=5, ComSignalInitValue=0, ComHandleId=74, ComSystemTemplateSystemSignalRef=TrlrAidTrgtId_No_Actl
        BpedDrvAppl_D_Actl_aea354aa: ComBitPosition=5, ComBitSize=2, ComSignalInitValue=1, ComHandleId=6, ComSystemTemplateSystemSignalRef=BpedDrvAppl_D_Actl
      LateralMotionControl_FD1_oFD1_CAN_3abd61be (ComIPdu):
        ComIPduDirection = RECEIVE
        ComIPduType = NORMAL
        ComIPduHandleId = 23
        ComIPduSignalProcessing = DEFERRED
        ComIPduCancellationSupport = false
        ComIPduCallout = ComIPduCallout_LateralMotionControl_FD1_Oper
        ComIPduGroupRef = PSCM_FD_oFD1_CAN_Rx_fcef2243
        ComIPduSignalRef = HandsOffCnfm_B_Rq_5abef978
        ComIPduSignalRef = LatCtlCurv_NoRate_Actl_5abef978
        ComIPduSignalRef = LatCtlCurv_No_Actl_5abef978
        ComIPduSignalRef = LatCtlPathOffst_L_Actl_5abef978
        ComIPduSignalRef = LatCtlPath_An_Actl_5abef978
        ComIPduSignalRef = LatCtlPrecision_D_Rq_5abef978
        ComIPduSignalRef = LatCtlRampType_D_Rq_5abef978
        ComIPduSignalRef = LatCtlRng_L_Max_5abef978
        ComIPduSignalRef = LatCtl_D_Rq_5abef978
        ComPduIdRef = PT_LateralMotionControl_FD1_PP_LateralMotionControl_FD1_Rx_3290b631_3cf8f7d5
      WhlDirFl_D_Actl_91fa0768 (ComSignal):
        ComBitPosition = 35
        ComBitSize = 2
        ComSignalEndianness = BIG_ENDIAN
        ComSignalInitValue = 0
        ComSignalType = UINT8
        ComTimeout = 0.03
        ComSignalAccess = ACCESS_NEEDED_BY_SWC_OR_COM
        ComHandleId = 113
        ComTimeoutNotification = ComTimeoutNotification_WhlDirFl_D_Actl_Oper
        ComFirstTimeout = 0.03
        ComSystemTemplateSystemSignalRef = WhlDirFl_D_Actl
      FileVersionMonth_216bb0c2 (ComSignal):
        ComBitPosition = 8
        ComBitSize = 8
        ComSignalEndianness = LITTLE_ENDIAN
        ComSignalInitValue = 17
        ComSignalType = UINT8
        ComSignalAccess = ACCESS_NEEDED_BY_SWC_OR_COM
        ComHandleId = 31
        ComSystemTemplateSystemSignalRef = FileVersionMonth
      SteeringPinion_Data_FD1_oFD1_CAN_3abd61be (ComIPdu):
        ComIPduDirection = SEND
        ComIPduType = NORMAL
        ComIPduHandleId = 2
        ComIPduSignalProcessing = DEFERRED
        ComIPduCancellationSupport = false
        ComIPduGroupRef = PSCM_FD_oFD1_CAN_Tx_fcef2243
        ComIPduSignalRef = StePinAn_No_Cnt_837112cd
        ComIPduSignalRef = StePinAn_No_Cs_837112cd
        ComIPduSignalRef = StePinCompAnEst_D_Qf_837112cd
        ComIPduSignalRef = StePinComp_An_Est_837112cd
        ComIPduSignalRef = StePinRelInit_An_Sns_837112cd
        ComIPduSignalRef = StePw_B_Rq_837112cd
        ComPduIdRef = PT_SteeringPinion_Data_FD1_PP_SteeringPinion_Data_FD1_Tx_3290b631_3cf8f7d5
        ComTxIPdu: ComMinimumDelayTime=0, ComTxIPduUnusedAreasDefault=0
          ComTxModeTrue
            ComTxMode: ComTxModeMode=PERIODIC, ComTxModeTimeOffset=0, ComTxModeTimePeriod=0.01
          ComTxModeFalse
            ComTxMode: ComTxModeMode=PERIODIC, ComTxModeTimeOffset=0, ComTxModeTimePeriod=0.01
      VehYawComp_W_Actl_470bb112 (ComSignal):
        ComBitPosition = 19
        ComBitSize = 12
        ComSignalEndianness = BIG_ENDIAN
        ComSignalInitValue = 4094
        ComSignalType = UINT16
        ComTimeout = 0
        ComSignalAccess = ACCESS_NEEDED_BY_SWC_OR_COM
        ComHandleId = 108
        ComSystemTemplateSystemSignalRef = VehYawComp_W_Actl
      Yaw_Data_FD1_oFD1_CAN_3abd61be (ComIPdu):
        ComIPduDirection = RECEIVE
        ComIPduType = NORMAL
        ComIPduHandleId = 41
        ComIPduSignalProcessing = DEFERRED
        ComIPduCancellationSupport = false
        ComIPduCallout = ComIPduCallout_Yaw_Data_FD1_Oper
        ComIPduGroupRef = PSCM_FD_oFD1_CAN_Rx_fcef2243
        ComIPduSignalRef = VehYaw_W_Actl_f318059c
        ComPduIdRef = PT_Yaw_Data_FD1_PP_Yaw_Data_FD1_Rx_3290b631_3cf8f7d5
      7 x ComSignal, all with ComSignalEndianness=BIG_ENDIAN, ComSignalAccess=ACCESS_NEEDED_BY_SWC_OR_COM:
        TrlrAn_An_TrgtCalc_3724073d: ComBitPosition=31, ComBitSize=8, ComSignalInitValue=128, ComSignalType=UINT8, ComTransferProperty=PENDING, ComHandleId=37, ComSystemTemplateSystemSignalRef=TrlrAn_An_TrgtCalc
        TrlrAxleToBmpr_L_Actl_0edbb78e: ComBitPosition=7, ComBitSize=9, ComSignalInitValue=0, ComSignalType=UINT16, ComTimeout=0, ComHandleId=79, ComSystemTemplateSystemSignalRef=TrlrAxleToBmpr_L_Actl
        VehYaw_W_Actl_f318059c: ComBitPosition=23, ComBitSize=16, ComSignalInitValue=65534, ComSignalType=UINT16, ComTimeout=0.02, ComHandleId=109, ComTimeoutNotification=ComTimeoutNotification_VehYaw_W_Actl_Oper, ComFirstTimeout=0.02, ComSystemTemplateSystemSignalRef=VehYaw_W_Actl
        VehVTrlrAid_B_Rq_635efcb3: ComBitPosition=25, ComBitSize=1, ComSignalInitValue=0, ComSignalType=BOOLEAN, ComTransferProperty=PENDING, ComHandleId=40, ComSystemTemplateSystemSignalRef=VehVTrlrAid_B_Rq
        LatCtlLim_D_Stat_51142c79: ComBitPosition=22, ComBitSize=2, ComSignalInitValue=0, ComSignalType=UINT8, ComTransferProperty=TRIGGERED_ON_CHANGE_WITHOUT_REPETITION, ComHandleId=8, ComSystemTemplateSystemSignalRef=LatCtlLim_D_Stat
        ElPw_D_Stat_e6deed9e: ComBitPosition=3, ComBitSize=3, ComSignalInitValue=0, ComSignalType=UINT8, ComTimeout=0, ComHandleId=25, ComSystemTemplateSystemSignalRef=ElPw_D_Stat
        Ignition_Status_3c341b34: ComBitPosition=7, ComBitSize=4, ComSignalInitValue=0, ComSignalType=UINT8, ComTimeout=0.51, ComHandleId=39, ComTimeoutNotification=ComTimeoutNotification_Ignition_Status_Oper, ComFirstTimeout=0.51, ComSystemTemplateSystemSignalRef=Ignition_Status
      GGCC_Config_Mgmt_ID_1_FD1_oFD1_CAN_3abd61be (ComIPdu):
        ComIPduDirection = RECEIVE
        ComIPduType = NORMAL
        ComIPduHandleId = 20
        ComIPduSignalProcessing = DEFERRED
        ComIPduCancellationSupport = false
        ComIPduCallout = ComIPduCallout_GGCC_Config_Mgmt_ID_1_HS2_Oper
        ComIPduGroupRef = PSCM_FD_oFD1_CAN_Rx_fcef2243
        ComIPduSignalRef = VehicleGGCCData_575096ac
        ComPduIdRef = PT_GGCC_Config_Mgmt_ID_1_FD1_PP_GGCC_Config_Mgmt_ID_1_FD1_Rx_3290b631_3cf8f7d5
      TrlrHitchLamp_D_Rqst_635efcb3 (ComSignal):
        ComBitPosition = 24
        ComBitSize = 1
        ComSignalEndianness = BIG_ENDIAN
        ComSignalInitValue = 0
        ComSignalType = BOOLEAN
        ComTransferProperty = PENDING
        ComSignalAccess = ACCESS_NEEDED_BY_SWC_OR_COM
        ComHandleId = 39
        ComSystemTemplateSystemSignalRef = TrlrHitchLamp_D_Rqst
      StePinOffst_An_Est_c3a8df7f (ComSignal):
        ComBitPosition = 7
        ComBitSize = 16
        ComSignalEndianness = BIG_ENDIAN
        ComSignalInitValue = 65534
        ComSignalType = UINT16
        ComTimeout = 0
        ComSignalAccess = ACCESS_NEEDED_BY_SWC_OR_COM
        ComHandleId = 63
        ComSystemTemplateSystemSignalRef = StePinOffst_An_Est
      BrakeSysFeatures_3_oFD1_CAN_3abd61be (ComIPdu):
        ComIPduDirection = RECEIVE
        ComIPduType = NORMAL
        ComIPduHandleId = 10
        ComIPduSignalProcessing = DEFERRED
        ComIPduCancellationSupport = false
        ComIPduCallout = ComIPduCallout_BrakeSysFeatures_3_FD1
        ComIPduGroupRef = PSCM_FD_oFD1_CAN_Rx_fcef2243
        ComIPduSignalRef = SelDrvMdeChassis2_D_Rq_e000acae
        ComPduIdRef = PT_BrakeSysFeatures_3_PP_BrakeSysFeatures_3_Rx_3290b631_3cf8f7d5
      EsaOn_B_Rq_bffaafb8 (ComSignal):
        ComBitPosition = 15
        ComBitSize = 1
        ComSignalEndianness = BIG_ENDIAN
        ComSignalInitValue = 1
        ComSignalType = BOOLEAN
        ComTimeout = 1.01
        ComSignalAccess = ACCESS_NEEDED_BY_SWC_OR_COM
        ComHandleId = 28
        ComTimeoutNotification = ComTimeoutNotification_EsaOn_B_Rq
        ComFirstTimeout = 1.01
        ComSystemTemplateSystemSignalRef = EsaOn_B_Rq
      Mc_Send_Signals_2_FD1_oFD1_CAN_3abd61be (ComIPdu):
        ComIPduDirection = RECEIVE
        ComIPduType = NORMAL
        ComIPduHandleId = 24
        ComIPduSignalProcessing = DEFERRED
        ComIPduCancellationSupport = false
        ComIPduCallout = ComIPduCallout_Mc_Send_Signlas_2_FD1
        ComIPduGroupRef = PSCM_FD_oFD1_CAN_Rx_fcef2243
        ComIPduSignalRef = EsaOn_B_Rq_bffaafb8
        ComPduIdRef = PT_Mc_Send_Signals_2_FD1_PP_Mc_Send_Signals_2_FD1_Rx_3290b631_3cf8f7d5
      BrkTot_Tq_Actl_22c61bd2 (ComSignal):
        ComBitPosition = 27
        ComBitSize = 13
        ComSignalEndianness = BIG_ENDIAN
        ComSignalInitValue = 0
        ComSignalType = UINT16
        ComTimeout = 0.03
        ComSignalAccess = ACCESS_NEEDED_BY_SWC_OR_COM
        ComHandleId = 7
        ComTimeoutNotification = ComTimeoutNotification_BrkTot_Tq_Actl_Oper
        ComFirstTimeout = 0.03
        ComSystemTemplateSystemSignalRef = BrkTot_Tq_Actl
      PrplWhlTot2_Tq_Actl_e6deed9e (ComSignal):
        ComBitPosition = 15
        ComBitSize = 16
        ComSignalEndianness = BIG_ENDIAN
        ComSignalInitValue = 0
        ComSignalType = UINT16
        ComTimeout = 0
        ComSignalAccess = ACCESS_NEEDED_BY_SWC_OR_COM
        ComHandleId = 59
        ComSystemTemplateSystemSignalRef = PrplWhlTot2_Tq_Actl
      Lane_Assist_Data3_FD1_oFD1_CAN_3abd61be (ComIPdu):
        ComIPduDirection = SEND
        ComIPduType = NORMAL
        ComIPduHandleId = 1
        ComIPduSignalProcessing = DEFERRED
        ComIPduCancellationSupport = false
        ComIPduGroupRef = PSCM_FD_oFD1_CAN_Tx_fcef2243
        ComIPduSignalRef = LaActAvail_D_Actl_3724073d
        ComIPduSignalRef = LaActDeny_B_Actl_3724073d
        ComIPduSignalRef = LaHandsOff_B_Actl_3724073d
        ComIPduSignalRef = LsmcBrkDecelEnbl_D_Rq_3724073d
        ComIPduSignalRef = LsmcBrk_Tq_Rq_3724073d
        ComIPduSignalRef = TjaHandsOnCnfdnc_B_Est_3724073d
        ComIPduSignalRef = TrlrAn_An_TrgtCalc_3724073d
        ComPduIdRef = PT_Lane_Assist_Data3_FD1_PP_Lane_Assist_Data3_FD1_Tx_3290b631_3cf8f7d5
        ComTxIPdu: ComMinimumDelayTime=0.01, ComTxIPduUnusedAreasDefault=0
          ComTxModeTrue
            ComTxMode: ComTxModeMode=PERIODIC, ComTxModeTimeOffset=0, ComTxModeTimePeriod=0.03
          ComTxModeFalse
            ComTxMode: ComTxModeMode=PERIODIC, ComTxModeTimeOffset=0, ComTxModeTimePeriod=0.03
      Steer_Assist_Data_FD1_oFD1_CAN_3abd61be (ComIPdu):
        ComIPduDirection = RECEIVE
        ComIPduType = NORMAL
        ComIPduHandleId = 27
        ComIPduSignalProcessing = DEFERRED
        ComIPduCancellationSupport = false
        ComIPduCallout = ComIPduCallout_Steer_Assist_Data_FD1
        ComIPduGroupRef = PSCM_FD_oFD1_CAN_Rx_fcef2243
        ComIPduSignalRef = CmbbObjClass_D_Stat_dafea5bb
        ComIPduSignalRef = CmbbObjColl_T_Actl_dafea5bb
        ComIPduSignalRef = CmbbObjConfdnc_D_Stat_dafea5bb
        ComIPduSignalRef = CmbbObjDistLat_L_Actl_dafea5bb
        ComIPduSignalRef = CmbbObjDistLong_L_Actl_dafea5bb
        ComIPduSignalRef = CmbbObjRelLat_V_Actl_dafea5bb
        ComIPduSignalRef = CmbbObjRelLong_V_Actl_dafea5bb
        ComIPduSignalRef = EsaEnbl_D2_Rq_dafea5bb
        ComPduIdRef = PT_Steer_Assist_Data_FD1_PP_Steer_Assist_Data_FD1_Rx_3290b631_3cf8f7d5
      SelDrvMdeChassis2_D_Rq_e000acae (ComSignal):
        ComBitPosition = 45
        ComBitSize = 5
        ComSignalEndianness = BIG_ENDIAN
        ComSignalInitValue = 0
        ComSignalType = UINT8
        ComTimeout = 1.01
        ComSignalAccess = ACCESS_NEEDED_BY_SWC_OR_COM
        ComHandleId = 61
        ComFirstTimeout = 1.01
        ComTimeoutNotification = ComTimeoutNotification_SelDrvMdeChassis2_D_Rq
        ComSystemTemplateSystemSignalRef = SelDrvMdeChassis2_D_Rq
      Image_Processing_Data_FD1_oFD1_CAN_3abd61be (ComIPdu):
        ComIPduDirection = RECEIVE
        ComIPduType = NORMAL
        ComIPduHandleId = 21
        ComIPduSignalProcessing = DEFERRED
        ComIPduCancellationSupport = false
        ComIPduGroupRef = PSCM_FD_oFD1_CAN_Rx_fcef2243
        ComIPduSignalRef = TrlrRvrseEnbl_D2_Stat_ae9dea9d
        ComIPduSignalRef = TrlrRvrseMsgTxt_D2_Rq_ae9dea9d
        ComPduIdRef = PT_Image_Processing_Data_FD1_PP_Image_Processing_Data_FD1_Rx_3290b631_3cf8f7d5
      3 x ComSignal, all with ComBitPosition=7, ComSignalEndianness=BIG_ENDIAN, ComSignalType=UINT16, ComSignalAccess=ACCESS_NEEDED_BY_SWC_OR_COM:
        LatCtlCurv_No_Actl_5abef978: ComBitSize=11, ComSignalInitValue=1000, ComTimeout=0, ComHandleId=44, ComSystemTemplateSystemSignalRef=LatCtlCurv_No_Actl
        CmbbObjDistLong_L_Actl_dafea5bb: ComBitSize=10, ComSignalInitValue=1022, ComTimeout=0, ComHandleId=14, ComSystemTemplateSystemSignalRef=CmbbObjDistLong_L_Actl
        HitchToTrlrAxle_L_Calc_51142c79: ComBitSize=9, ComSignalInitValue=0, ComTransferProperty=PENDING, ComHandleId=4, ComSystemTemplateSystemSignalRef=HitchToTrlrAxle_L_Calc
      APIM_Send_Signals_2_FD1_oFD1_CAN_3abd61be (ComIPdu):
        ComIPduDirection = RECEIVE
        ComIPduType = NORMAL
        ComIPduHandleId = 2
        ComIPduSignalProcessing = DEFERRED
        ComIPduCancellationSupport = false
        ComIPduCallout = ComIPduCallout_APIM_Send_Signals_2_FD1_Oper
        ComIPduGroupRef = PSCM_FD_oFD1_CAN_Rx_fcef2243
        ComIPduSignalRef = TrlrAidMde_D_Rq_a35cbfab
        ComPduIdRef = PT_APIM_Send_Signals_2_FD1_PP_APIM_Send_Signals_2_FD1_Rx_3290b631_3cf8f7d5
      5 x ComSignal, all with ComSignalEndianness=BIG_ENDIAN, ComSignalType=UINT8, ComSignalAccess=ACCESS_NEEDED_BY_SWC_OR_COM:
        GearRvrse_D_Actl_2508f61f: ComBitPosition=4, ComBitSize=3, ComSignalInitValue=7, ComTimeout=0, ComHandleId=36, ComSystemTemplateSystemSignalRef=GearRvrse_D_Actl
        TrlrHitchYaw_D_Stat_96fdcdb8: ComBitPosition=47, ComBitSize=4, ComSignalInitValue=0, ComTimeout=0, ComHandleId=83, ComSystemTemplateSystemSignalRef=TrlrHitchYaw_D_Stat
        LatCtlSte_D_Stat_51142c79: ComBitPosition=20, ComBitSize=3, ComSignalInitValue=0, ComTransferProperty=TRIGGERED_ON_CHANGE_WITHOUT_REPETITION, ComHandleId=9, ComSystemTemplateSystemSignalRef=LatCtlSte_D_Stat
        Veh_V_RqMxTrlrAid_635efcb3: ComBitPosition=63, ComBitSize=8, ComSignalInitValue=255, ComTransferProperty=PENDING, ComHandleId=41, ComSystemTemplateSystemSignalRef=Veh_V_RqMxTrlrAid
        TrlrAn_An_WarnCalc_51142c79: ComBitPosition=28, ComBitSize=5, ComSignalInitValue=0, ComTransferProperty=PENDING, ComHandleId=38, ComSystemTemplateSystemSignalRef=TrlrAn_An_WarnCalc
      Cluster_Info1_FD1_oFD1_CAN_3abd61be (ComIPdu):
        ComIPduDirection = RECEIVE
        ComIPduType = NORMAL
        ComIPduHandleId = 13
        ComIPduSignalProcessing = DEFERRED
        ComIPduCancellationSupport = false
        ComIPduCallout = ComIPduCallout_Cluster_Info1_HS2
        ComIPduGroupRef = PSCM_FD_oFD1_CAN_Rx_fcef2243
        ComIPduSignalRef = OdometerMasterValue_09a60c78
        ComPduIdRef = PT_Cluster_Info1_FD1_PP_Cluster_Info1_FD1_Rx_3290b631_3cf8f7d5
      3 x ComSignal, all with ComSignalInitValue=0, ComSignalAccess=ACCESS_NEEDED_BY_SWC_OR_COM:
        TrlrRvrseCancl_B_Rq_0edbb78e: ComBitPosition=8, ComBitSize=1, ComSignalEndianness=BIG_ENDIAN, ComSignalType=BOOLEAN, ComTimeout=0, ComHandleId=87, ComSystemTemplateSystemSignalRef=TrlrRvrseCancl_B_Rq
        VehVTrlrAid_B_Avail_2508f61f: ComBitPosition=23, ComBitSize=1, ComSignalEndianness=BIG_ENDIAN, ComSignalType=BOOLEAN, ComTimeout=0, ComHandleId=106, ComSystemTemplateSystemSignalRef=VehVTrlrAid_B_Avail
        DeliveryNumber_f2797042: ComBitPosition=56, ComBitSize=8, ComSignalEndianness=LITTLE_ENDIAN, ComSignalType=UINT8, ComHandleId=18, ComSystemTemplateSystemSignalRef=DeliveryNumber
      TrailerAid_Stat2_FD1_oFD1_CAN_3abd61be (ComIPdu):
        ComIPduDirection = RECEIVE
        ComIPduType = NORMAL
        ComIPduHandleId = 32
        ComIPduSignalProcessing = DEFERRED
        ComIPduCancellationSupport = false
        ComIPduGroupRef = PSCM_FD_oFD1_CAN_Rx_fcef2243
        ComIPduSignalRef = TrlrHitYaw_AnRate_Actl_96fdcdb8
        ComIPduSignalRef = TrlrHitchYaw_An_Actl_96fdcdb8
        ComIPduSignalRef = TrlrHitchYaw_D_Stat_96fdcdb8
        ComIPduSignalRef = TrlrYawWActl_D_Qf_96fdcdb8
        ComIPduSignalRef = TrlrYaw_W_Actl_96fdcdb8
        ComPduIdRef = PT_TrailerAid_Stat2_FD1_PP_TrailerAid_Stat2_FD1_Rx_3290b631_3cf8f7d5
      12 x ComSignal, all with ComSignalAccess=ACCESS_NEEDED_BY_SWC_OR_COM:
        TrlrTrgtAcquire_D_Stat_0bf22cce: ComBitPosition=51, ComBitSize=3, ComSignalEndianness=BIG_ENDIAN, ComSignalInitValue=0, ComSignalType=UINT8, ComTimeout=0, ComHandleId=92, ComSystemTemplateSystemSignalRef=TrlrTrgtAcquire_D_Stat
        TrlrYawWActl_D_Qf_96fdcdb8: ComBitPosition=43, ComBitSize=2, ComSignalEndianness=BIG_ENDIAN, ComSignalInitValue=1, ComSignalType=UINT8, ComTimeout=0, ComHandleId=93, ComSystemTemplateSystemSignalRef=TrlrYawWActl_D_Qf
        TrlrAid_An3_Actl_0bf22cce: ComBitPosition=28, ComBitSize=11, ComSignalEndianness=BIG_ENDIAN, ComSignalInitValue=720, ComSignalType=UINT16, ComTimeout=0, ComHandleId=75, ComSystemTemplateSystemSignalRef=TrlrAid_An3_Actl
        SAPPAngleControlStat3_635efcb3: ComBitPosition=12, ComBitSize=1, ComSignalEndianness=BIG_ENDIAN, ComSignalInitValue=0, ComSignalType=BOOLEAN, ComTransferProperty=PENDING, ComHandleId=14, ComSystemTemplateSystemSignalRef=SAPPAngleControlStat3
        VehLatComp_A_Actl_470bb112: ComBitPosition=43, ComBitSize=10, ComSignalEndianness=BIG_ENDIAN, ComSignalInitValue=1022, ComSignalType=UINT16, ComTimeout=0.03, ComHandleId=97, ComFirstTimeout=0.03, ComTimeoutNotification=ComTimeoutNotification_VehLatComp_A_Actl_Oper, ComSystemTemplateSystemSignalRef=VehLatComp_A_Actl
        EsaEnbl_D2_Rq_dafea5bb: ComBitPosition=52, ComBitSize=2, ComSignalEndianness=BIG_ENDIAN, ComSignalInitValue=0, ComSignalType=UINT8, ComTimeout=0.06, ComHandleId=27, ComTimeoutNotification=ComTimeoutNotification_EsaEnbl_D2_Rq, ComFirstTimeout=0.06, ComSystemTemplateSystemSignalRef=EsaEnbl_D2_Rq
        StePinAn_No_Cs_837112cd: ComBitPosition=39, ComBitSize=8, ComSignalEndianness=BIG_ENDIAN, ComSignalInitValue=0, ComSignalType=UINT8, ComTransferProperty=PENDING, ComHandleId=23, ComSystemTemplateSystemSignalRef=StePinAn_No_Cs
        LatCtlPath_An_Actl_5abef978: ComBitPosition=31, ComBitSize=11, ComSignalEndianness=BIG_ENDIAN, ComSignalInitValue=1000, ComSignalType=UINT16, ComTimeout=0, ComHandleId=46, ComSystemTemplateSystemSignalRef=LatCtlPath_An_Actl
        VehicleGGCCData_575096ac: ComBitPosition=0, ComSignalEndianness=opaque, ComSignalInitValue=0 0 0 0 0 0 0 0, ComSignalLength=8, ComSignalType=UINT8_N, ComTimeout=0.21, ComHandleId=112, ComTimeoutNotification=ComTimeoutNotification_VehicleGGCCData_Oper, ComFirstTimeout=0.21, ComSystemTemplateSystemSignalRef=VehicleGGCCData
        DeliverySipNumber_f2797042: ComBitPosition=0, ComBitSize=24, ComSignalEndianness=LITTLE_ENDIAN, ComSignalInitValue=1507332, ComSignalType=UINT32, ComHandleId=19, ComSystemTemplateSystemSignalRef=DeliverySipNumber
        LatCtlRampType_D_Rq_5abef978: ComBitPosition=53, ComBitSize=2, ComSignalEndianness=BIG_ENDIAN, ComSignalInitValue=0, ComSignalType=UINT8, ComTimeout=0.06, ComHandleId=48, ComTimeoutNotification=ComTimeoutNotification_LatCtlRampType_D_Rq_Oper, ComFirstTimeout=0.06, ComSystemTemplateSystemSignalRef=LatCtlRampType_D_Rq
        LsmcBrkDecelEnbl_D_Rq_3724073d: ComBitPosition=1, ComBitSize=2, ComSignalEndianness=BIG_ENDIAN, ComSignalInitValue=0, ComSignalType=UINT8, ComTransferProperty=PENDING, ComHandleId=10, ComSystemTemplateSystemSignalRef=LsmcBrkDecelEnbl_D_Rq
      TrailerInfo_FD1_oFD1_CAN_3abd61be (ComIPdu):
        ComIPduDirection = RECEIVE
        ComIPduType = NORMAL
        ComIPduHandleId = 36
        ComIPduSignalProcessing = DEFERRED
        ComIPduCancellationSupport = false
        ComIPduCallout = ComIPduCallout_TrailerInfo_FD1
        ComIPduGroupRef = PSCM_FD_oFD1_CAN_Rx_fcef2243
        ComIPduSignalRef = TrlrLampCnnct_B_Actl_6acffff2
        ComPduIdRef = PT_TrailerInfo_FD1_PP_TrailerInfo_FD1_Rx_3290b631_3cf8f7d5
      TjaHandsOnCnfdnc_B_Est_3724073d (ComSignal):
        ComBitPosition = 3
        ComBitSize = 1
        ComSignalEndianness = BIG_ENDIAN
        ComSignalInitValue = 1
        ComSignalType = BOOLEAN
        ComTransferProperty = PENDING
        ComSignalAccess = ACCESS_NEEDED_BY_SWC_OR_COM
        ComHandleId = 29
        ComSystemTemplateSystemSignalRef = TjaHandsOnCnfdnc_B_Est
      PSCM_FD_oFD1_CAN_Tx_fcef2243 (ComIPduGroup): ComIPduGroupHandleId=1
      3 x ComSignal, all with ComSignalAccess=ACCESS_NEEDED_BY_SWC_OR_COM:
        DeliverySubProjectNumber_f2797042: ComBitPosition=24, ComBitSize=32, ComSignalEndianness=LITTLE_ENDIAN, ComSignalInitValue=23072854, ComSignalType=UINT32, ComHandleId=20, ComSystemTemplateSystemSignalRef=DeliverySubProjectNumber
        StePinCompAnEst_D_Qf_837112cd: ComBitPosition=43, ComBitSize=2, ComSignalEndianness=BIG_ENDIAN, ComSignalInitValue=1, ComSignalType=UINT8, ComTransferProperty=PENDING, ComHandleId=24, ComSystemTemplateSystemSignalRef=StePinCompAnEst_D_Qf
        LatCtlPrecision_D_Rq_5abef978: ComBitPosition=33, ComBitSize=2, ComSignalEndianness=BIG_ENDIAN, ComSignalInitValue=0, ComSignalType=UINT8, ComTimeout=0, ComHandleId=47, ComSystemTemplateSystemSignalRef=LatCtlPrecision_D_Rq
      TrailerAid_Data2_FD1_oFD1_CAN_3abd61be (ComIPdu):
        ComIPduDirection = SEND
        ComIPduType = NORMAL
        ComIPduHandleId = 3
        ComIPduSignalProcessing = DEFERRED
        ComIPduCancellationSupport = false
        ComIPduGroupRef = PSCM_FD_oFD1_CAN_Tx_fcef2243
        ComIPduSignalRef = EsaOn_B_Stat_51142c79
        ComIPduSignalRef = HitchToTrlrAxle_L_Calc_51142c79
        ComIPduSignalRef = LatCtlLim_D_Stat_51142c79
        ComIPduSignalRef = LatCtlSte_D_Stat_51142c79
        ComIPduSignalRef = SelDrvMdeSte_D_Stat_51142c79
        ComIPduSignalRef = TrlrAidEnbl_D2_Stat_51142c79
        ComIPduSignalRef = TrlrAidMsgTxt_D2_Rq_51142c79
        ComIPduSignalRef = TrlrAidSetup_D2_Stat_51142c79
        ComIPduSignalRef = TrlrAidTrgtId_No_Rq_51142c79
        ComIPduSignalRef = TrlrAidTrlrId_No_Rq_51142c79
        ComIPduSignalRef = TrlrAnOffst_An2_Calc_51142c79
        ComIPduSignalRef = TrlrAn_An_MxCalc_51142c79
        ComIPduSignalRef = TrlrAn_An_WarnCalc_51142c79
        ComPduIdRef = PT_TrailerAid_Data2_FD1_PP_TrailerAid_Data2_FD1_Tx_3290b631_3cf8f7d5
        ComTxIPdu: ComMinimumDelayTime=0.02, ComTxIPduUnusedAreasDefault=0
          ComTxModeTrue
            ComTxMode: ComTxModeMode=MIXED, ComTxModeNumberOfRepetitions=0, ComTxModeRepetitionPeriod=0, ComTxModeTimeOffset=0, ComTxModeTimePeriod=1
          ComTxModeFalse
            ComTxMode: ComTxModeMode=MIXED, ComTxModeNumberOfRepetitions=0, ComTxModeRepetitionPeriod=0, ComTxModeTimeOffset=0, ComTxModeTimePeriod=1
      BrakeSysFeatures_FD1_oFD1_CAN_3abd61be (ComIPdu):
        ComIPduDirection = RECEIVE
        ComIPduType = NORMAL
        ComIPduHandleId = 11
        ComIPduSignalProcessing = DEFERRED
        ComIPduCancellationSupport = false
        ComIPduCallout = ComIPduCallout_BrakeSysFeatures_HS2_Oper
        ComIPduGroupRef = PSCM_FD_oFD1_CAN_Rx_fcef2243
        ComIPduSignalRef = LsmcBrkDecel_D_Stat_9f750b9f
        ComIPduSignalRef = VehVActlBrk_D_Qf_9f750b9f
        ComIPduSignalRef = VehVActlBrk_No_Cnt_9f750b9f
        ComIPduSignalRef = VehVActlBrk_No_Cs_9f750b9f
        ComIPduSignalRef = Veh_V_ActlBrk_9f750b9f
        ComPduIdRef = PT_BrakeSysFeatures_FD1_PP_BrakeSysFeatures_FD1_Rx_3290b631_3cf8f7d5
      4 x ComSignal, all with ComSignalEndianness=BIG_ENDIAN, ComSignalAccess=ACCESS_NEEDED_BY_SWC_OR_COM:
        TrlrBrkActCnnct_B_Actl_e983cb78: ComBitPosition=6, ComBitSize=1, ComSignalInitValue=0, ComSignalType=BOOLEAN, ComTimeout=0, ComHandleId=80, ComSystemTemplateSystemSignalRef=TrlrBrkActCnnct_B_Actl
        Outside_Air_Temp_Stat_f1463698: ComBitPosition=7, ComBitSize=8, ComSignalInitValue=254, ComSignalType=UINT8, ComTimeout=1.01, ComHandleId=58, ComFirstTimeout=1.01, ComTimeoutNotification=ComTimeoutNotification_Outside_Air_Temp_Stat, ComSystemTemplateSystemSignalRef=Outside_Air_Temp_Stat
        GearPos_D_Actl_1e331f99: ComBitPosition=3, ComBitSize=4, ComSignalInitValue=15, ComSignalType=UINT8, ComTimeout=0, ComHandleId=35, ComSystemTemplateSystemSignalRef=GearPos_D_Actl
        CmbbObjColl_T_Actl_dafea5bb: ComBitPosition=30, ComBitSize=7, ComSignalInitValue=126, ComSignalType=UINT8, ComTimeout=0, ComHandleId=11, ComSystemTemplateSystemSignalRef=CmbbObjColl_T_Actl
      TrailerBrakeInfo_FD1_oFD1_CAN_3abd61be (ComIPdu):
        ComIPduDirection = RECEIVE
        ComIPduType = NORMAL
        ComIPduHandleId = 34
        ComIPduSignalProcessing = DEFERRED
        ComIPduCancellationSupport = false
        ComIPduGroupRef = PSCM_FD_oFD1_CAN_Rx_fcef2243
        ComIPduSignalRef = TrlrBrkActCnnct_B_Actl_e983cb78
        ComPduIdRef = PT_TrailerBrakeInfo_FD1_PP_TrailerBrakeInfo_FD1_Rx_3290b631_3cf8f7d5
      TurnLghtSwtch_D_Stat_7262fead (ComSignal):
        ComBitPosition = 5
        ComBitSize = 2
        ComSignalEndianness = BIG_ENDIAN
        ComSignalInitValue = 0
        ComSignalType = UINT8
        ComTimeout = 0.11
        ComSignalAccess = ACCESS_NEEDED_BY_SWC_OR_COM
        ComHandleId = 96
        ComTimeoutNotification = ComTimeoutNotification_TurnLghtSwtch_D_Stat_Oper
        ComFirstTimeout = 0.11
        ComSystemTemplateSystemSignalRef = TurnLghtSwtch_D_Stat
      VehVActlBrk_No_Cnt_9f750b9f (ComSignal):
        ComBitPosition = 21
        ComBitSize = 4
        ComSignalEndianness = BIG_ENDIAN
        ComSignalInitValue = 0
        ComSignalType = UINT8
        ComTimeout = 0
        ComSignalAccess = ACCESS_NEEDED_BY_SWC_OR_COM
        ComHandleId = 101
        ComSystemTemplateSystemSignalRef = VehVActlBrk_No_Cnt
      BrakeSnData_4_FD1_oFD1_CAN_3abd61be (ComIPdu):
        ComIPduDirection = RECEIVE
        ComIPduType = NORMAL
        ComIPduHandleId = 7
        ComIPduSignalProcessing = DEFERRED
        ComIPduCancellationSupport = false
        ComIPduCallout = ComIPduCallout_BrakeSnData_4_FD1_Oper
        ComIPduGroupRef = PSCM_FD_oFD1_CAN_Rx_fcef2243
        ComIPduSignalRef = BrkTot_Tq_Actl_22c61bd2
        ComIPduSignalRef = VehVertComp_A_Actl_22c61bd2
        ComPduIdRef = PT_BrakeSnData_4_FD1_PP_BrakeSnData_4_FD1_Rx_3290b631_3cf8f7d5
      WheelSpeed_FD1_oFD1_CAN_3abd61be (ComIPdu):
        ComIPduDirection = RECEIVE
        ComIPduType = NORMAL
        ComIPduHandleId = 40
        ComIPduSignalProcessing = DEFERRED
        ComIPduCancellationSupport = false
        ComIPduCallout = ComIPduCallout_WheelSpeed_HS2_Oper
        ComIPduGroupRef = PSCM_FD_oFD1_CAN_Rx_fcef2243
        ComIPduSignalRef = WhlFl_W_Meas_5a620481
        ComIPduSignalRef = WhlFr_W_Meas_5a620481
        ComIPduSignalRef = WhlRl_W_Meas_5a620481
        ComIPduSignalRef = WhlRr_W_Meas_5a620481
        ComPduIdRef = PT_WheelSpeed_FD1_PP_WheelSpeed_FD1_Rx_3290b631_3cf8f7d5
      11 x ComSignal, all with ComSignalEndianness=BIG_ENDIAN, ComSignalAccess=ACCESS_NEEDED_BY_SWC_OR_COM:
        WhlRl_W_Meas_5a620481: ComBitPosition=38, ComBitSize=15, ComSignalInitValue=0, ComSignalType=UINT16, ComTimeout=0, ComHandleId=119, ComSystemTemplateSystemSignalRef=WhlRl_W_Meas
        CmbbObjClass_D_Stat_dafea5bb: ComBitPosition=13, ComBitSize=4, ComSignalInitValue=0, ComSignalType=UINT8, ComTimeout=0, ComHandleId=10, ComSystemTemplateSystemSignalRef=CmbbObjClass_D_Stat
        LatCtlCurv_NoRate_Actl_5abef978: ComBitPosition=12, ComBitSize=13, ComSignalInitValue=4096, ComSignalType=UINT16, ComTimeout=0, ComHandleId=43, ComSystemTemplateSystemSignalRef=LatCtlCurv_NoRate_Actl
        BPedDrvAppl_D_QF_aea354aa: ComBitPosition=15, ComBitSize=2, ComSignalInitValue=1, ComSignalType=UINT8, ComTimeout=0, ComHandleId=4, ComSystemTemplateSystemSignalRef=BPedDrvAppl_D_QF
        VehVActlEng_D_Qf_2508f61f: ComBitPosition=38, ComBitSize=2, ComSignalInitValue=0, ComSignalType=UINT8, ComTimeout=0.03, ComHandleId=103, ComTimeoutNotification=ComTimeoutNotification_Ford_VehVActlEng_D_Qf_Oper, ComFirstTimeout=0.03, ComSystemTemplateSystemSignalRef=VehVActlEng_D_Qf
        TrlrAidEnbl_D2_Rq_cc1bcd0f: ComBitPosition=7, ComBitSize=3, ComSignalInitValue=0, ComSignalType=UINT8, ComTimeout=0, ComHandleId=70, ComSystemTemplateSystemSignalRef=TrlrAidEnbl_D2_Rq
        CmbbDeny_B_ActlBrk_eaa4779a: ComBitPosition=60, ComBitSize=1, ComSignalInitValue=0, ComSignalType=BOOLEAN, ComTimeout=0.03, ComHandleId=9, ComTimeoutNotification=ComTimeoutNotification_CmbbDeny_B_ActlBrk_Oper, ComFirstTimeout=0.03, ComSystemTemplateSystemSignalRef=CmbbDeny_B_ActlBrk
        VehLongComp_A_Actl_470bb112: ComBitPosition=49, ComBitSize=10, ComSignalInitValue=1022, ComSignalType=UINT16, ComTimeout=0, ComHandleId=98, ComSystemTemplateSystemSignalRef=VehLongComp_A_Actl
        LsmcBrk_Tq_Rq_3724073d: ComBitPosition=15, ComBitSize=13, ComSignalInitValue=0, ComSignalType=UINT16, ComTransferProperty=PENDING, ComHandleId=11, ComSystemTemplateSystemSignalRef=LsmcBrk_Tq_Rq
        WhlDirRr_D_Actl_91fa0768: ComBitPosition=33, ComBitSize=2, ComSignalInitValue=0, ComSignalType=UINT8, ComTimeout=0, ComHandleId=116, ComSystemTemplateSystemSignalRef=WhlDirRr_D_Actl
        WhlRotatFl_No_Cnt_91fa0768: ComBitPosition=15, ComBitSize=8, ComSignalInitValue=0, ComSignalType=UINT8, ComTimeout=0, ComHandleId=120, ComSystemTemplateSystemSignalRef=WhlRotatFl_No_Cnt
      APIM_Send_Signals1_FD1_oFD1_CAN_3abd61be (ComIPdu):
        ComIPduDirection = RECEIVE
        ComIPduType = NORMAL
        ComIPduHandleId = 1
        ComIPduSignalProcessing = DEFERRED
        ComIPduCancellationSupport = false
        ComIPduGroupRef = PSCM_FD_oFD1_CAN_Rx_fcef2243
        ComIPduSignalRef = TrlrAidCancl_B_Rq_630ef174
        ComPduIdRef = PT_APIM_Send_Signals1_FD1_PP_APIM_Send_Signals1_FD1_Rx_3290b631_3cf8f7d5
      3 x ComSignal, all with ComSignalEndianness=BIG_ENDIAN, ComSignalInitValue=0, ComSignalType=UINT8, ComSignalAccess=ACCESS_NEEDED_BY_SWC_OR_COM:
        WhlRotatFr_No_Cnt_91fa0768: ComBitPosition=7, ComBitSize=8, ComTimeout=0, ComHandleId=121, ComSystemTemplateSystemSignalRef=WhlRotatFr_No_Cnt
        EPAS_Failure_635efcb3: ComBitPosition=9, ComBitSize=2, ComTransferProperty=PENDING, ComHandleId=2, ComSystemTemplateSystemSignalRef=EPAS_Failure
        TrlrRvrse_D_Stat_0bf22cce: ComBitPosition=42, ComBitSize=2, ComTimeout=0, ComHandleId=90, ComSystemTemplateSystemSignalRef=TrlrRvrse_D_Stat
      DeliveryVersion_oFD1_CAN_3abd61be (ComIPdu):
        ComIPduDirection = RECEIVE
        ComIPduType = NORMAL
        ComIPduHandleId = 14
        ComIPduSignalProcessing = DEFERRED
        ComIPduCancellationSupport = false
        ComIPduGroupRef = PSCM_FD_oFD1_CAN_Rx_fcef2243
        ComIPduSignalRef = DeliveryIdle_f2797042
        ComIPduSignalRef = DeliveryNumber_f2797042
        ComIPduSignalRef = DeliverySipNumber_f2797042
        ComIPduSignalRef = DeliverySubProjectNumber_f2797042
        ComPduIdRef = PT_DeliveryVersion_PP_DeliveryVersion_Rx_3290b631_3cf8f7d5
      Lane_Assist_Data1_FD1_oFD1_CAN_3abd61be (ComIPdu):
        ComIPduDirection = RECEIVE
        ComIPduType = NORMAL
        ComIPduHandleId = 22
        ComIPduSignalProcessing = DEFERRED
        ComIPduCancellationSupport = false
        ComIPduCallout = ComIPduCallout_Lane_Assist_Data1_FD1_Oper
        ComIPduGroupRef = PSCM_FD_oFD1_CAN_Rx_fcef2243
        ComIPduSignalRef = LaCurvature_No_Calc_d64ac390
        ComIPduSignalRef = LaRampType_B_Req_d64ac390
        ComIPduSignalRef = LaRefAng_No_Req_d64ac390
        ComIPduSignalRef = LdwActvIntns_D_Req_d64ac390
        ComIPduSignalRef = LdwActvStats_D_Req_d64ac390
        ComIPduSignalRef = LkaActvStats_D2_Req_d64ac390
        ComIPduSignalRef = LkaDrvOvrrd_D_Rq_d64ac390
        ComPduIdRef = PT_Lane_Assist_Data1_FD1_PP_Lane_Assist_Data1_FD1_Rx_3290b631_3cf8f7d5
      9 x ComSignal, all with ComSignalEndianness=BIG_ENDIAN, ComSignalAccess=ACCESS_NEEDED_BY_SWC_OR_COM:
        TrlrAnOffst_An2_Calc_51142c79: ComBitPosition=39, ComBitSize=8, ComSignalInitValue=128, ComSignalType=UINT8, ComTransferProperty=PENDING, ComHandleId=35, ComSystemTemplateSystemSignalRef=TrlrAnOffst_An2_Calc
        TrlrAidMsgTxt_D2_Rq_51142c79: ComBitPosition=14, ComBitSize=6, ComSignalInitValue=0, ComSignalType=UINT8, ComTransferProperty=TRIGGERED_ON_CHANGE_WITHOUT_REPETITION, ComHandleId=31, ComSystemTemplateSystemSignalRef=TrlrAidMsgTxt_D2_Rq
        WhlDirRl_D_Actl_91fa0768: ComBitPosition=39, ComBitSize=2, ComSignalInitValue=0, ComSignalType=UINT8, ComTimeout=0, ComHandleId=115, ComSystemTemplateSystemSignalRef=WhlDirRl_D_Actl
        TrlrRvrseEnbl_D2_Stat_ae9dea9d: ComBitPosition=18, ComBitSize=3, ComSignalInitValue=0, ComSignalType=UINT8, ComTimeout=0, ComHandleId=88, ComSystemTemplateSystemSignalRef=TrlrRvrseEnbl_D2_Stat
        SAPPAngleControlStat6_635efcb3: ComBitPosition=15, ComBitSize=1, ComSignalInitValue=0, ComSignalType=BOOLEAN, ComTransferProperty=PENDING, ComHandleId=17, ComSystemTemplateSystemSignalRef=SAPPAngleControlStat6
        TrlrYaw_W_Actl_96fdcdb8: ComBitPosition=7, ComBitSize=16, ComSignalInitValue=65534, ComSignalType=UINT16, ComTimeout=0, ComHandleId=94, ComSystemTemplateSystemSignalRef=TrlrYaw_W_Actl
        AbsActv_B_Actl_eaa4779a: ComBitPosition=45, ComBitSize=1, ComSignalInitValue=0, ComSignalType=BOOLEAN, ComTimeout=0, ComHandleId=0, ComSystemTemplateSystemSignalRef=AbsActv_B_Actl
        StabCtlBrkActv_B_Actl_eaa4779a: ComBitPosition=23, ComBitSize=1, ComSignalInitValue=0, ComSignalType=BOOLEAN, ComTimeout=0, ComHandleId=62, ComSystemTemplateSystemSignalRef=StabCtlBrkActv_B_Actl
        Veh_V_ActlBrk_9f750b9f: ComBitPosition=7, ComBitSize=16, ComSignalInitValue=0, ComSignalType=UINT16, ComTimeout=0.03, ComHandleId=110, ComFirstTimeout=0.03, ComTimeoutNotification=ComTimeoutNotification_Veh_V_ActlBrk_Oper, ComSystemTemplateSystemSignalRef=Veh_V_ActlBrk
      PowertrainData_10_FD1_oFD1_CAN_3abd61be (ComIPdu):
        ComIPduDirection = RECEIVE
        ComIPduType = NORMAL
        ComIPduHandleId = 26
        ComIPduSignalProcessing = DEFERRED
        ComIPduCancellationSupport = false
        ComIPduGroupRef = PSCM_FD_oFD1_CAN_Rx_fcef2243
        ComIPduSignalRef = GearPos_D_Actl_1e331f99
        ComIPduSignalRef = TrnRng_D_Rq_1e331f99
        ComPduIdRef = PT_PowertrainData_10_FD1_PP_PowertrainData_10_FD1_Rx_3290b631_3cf8f7d5
      SAPPAngleControlStat1_635efcb3 (ComSignal):
        ComBitPosition = 23
        ComBitSize = 2
        ComSignalEndianness = BIG_ENDIAN
        ComSignalInitValue = 0
        ComSignalType = UINT8
        ComTransferProperty = PENDING
        ComSignalAccess = ACCESS_NEEDED_BY_SWC_OR_COM
        ComHandleId = 12
        ComSystemTemplateSystemSignalRef = SAPPAngleControlStat1
      TrlrAn_An_MxCalc_51142c79 (ComSignal):
        ComBitPosition = 55
        ComBitSize = 7
        ComSignalEndianness = BIG_ENDIAN
        ComSignalInitValue = 0
        ComSignalType = UINT8
        ComTransferProperty = PENDING
        ComSignalAccess = ACCESS_NEEDED_BY_SWC_OR_COM
        ComHandleId = 36
        ComSystemTemplateSystemSignalRef = TrlrAn_An_MxCalc
      TrailerAid_Stat3_FD1_oFD1_CAN_3abd61be (ComIPdu):
        ComIPduDirection = RECEIVE
        ComIPduType = NORMAL
        ComIPduHandleId = 33
        ComIPduSignalProcessing = DEFERRED
        ComIPduCancellationSupport = false
        ComIPduCallout = ComIPduCallout_TrailerAidStat3_FD1
        ComIPduGroupRef = PSCM_FD_oFD1_CAN_Rx_fcef2243
        ComIPduSignalRef = HitchToVehAxle_L_Calc_0bf22cce
        ComIPduSignalRef = TrlrAidTrgtId_No_Actl_0bf22cce
        ComIPduSignalRef = TrlrAid_An3_Actl_0bf22cce
        ComIPduSignalRef = TrlrAid_AnRate2_Actl_0bf22cce
        ComIPduSignalRef = TrlrAid_D2_Stat_0bf22cce
        ComIPduSignalRef = TrlrRvrse_D_Stat_0bf22cce
        ComIPduSignalRef = TrlrTrgtAcquire_D_Stat_0bf22cce
        ComPduIdRef = PT_TrailerAid_Stat3_FD1_PP_TrailerAid_Stat3_FD1_Rx_3290b631_3cf8f7d5
      PSCM_FD_oFD1_CAN_Rx_fcef2243 (ComIPduGroup): ComIPduGroupHandleId=0
      StePinOffst_D_Stat_c3a8df7f (ComSignal):
        ComBitPosition = 23
        ComBitSize = 2
        ComSignalEndianness = BIG_ENDIAN
        ComSignalInitValue = 0
        ComSignalType = UINT8
        ComTimeout = 0.11
        ComSignalAccess = ACCESS_NEEDED_BY_SWC_OR_COM
        ComHandleId = 64
        ComFirstTimeout = 0.11
        ComTimeoutNotification = ComTimeoutNotification_Ford_StePinOffst_D_Stat_Oper
        ComSystemTemplateSystemSignalRef = StePinOffst_D_Stat
      TrailerAid_Stat1_FD1_oFD1_CAN_3abd61be (ComIPdu):
        ComIPduDirection = RECEIVE
        ComIPduType = NORMAL
        ComIPduHandleId = 31
        ComIPduSignalProcessing = DEFERRED
        ComIPduCancellationSupport = false
        ComIPduGroupRef = PSCM_FD_oFD1_CAN_Rx_fcef2243
        ComIPduSignalRef = TrlrSnsId_No_Actl_ea9ce863
        ComPduIdRef = PT_TrailerAid_Stat1_FD1_PP_TrailerAid_Stat1_FD1_Rx_3290b631_3cf8f7d5
      3 x ComSignal, all with ComSignalEndianness=BIG_ENDIAN, ComSignalAccess=ACCESS_NEEDED_BY_SWC_OR_COM:
        LaCurvature_No_Calc_d64ac390: ComBitPosition=15, ComBitSize=12, ComSignalInitValue=2048, ComSignalType=UINT16, ComTimeout=0.04, ComHandleId=40, ComTimeoutNotification=ComTimeoutNotification_LaCurvature_No_Calc_Oper, ComFirstTimeout=0.04, ComSystemTemplateSystemSignalRef=LaCurvature_No_Calc
        TrlrAid_D2_Stat_0bf22cce: ComBitPosition=55, ComBitSize=4, ComSignalInitValue=0, ComSignalType=UINT8, ComTimeout=0, ComHandleId=77, ComSystemTemplateSystemSignalRef=TrlrAid_D2_Stat
        TrlrId_No_Actl_0edbb78e: ComBitPosition=12, ComBitSize=4, ComSignalInitValue=0, ComSignalType=UINT8, ComTimeout=0, ComHandleId=85, ComSystemTemplateSystemSignalRef=TrlrId_No_Actl
      EngBrakeData_FD1_oFD1_CAN_3abd61be (ComIPdu):
        ComIPduDirection = RECEIVE
        ComIPduType = NORMAL
        ComIPduHandleId = 16
        ComIPduSignalProcessing = DEFERRED
        ComIPduCancellationSupport = false
        ComIPduGroupRef = PSCM_FD_oFD1_CAN_Rx_fcef2243
        ComIPduSignalRef = BPedDrvAppl_D_QF_aea354aa
        ComIPduSignalRef = BpedDrvAppl_D_Actl_aea354aa
        ComPduIdRef = PT_EngBrakeData_FD1_PP_EngBrakeData_FD1_Rx_3290b631_3cf8f7d5
      5 x ComSignal, all with ComSignalEndianness=BIG_ENDIAN, ComSignalAccess=ACCESS_NEEDED_BY_SWC_OR_COM:
        DrvSte_Tq_Actl_635efcb3: ComBitPosition=47, ComBitSize=8, ComSignalInitValue=128, ComSignalType=UINT8, ComTransferProperty=PENDING, ComHandleId=1, ComSystemTemplateSystemSignalRef=DrvSte_Tq_Actl
        SAPPAngleControlStat4_635efcb3: ComBitPosition=13, ComBitSize=1, ComSignalInitValue=0, ComSignalType=BOOLEAN, ComTransferProperty=PENDING, ComHandleId=15, ComSystemTemplateSystemSignalRef=SAPPAngleControlStat4
        TrlrAidCancl_B_Rq_630ef174: ComBitPosition=48, ComBitSize=1, ComSignalInitValue=0, ComSignalType=BOOLEAN, ComTimeout=0, ComHandleId=68, ComSystemTemplateSystemSignalRef=TrlrAidCancl_B_Rq
        CmbbObjRelLong_V_Actl_dafea5bb: ComBitPosition=39, ComBitSize=10, ComSignalInitValue=1022, ComSignalType=UINT16, ComTimeout=0, ComHandleId=16, ComSystemTemplateSystemSignalRef=CmbbObjRelLong_V_Actl
        CmbbObjRelLat_V_Actl_dafea5bb: ComBitPosition=23, ComBitSize=9, ComSignalInitValue=510, ComSignalType=UINT16, ComTimeout=0, ComHandleId=15, ComSystemTemplateSystemSignalRef=CmbbObjRelLat_V_Actl
      EngVehicleSpThrottle2_FD1_oFD1_CAN_3abd61be (ComIPdu):
        ComIPduDirection = RECEIVE
        ComIPduType = NORMAL
        ComIPduHandleId = 17
        ComIPduSignalProcessing = DEFERRED
        ComIPduCancellationSupport = false
        ComIPduCallout = ComIPduCallout_EngVehicleSpThrottle2_HS2_Oper
        ComIPduGroupRef = PSCM_FD_oFD1_CAN_Rx_fcef2243
        ComIPduSignalRef = GearRvrse_D_Actl_2508f61f
        ComIPduSignalRef = VehVActlEng_D_Qf_2508f61f
        ComIPduSignalRef = VehVActlEng_No_Cnt_2508f61f
        ComIPduSignalRef = VehVActlEng_No_Cs_2508f61f
        ComIPduSignalRef = VehVTrlrAid_B_Avail_2508f61f
        ComIPduSignalRef = Veh_V_ActlEng_2508f61f
        ComPduIdRef = PT_EngVehicleSpThrottle2_FD1_PP_EngVehicleSpThrottle2_FD1_Rx_3290b631_3cf8f7d5
      4 x ComSignal, all with ComSignalEndianness=BIG_ENDIAN, ComSignalAccess=ACCESS_NEEDED_BY_SWC_OR_COM:
        StePw_B_Rq_837112cd: ComBitPosition=23, ComBitSize=1, ComSignalInitValue=0, ComSignalType=BOOLEAN, ComTransferProperty=PENDING, ComHandleId=27, ComSystemTemplateSystemSignalRef=StePw_B_Rq
        TrlrRvrseMsgTxt_D2_Rq_ae9dea9d: ComBitPosition=31, ComBitSize=6, ComSignalInitValue=0, ComSignalType=UINT8, ComTimeout=0, ComHandleId=89, ComSystemTemplateSystemSignalRef=TrlrRvrseMsgTxt_D2_Rq
        CmbbObjConfdnc_D_Stat_dafea5bb: ComBitPosition=9, ComBitSize=2, ComSignalInitValue=0, ComSignalType=UINT8, ComTimeout=0, ComHandleId=12, ComSystemTemplateSystemSignalRef=CmbbObjConfdnc_D_Stat
        CmbbObjDistLat_L_Actl_dafea5bb: ComBitPosition=45, ComBitSize=9, ComSignalInitValue=510, ComSignalType=UINT16, ComTimeout=0, ComHandleId=13, ComSystemTemplateSystemSignalRef=CmbbObjDistLat_L_Actl
      Body_Info_4_FD1_oFD1_CAN_3abd61be (ComIPdu):
        ComIPduDirection = RECEIVE
        ComIPduType = NORMAL
        ComIPduHandleId = 5
        ComIPduSignalProcessing = DEFERRED
        ComIPduCancellationSupport = false
        ComIPduGroupRef = PSCM_FD_oFD1_CAN_Rx_fcef2243
        ComIPduSignalRef = BattULo_U_Actl_0a3b9a6b
        ComPduIdRef = PT_Body_Info_4_FD1_PP_Body_Info_4_FD1_Rx_3290b631_3cf8f7d5
      TrlrAidTrgtId_No_Rq_51142c79 (ComSignal):
        ComBitPosition = 44
        ComBitSize = 5
        ComSignalEndianness = BIG_ENDIAN
        ComSignalInitValue = 0
        ComSignalType = UINT8
        ComTransferProperty = PENDING
        ComSignalAccess = ACCESS_NEEDED_BY_SWC_OR_COM
        ComHandleId = 33
        ComSystemTemplateSystemSignalRef = TrlrAidTrgtId_No_Rq
      TransGearData_FD1_oFD1_CAN_3abd61be (ComIPdu):
        ComIPduDirection = RECEIVE
        ComIPduType = NORMAL
        ComIPduHandleId = 37
        ComIPduSignalProcessing = DEFERRED
        ComIPduCancellationSupport = false
        ComIPduCallout = ComIPduCallout_TransGearData_FD1_Oper
        ComIPduGroupRef = PSCM_FD_oFD1_CAN_Rx_fcef2243
        ComIPduSignalRef = GearLvrPos_D_Actl_8c4ca771
        ComPduIdRef = PT_TransGearData_FD1_PP_TransGearData_FD1_Rx_3290b631_3cf8f7d5
      13 x ComSignal, all with ComSignalEndianness=BIG_ENDIAN, ComSignalAccess=ACCESS_NEEDED_BY_SWC_OR_COM:
        WhlFl_W_Meas_5a620481: ComBitPosition=6, ComBitSize=15, ComSignalInitValue=0, ComSignalType=UINT16, ComTimeout=0.02, ComHandleId=117, ComFirstTimeout=0.02, ComTimeoutNotification=ComTimeoutNotification_WhlFl_W_Meas_Oper, ComSystemTemplateSystemSignalRef=WhlFl_W_Meas
        LaRampType_B_Req_d64ac390: ComBitPosition=39, ComBitSize=1, ComSignalInitValue=0, ComSignalType=BOOLEAN, ComTimeout=0, ComHandleId=41, ComSystemTemplateSystemSignalRef=LaRampType_B_Req
        WhlFr_W_Meas_5a620481: ComBitPosition=22, ComBitSize=15, ComSignalInitValue=0, ComSignalType=UINT16, ComTimeout=0, ComHandleId=118, ComSystemTemplateSystemSignalRef=WhlFr_W_Meas
        LaActDeny_B_Actl_3724073d: ComBitPosition=6, ComBitSize=1, ComSignalInitValue=0, ComSignalType=BOOLEAN, ComTransferProperty=PENDING, ComHandleId=6, ComSystemTemplateSystemSignalRef=LaActDeny_B_Actl
        TrlrAidEnbl_D2_Stat_51142c79: ComBitPosition=31, ComBitSize=3, ComSignalInitValue=0, ComSignalType=UINT8, ComTransferProperty=TRIGGERED_ON_CHANGE_WITHOUT_REPETITION, ComHandleId=30, ComSystemTemplateSystemSignalRef=TrlrAidEnbl_D2_Stat
        VehVActlEng_No_Cs_2508f61f: ComBitPosition=15, ComBitSize=8, ComSignalInitValue=0, ComSignalType=UINT8, ComTimeout=0, ComHandleId=105, ComSystemTemplateSystemSignalRef=VehVActlEng_No_Cs
        SteeringColumnTorque_635efcb3: ComBitPosition=7, ComBitSize=8, ComSignalInitValue=254, ComSignalType=UINT8, ComTransferProperty=PENDING, ComHandleId=28, ComSystemTemplateSystemSignalRef=SteeringColumnTorque
        SelDrvMdeSte_D_Stat_51142c79: ComBitPosition=17, ComBitSize=2, ComSignalInitValue=0, ComSignalType=UINT8, ComTransferProperty=TRIGGERED_ON_CHANGE_WITHOUT_REPETITION, ComHandleId=18, ComSystemTemplateSystemSignalRef=SelDrvMdeSte_D_Stat
        StePinOffst_No_Cs_c3a8df7f: ComBitPosition=31, ComBitSize=8, ComSignalInitValue=0, ComSignalType=UINT8, ComTimeout=0, ComHandleId=66, ComSystemTemplateSystemSignalRef=StePinOffst_No_Cs
        TrlrAnOffstDir_D_Mem_0edbb78e: ComBitPosition=62, ComBitSize=2, ComSignalInitValue=0, ComSignalType=UINT8, ComTimeout=0, ComHandleId=78, ComSystemTemplateSystemSignalRef=TrlrAnOffstDir_D_Mem
        VehOverGnd_V_Est_470bb112: ComBitPosition=7, ComBitSize=16, ComSignalInitValue=0, ComSignalType=UINT16, ComTimeout=0, ComHandleId=99, ComSystemTemplateSystemSignalRef=VehOverGnd_V_Est
        SteMdule_U_Meas_635efcb3: ComBitPosition=39, ComBitSize=8, ComSignalInitValue=255, ComSignalType=UINT8, ComTransferProperty=PENDING, ComHandleId=21, ComSystemTemplateSystemSignalRef=SteMdule_U_Meas
        TrlrAidTrlrId_No_Rq_51142c79: ComBitPosition=63, ComBitSize=4, ComSignalInitValue=0, ComSignalType=UINT8, ComTransferProperty=PENDING, ComHandleId=34, ComSystemTemplateSystemSignalRef=TrlrAidTrlrId_No_Rq
      VehicleOperatingModes_FD1_oFD1_CAN_3abd61be (ComIPdu):
        ComIPduDirection = RECEIVE
        ComIPduType = NORMAL
        ComIPduHandleId = 38
        ComIPduSignalProcessing = DEFERRED
        ComIPduCancellationSupport = false
        ComIPduCallout = ComIPduCallout_VehicleOperatingModes_HS2_Oper
        ComIPduGroupRef = PSCM_FD_oFD1_CAN_Rx_fcef2243
        ComIPduSignalRef = ElPw_D_StatStrtStop_e6deed9e
        ComIPduSignalRef = ElPw_D_Stat_e6deed9e
        ComIPduSignalRef = PrplWhlTot2_Tq_Actl_e6deed9e
        ComIPduSignalRef = PwPckTq_D_Stat_e6deed9e
        ComPduIdRef = PT_VehicleOperatingModes_FD1_PP_VehicleOperatingModes_FD1_Rx_3290b631_3cf8f7d5
      Climate_Control_Data_FD1_oFD1_CAN_3abd61be (ComIPdu):
        ComIPduDirection = RECEIVE
        ComIPduType = NORMAL
        ComIPduHandleId = 12
        ComIPduSignalProcessing = DEFERRED
        ComIPduCancellationSupport = false
        ComIPduCallout = ComIPduCallout_Climate_Control_Data_FD1
        ComIPduGroupRef = PSCM_FD_oFD1_CAN_Rx_fcef2243
        ComIPduSignalRef = Outside_Air_Temp_Stat_f1463698
        ComPduIdRef = PT_Climate_Control_Data_FD1_PP_Climate_Control_Data_FD1_Rx_3290b631_3cf8f7d5
      PwPckTq_D_Stat_e6deed9e (ComSignal):
        ComBitPosition = 5
        ComBitSize = 2
        ComSignalEndianness = BIG_ENDIAN
        ComSignalInitValue = 0
        ComSignalType = UINT8
        ComTimeout = 0.02
        ComSignalAccess = ACCESS_NEEDED_BY_SWC_OR_COM
        ComHandleId = 60
        ComTimeoutNotification = ComTimeoutNotification_PwPckTq_D_Stat_Oper
        ComFirstTimeout = 0.02
        ComSystemTemplateSystemSignalRef = PwPckTq_D_Stat
      Veh_V_ActlEng_2508f61f (ComSignal):
        ComBitPosition = 55
        ComBitSize = 16
        ComSignalEndianness = BIG_ENDIAN
        ComSignalInitValue = 0
        ComSignalType = UINT16
        ComTimeout = 0
        ComSignalAccess = ACCESS_NEEDED_BY_SWC_OR_COM
        ComHandleId = 111
        ComSystemTemplateSystemSignalRef = Veh_V_ActlEng
      EngVehicleSpThrottle_FD1_oFD1_CAN_3abd61be (ComIPdu):
        ComIPduDirection = RECEIVE
        ComIPduType = NORMAL
        ComIPduHandleId = 18
        ComIPduSignalProcessing = DEFERRED
        ComIPduCancellationSupport = false
        ComIPduGroupRef = PSCM_FD_oFD1_CAN_Rx_fcef2243
        ComIPduSignalRef = ApedPosPcActl_D_Qf_a3d34b0d
        ComIPduSignalRef = ApedPos_Pc_ActlArb_a3d34b0d
        ComIPduSignalRef = EngAout_N_Actl_a3d34b0d
        ComPduIdRef = PT_EngVehicleSpThrottle_FD1_PP_EngVehicleSpThrottle_FD1_Rx_3290b631_3cf8f7d5
      5 x ComSignal, all with ComSignalEndianness=BIG_ENDIAN, ComSignalAccess=ACCESS_NEEDED_BY_SWC_OR_COM:
        EPASExtAngleStatReq_ef286bfc: ComBitPosition=23, ComBitSize=1, ComSignalInitValue=0, ComSignalType=BOOLEAN, ComTimeout=0, ComHandleId=23, ComSystemTemplateSystemSignalRef=EPASExtAngleStatReq
        LsmcBrkDecel_D_Stat_9f750b9f: ComBitPosition=39, ComBitSize=3, ComSignalInitValue=0, ComSignalType=UINT8, ComTimeout=0, ComHandleId=56, ComSystemTemplateSystemSignalRef=LsmcBrkDecel_D_Stat
        HitchToVehAxle_L_Calc_0bf22cce: ComBitPosition=7, ComBitSize=8, ComSignalInitValue=255, ComSignalType=UINT8, ComTimeout=0.06, ComHandleId=38, ComTimeoutNotification=ComTimeoutNotification_HitchToVehAxle_L_Calc, ComFirstTimeout=0.06, ComSystemTemplateSystemSignalRef=HitchToVehAxle_L_Calc
        DrvSte_Tq_Rq_bfc9faa4: ComBitPosition=31, ComBitSize=8, ComSignalInitValue=128, ComSignalType=UINT8, ComTimeout=0, ComHandleId=22, ComSystemTemplateSystemSignalRef=DrvSte_Tq_Rq
        SAPPAngleControlStat2_635efcb3: ComBitPosition=11, ComBitSize=1, ComSignalInitValue=0, ComSignalType=BOOLEAN, ComTransferProperty=PENDING, ComHandleId=13, ComSystemTemplateSystemSignalRef=SAPPAngleControlStat2
      EPAS_INFO_FD1_oFD1_CAN_3abd61be (ComIPdu):
        ComIPduDirection = SEND
        ComIPduType = NORMAL
        ComIPduHandleId = 0
        ComIPduSignalProcessing = DEFERRED
        ComIPduCancellationSupport = false
        ComIPduGroupRef = PSCM_FD_oFD1_CAN_Tx_fcef2243
        ComIPduSignalRef = DrvSteActv_B_Stat_635efcb3
        ComIPduSignalRef = DrvSte_Tq_Actl_635efcb3
        ComIPduSignalRef = EPAS_Failure_635efcb3
        ComIPduSignalRef = SAPPAngleControlStat{1..6}_635efcb3
        ComIPduSignalRef = SteMdule_D_Stat_635efcb3
        ComIPduSignalRef = SteMdule_I_Est_635efcb3
        ComIPduSignalRef = SteMdule_U_Meas_635efcb3
        ComIPduSignalRef = SteeringColumnTorque_635efcb3
        ComIPduSignalRef = TrlrHitchLamp_D_Rqst_635efcb3
        ComIPduSignalRef = VehVTrlrAid_B_Rq_635efcb3
        ComIPduSignalRef = Veh_V_RqMxTrlrAid_635efcb3
        ComPduIdRef = PT_EPAS_INFO_FD1_PP_EPAS_INFO_FD1_Tx_3290b631_3cf8f7d5
        ComTxIPdu: ComMinimumDelayTime=0.01, ComTxIPduUnusedAreasDefault=0
          ComTxModeTrue
            ComTxMode: ComTxModeMode=PERIODIC, ComTxModeTimeOffset=0, ComTxModeTimePeriod=0.02
          ComTxModeFalse
            ComTxMode: ComTxModeMode=PERIODIC, ComTxModeTimeOffset=0, ComTxModeTimePeriod=0.02
      6 x ComSignal, all with ComSignalEndianness=BIG_ENDIAN, ComSignalInitValue=0, ComSignalAccess=ACCESS_NEEDED_BY_SWC_OR_COM:
        OdometerMasterValue_09a60c78: ComBitPosition=15, ComBitSize=24, ComSignalType=UINT32, ComTimeout=0.11, ComHandleId=57, ComFirstTimeout=0.11, ComTimeoutNotification=ComTimeoutNotification_OdometerMasterValue, ComSystemTemplateSystemSignalRef=OdometerMasterValue
        DrvSteActv_B_Stat_635efcb3: ComBitPosition=10, ComBitSize=1, ComSignalType=BOOLEAN, ComTransferProperty=PENDING, ComHandleId=0, ComSystemTemplateSystemSignalRef=DrvSteActv_B_Stat
        LaActAvail_D_Actl_3724073d: ComBitPosition=5, ComBitSize=2, ComSignalType=UINT8, ComTransferProperty=PENDING, ComHandleId=5, ComSystemTemplateSystemSignalRef=LaActAvail_D_Actl
        LkaActvStats_D2_Req_d64ac390: ComBitPosition=7, ComBitSize=3, ComSignalType=UINT8, ComTimeout=0, ComHandleId=54, ComSystemTemplateSystemSignalRef=LkaActvStats_D2_Req
        StePinAn_No_Cnt_837112cd: ComBitPosition=47, ComBitSize=4, ComSignalType=UINT8, ComTransferProperty=PENDING, ComHandleId=22, ComSystemTemplateSystemSignalRef=StePinAn_No_Cnt
        VehVActlEng_No_Cnt_2508f61f: ComBitPosition=22, ComBitSize=4, ComSignalType=UINT8, ComTimeout=0, ComHandleId=104, ComSystemTemplateSystemSignalRef=VehVActlEng_No_Cnt
      WheelData_FD1_oFD1_CAN_3abd61be (ComIPdu):
        ComIPduDirection = RECEIVE
        ComIPduType = NORMAL
        ComIPduHandleId = 39
        ComIPduSignalProcessing = DEFERRED
        ComIPduCancellationSupport = false
        ComIPduCallout = ComIPduCallout_WheelData_FD1_Oper
        ComIPduGroupRef = PSCM_FD_oFD1_CAN_Rx_fcef2243
        ComIPduSignalRef = WhlDirFl_D_Actl_91fa0768
        ComIPduSignalRef = WhlDirFr_D_Actl_91fa0768
        ComIPduSignalRef = WhlDirRl_D_Actl_91fa0768
        ComIPduSignalRef = WhlDirRr_D_Actl_91fa0768
        ComIPduSignalRef = WhlRotatFl_No_Cnt_91fa0768
        ComIPduSignalRef = WhlRotatFr_No_Cnt_91fa0768
        ComIPduSignalRef = WhlRotatRl_No_Cnt_91fa0768
        ComIPduSignalRef = WhlRotatRr_No_Cnt_91fa0768
        ComPduIdRef = PT_WheelData_FD1_PP_WheelData_FD1_Rx_3290b631_3cf8f7d5
      ActiveFrontStrg_Stat2_FD1_oFD1_CAN_3abd61be (ComIPdu):
        ComIPduDirection = RECEIVE
        ComIPduType = NORMAL
        ComIPduHandleId = 3
        ComIPduSignalProcessing = DEFERRED
        ComIPduCancellationSupport = false
        ComIPduGroupRef = PSCM_FD_oFD1_CAN_Rx_fcef2243
        ComIPduSignalRef = SteWhlRelCalib_An_Sns_11fa9ae5
        ComPduIdRef = PT_ActiveFrontStrg_Stat2_FD1_PP_ActiveFrontStrg_Stat2_FD1_Rx_3290b631_3cf8f7d5
      TrlrLampCnnct_B_Actl_6acffff2 (ComSignal):
        ComBitPosition = 7
        ComBitSize = 1
        ComSignalEndianness = BIG_ENDIAN
        ComSignalInitValue = 0
        ComSignalType = BOOLEAN
        ComTimeout = 1.01
        ComSignalAccess = ACCESS_NEEDED_BY_SWC_OR_COM
        ComHandleId = 86
        ComTimeoutNotification = ComTimeoutNotification_TrlrLampCnnct_B_Actl
        ComFirstTimeout = 1.01
        ComSystemTemplateSystemSignalRef = TrlrLampCnnct_B_Actl
      Steering_Data_FD1_oFD1_CAN_3abd61be (ComIPdu):
        ComIPduDirection = RECEIVE
        ComIPduType = NORMAL
        ComIPduHandleId = 28
        ComIPduSignalProcessing = DEFERRED
        ComIPduCancellationSupport = false
        ComIPduCallout = ComIPduCallout_Steering_Data_FD1_Oper
        ComIPduGroupRef = PSCM_FD_oFD1_CAN_Rx_fcef2243
        ComIPduSignalRef = TurnLghtSwtch_D_Stat_7262fead
        ComPduIdRef = PT_Steering_Data_FD1_PP_Steering_Data_FD1_Rx_3290b631_3cf8f7d5
      DesiredTorqBrk_FD1_oFD1_CAN_3abd61be (ComIPdu):
        ComIPduDirection = RECEIVE
        ComIPduType = NORMAL
        ComIPduHandleId = 15
        ComIPduSignalProcessing = DEFERRED
        ComIPduCancellationSupport = false
        ComIPduCallout = ComIPduCallout_DesiredTorqBrk_FD1_Oper
        ComIPduGroupRef = PSCM_FD_oFD1_CAN_Rx_fcef2243
        ComIPduSignalRef = AbsActv_B_Actl_eaa4779a
        ComIPduSignalRef = CmbbBrkDis_B_Actl_eaa4779a
        ComIPduSignalRef = CmbbDeny_B_ActlBrk_eaa4779a
        ComIPduSignalRef = StabCtlBrkActv_B_Actl_eaa4779a
        ComPduIdRef = PT_DesiredTorqBrk_FD1_PP_DesiredTorqBrk_FD1_Rx_3290b631_3cf8f7d5
      5 x ComSignal, all with ComSignalAccess=ACCESS_NEEDED_BY_SWC_OR_COM:
        WhlRr_W_Meas_5a620481: ComBitPosition=54, ComBitSize=15, ComSignalEndianness=BIG_ENDIAN, ComSignalInitValue=0, ComSignalType=UINT16, ComTimeout=0, ComHandleId=124, ComSystemTemplateSystemSignalRef=WhlRr_W_Meas
        SteWhlRelCalib_An_Sns_11fa9ae5: ComBitPosition=15, ComBitSize=15, ComSignalEndianness=BIG_ENDIAN, ComSignalInitValue=0, ComSignalType=UINT16, ComTimeout=0, ComHandleId=67, ComSystemTemplateSystemSignalRef=SteWhlRelCalib_An_Sns
        DeliveryIdle_f2797042: ComBitPosition=64, ComBitSize=16, ComSignalEndianness=LITTLE_ENDIAN, ComSignalInitValue=0, ComSignalType=UINT16, ComHandleId=17, ComSystemTemplateSystemSignalRef=DeliveryIdle
        BattULo_U_Actl_0a3b9a6b: ComBitPosition=39, ComBitSize=8, ComSignalEndianness=BIG_ENDIAN, ComSignalInitValue=255, ComSignalType=UINT8, ComTimeout=0, ComHandleId=5, ComSystemTemplateSystemSignalRef=BattULo_U_Actl
        LatCtl_D_Rq_5abef978: ComBitPosition=36, ComBitSize=3, ComSignalEndianness=BIG_ENDIAN, ComSignalInitValue=0, ComSignalType=UINT8, ComTimeout=0, ComHandleId=50, ComSystemTemplateSystemSignalRef=LatCtl_D_Rq
      ABS_BrkBst_Data_FD1_oFD1_CAN_3abd61be (ComIPdu):
        ComIPduDirection = RECEIVE
        ComIPduType = NORMAL
        ComIPduHandleId = 0
        ComIPduSignalProcessing = DEFERRED
        ComIPduCancellationSupport = false
        ComIPduCallout = ComIPduCallout_ABS_BrkBst_Data_FD1_Oper
        ComIPduGroupRef = PSCM_FD_oFD1_CAN_Rx_fcef2243
        ComIPduSignalRef = YawStabilityIndex_706a037f
        ComPduIdRef = PT_ABS_BrkBst_Data_FD1_PP_ABS_BrkBst_Data_FD1_Rx_3290b631_3cf8f7d5
      StePinOffst_No_Cnt_c3a8df7f (ComSignal):
        ComBitPosition = 21
        ComBitSize = 4
        ComSignalEndianness = BIG_ENDIAN
        ComSignalInitValue = 0
        ComSignalType = UINT8
        ComTimeout = 0
        ComSignalAccess = ACCESS_NEEDED_BY_SWC_OR_COM
        ComHandleId = 65
        ComSystemTemplateSystemSignalRef = StePinOffst_No_Cnt
      TrailerAid_Data_FD1_oFD1_CAN_3abd61be (ComIPdu):
        ComIPduDirection = RECEIVE
        ComIPduType = NORMAL
        ComIPduHandleId = 30
        ComIPduSignalProcessing = DEFERRED
        ComIPduCancellationSupport = false
        ComIPduGroupRef = PSCM_FD_oFD1_CAN_Rx_fcef2243
        ComIPduSignalRef = TrlrAnOffstDir_D_Mem_0edbb78e
        ComIPduSignalRef = TrlrAxleToBmpr_L_Actl_0edbb78e
        ComIPduSignalRef = TrlrIdType_D_Stat_0edbb78e
        ComIPduSignalRef = TrlrId_No_Actl_0edbb78e
        ComIPduSignalRef = TrlrRvrseCancl_B_Rq_0edbb78e
        ComPduIdRef = PT_TrailerAid_Data_FD1_PP_TrailerAid_Data_FD1_Rx_3290b631_3cf8f7d5
      StePinComp_An_Est_837112cd (ComSignal):
        ComBitPosition = 22
        ComBitSize = 15
        ComSignalEndianness = BIG_ENDIAN
        ComSignalInitValue = 16000
        ComSignalType = UINT16
        ComTransferProperty = PENDING
        ComSignalAccess = ACCESS_NEEDED_BY_SWC_OR_COM
        ComHandleId = 25
        ComSystemTemplateSystemSignalRef = StePinComp_An_Est
      BrakeSnData_6_FD1_oFD1_CAN_3abd61be (ComIPdu):
        ComIPduDirection = RECEIVE
        ComIPduType = NORMAL
        ComIPduHandleId = 9
        ComIPduSignalProcessing = DEFERRED
        ComIPduCancellationSupport = false
        ComIPduCallout = ComIPduCallout_BrakeSnData_6_FD1_Oper
        ComIPduGroupRef = PSCM_FD_oFD1_CAN_Rx_fcef2243
        ComIPduSignalRef = StePinOffst_An_Est_c3a8df7f
        ComIPduSignalRef = StePinOffst_D_Stat_c3a8df7f
        ComIPduSignalRef = StePinOffst_No_Cnt_c3a8df7f
        ComIPduSignalRef = StePinOffst_No_Cs_c3a8df7f
        ComPduIdRef = PT_BrakeSnData_6_FD1_PP_BrakeSnData_6_FD1_Rx_3290b631_3cf8f7d5
      6 x ComSignal, all with ComSignalEndianness=BIG_ENDIAN, ComTimeout=0, ComSignalAccess=ACCESS_NEEDED_BY_SWC_OR_COM:
        WhlRotatRl_No_Cnt_91fa0768: ComBitPosition=31, ComBitSize=8, ComSignalInitValue=0, ComSignalType=UINT8, ComHandleId=122, ComSystemTemplateSystemSignalRef=WhlRotatRl_No_Cnt
        ExtSteeringAngleReq2_ef286bfc: ComBitPosition=22, ComBitSize=15, ComSignalInitValue=0, ComSignalType=UINT16, ComHandleId=29, ComSystemTemplateSystemSignalRef=ExtSteeringAngleReq2
        TrlrAidCtl_U_RqDrv_372f28fe: ComBitPosition=31, ComBitSize=12, ComSignalInitValue=4094, ComSignalType=UINT16, ComHandleId=69, ComSystemTemplateSystemSignalRef=TrlrAidCtl_U_RqDrv
        WhlRotatRr_No_Cnt_91fa0768: ComBitPosition=23, ComBitSize=8, ComSignalInitValue=0, ComSignalType=UINT8, ComHandleId=123, ComSystemTemplateSystemSignalRef=WhlRotatRr_No_Cnt
        ApaSys_D_Stat_ef286bfc: ComBitPosition=61, ComBitSize=3, ComSignalInitValue=0, ComSignalType=UINT8, ComHandleId=1, ComSystemTemplateSystemSignalRef=ApaSys_D_Stat
        LdwActvStats_D_Req_d64ac390: ComBitPosition=4, ComBitSize=3, ComSignalInitValue=0, ComSignalType=UINT8, ComHandleId=52, ComSystemTemplateSystemSignalRef=LdwActvStats_D_Req
    ComGeneral:
      ComConfigurationUseDet = true
      ComEnableSignalGroupArrayApi = false
      ComRetryFailedTransmitRequests = false
      ComSupportedIPduGroups = 2
      ComVersionInfoApi = false
      ComAdvancedIPduCallouts = true
      ComOptimizedIPduGroupHandling = false
      ComMetaDataSupport = false
      ComReceiveSignalMacroAPI = false
      ComDeferredEventCacheSupport = false
      ComMainfunctionTimingDomainSupport = false
      ComDescriptionRoutingCodeGeneration = false
      ComUserCbkHeaderFile = Appl_Cbk.h
    ComGeneration:
      ComOutOfBoundsWriteProtectionStrategy = NONE
      ComOutOfBoundsWriteSanitizer = false
      ComOutOfBoundsReadSanitizer = false
      ComNumericalDataTypeMinimizationStrategy = WITH_CAST
      ComReduceConstantData2Define = false
      ComBoolDataInArrayOfStructStrategy = BOOLEAN
      ComDeduplicateIndirectedData = true
      ComDataDeduplicationStrategy = WITH_CAST
      ComReduceBoolDataByNegationThreshold = 2
      ComReduceBoolDataByNumericalComparisonThreshold = 2
      ComReduceBoolDataByNumericalRelationThreshold = 2
      ComReduceBoolDataByNumericalOperandStrategy = WITH_ANY_VALUE
      ComReduceNumericalDataByOffsetThreshold = 2
      ComReduceNumericalDataByArraySubtractionThreshold = 2
      ComReduceDataByStreaming = false
      ComShortSymbols = false
      ComInterfacesForDeactivatedData = false
      ComReferringKeysInComments = false
    ComOptimization:
      ComTxCyclicProcessingISRLockThreshold = 1
      ComTxDeadlineMonitoringISRLockThreshold = 1
      ComTxProcessingISRLockThreshold = 1
      ComRxDeadlineMonitoringISRLockThreshold = 1
      ComRxDeferredProcessingISRLockThreshold = 1
      ComGatewayProcessingISRLockThreshold = 1
      ComGatewayDescriptionProcessingISRLockThreshold = 1
      ComIPduGroupISRLockThreshold = 1
