AUTOSAR XML (schema 4-2-1)
package /ActiveEcuC
  module config EcuC: implementation-config-variant=VARIANT-POST-BUILD-SELECTABLE, module-description=EcuC_Impl
    EcucGeneral:
      CPUType = CPU32Bit
      SizeOfInt = Size32Bit
      ByteOrder = LITTLE_ENDIAN
      BitOrder = LSB_to_MSB
      AtomicBitAccessInBitfield = false
      AtomicVariableAccess = Atomic32BitAccess
      SizeOfEnum = Size32Bit
      SizeOfROMPointer = Size32Bit
      SizeOfRAMPointer = Size32Bit
      BitFieldDataType = INT
      StructAlignment = Auto
      ArrayAlignment = Auto
      StructInArrayAlignment = Auto
      DummyFunction = false
      EcuCSafeBswChecks = false
      DummyStatement = true
      DummyStatementKind = SelfAssignment
      ConditionalGenerating = true
      EcucBswImplementationCodeType = EcuCSourceCode
      EcuCUseStdReturnTypeForRte = false
      BswInitialization
        38 x InitFunction:
          BswM_InitMemory: Header=BswM.h, InitPhase=INIT_MEMORY, ModuleRef=BswM
          BswM_Init: Header=BswM.h, InitPhase=NO_INIT, ConfigType=BswM_ConfigType, ConfigPtrName=BswM_Config_ECU1_Ptr if post-build-variant-condition{matching-criterion=Communication, value=0}, ConfigPtrClass=BSWM_INIT_DATA, ConfigPtrName=BswM_Config_ECU2_Ptr if post-build-variant-condition{matching-criterion=Communication, value=1}, ModuleRef=BswM
          Dem_PreInit: Header=Dem.h, InitPhase=INIT_ZERO, ConfigType=Dem_ConfigType, ConfigPtrName=Dem_Config_Ptr, ConfigPtrClass=DEM_INIT_DATA, ModuleRef=Dem
          Dem_Init: Header=Dem.h, InitPhase=INIT_TWO_POST_NVMREADALL, ConfigType=Dem_ConfigType, ConfigPtrName=Dem_Config_Ptr, ConfigPtrClass=DEM_INIT_DATA, ModuleRef=Dem
          Dem_InitMemory: Header=Dem.h, InitPhase=INIT_MEMORY, ModuleRef=Dem
          Det_InitMemory: Header=Det.h, InitPhase=INIT_MEMORY, ModuleRef=Det
          Det_Init: Header=Det.h, InitPhase=INIT_ZERO, ModuleRef=Det
          EcuM_Init: Header=EcuM.h, InitPhase=NO_INIT, ConfigType=EcuM_PbConfigType, ConfigPtrName=EcuM_Config_ECU1_Ptr if post-build-variant-condition{matching-criterion=Communication, value=0}, ConfigPtrClass=ECUM_INIT_DATA, ConfigPtrName=EcuM_Config_ECU2_Ptr if post-build-variant-condition{matching-criterion=Communication, value=1}, ModuleRef=EcuM
          SchM_Init: Header=Rte_Main.h, InitPhase=NO_INIT, ConfigType=SchM_ConfigType, ConfigPtrName=&Rte_Config_ECU1 if post-build-variant-condition{matching-criterion=Communication, value=0}, ConfigPtrClass=RTE_CONST, ConfigPtrName=&Rte_Config_ECU2 if post-build-variant-condition{matching-criterion=Communication, value=1}, ModuleRef=Rte
          Rte_InitMemory: Header=Rte_Main.h, InitPhase=INIT_MEMORY, ModuleRef=Rte
          NvM_Init: Header=NvM.h, InitPhase=INIT_TWO_SYS, ModuleRef=NvM
          Fee_30_SmallSector_Init: Header=Fee_30_SmallSector.h, InitPhase=INIT_TWO_IF, ModuleRef=Fee
          Mcu_Init: Header=Mcu.h, InitPhase=INIT_ONE, ModuleRef=Mcu
          CanIf_Init: Header=CanIf.h, InitPhase=INIT_TWO_IF, ConfigType=CanIf_ConfigType, ConfigPtrName=CanIf_Config_ECU1_Ptr if post-build-variant-condition{matching-criterion=Communication, value=0}, ConfigPtrClass=CANIF_INIT_DATA, ConfigPtrName=CanIf_Config_ECU2_Ptr if post-build-variant-condition{matching-criterion=Communication, value=1}, ModuleRef=CanIf
          CanIf_InitMemory: Header=CanIf.h, InitPhase=INIT_MEMORY, ModuleRef=CanIf
          Can_Init: Header=Can.h, InitPhase=INIT_TWO_DRV, ConfigType=Can_ConfigType, ConfigPtrName=Can_Config_ECU1_Ptr if post-build-variant-condition{matching-criterion=Communication, value=0}, ConfigPtrClass=CAN_INIT_DATA, ConfigPtrName=Can_Config_ECU2_Ptr if post-build-variant-condition{matching-criterion=Communication, value=1}, ModuleRef=Can
          Can_InitMemory: Header=Can.h, InitPhase=INIT_MEMORY, ModuleRef=Can
          CanSM_Init: Header=CanSM_EcuM.h, InitPhase=INIT_TWO_SM, ConfigType=CanSM_ConfigType, ConfigPtrName=CanSM_Config_Ptr, ConfigPtrClass=CANSM_INIT_DATA, ModuleRef=CanSM
          CanSM_InitMemory: Header=CanSM_EcuM.h, InitPhase=INIT_MEMORY, ModuleRef=CanSM
          ComM_InitMemory: Header=ComM.h, InitPhase=INIT_MEMORY, ModuleRef=ComM
          ComM_Init: Header=ComM.h, InitPhase=INIT_TWO_POST_NVMREADALL, ModuleRef=ComM
          Com_InitMemory: Header=Com.h, InitPhase=INIT_MEMORY, ModuleRef=Com
          Com_Init: Header=Com.h, InitPhase=INIT_TWO_COM, ConfigType=Com_ConfigType, ConfigPtrName=Com_Config_Ptr, ConfigPtrClass=COM_INIT_DATA, ModuleRef=Com
          PduR_Init: Header=PduR.h, InitPhase=INIT_TWO_COM, ConfigType=PduR_PBConfigType, ConfigPtrName=PduR_Config_Ptr, ConfigPtrClass=PDUR_INIT_DATA, ModuleRef=PduR
          PduR_InitMemory: Header=PduR.h, InitPhase=INIT_MEMORY, ModuleRef=PduR
          CanTp_Init: Header=CanTp.h, InitPhase=INIT_TWO_TP, ConfigType=CanTp_ConfigType, ConfigPtrName=CanTp_Config_Ptr, ConfigPtrClass=CANTP_INIT_DATA, ModuleRef=CanTp
          CanTp_InitMemory: Header=CanTp.h, InitPhase=INIT_MEMORY, ModuleRef=CanTp
          Dcm_InitMemory: Header=Dcm.h, InitPhase=INIT_MEMORY, ModuleRef=Dcm
          Dcm_Init: Header=Dcm.h, InitPhase=INIT_TWO_POST_NVMREADALL, ConfigType=Dcm_ConfigType, ConfigPtrName=NULL_PTR, ConfigPtrClass=DCM_CONST, ModuleRef=Dcm
          Xcp_InitMemory: Header=Xcp.h, InitPhase=INIT_MEMORY, ModuleRef=Xcp
          Xcp_Init: Header=Xcp.h, InitPhase=INIT_TWO_TP, ModuleRef=Xcp
          CanXcp_InitMemory: Header=CanXcp.h, InitPhase=INIT_MEMORY, ModuleRef=Xcp
          CanXcp_Init: Header=CanXcp.h, InitPhase=INIT_TWO_TP, ConfigType=CanXcp_ConfigType, ConfigPtrName=&CanXcp_Config_ECU1 if post-build-variant-condition{matching-criterion=Communication, value=0}, ConfigPtrClass=CANXCP_PBCFG, ConfigPtrName=&CanXcp_Config_ECU2 if post-build-variant-condition{matching-criterion=Communication, value=1}, ModuleRef=Xcp
          IoHwAb_Init: Header=IoHwAb.h, InitPhase=INIT_TWO_POST_NVMREADALL, ModuleRef=IoHwAb
          CanNm_InitMemory: Header=CanNm.h, InitPhase=INIT_MEMORY, ModuleRef=CanNm
          CanNm_Init: Header=CanNm.h, InitPhase=INIT_TWO_NM, ConfigType=CanNm_ConfigType, ConfigPtrName=CanNm_Config_Ptr, ConfigPtrClass=CANNM_INIT_DATA, ModuleRef=CanNm
          Nm_InitMemory: Header=Nm.h, InitPhase=INIT_MEMORY, ModuleRef=Nm
          Nm_Init: Header=Nm.h, InitPhase=INIT_TWO_NM, ModuleRef=Nm
    EcucHardware
      Core0 (EcucCoreDefinition): EcucCoreId=0
    EcucPduCollection: PduIdTypeEnum=UINT8, PduLengthTypeEnum=UINT16
      64 x Pdu, all with J1939Requestable=false:
        EcuC_XcpPdu_Rx: PduLength=8
        EcuC_XcpPdu_Tx: PduLength=8
        PT_Body_Info_4_FD1_PP_Body_Info_4_FD1_Rx_3290b631_3cf8f7d5: PduLength=8, SysTPduToFrameMappingRef=Body_Info_4_FD1  # Body_Info_4_FD1_oFD1_CAN
        PT_WheelData_FD1_PP_WheelData_FD1_Rx_3290b631_3cf8f7d5: PduLength=8, SysTPduToFrameMappingRef=WheelData_FD1  # WheelData_FD1_oFD1_CAN
        PT_TrailerAid_Stat2_FD1_PP_TrailerAid_Stat2_FD1_Rx_3290b631_3cf8f7d5: PduLength=8, SysTPduToFrameMappingRef=TrailerAid_Stat2_FD1  # TrailerAid_Stat2_FD1_oFD1_CAN
        PT_TrailerInfo_2_FD1_PP_TrailerInfo_2_FD1_Rx_3290b631_3cf8f7d5: PduLength=8, SysTPduToFrameMappingRef=TrailerInfo_2_FD1  # TrailerInfo_2_FD1_oFD1_CAN
        PT_Cluster_Info1_FD1_PP_Cluster_Info1_FD1_Rx_3290b631_3cf8f7d5: PduLength=8, SysTPduToFrameMappingRef=Cluster_Info1_FD1  # Cluster_Info1_FD1_oFD1_CAN
        PT_TesterFunctionalReq_FD1_PP_TesterFunctionalReq_FD1_Rx_3290b631_3cf8f7d5: PduLength=62  # TesterFunctionalReq_FD1_oFD1_CAN
        PT_BrakeSnData_3_FD1_PP_BrakeSnData_3_FD1_Rx_3290b631_3cf8f7d5: PduLength=8, SysTPduToFrameMappingRef=BrakeSnData_3_FD1  # BrakeSnData_3_FD1_oFD1_CAN
        PT_TesterPhysicalReqPSCM_FD1_Tp_20_PP_TesterPhysicalReqPSCM_FD1_Tp_Rx_20_3290b631_3cf8f7d5: PduLength=8, SysTPduToFrameMappingRef=TesterPhysicalReqPSCM_FD1_Tp  # TesterPhysicalReqPSCM_FD1_Tp_oFD1_CAN_20
        PT_Climate_Control_Data_FD1_PP_Climate_Control_Data_FD1_Rx_3290b631_3cf8f7d5: PduLength=8, SysTPduToFrameMappingRef=Climate_Control_Data_FD1  # Climate_Control_Data_FD1_oFD1_CAN
        PT_BrakeSysFeatures_3_PP_BrakeSysFeatures_3_Rx_3290b631_3cf8f7d5: PduLength=8, SysTPduToFrameMappingRef=BrakeSysFeatures_3  # BrakeSysFeatures_3_oFD1_CAN
        PT_Lane_Assist_Data3_FD1_PP_Lane_Assist_Data3_FD1_Tx_3290b631_3cf8f7d5: PduLength=8, SysTPduToFrameMappingRef=Lane_Assist_Data3_FD1  # Lane_Assist_Data3_FD1_oFD1_CAN
        PT_BrakeSnData_4_FD1_PP_BrakeSnData_4_FD1_Rx_3290b631_3cf8f7d5: PduLength=8, SysTPduToFrameMappingRef=BrakeSnData_4_FD1  # BrakeSnData_4_FD1_oFD1_CAN
        PT_Steering_Data_FD1_PP_Steering_Data_FD1_Rx_3290b631_3cf8f7d5: PduLength=8, SysTPduToFrameMappingRef=Steering_Data_FD1  # Steering_Data_FD1_oFD1_CAN
        PT_TrailerBrakeInfo_FD1_PP_TrailerBrakeInfo_FD1_Rx_3290b631_3cf8f7d5: PduLength=8, SysTPduToFrameMappingRef=TrailerBrakeInfo_FD1  # TrailerBrakeInfo_FD1_oFD1_CAN
        PT_Lane_Assist_Data1_FD1_PP_Lane_Assist_Data1_FD1_Rx_3290b631_3cf8f7d5: PduLength=8, SysTPduToFrameMappingRef=Lane_Assist_Data1_FD1  # Lane_Assist_Data1_FD1_oFD1_CAN
        PT_Yaw_Data_FD1_PP_Yaw_Data_FD1_Rx_3290b631_3cf8f7d5: PduLength=8, SysTPduToFrameMappingRef=Yaw_Data_FD1  # Yaw_Data_FD1_oFD1_CAN
        PT_ActiveFrontStrg_Stat2_FD1_PP_ActiveFrontStrg_Stat2_FD1_Rx_3290b631_3cf8f7d5: PduLength=8, SysTPduToFrameMappingRef=ActiveFrontStrg_Stat2_FD1  # ActiveFrontStrg_Stat2_FD1_oFD1_CAN
        PT_WheelSpeed_FD1_PP_WheelSpeed_FD1_Rx_3290b631_3cf8f7d5: PduLength=8, SysTPduToFrameMappingRef=WheelSpeed_FD1  # WheelSpeed_FD1_oFD1_CAN
        PT_TesterPhysicalResPSCM_FD1_20_PP_TesterPhysicalResPSCM_FD1_Tx_20_3290b631_3cf8f7d5: PduLength=8  # TesterPhysicalResPSCM_FD1_oFD1_CAN_20
        PT_EngVehicleSpThrottle2_FD1_PP_EngVehicleSpThrottle2_FD1_Rx_3290b631_3cf8f7d5: PduLength=8, SysTPduToFrameMappingRef=EngVehicleSpThrottle2_FD1  # EngVehicleSpThrottle2_FD1_oFD1_CAN
        PT_VehicleOperatingModes_FD1_PP_VehicleOperatingModes_FD1_Rx_3290b631_3cf8f7d5: PduLength=8, SysTPduToFrameMappingRef=VehicleOperatingModes_FD1  # VehicleOperatingModes_FD1_oFD1_CAN
        PT_TesterFunctionalReq_FD1_Tp_20_PP_TesterFunctionalReq_FD1_Tp_Rx_20_3290b631_3cf8f7d5: PduLength=8, SysTPduToFrameMappingRef=TesterFunctionalReq_FD1_Tp  # TesterFunctionalReq_FD1_Tp_oFD1_CAN_20
        PT_TesterPhysicalResPSCM_FD1_Tp_20_PP_TesterPhysicalResPSCM_FD1_Tp_Tx_20_3290b631_3cf8f7d5: PduLength=8, SysTPduToFrameMappingRef=TesterPhysicalResPSCM_FD1_Tp  # TesterPhysicalResPSCM_FD1_Tp_oFD1_CAN_20
        PT_TesterPhysicalResPSCM_FD1_Tp_PP_TesterPhysicalResPSCM_FD1_Tp_Tx_3290b631_3cf8f7d5: PduLength=64, SysTPduToFrameMappingRef=TesterPhysicalResPSCM_FD1_Tp  # TesterPhysicalResPSCM_FD1_Tp_oFD1_CAN
        PT_PowertrainData_10_FD1_PP_PowertrainData_10_FD1_Rx_3290b631_3cf8f7d5: PduLength=8, SysTPduToFrameMappingRef=PowertrainData_10_FD1  # PowertrainData_10_FD1_oFD1_CAN
        PT_TrailerAid_Data2_FD1_PP_TrailerAid_Data2_FD1_Tx_3290b631_3cf8f7d5: PduLength=8, SysTPduToFrameMappingRef=TrailerAid_Data2_FD1  # TrailerAid_Data2_FD1_oFD1_CAN
        PT_BrakeSnData_6_FD1_PP_BrakeSnData_6_FD1_Rx_3290b631_3cf8f7d5: PduLength=8, SysTPduToFrameMappingRef=BrakeSnData_6_FD1  # BrakeSnData_6_FD1_oFD1_CAN
        PT_EPAS_INFO_FD1_PP_EPAS_INFO_FD1_Tx_3290b631_3cf8f7d5: PduLength=8, SysTPduToFrameMappingRef=EPAS_INFO_FD1  # EPAS_INFO_FD1_oFD1_CAN
        PT_LateralMotionControl_FD1_PP_LateralMotionControl_FD1_Rx_3290b631_3cf8f7d5: PduLength=8, SysTPduToFrameMappingRef=LateralMotionControl_FD1  # LateralMotionControl_FD1_oFD1_CAN
        PSCM_AutoSar_NetwrkMgt_FD1_9b1e365c: PduLength=8, SysTPduToFrameMappingRef=PSCM_AutoSar_NetwrkMgt_FD1  # PSCM_AutoSar_NetwrkMgt_FD1_oFD1_CAN
        PT_Image_Processing_Data_FD1_PP_Image_Processing_Data_FD1_Rx_3290b631_3cf8f7d5: PduLength=8, SysTPduToFrameMappingRef=Image_Processing_Data_FD1  # Image_Processing_Data_FD1_oFD1_CAN
        PT_TrailerAid_Stat3_FD1_PP_TrailerAid_Stat3_FD1_Rx_3290b631_3cf8f7d5: PduLength=8, SysTPduToFrameMappingRef=TrailerAid_Stat3_FD1  # TrailerAid_Stat3_FD1_oFD1_CAN
        PT_TrailerInfo_FD1_PP_TrailerInfo_FD1_Rx_3290b631_3cf8f7d5: PduLength=8, SysTPduToFrameMappingRef=TrailerInfo_FD1  # TrailerInfo_FD1_oFD1_CAN
        PT_Steer_Assist_Data_FD1_PP_Steer_Assist_Data_FD1_Rx_3290b631_3cf8f7d5: PduLength=8, SysTPduToFrameMappingRef=Steer_Assist_Data_FD1  # Steer_Assist_Data_FD1_oFD1_CAN
        PT_TesterPhysicalReqPSCM_FD1_20_PP_TesterPhysicalReqPSCM_FD1_Rx_20_3290b631_3cf8f7d5: PduLength=8  # TesterPhysicalReqPSCM_FD1_oFD1_CAN_20
        PT_EngBrakeData_FD1_PP_EngBrakeData_FD1_Rx_3290b631_3cf8f7d5: PduLength=8, SysTPduToFrameMappingRef=EngBrakeData_FD1  # EngBrakeData_FD1_oFD1_CAN
        PT_APIM_Send_Signals1_FD1_PP_APIM_Send_Signals1_FD1_Rx_3290b631_3cf8f7d5: PduLength=8, SysTPduToFrameMappingRef=APIM_Send_Signals1_FD1  # APIM_Send_Signals1_FD1_oFD1_CAN
        PT_APIM_Send_Signals_2_FD1_PP_APIM_Send_Signals_2_FD1_Rx_3290b631_3cf8f7d5: PduLength=8, SysTPduToFrameMappingRef=APIM_Send_Signals_2_FD1  # APIM_Send_Signals_2_FD1_oFD1_CAN
        PT_DesiredTorqBrk_FD1_PP_DesiredTorqBrk_FD1_Rx_3290b631_3cf8f7d5: PduLength=8, SysTPduToFrameMappingRef=DesiredTorqBrk_FD1  # DesiredTorqBrk_FD1_oFD1_CAN
        PT_TesterFunctionalReq_FD1_20_PP_TesterFunctionalReq_FD1_Rx_20_3290b631_3cf8f7d5: PduLength=7  # TesterFunctionalReq_FD1_oFD1_CAN_20
        PT_BodyInfo_3_FD1_PP_BodyInfo_3_FD1_Rx_3290b631_3cf8f7d5: PduLength=8, SysTPduToFrameMappingRef=BodyInfo_3_FD1  # BodyInfo_3_FD1_oFD1_CAN
        PT_TesterPhysicalReqPSCM_FD1_Tp_PP_TesterPhysicalReqPSCM_FD1_Tp_Rx_3290b631_3cf8f7d5: PduLength=64, SysTPduToFrameMappingRef=TesterPhysicalReqPSCM_FD1_Tp  # TesterPhysicalReqPSCM_FD1_Tp_oFD1_CAN
        PT_TransGearData_FD1_PP_TransGearData_FD1_Rx_3290b631_3cf8f7d5: PduLength=8, SysTPduToFrameMappingRef=TransGearData_FD1  # TransGearData_FD1_oFD1_CAN
        PT_TesterPhysicalResPSCM_FD1_PP_TesterPhysicalResPSCM_FD1_Tx_3290b631_3cf8f7d5: PduLength=64  # TesterPhysicalResPSCM_FD1_oFD1_CAN
        PT_FileVersion_PP_FileVersion_Rx_3290b631_3cf8f7d5: PduLength=4  # FileVersion_oFD1_CAN
        PT_BrakeSnData_5_FD1_PP_BrakeSnData_5_FD1_Rx_3290b631_3cf8f7d5: PduLength=8, SysTPduToFrameMappingRef=BrakeSnData_5_FD1  # BrakeSnData_5_FD1_oFD1_CAN
        PT_ABS_BrkBst_Data_FD1_PP_ABS_BrkBst_Data_FD1_Rx_3290b631_3cf8f7d5: PduLength=8, SysTPduToFrameMappingRef=ABS_BrkBst_Data_FD1  # ABS_BrkBst_Data_FD1_oFD1_CAN
        PT_TesterPhysicalReqPSCM_FD1_PP_TesterPhysicalReqPSCM_FD1_Rx_3290b631_3cf8f7d5: PduLength=64  # TesterPhysicalReqPSCM_FD1_oFD1_CAN
        PT_TrailerAid_Data3_FD1_PP_TrailerAid_Data3_FD1_Rx_3290b631_3cf8f7d5: PduLength=8, SysTPduToFrameMappingRef=TrailerAid_Data3_FD1  # TrailerAid_Data3_FD1_oFD1_CAN
        PT_TrailerAid_Data_FD1_PP_TrailerAid_Data_FD1_Rx_3290b631_3cf8f7d5: PduLength=8, SysTPduToFrameMappingRef=TrailerAid_Data_FD1  # TrailerAid_Data_FD1_oFD1_CAN
        PT_BrakeSysFeatures_FD1_PP_BrakeSysFeatures_FD1_Rx_3290b631_3cf8f7d5: PduLength=8, SysTPduToFrameMappingRef=BrakeSysFeatures_FD1  # BrakeSysFeatures_FD1_oFD1_CAN
        PT_Mc_Send_Signals_2_FD1_PP_Mc_Send_Signals_2_FD1_Rx_3290b631_3cf8f7d5: PduLength=8, SysTPduToFrameMappingRef=Mc_Send_Signals_2_FD1  # Mc_Send_Signals_2_FD1_oFD1_CAN
        PT_TrailerAid_Stat1_FD1_PP_TrailerAid_Stat1_FD1_Rx_3290b631_3cf8f7d5: PduLength=8, SysTPduToFrameMappingRef=TrailerAid_Stat1_FD1  # TrailerAid_Stat1_FD1_oFD1_CAN
        PT_EngVehicleSpThrottle_FD1_PP_EngVehicleSpThrottle_FD1_Rx_3290b631_3cf8f7d5: PduLength=8, SysTPduToFrameMappingRef=EngVehicleSpThrottle_FD1  # EngVehicleSpThrottle_FD1_oFD1_CAN
        PT_GGCC_Config_Mgmt_ID_1_FD1_PP_GGCC_Config_Mgmt_ID_1_FD1_Rx_3290b631_3cf8f7d5: PduLength=8, SysTPduToFrameMappingRef=GGCC_Config_Mgmt_ID_1_FD1  # GGCC_Config_Mgmt_ID_1_FD1_oFD1_CAN
        PT_ParkAid_Data_FD1_PP_ParkAid_Data_FD1_Rx_3290b631_3cf8f7d5: PduLength=8, SysTPduToFrameMappingRef=ParkAid_Data_FD1  # ParkAid_Data_FD1_oFD1_CAN
        PT_SteeringPinion_Data_FD1_PP_SteeringPinion_Data_FD1_Tx_3290b631_3cf8f7d5: PduLength=8, SysTPduToFrameMappingRef=SteeringPinion_Data_FD1  # SteeringPinion_Data_FD1_oFD1_CAN
        PT_DeliveryVersion_PP_DeliveryVersion_Rx_3290b631_3cf8f7d5: PduLength=10  # DeliveryVersion_oFD1_CAN
        PT_TesterFunctionalReq_FD1_Tp_PP_TesterFunctionalReq_FD1_Tp_Rx_3290b631_3cf8f7d5: PduLength=64, SysTPduToFrameMappingRef=TesterFunctionalReq_FD1_Tp  # TesterFunctionalReq_FD1_Tp_oFD1_CAN
        Pdu_NmRx_Dummy: PduLength=8
        PT_Xcp_DTO_Msg_PP_Xcp_DTO_Msg_Tx_3290b631_3cf8f7d5: PduLength=8, SysTPduToFrameMappingRef=Xcp_DTO_Msg  # Xcp_DTO_Msg_oFD1_CAN
        PT_Xcp_CRO_Msg_PP_Xcp_CRO_Msg_Rx_3290b631_3cf8f7d5: PduLength=8, SysTPduToFrameMappingRef=Xcp_CRO_Msg  # Xcp_CRO_Msg_oFD1_CAN
