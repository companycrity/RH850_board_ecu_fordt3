AUTOSAR XML (schema 4-2-1)
package /ActiveEcuC
  module config Can: implementation-config-variant=VARIANT-POST-BUILD-SELECTABLE, module-description=Can_Impl
    CanConfigSet
      CT_FD1_CAN_b4e1ca3b (CanController):
        CanControllerActivation = true
        CanBusoffProcessing = INTERRUPT
        CanControllerBaseAddress = 4293853184
        CanControllerId = 0
        CanRxProcessing = INTERRUPT
        CanTxProcessing = INTERRUPT
        CanWakeupProcessing = INTERRUPT
        CanWakeupSupport = false
        CanWakeupSourceId = 0
        CanBasisAddressEnum = M_CAN0
        CanTxBufferElementSize = ES_64
        CanTxEfBufferElementSize = ES_8
        CanRxBufferElementSize = ES_64
        CanRxFifo0ElementSize = ES_64
        CanRxFifo1ElementSize = ES_8
        CanMaxNrOfRxFifo0Elements = 64
        CanMaxNrOfRxFifo1Elements = 64
        CanMaxNrOfRxBuffers = 64
        CanMaxNrOfTxBuffers = 32
        CanMaxNrOfTxEventFifoBuffers = 0
        CanIsTTCAN = false
        CanControllerDefaultBaudrate = CanControllerBaudrateConfig
        CanWakeupSourceRef = FD1_CAN_f26020e5
        CanCpuClockRef = McuClockReferencePoint_CAN
        CanControllerBaudrateConfig:
          CanControllerBaudRate = 500
          CanControllerBaudRateConfigID = 0
          CanControllerPropSeg = 16
          CanControllerSeg1 = 15
          CanControllerSeg2 = 8
          CanControllerSyncJumpWidth = 8
          CanBaudrateClock = 80000
          CanBaudratePrescaler = 4
          CanControllerFdBaudrateConfig:
            CanControllerFdBaudRate = 2000
            CanControllerPropSeg = 4
            CanControllerSeg1 = 3
            CanControllerSeg2 = 2
            CanControllerSyncJumpWidth = 2
            CanControllerTxBitRateSwitch = true
            CanBaudratePrescaler = 4
            CanControllerTrcvDelayCompensationOffset = 0
        CanFilterMask: CanFilterMaskValue=1536, CanFilterCodeValue=1536, IsLocked=false
      43 x CanHardwareObject, all with CanIdType=STANDARD, CanHwProcessing=false, CanFdPaddingValue=0, CanControllerRef=CT_FD1_CAN_b4e1ca3b:
        CN_FD1_CAN_b4e1ca3b_Rx_Std: CanHandleType=BASIC, CanIdValue=1536, CanObjectType=RECEIVE, CanObjectId=42, CanObjectHwSize=6, CanObjectHwHandle=96, CanMaxDataLen=64, CanFilterMaskRef=CanFilterMask
        CN_FD1_CAN_b4e1ca3b_Tx_Std: CanHandleType=BASIC, CanIdValue=0, CanObjectType=TRANSMIT, CanObjectId=0, CanObjectHwSize=1, CanObjectHwHandle=0, CanMaxDataLen=64
        CanHardwareObject_ABS_BrkBst_Data_FD1_oFD1_CAN_Rx_3abd61be: CanHandleType=FULL, CanIdValue=1200, CanObjectId=2, CanObjectType=RECEIVE, CanObjectHwSize=1, CanObjectHwHandle=33, CanMaxDataLen=8, CanCommonCANNode=A
        CanHardwareObject_Yaw_Data_FD1_oFD1_CAN_Rx_3abd61be: CanHandleType=FULL, CanIdValue=145, CanObjectId=36, CanObjectType=RECEIVE, CanObjectHwSize=1, CanObjectHwHandle=67, CanMaxDataLen=8, CanCommonCANNode=A
        CanHardwareObject_ActiveFrontStrg_Stat2_FD1_oFD1_CAN_Rx_3abd61be: CanHandleType=FULL, CanIdValue=138, CanObjectId=37, CanObjectType=RECEIVE, CanObjectHwSize=1, CanObjectHwHandle=68, CanMaxDataLen=8, CanCommonCANNode=A
        CanHardwareObject_APIM_Send_Signals1_FD1_oFD1_CAN_Rx_3abd61be: CanHandleType=FULL, CanIdValue=1009, CanObjectId=18, CanObjectType=RECEIVE, CanObjectHwSize=1, CanObjectHwHandle=49, CanMaxDataLen=8, CanCommonCANNode=A
        CanHardwareObject_APIM_Send_Signals_2_FD1_oFD1_CAN_Rx_3abd61be: CanHandleType=FULL, CanIdValue=533, CanObjectId=29, CanObjectType=RECEIVE, CanObjectHwSize=1, CanObjectHwHandle=60, CanMaxDataLen=8, CanCommonCANNode=A
        CanHardwareObject_Body_Info_4_FD1_oFD1_CAN_Rx_3abd61be: CanHandleType=FULL, CanIdValue=578, CanObjectId=25, CanObjectType=RECEIVE, CanObjectHwSize=1, CanObjectHwHandle=56, CanMaxDataLen=8, CanCommonCANNode=A
        CanHardwareObject_BodyInfo_3_FD1_oFD1_CAN_Rx_3abd61be: CanHandleType=FULL, CanIdValue=947, CanObjectId=22, CanObjectType=RECEIVE, CanObjectHwSize=1, CanObjectHwHandle=53, CanMaxDataLen=8, CanCommonCANNode=A
        CanHardwareObject_BrakeSnData_3_FD1_oFD1_CAN_Rx_3abd61be: CanHandleType=FULL, CanIdValue=119, CanObjectId=40, CanObjectType=RECEIVE, CanObjectHwSize=1, CanObjectHwHandle=71, CanMaxDataLen=8, CanCommonCANNode=A
        CanHardwareObject_BrakeSnData_4_FD1_oFD1_CAN_Rx_3abd61be: CanHandleType=FULL, CanIdValue=125, CanObjectId=39, CanObjectType=RECEIVE, CanObjectHwSize=1, CanObjectHwHandle=70, CanMaxDataLen=8, CanCommonCANNode=A
        CanHardwareObject_BrakeSnData_5_FD1_oFD1_CAN_Rx_3abd61be: CanHandleType=FULL, CanIdValue=118, CanObjectId=41, CanObjectType=RECEIVE, CanObjectHwSize=1, CanObjectHwHandle=72, CanMaxDataLen=8, CanCommonCANNode=A
        CanHardwareObject_BrakeSnData_6_FD1_oFD1_CAN_Rx_3abd61be: CanHandleType=FULL, CanIdValue=1044, CanObjectId=16, CanObjectType=RECEIVE, CanObjectHwSize=1, CanObjectHwHandle=47, CanMaxDataLen=8, CanCommonCANNode=A
        CanHardwareObject_BrakeSysFeatures_3_oFD1_CAN_Rx_3abd61be: CanHandleType=FULL, CanIdValue=1054, CanObjectId=13, CanObjectType=RECEIVE, CanObjectHwSize=1, CanObjectHwHandle=44, CanMaxDataLen=8, CanCommonCANNode=A
        CanHardwareObject_WheelSpeed_FD1_oFD1_CAN_Rx_3abd61be: CanHandleType=FULL, CanIdValue=535, CanObjectId=27, CanObjectType=RECEIVE, CanObjectHwSize=1, CanObjectHwHandle=58, CanMaxDataLen=8, CanCommonCANNode=A
        CanHardwareObject_TrailerInfo_FD1_oFD1_CAN_Rx_3abd61be: CanHandleType=FULL, CanIdValue=1091, CanObjectId=11, CanObjectType=RECEIVE, CanObjectHwSize=1, CanObjectHwHandle=42, CanMaxDataLen=8, CanCommonCANNode=A
        CanHardwareObject_TrailerBrakeInfo_FD1_oFD1_CAN_Rx_3abd61be: CanHandleType=FULL, CanIdValue=1093, CanObjectId=10, CanObjectType=RECEIVE, CanObjectHwSize=1, CanObjectHwHandle=41, CanMaxDataLen=8, CanCommonCANNode=A
        CanHardwareObject_BrakeSysFeatures_FD1_oFD1_CAN_Rx_3abd61be: CanHandleType=FULL, CanIdValue=1045, CanObjectId=15, CanObjectType=RECEIVE, CanObjectHwSize=1, CanObjectHwHandle=46, CanMaxDataLen=8, CanCommonCANNode=A
        CanHardwareObject_VehicleOperatingModes_FD1_oFD1_CAN_Rx_3abd61be: CanHandleType=FULL, CanIdValue=359, CanObjectId=34, CanObjectType=RECEIVE, CanObjectHwSize=1, CanObjectHwHandle=65, CanMaxDataLen=8, CanCommonCANNode=A
        CanHardwareObject_TrailerAid_Stat2_FD1_oFD1_CAN_Rx_3abd61be: CanHandleType=FULL, CanIdValue=1111, CanObjectId=7, CanObjectType=RECEIVE, CanObjectHwSize=1, CanObjectHwHandle=38, CanMaxDataLen=8, CanCommonCANNode=A
        CanHardwareObject_TrailerAid_Data_FD1_oFD1_CAN_Rx_3abd61be: CanHandleType=FULL, CanIdValue=1114, CanObjectId=5, CanObjectType=RECEIVE, CanObjectHwSize=1, CanObjectHwHandle=36, CanMaxDataLen=8, CanCommonCANNode=A
        CanHardwareObject_Mc_Send_Signals_2_FD1_oFD1_CAN_Rx_3abd61be: CanHandleType=FULL, CanIdValue=765, CanObjectId=24, CanObjectType=RECEIVE, CanObjectHwSize=1, CanObjectHwHandle=55, CanMaxDataLen=8, CanCommonCANNode=A
        CanHardwareObject_Lane_Assist_Data1_FD1_oFD1_CAN_Rx_3abd61be: CanHandleType=FULL, CanIdValue=970, CanObjectId=21, CanObjectType=RECEIVE, CanObjectHwSize=1, CanObjectHwHandle=52, CanMaxDataLen=8, CanCommonCANNode=A
        CanHardwareObject_Steering_Data_FD1_oFD1_CAN_Rx_3abd61be: CanHandleType=FULL, CanIdValue=131, CanObjectId=38, CanObjectType=RECEIVE, CanObjectHwSize=1, CanObjectHwHandle=69, CanMaxDataLen=8, CanCommonCANNode=A
        CanHardwareObject_PowertrainData_10_FD1_oFD1_CAN_Rx_3abd61be: CanHandleType=FULL, CanIdValue=374, CanObjectId=33, CanObjectType=RECEIVE, CanObjectHwSize=1, CanObjectHwHandle=64, CanMaxDataLen=8, CanCommonCANNode=A
        CanHardwareObject_DesiredTorqBrk_FD1_oFD1_CAN_Rx_3abd61be: CanHandleType=FULL, CanIdValue=531, CanObjectId=30, CanObjectType=RECEIVE, CanObjectHwSize=1, CanObjectHwHandle=61, CanMaxDataLen=8, CanCommonCANNode=A
        CanHardwareObject_Climate_Control_Data_FD1_oFD1_CAN_Rx_3abd61be: CanHandleType=FULL, CanIdValue=1050, CanObjectId=14, CanObjectType=RECEIVE, CanObjectHwSize=1, CanObjectHwHandle=45, CanMaxDataLen=8, CanCommonCANNode=A
        CanHardwareObject_GGCC_Config_Mgmt_ID_1_FD1_oFD1_CAN_Rx_3abd61be: CanHandleType=FULL, CanIdValue=1034, CanObjectId=17, CanObjectType=RECEIVE, CanObjectHwSize=1, CanObjectHwHandle=48, CanMaxDataLen=8, CanCommonCANNode=A
        CanHardwareObject_EngVehicleSpThrottle2_FD1_oFD1_CAN_Rx_3abd61be: CanHandleType=FULL, CanIdValue=514, CanObjectId=32, CanObjectType=RECEIVE, CanObjectHwSize=1, CanObjectHwHandle=63, CanMaxDataLen=8, CanCommonCANNode=A
        CanHardwareObject_TrailerInfo_2_FD1_oFD1_CAN_Rx_3abd61be: CanHandleType=FULL, CanIdValue=1146, CanObjectId=3, CanObjectType=RECEIVE, CanObjectHwSize=1, CanObjectHwHandle=34, CanMaxDataLen=8, CanCommonCANNode=A
        CanHardwareObject_TrailerAid_Stat3_FD1_oFD1_CAN_Rx_3abd61be: CanHandleType=FULL, CanIdValue=1113, CanObjectId=6, CanObjectType=RECEIVE, CanObjectHwSize=1, CanObjectHwHandle=37, CanMaxDataLen=8, CanCommonCANNode=A
        CanHardwareObject_WheelData_FD1_oFD1_CAN_Rx_3abd61be: CanHandleType=FULL, CanIdValue=534, CanObjectId=28, CanObjectType=RECEIVE, CanObjectHwSize=1, CanObjectHwHandle=59, CanMaxDataLen=8, CanCommonCANNode=A
        CanHardwareObject_TransGearData_FD1_oFD1_CAN_Rx_3abd61be: CanHandleType=FULL, CanIdValue=560, CanObjectId=26, CanObjectType=RECEIVE, CanObjectHwSize=1, CanObjectHwHandle=57, CanMaxDataLen=8, CanCommonCANNode=A
        CanHardwareObject_TrailerAid_Stat1_FD1_oFD1_CAN_Rx_3abd61be: CanHandleType=FULL, CanIdValue=1106, CanObjectId=8, CanObjectType=RECEIVE, CanObjectHwSize=1, CanObjectHwHandle=39, CanMaxDataLen=8, CanCommonCANNode=A
        CanHardwareObject_TrailerAid_Data3_FD1_oFD1_CAN_Rx_3abd61be: CanHandleType=FULL, CanIdValue=1116, CanObjectId=4, CanObjectType=RECEIVE, CanObjectHwSize=1, CanObjectHwHandle=35, CanMaxDataLen=8, CanCommonCANNode=A
        CanHardwareObject_LateralMotionControl_FD1_oFD1_CAN_Rx_3abd61be: CanHandleType=FULL, CanIdValue=979, CanObjectId=20, CanObjectType=RECEIVE, CanObjectHwSize=1, CanObjectHwHandle=51, CanMaxDataLen=8, CanCommonCANNode=A
        CanHardwareObject_Image_Processing_Data_FD1_oFD1_CAN_Rx_3abd61be: CanHandleType=FULL, CanIdValue=1105, CanObjectId=9, CanObjectType=RECEIVE, CanObjectHwSize=1, CanObjectHwHandle=40, CanMaxDataLen=8, CanCommonCANNode=A
        CanHardwareObject_Steer_Assist_Data_FD1_oFD1_CAN_Rx_3abd61be: CanHandleType=FULL, CanIdValue=983, CanObjectId=19, CanObjectType=RECEIVE, CanObjectHwSize=1, CanObjectHwHandle=50, CanMaxDataLen=8, CanCommonCANNode=A
        CanHardwareObject_ParkAid_Data_FD1_oFD1_CAN_Rx_3abd61be: CanHandleType=FULL, CanIdValue=936, CanObjectId=23, CanObjectType=RECEIVE, CanObjectHwSize=1, CanObjectHwHandle=54, CanMaxDataLen=8, CanCommonCANNode=A
        CanHardwareObject_Cluster_Info1_FD1_oFD1_CAN_Rx_3abd61be: CanHandleType=FULL, CanIdValue=1072, CanObjectId=12, CanObjectType=RECEIVE, CanObjectHwSize=1, CanObjectHwHandle=43, CanMaxDataLen=8, CanCommonCANNode=A
        CanHardwareObject_CanIfRxPduCfg_Nm_Dummy: CanHandleType=FULL, CanIdValue=4660, CanObjectId=1, CanObjectType=RECEIVE, CanObjectHwSize=1, CanObjectHwHandle=32, CanMaxDataLen=8, CanCommonCANNode=A
        CanHardwareObject_EngVehicleSpThrottle_FD1_oFD1_CAN_Rx_3abd61be: CanHandleType=FULL, CanIdValue=516, CanObjectId=31, CanObjectType=RECEIVE, CanObjectHwSize=1, CanObjectHwHandle=62, CanMaxDataLen=8, CanCommonCANNode=A
        CanHardwareObject_EngBrakeData_FD1_oFD1_CAN_Rx_3abd61be: CanHandleType=FULL, CanIdValue=357, CanObjectId=35, CanObjectType=RECEIVE, CanObjectHwSize=1, CanObjectHwHandle=66, CanMaxDataLen=8, CanCommonCANNode=A
    CanGeneral:
      CanIndex = 0
      CanChangeBaudrateApi = false
      CanDevErrorDetection = true
      CanHardwareCancellation = false
      CanIdenticalIdCancellation = false
      CanMainFunctionBusoffPeriod = 0.01
      CanMainFunctionModePeriod = 0.01
      CanMainFunctionWakeupPeriod = 0.01
      CanMultiplexedTransmission = false
      CanSetBaudrateApi = false
      CanTimeoutDuration = 0.01
      CanVersionInfoApi = false
      CanGenericPrecopy = false
      CanHardwareLoopCheck = true
      CanSecureTempBuffer = false
      CanRxFullCANSupport = true
      CanTxFullCANSupport = false
      CanRxBasicCANSupport = true
      CanUseNestedCANInterrupts = true
      CanHardwareCancelByAppl = true
      CanIndividualProcessing = false
      CanGenericConfirmation = false
      CanRxQueue = false
      CanSupportMixedID = false
      CanRxQueueSize = 10
      CanMultipleBasicCANObjects = false
      CanMultipleBasicCANTxObjects = false
      CanHardwareHandleType = UINT8
      CanOptimizeOneController = false
      CanInterruptCategory = CATEGORY2
      CanGetStatus = false
      CanInterruptLock = DRIVER
      CanWakeupSupport = false
      CanRamCheck = None
      CanOverrunNotification = Application
      CanReinitStart = false
      CanGenericPreTransmit = false
      CanFdSupport = FULL
      CanRuntimeMeasurementSupport = false
      CanMaxRxDataLen = 64
      CanMaxTxDataLen = 64
      CanUsePeripheralAccessApi = false
      CanMirrorModeSupport = false
      CanUseOsInterruptControl = false
      CanMcanRevision = M_CAN_REV_315
      CanFdNISO = ISO_11898
      CanCounterRef = OsCounter
      CanMainFunctionRWPeriods: CanMainFunctionReadPeriod=0.01, CanMainFunctionWritePeriod=0.01
