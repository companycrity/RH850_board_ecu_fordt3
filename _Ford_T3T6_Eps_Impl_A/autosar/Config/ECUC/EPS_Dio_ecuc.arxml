AUTOSAR XML (schema 4-2-1)
package /ActiveEcuC
  module config Dio: implementation-config-variant=VARIANT-POST-BUILD, module-description=Dio_Impl
    DioGeneral:
      DioVersionCheckExternalModules = false
      DioDevErrorDetect = true
      DioMaskedWritePortApi = false
      DioFlipChannelApi = false
      DioVersionInfoApi = false
      DioCriticalSectionProtection = true
      DioDeviceName = R7F701373
      DioUseWriteVerifyErrorInterface = false
      DioWriteVerify = WV_DISABLE
    DioConfig
      7 x DioPort:
        Port0: DioPortId=0, DioPortName=PORTGROUP_0_BITS_0_TO_10_13_14
          5 x DioChannel:
            HwTrqA: DioChannelId=0, DioChannelBitPosition=13
            ResetOutZ: DioChannelId=1, DioChannelBitPosition=10
            HwTrqB: DioChannelId=2, DioChannelBitPosition=1
            EcuId2: DioChannelId=3, DioChannelBitPosition=3
            HwTrqD: DioChannelId=4, DioChannelBitPosition=7
        Port1: DioPortId=1, DioPortName=PORTGROUP_1_BITS_1_TO_7
          GateDrv0Rst (DioChannel): DioChannelId=0, DioChannelBitPosition=2
          TmplMonrWdg (DioChannel): DioChannelId=1, DioChannelBitPosition=4
        Port2: DioPortId=2, DioPortName=PORTGROUP_2_BITS_0_TO_15
          GateDrv0Diagc (DioChannel): DioChannelId=0, DioChannelBitPosition=13
        Port3: DioPortId=3, DioPortName=PORTGROUP_3_BITS_0_TO_14
          7 x DioChannel:
            HwTrqB_SPCO: DioChannelId=0, DioChannelBitPosition=9
            SysFlt2A: DioChannelId=1, DioChannelBitPosition=3
            HwPos1_SPCO: DioChannelId=2, DioChannelBitPosition=4
            PwrSplyCs: DioChannelId=3, DioChannelBitPosition=7
            HwTrqA_SPCO: DioChannelId=4, DioChannelBitPosition=1
            EcuId1: DioChannelId=5, DioChannelBitPosition=11
            PhaAUpprCmd: DioChannelId=6, DioChannelBitPosition=12
        Port4: DioPortId=4, DioPortName=PORTGROUP_4_BITS_0_TO_14
          9 x DioChannel:
            Mod0: DioChannelId=0, DioChannelBitPosition=2
            Mod1: DioChannelId=1, DioChannelBitPosition=3
            PwrSplyNotFlt: DioChannelId=2, DioChannelBitPosition=4
            FLMD1: DioChannelId=3, DioChannelBitPosition=5
            McuEna: DioChannelId=4, DioChannelBitPosition=6
            PhaBUpprCmd: DioChannelId=6, DioChannelBitPosition=1
            PhaALowrCmd: DioChannelId=7, DioChannelBitPosition=8
            HwPos1: DioChannelId=5, DioChannelBitPosition=13
            HwTrqC: DioChannelId=8, DioChannelBitPosition=12
        Port5: DioPortId=5, DioPortName=PORTGROUP_5_BITS_4_TO_15_0_1
          4 x DioChannel:
            PwrOutpEnaFb: DioChannelId=0, DioChannelBitPosition=11
            PhaCUpprCmd: DioChannelId=1, DioChannelBitPosition=8
            PhaCLowrCmd: DioChannelId=2, DioChannelBitPosition=9
            PhaBLowrCmd: DioChannelId=3, DioChannelBitPosition=15
        Port6: DioPortId=6, DioPortName=PORTGROUP_6_BITS_0_TO_6_10_11_12_13
          McuTod (DioChannel): DioChannelId=0, DioChannelBitPosition=3
    DioDemEventParameterRefs: DIO_E_REG_WRITE_VERIFY=DIO_E_REG_WRITE_VERIFY
