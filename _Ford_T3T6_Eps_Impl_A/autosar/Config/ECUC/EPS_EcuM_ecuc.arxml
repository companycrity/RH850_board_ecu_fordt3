AUTOSAR XML (schema 4-2-1)
package /ActiveEcuC
  module config EcuM: implementation-config-variant=VARIANT-POST-BUILD-SELECTABLE, module-description=EcuM_Impl
    EcuMFlexGeneral: EcuMAlarmClockPresent=false, EcuMResetLoopDetection=false, EcuMEnableDefBehaviour=false, EcuMModeHandling=false
    EcuMGeneral:
      EcuMDevErrorDetect = true
      EcuMIncludeDem = true
      EcuMIncludeDet = true
      EcuMMainFunctionPeriod = 0.01
      EcuMVersionInfoApi = true
      EcuMDeferredBswMNotification = false
      EcuMSlaveCoreHandling = false
      EcuMEnableFixBehavior = false
      EcuMGeneration: EcuMOutOfBoundsWriteSanitizer=false, EcuMOutOfBoundsReadSanitizer=false, EcuMInterfacesForDeactivatedData=false
    EcuMConfiguration
      EcuMCommonConfiguration: EcuMConfigConsistencyHash=2432377068135194428, EcuMDefaultAppMode=OSDEFAULTAPPMODE, EcuMOSResource=OsResource
        5 x EcuMWakeupSource, all with EcuMValidationTimeout=0, EcuMCheckWakeupTimeout=0, EcuMWakeupSourcePolling=false:
          ECUM_WKSOURCE_POWER: EcuMWakeupSourceId=0
          ECUM_WKSOURCE_RESET: EcuMWakeupSourceId=1
          ECUM_WKSOURCE_INTERNAL_RESET: EcuMWakeupSourceId=2
          ECUM_WKSOURCE_INTERNAL_WDG: EcuMWakeupSourceId=3
          ECUM_WKSOURCE_EXTERNAL_WDG: EcuMWakeupSourceId=4
        EcuMDefaultShutdownTarget: EcuMDefaultState=EcuMStateOff
        EcuMDriverInitListZero
          Det_Init_Nxtr (EcuMDriverInitItem): index=2, EcuMModuleID=Code, EcuMModuleHeader=Det.h, EcuMAdditionalInitCode={ #ifdef DET_ENABLED Det_InitMemory(); Det_Init(); #endif };
        EcuMDriverInitListOne
          14 x EcuMDriverInitItem, all with EcuMModuleID=Code:
            Dem_PreInit: index=7, EcuMModuleHeader=Dem.h, EcuMAdditionalInitCode=Dem_PreInit(NULL_PTR)
            CoreVltgMonrInit1: EcuMModuleHeader=CDD_CoreVltgMonr.h, EcuMAdditionalInitCode=// TODO add this back later CoreVltgMonrInit1()
            McuCoreCfgAndDiagcInit1: EcuMModuleHeader=CDD_McuCoreCfgAndDiagc.h, EcuMAdditionalInitCode=McuCoreCfgAndDiagcInit1()
            EcmOutpAndDiagcInit3: EcuMModuleHeader=CDD_EcmOutpAndDiagc.h, EcuMAdditionalInitCode=EcmOutpAndDiagcInit3()
            Mcu_Init: index=3, EcuMAdditionalInitCode=Mcu_Init(McuConf_McuModuleConfiguration_McuModuleConfiguration), EcuMModuleHeader=Mcu.h
            Mcu_InitClock: index=2, EcuMAdditionalInitCode=Mcu_InitClock(McuConf_McuClockSettingConfig_McuClockSettingConfig), EcuMModuleHeader=Mcu.h
            FordT3T6McuCfgInit1: EcuMAdditionalInitCode=FordT3T6McuCfgInit1(), EcuMModuleHeader=CDD_FordT3T6McuCfg.h
            MCAN_Patch: EcuMAdditionalInitCode=*(volatile uint32*)0xFFF81710 = 0; /* MCAN_Patch: MCAN clock supply patch. Set MSR-LM3 bit 0 = 0 (MCAN is operating) */, EcuMModuleHeader=
            EcmOutpAndDiagcInit1: EcuMModuleHeader=CDD_EcmOutpAndDiagc.h, EcuMAdditionalInitCode=EcmOutpAndDiagcInit1()
            ExcpnHndlgInit1: EcuMModuleHeader=CDD_ExcpnHndlg.h, EcuMAdditionalInitCode=ExcpnHndlgInit1()
            Spi_Init: index=4, EcuMAdditionalInitCode=Spi_Init(Spi_GstConfiguration), EcuMModuleHeader=Spi.h
            Port_Init: index=5, EcuMAdditionalInitCode=Port_Init(PortConfigSet), EcuMModuleHeader=Port.h
            Dio_Init: index=6, EcuMModuleHeader=Dio.h, EcuMAdditionalInitCode=Dio_Init(DioConf_DioConfig_DioConfig)
            Wdg_59_DriverA_Init: EcuMAdditionalInitCode=Wdg_59_DriverA_Init(Wdg_59_DriverA_WdgSettingsConfig), EcuMModuleHeader=Wdg_59_DriverA.h
        EcuMDriverRestartList
        FD1_CAN_f26020e5 (EcuMWakeupSource): EcuMWakeupSourceId=5, EcuMWakeupSourcePolling=false, EcuMComMChannelRef=FD1_CAN_f26020e5
      EcuMFlexConfiguration: EcuMFlexModuleConfigurationRef=CanConfigSet, EcuMNormalMcuModeRef=McuModeSettingConf
        3 x EcuMResetMode:
          ECUM_RESET_MCU: EcuMResetModeId=0
          ECUM_RESET_WDG: EcuMResetModeId=1
          ECUM_RESET_IO: EcuMResetModeId=2
        4 x EcuMShutdownCause:
          ECUM_CAUSE_UNKNOWN: EcuMShutdownCauseId=0
          ECUM_CAUSE_ECU_STATE: EcuMShutdownCauseId=1
          ECUM_CAUSE_WDGM: EcuMShutdownCauseId=2
          ECUM_CAUSE_DCM: EcuMShutdownCauseId=3
        ECUM_RESET_WAKEUP (EcuMResetMode): EcuMResetModeId=3
