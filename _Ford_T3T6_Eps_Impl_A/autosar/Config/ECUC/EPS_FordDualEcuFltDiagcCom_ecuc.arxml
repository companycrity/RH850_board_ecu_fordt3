AUTOSAR XML (schema 4-2-1)
package /ActiveEcuC
  module config FordDualEcuFltDiagcCom: implementation-config-variant=VARIANT-PRE-COMPILE
    53 x NTC_List:
      NTCNR_0X078: DTC_Index=1
      NTCNR_0X06E: DTC_Index=2
      NTCNR_0X076: DTC_Index=3
      NTCNR_0X06F: DTC_Index=4
      NTCNR_0X086: DTC_Index=5
      NTCNR_0X0F0: DTC_Index=7
      NTCNR_0X0F1: DTC_Index=8
      NTCNR_0X1C5: DTC_Index=38
      NTCNR_0X1C8: DTC_Index=41
      NTCNR_0X1C9: DTC_Index=42
      NTCNR_0X1CA: DTC_Index=43
      NTCNR_0X1CB: DTC_Index=44
      NTCNR_0X1CC: DTC_Index=45
      NTCNR_0X1CD: DTC_Index=46
      NTCNR_0X1CE: DTC_Index=47
      NTCNR_0X1CF: DTC_Index=48
      NTCNR_0X1D6: DTC_Index=49
      NTCNR_0X1D7: DTC_Index=50
      NTCNR_0X1D8: DTC_Index=51
      NTCNR_0X1D9: DTC_Index=52
      NTCNR_0X1DA: DTC_Index=53
      NTCNR_0X0F3: DTC_Index=10
      NTCNR_0X0F2: DTC_Index=9
      NTCNR_0X1C4: DTC_Index=37
      NTCNR_0X1C3: DTC_Index=36
      NTCNR_0X1C2: DTC_Index=35
      NTCNR_0X1C1: DTC_Index=34
      NTCNR_0X1C0: DTC_Index=33
      NTCNR_0X1BF: DTC_Index=32
      NTCNR_0X1BE: DTC_Index=31
      NTCNR_0X1BB: DTC_Index=28
      NTCNR_0X1C6: DTC_Index=39
      NTCNR_0X1C7: DTC_Index=40
      NTCNR_0X1BD: DTC_Index=30
      NTCNR_0X1BA: DTC_Index=27
      NTCNR_0X1B9: DTC_Index=26
      NTCNR_0X0FE: DTC_Index=25
      NTCNR_0X0FD: DTC_Index=24
      NTCNR_0X0FC: DTC_Index=23
      NTCNR_0X0FB: DTC_Index=22
      NTCNR_0X0FA: DTC_Index=21
      NTCNR_0X0F9: DTC_Index=20
      NTCNR_0X1BC: DTC_Index=29
      NTCNR_0X084: DTC_Index=6
      NTCNR_0X0F4: DTC_Index=11
      NTCNR_0X0BA: DTC_Index=12
      NTCNR_0X0BB: DTC_Index=13
      NTCNR_0X0BC: DTC_Index=14
      NTCNR_0X09B: DTC_Index=15
      NTCNR_0X0F5: DTC_Index=16
      NTCNR_0X0F6: DTC_Index=17
      NTCNR_0X0F7: DTC_Index=18
      NTCNR_0X0F8: DTC_Index=19
