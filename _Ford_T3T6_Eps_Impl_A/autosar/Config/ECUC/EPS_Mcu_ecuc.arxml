AUTOSAR XML (schema 4-2-1)
package /ActiveEcuC
  module config Mcu: implementation-config-variant=VARIANT-POST-BUILD, module-description=Mcu_Impl
    McuGeneralConfiguration:
      McuVersionCheckExternalModules = false
      McuDevErrorDetect = true
      McuGetRamStateApi = false
      McuInitClock = true
      McuNoPll = true
      McuPerformResetApi = true
      McuVersionInfoApi = false
      McuCriticalSectionProtection = true
      McuSwResetCallApi = false
      McuEcmDelayTimerOverflowValue = 65535
      McuEcmErrorOutputMode = NON_DYNAMIC_MODE
      McuClm0Operation = true
      McuClm0MonitoringClockAccuracy = 6
      McuClm0SamplingClockAccuracy = 10
      McuClm1Operation = true
      McuClm1MonitoringClockAccuracy = 6
      McuClm1SamplingClockAccuracy = 6
      McuClm2Operation = true
      McuClm2MonitoringClockAccuracy = 10
      McuClm2SamplingClockAccuracy = 6
      McuClm3Operation = true
      McuClm3MonitoringClockAccuracy = 6
      McuClm3SamplingClockAccuracy = 6
      McuLoopCount = 5
      McuEcmRstConfigure = SYSTEM_RESET
      McuDeviceName = R7F701373
      McuGTMConfigurationSupport = false
      McuClm4MonitoringClockAccuracy = 9
      McuClm4Operation = false
      McuClm4SamplingClockAccuracy = 9
      McuClma{0..4}SelfDiagnosticTest = false
      McuCvmSelfDiagnosticTest = false
      McuEcmSelfDiagnosticTest = false
      McuInterruptConsistencyCheck = false
      McuLockStepSelfDiagnosticTest = false
      McuRamSectorSetting = false
      McuUseWriteVerifyErrorInterface = false
      McuWriteVerify = WV_DISABLE
    McuPublishedInformation
      McuResetReasonConf: McuResetReason=0
      McuRstRsnConfPowOnRst: McuResetReason=0
      McuRstRsnConfTerminalRst: McuResetReason=1
      McuRstRsnConfCvmRst: McuResetReason=2
      McuRstRsnConfSwSysRst: McuResetReason=3
      McuRstRsnConfWdtRst: McuResetReason=4
      McuRstRsnConfLockStepCoreRst: McuResetReason=5
      McuRstRsnConfPbusFssRst: McuResetReason=6
      McuRstRsnConfBusBridgeErrorRst: McuResetReason=7
      McuRstRsnConfSafetyMechCompRst: McuResetReason=8
      McuRstRsnConfTempSensorRst: McuResetReason=9
      McuRstRsnConfClma0Rst: McuResetReason=10
      McuRstRsnConfClma2Rst: McuResetReason=11
      McuRstRsnConfClma3Rst: McuResetReason=12
      McuRstRsnConfClma1Rst: McuResetReason=14
      McuRstRsnConfLRamEccDedRst: McuResetReason=15
      McuRstRsnConfGRamEccDedRst: McuResetReason=16
      McuRstRsnConfCacheRamEdcRst: McuResetReason=17
      McuRstRsnConfCodeFlsEccDedRst: McuResetReason=18
      McuRstRsnConfDataFlsEccDedRst: McuResetReason=19
      McuRstRsnConfCsihRamEccDedRst: McuResetReason=20
      McuRstRsnConfCanRamEccDedRst: McuResetReason=21
      McuRstRsnConfEthRamDedRst: McuResetReason=22
      McuRstRsnConfFrRamEccDedRst: McuResetReason=23
      McuRstRsnConfGtmRamEccDedRst: McuResetReason=24
      McuRstRsnConfBusEccDedRst: McuResetReason=25
      McuRstRsnConfBusEccSedRst: McuResetReason=26
      McuRstRsnConfLRamAddrOvfRst: McuResetReason=27
      McuRstRsnConfGRamAddrOvfRst: McuResetReason=28
      McuRstRsnConfCodeFlsAddrOvfRst: McuResetReason=29
      McuRstRsnConfDataFlsAddrOvfRst: McuResetReason=30
      McuRstRsnConfPeriRamEccAddrOvfRst: McuResetReason=31
      McuRstRsnConfDtsRamEccDedRst: McuResetReason=32
      McuRstRsnConfDtsRamEccSedRst: McuResetReason=33
      McuRstRsnConfLRamEccSedRst: McuResetReason=34
      McuRstRsnConfGRamEccSedRst: McuResetReason=35
      McuRstRsnConfCodeFlsEccSedRst: McuResetReason=36
      McuRstRsnConfDataFlsEccSedRst: McuResetReason=37
      McuRstRsnConfCsihRamEccSedRst: McuResetReason=38
      McuRstRsnConfCanRamEccSedRst: McuResetReason=39
      McuRstRsnConfEthRamEccSedRst: McuResetReason=40
      McuRstRsnConfFrRamEccSedRst: McuResetReason=41
      McuRstRsnConfGtmRamEccSedRst: McuResetReason=42
      McuRstRsnConfPEGuardRst: McuResetReason=43
      McuRstRsnConfGramGuardRst: McuResetReason=44
      McuRstRsnConfMemcGuardRst: McuResetReason=45
      McuRstRsnConfSlaveGuardRst: McuResetReason=46
      McuRstRsnConfCodeFlsPEUnmapAccessRst: McuResetReason=47
      McuRstRsnConfGramPEUnmapAccessRst: McuResetReason=48
      McuRstRsnConfLpbPEUnmapAccessRst: McuResetReason=49
      McuRstRsnConfPBusUnmapAccessRst: McuResetReason=50
      McuRstRsnConfHBusUnmapAccessRst: McuResetReason=51
      McuRstRsnConfCodeFlsGvciUnmapAccessRst: McuResetReason=52
      McuRstRsnConfGramFlsGvciUnmapAccessRst: McuResetReason=53
      McuRstRsnConfResHbusUnmapAccessRst: McuResetReason=54
      McuRstRsnConfDmaTransferRst: McuResetReason=55
      McuRstRsnConfDmaUnmappedRst: McuResetReason=56
      McuRstRsnConfFlsSequenceRst: McuResetReason=57
      McuRstRsnConfFlsFaciRst: McuResetReason=58
      McuRstRsnConfAdcParityRst: McuResetReason=59
      McuRstRsnConfPEUnintenEnableDisableRst: McuResetReason=60
      McuRstRsnConfUnintenDeactUserRst: McuResetReason=61
      McuRstRsnConfUnintenActCfpModeRst: McuResetReason=62
      McuRstRsnConfUnintenDebugEnableDetectRst: McuResetReason=63
      McuRstRsnConfUnintenActTestModeRst: McuResetReason=64
      McuRstRsnConfEcmCompRst: McuResetReason=65
      McuRstRsnConfDebuggerRst: McuResetReason=66
      McuRstRsnConfSwApplRst: McuResetReason=67
      McuRstRsnConfBistRst: McuResetReason=68
      McuRstRsnConfRstUndefined: McuResetReason=69
      McuRstRsnConfRstUnknown: McuResetReason=70
      McuRstRsnConfClma4Rst: McuResetReason=13
    McuModuleConfiguration:
      McuClockSrcFailureNotification = DISABLED
      McuNumberOfMcuModes = 1
      McuRamSectors = 1
      McuCvmOutMaskFbist = true
      McuCvmOutMaskDiag = false
      McuCvmOutputFilter = true
      McuSwResetTrigger = SW_APPLICATION_RESET
      McuCvmDiagLockBit = true
      McuCvmResetEnable = true
      McuClockSettingConfig: McuClockSettingId=0, McuCpuMainSysClk=240000000, McuUnitName=CLK_CPUM, McuMainOsciFrequency=FREQ_16000000
        McuInternalOscillatorClk: McuPeripheralClock=16000000
        McuExternalClkOutSetting:
          McuExternalClk0SourceSel = MCU_BACKUP_CLOCK
          McuExternalClk0DividerSel = 1
          McuExternalClock0 = 8000000
          McuExternalClk1SourceSel = MCU_BACKUP_CLOCK
          McuExternalClk1DividerSel = 1
          McuExternalClock1 = 8000000
        McuPLLClkSetting: McuSystemSourceSel=MCU_PLL, McuPLLClk0DividerSel=1, McuPLLClock0=480000000, McuPLLClk1DividerSel=1, McuOPBT1Sel=3221211608
        McuSAWdtCounterClk: McuSAWdtCounterDivider=DIVBY_ID_8, McuUnitName=WDTCLKI, McuPeripheralClock=640000
        McuClockReferencePoint: McuClockReferencePointFrequency=0
        McuWdtaCounterClk: McuWdtCounterDivider=DIVBY_1_ID_1, McuUnitName=CLK_WDTA, McuPeripheralClock=8000000
        McuClockReferencePoint_CAN (McuClockReferencePoint): McuClockReferencePointFrequency=80000000
      McuGTMClockSettingsConfig: McuGTMCMUGCLKNumerator=1, McuGTMCMUGCLKDenominator=1
        McuGTMClockSettings: McuGTMClockSelection=CMU_CLK0, McuGTMChannelClkSrcDivider=1
      McuEcmErrorSourcesCfg
        McuEcmErrorSource0:
          McuEcmErrorMaskableInterrupt = false
          McuEcmErrorNonMaskableInterrupt = true
          McuEcmErrorInternalReset = false
          McuEcmErrorNMIDelayTimer = false
          McuEcmErrorMIDelayTimer = false
          McuEcmErrorOutputMask = false
          McuEcmInitialNotification = NULL_PTR
          McuNmiNotification = FeNmiWdgErr
          McuMiNotification = NULL_PTR
        McuEcmErrorSource1:
          McuEcmErrorMaskableInterrupt = false
          McuEcmErrorNonMaskableInterrupt = false
          McuEcmErrorInternalReset = true
          McuEcmErrorNMIDelayTimer = false
          McuEcmErrorMIDelayTimer = false
          McuEcmErrorOutputMask = false
          McuMiNotification = NULL_PTR
          McuNmiNotification = NULL_PTR
        McuEcmErrorSource2:
          McuEcmErrorMaskableInterrupt = false
          McuEcmErrorNonMaskableInterrupt = true
          McuEcmErrorInternalReset = false
          McuEcmErrorNMIDelayTimer = false
          McuEcmErrorMIDelayTimer = false
          McuEcmErrorOutputMask = false
          McuNmiNotification = FeNmiDmaLockStepErrOrGblRamWrBufErr
        McuEcmErrorSource3:
          McuEcmErrorMaskableInterrupt = false
          McuEcmErrorNonMaskableInterrupt = true
          McuEcmErrorInternalReset = false
          McuEcmErrorNMIDelayTimer = false
          McuEcmErrorMIDelayTimer = false
          McuEcmErrorOutputMask = false
          McuNmiNotification = FeNmiBusBrdgErr
        McuEcmErrorSource4:
          McuEcmErrorMaskableInterrupt = false
          McuEcmErrorNonMaskableInterrupt = true
          McuEcmErrorInternalReset = false
          McuEcmErrorNMIDelayTimer = false
          McuEcmErrorMIDelayTimer = false
          McuEcmErrorOutputMask = false
          McuNmiNotification = FeNmiProcrLockStepErr
        McuEcmErrorSource6:
          McuEcmErrorMaskableInterrupt = false
          McuEcmErrorNonMaskableInterrupt = false
          McuEcmErrorInternalReset = false
          McuEcmErrorNMIDelayTimer = false
          McuEcmErrorMIDelayTimer = false
          McuEcmErrorOutputMask = true
        McuEcmErrorSource8:
          McuEcmErrorMaskableInterrupt = false
          McuEcmErrorNonMaskableInterrupt = true
          McuEcmErrorInternalReset = false
          McuEcmErrorNMIDelayTimer = false
          McuEcmErrorMIDelayTimer = false
          McuEcmErrorOutputMask = false
          McuNmiNotification = FeNmiClkMonr0RtErr
        McuEcmErrorSource9:
          McuEcmErrorMaskableInterrupt = false
          McuEcmErrorNonMaskableInterrupt = true
          McuEcmErrorInternalReset = false
          McuEcmErrorNMIDelayTimer = false
          McuEcmErrorMIDelayTimer = false
          McuEcmErrorOutputMask = false
          McuNmiNotification = FeNmiClkMonr2RtErr
        McuEcmErrorSource10:
          McuEcmErrorMaskableInterrupt = false
          McuEcmErrorNonMaskableInterrupt = true
          McuEcmErrorInternalReset = false
          McuEcmErrorNMIDelayTimer = false
          McuEcmErrorMIDelayTimer = false
          McuEcmErrorOutputMask = false
          McuNmiNotification = FeNmiClkMonr3RtErr
        McuEcmErrorSource12:
          McuEcmErrorMaskableInterrupt = false
          McuEcmErrorNonMaskableInterrupt = true
          McuEcmErrorInternalReset = false
          McuEcmErrorNMIDelayTimer = false
          McuEcmErrorMIDelayTimer = false
          McuEcmErrorOutputMask = false
          McuNmiNotification = FeNmiClkMonr1RtErr
        McuEcmErrorSource16:
          McuEcmErrorMaskableInterrupt = false
          McuEcmErrorNonMaskableInterrupt = false
          McuEcmErrorInternalReset = false
          McuEcmErrorNMIDelayTimer = false
          McuEcmErrorMIDelayTimer = false
          McuEcmErrorOutputMask = false
        McuEcmErrorSource17:
          McuEcmErrorMaskableInterrupt = false
          McuEcmErrorNonMaskableInterrupt = false
          McuEcmErrorInternalReset = false
          McuEcmErrorNMIDelayTimer = false
          McuEcmErrorMIDelayTimer = false
          McuEcmErrorOutputMask = false
        McuEcmErrorSource18:
          McuEcmErrorMaskableInterrupt = false
          McuEcmErrorNonMaskableInterrupt = false
          McuEcmErrorInternalReset = false
          McuEcmErrorNMIDelayTimer = false
          McuEcmErrorMIDelayTimer = false
          McuEcmErrorOutputMask = true
        McuEcmErrorSource19:
          McuEcmErrorMaskableInterrupt = false
          McuEcmErrorNonMaskableInterrupt = false
          McuEcmErrorInternalReset = false
          McuEcmErrorNMIDelayTimer = false
          McuEcmErrorMIDelayTimer = false
          McuEcmErrorOutputMask = false
        McuEcmErrorSource20:
          McuEcmErrorMaskableInterrupt = false
          McuEcmErrorNonMaskableInterrupt = false
          McuEcmErrorInternalReset = false
          McuEcmErrorNMIDelayTimer = false
          McuEcmErrorMIDelayTimer = false
          McuEcmErrorOutputMask = true
        McuEcmErrorSource21:
          McuEcmErrorMaskableInterrupt = false
          McuEcmErrorNonMaskableInterrupt = false
          McuEcmErrorInternalReset = false
          McuEcmErrorNMIDelayTimer = false
          McuEcmErrorMIDelayTimer = false
          McuEcmErrorOutputMask = true
        McuEcmErrorSource22:
          McuEcmErrorMaskableInterrupt = false
          McuEcmErrorNonMaskableInterrupt = false
          McuEcmErrorInternalReset = false
          McuEcmErrorNMIDelayTimer = false
          McuEcmErrorMIDelayTimer = false
          McuEcmErrorOutputMask = true
        McuEcmErrorSource23:
          McuEcmErrorMaskableInterrupt = false
          McuEcmErrorNonMaskableInterrupt = false
          McuEcmErrorInternalReset = false
          McuEcmErrorNMIDelayTimer = false
          McuEcmErrorMIDelayTimer = false
          McuEcmErrorOutputMask = true
        McuEcmErrorSource24:
          McuEcmErrorMaskableInterrupt = false
          McuEcmErrorNonMaskableInterrupt = false
          McuEcmErrorInternalReset = false
          McuEcmErrorNMIDelayTimer = false
          McuEcmErrorMIDelayTimer = false
          McuEcmErrorOutputMask = true
        McuEcmErrorSource25:
          McuEcmErrorMaskableInterrupt = false
          McuEcmErrorNonMaskableInterrupt = true
          McuEcmErrorInternalReset = false
          McuEcmErrorNMIDelayTimer = false
          McuEcmErrorMIDelayTimer = false
          McuEcmErrorOutputMask = false
          McuNmiNotification = FeNmiGtmRamDblBitEccErr
        McuEcmErrorSource28:
          McuEcmErrorMaskableInterrupt = false
          McuEcmErrorNonMaskableInterrupt = false
          McuEcmErrorInternalReset = false
          McuEcmErrorNMIDelayTimer = false
          McuEcmErrorMIDelayTimer = false
          McuEcmErrorOutputMask = false
        McuEcmErrorSource29:
          McuEcmErrorMaskableInterrupt = false
          McuEcmErrorNonMaskableInterrupt = true
          McuEcmErrorInternalReset = false
          McuEcmErrorNMIDelayTimer = false
          McuEcmErrorMIDelayTimer = false
          McuEcmErrorOutputMask = false
          McuNmiNotification = FeNmiBusSngBitEccErr
        McuEcmErrorSource32:
          McuEcmErrorMaskableInterrupt = false
          McuEcmErrorNonMaskableInterrupt = true
          McuEcmErrorInternalReset = false
          McuEcmErrorNMIDelayTimer = false
          McuEcmErrorMIDelayTimer = false
          McuEcmErrorOutputMask = false
          McuNmiNotification = FeNmiLclRamEccAdrOvfErr
        McuEcmErrorSource33:
          McuEcmErrorMaskableInterrupt = false
          McuEcmErrorNonMaskableInterrupt = true
          McuEcmErrorInternalReset = false
          McuEcmErrorNMIDelayTimer = false
          McuEcmErrorMIDelayTimer = false
          McuEcmErrorOutputMask = false
          McuNmiNotification = FeNmiGlbRamEccAdrOvfErr
        McuEcmErrorSource35:
          McuEcmErrorMaskableInterrupt = false
          McuEcmErrorNonMaskableInterrupt = true
          McuEcmErrorInternalReset = false
          McuEcmErrorNMIDelayTimer = false
          McuEcmErrorMIDelayTimer = false
          McuEcmErrorOutputMask = false
          McuNmiNotification = FeNmiCodFlsEccAdrOvfErr
        McuEcmErrorSource36:
          McuEcmErrorMaskableInterrupt = false
          McuEcmErrorNonMaskableInterrupt = false
          McuEcmErrorInternalReset = false
          McuEcmErrorNMIDelayTimer = false
          McuEcmErrorMIDelayTimer = false
          McuEcmErrorOutputMask = true
        McuEcmErrorSource37:
          McuEcmErrorMaskableInterrupt = false
          McuEcmErrorNonMaskableInterrupt = true
          McuEcmErrorInternalReset = false
          McuEcmErrorNMIDelayTimer = false
          McuEcmErrorMIDelayTimer = false
          McuEcmErrorOutputMask = false
          McuNmiNotification = FeNmiPrphlRamEccAdrOvfErr
        McuEcmErrorSource40:
          McuEcmErrorMaskableInterrupt = false
          McuEcmErrorNonMaskableInterrupt = true
          McuEcmErrorInternalReset = false
          McuEcmErrorNMIDelayTimer = false
          McuEcmErrorMIDelayTimer = false
          McuEcmErrorOutputMask = false
          McuNmiNotification = FeNmiDtsRamDblBitEccErr
        McuEcmErrorSource41:
          McuEcmErrorMaskableInterrupt = false
          McuEcmErrorNonMaskableInterrupt = false
          McuEcmErrorInternalReset = false
          McuEcmErrorNMIDelayTimer = false
          McuEcmErrorMIDelayTimer = false
          McuEcmErrorOutputMask = true
        McuEcmErrorSource48:
          McuEcmErrorMaskableInterrupt = true
          McuEcmErrorNonMaskableInterrupt = false
          McuEcmErrorInternalReset = false
          McuEcmErrorNMIDelayTimer = false
          McuEcmErrorMIDelayTimer = false
          McuEcmErrorOutputMask = true
          McuMiNotification = RamMemLclRamSngBitEcc
        McuEcmErrorSource49:
          McuEcmErrorMaskableInterrupt = true
          McuEcmErrorNonMaskableInterrupt = false
          McuEcmErrorInternalReset = false
          McuEcmErrorNMIDelayTimer = false
          McuEcmErrorMIDelayTimer = false
          McuEcmErrorOutputMask = true
          McuMiNotification = RamMemGlbRamSngBitEcc
        McuEcmErrorSource51:
          McuEcmErrorMaskableInterrupt = true
          McuEcmErrorNonMaskableInterrupt = false
          McuEcmErrorInternalReset = false
          McuEcmErrorNMIDelayTimer = false
          McuEcmErrorMIDelayTimer = false
          McuEcmErrorOutputMask = true
          McuMiNotification = CodFlsSngBitEcc
        McuEcmErrorSource52:
          McuEcmErrorMaskableInterrupt = false
          McuEcmErrorNonMaskableInterrupt = false
          McuEcmErrorInternalReset = false
          McuEcmErrorNMIDelayTimer = false
          McuEcmErrorMIDelayTimer = false
          McuEcmErrorOutputMask = true
        McuEcmErrorSource53:
          McuEcmErrorMaskableInterrupt = false
          McuEcmErrorNonMaskableInterrupt = false
          McuEcmErrorInternalReset = false
          McuEcmErrorNMIDelayTimer = false
          McuEcmErrorMIDelayTimer = false
          McuEcmErrorOutputMask = true
        McuEcmErrorSource54:
          McuEcmErrorMaskableInterrupt = false
          McuEcmErrorNonMaskableInterrupt = false
          McuEcmErrorInternalReset = false
          McuEcmErrorNMIDelayTimer = false
          McuEcmErrorMIDelayTimer = false
          McuEcmErrorOutputMask = true
        McuEcmErrorSource55:
          McuEcmErrorMaskableInterrupt = false
          McuEcmErrorNonMaskableInterrupt = false
          McuEcmErrorInternalReset = false
          McuEcmErrorNMIDelayTimer = false
          McuEcmErrorMIDelayTimer = false
          McuEcmErrorOutputMask = true
        McuEcmErrorSource56:
          McuEcmErrorMaskableInterrupt = false
          McuEcmErrorNonMaskableInterrupt = false
          McuEcmErrorInternalReset = false
          McuEcmErrorNMIDelayTimer = false
          McuEcmErrorMIDelayTimer = false
          McuEcmErrorOutputMask = true
        McuEcmErrorSource57:
          McuEcmErrorMaskableInterrupt = false
          McuEcmErrorNonMaskableInterrupt = false
          McuEcmErrorInternalReset = false
          McuEcmErrorNMIDelayTimer = false
          McuEcmErrorMIDelayTimer = false
          McuEcmErrorOutputMask = true
        McuEcmErrorSource64:
          McuEcmErrorMaskableInterrupt = false
          McuEcmErrorNonMaskableInterrupt = true
          McuEcmErrorInternalReset = false
          McuEcmErrorNMIDelayTimer = false
          McuEcmErrorMIDelayTimer = false
          McuEcmErrorOutputMask = false
          McuNmiNotification = FeNmiPegErr
        McuEcmErrorSource65:
          McuEcmErrorMaskableInterrupt = false
          McuEcmErrorNonMaskableInterrupt = false
          McuEcmErrorInternalReset = false
          McuEcmErrorNMIDelayTimer = false
          McuEcmErrorMIDelayTimer = false
          McuEcmErrorOutputMask = true
        McuEcmErrorSource66:
          McuEcmErrorMaskableInterrupt = false
          McuEcmErrorNonMaskableInterrupt = false
          McuEcmErrorInternalReset = false
          McuEcmErrorNMIDelayTimer = false
          McuEcmErrorMIDelayTimer = false
          McuEcmErrorOutputMask = true
        McuEcmErrorSource67:
          McuEcmErrorMaskableInterrupt = false
          McuEcmErrorNonMaskableInterrupt = false
          McuEcmErrorInternalReset = false
          McuEcmErrorNMIDelayTimer = false
          McuEcmErrorMIDelayTimer = false
          McuEcmErrorOutputMask = true
        McuEcmErrorSource72:
          McuEcmErrorMaskableInterrupt = false
          McuEcmErrorNonMaskableInterrupt = false
          McuEcmErrorInternalReset = false
          McuEcmErrorNMIDelayTimer = false
          McuEcmErrorMIDelayTimer = false
          McuEcmErrorOutputMask = true
        McuEcmErrorSource73:
          McuEcmErrorMaskableInterrupt = false
          McuEcmErrorNonMaskableInterrupt = true
          McuEcmErrorInternalReset = false
          McuEcmErrorNMIDelayTimer = false
          McuEcmErrorMIDelayTimer = false
          McuEcmErrorOutputMask = false
          McuNmiNotification = FeNmiGblRamIllglAcsByProcr
        McuEcmErrorSource74:
          McuEcmErrorMaskableInterrupt = false
          McuEcmErrorNonMaskableInterrupt = false
          McuEcmErrorInternalReset = false
          McuEcmErrorNMIDelayTimer = false
          McuEcmErrorMIDelayTimer = false
          McuEcmErrorOutputMask = false
        McuEcmErrorSource75:
          McuEcmErrorMaskableInterrupt = false
          McuEcmErrorNonMaskableInterrupt = false
          McuEcmErrorInternalReset = false
          McuEcmErrorNMIDelayTimer = false
          McuEcmErrorMIDelayTimer = false
          McuEcmErrorOutputMask = false
        McuEcmErrorSource76:
          McuEcmErrorMaskableInterrupt = false
          McuEcmErrorNonMaskableInterrupt = false
          McuEcmErrorInternalReset = false
          McuEcmErrorNMIDelayTimer = false
          McuEcmErrorMIDelayTimer = false
          McuEcmErrorOutputMask = false
        McuEcmErrorSource77:
          McuEcmErrorMaskableInterrupt = false
          McuEcmErrorNonMaskableInterrupt = true
          McuEcmErrorInternalReset = false
          McuEcmErrorNMIDelayTimer = false
          McuEcmErrorMIDelayTimer = false
          McuEcmErrorOutputMask = false
          McuNmiNotification = FeNmiCodFlsIllglAcsBySysBus
        McuEcmErrorSource78:
          McuEcmErrorMaskableInterrupt = false
          McuEcmErrorNonMaskableInterrupt = true
          McuEcmErrorInternalReset = false
          McuEcmErrorNMIDelayTimer = false
          McuEcmErrorMIDelayTimer = false
          McuEcmErrorOutputMask = false
          McuNmiNotification = FeNmiGblRamIllglAcsBySysBus
        McuEcmErrorSource79:
          McuEcmErrorMaskableInterrupt = false
          McuEcmErrorNonMaskableInterrupt = true
          McuEcmErrorInternalReset = false
          McuEcmErrorNMIDelayTimer = false
          McuEcmErrorMIDelayTimer = false
          McuEcmErrorOutputMask = false
          McuNmiNotification = FeNmiResdAreaIllglAcsByHiSpdBus
        McuEcmErrorSource80:
          McuEcmErrorMaskableInterrupt = false
          McuEcmErrorNonMaskableInterrupt = true
          McuEcmErrorInternalReset = false
          McuEcmErrorNMIDelayTimer = false
          McuEcmErrorMIDelayTimer = false
          McuEcmErrorOutputMask = false
          McuNmiNotification = FeNmiDmaTrfErr
        McuEcmErrorSource81:
          McuEcmErrorMaskableInterrupt = false
          McuEcmErrorNonMaskableInterrupt = true
          McuEcmErrorInternalReset = false
          McuEcmErrorNMIDelayTimer = false
          McuEcmErrorMIDelayTimer = false
          McuEcmErrorOutputMask = false
          McuNmiNotification = FeNmiDmaIllglAcsErr
        McuEcmErrorSource82:
          McuEcmErrorMaskableInterrupt = false
          McuEcmErrorNonMaskableInterrupt = true
          McuEcmErrorInternalReset = false
          McuEcmErrorNMIDelayTimer = false
          McuEcmErrorMIDelayTimer = false
          McuEcmErrorOutputMask = false
          McuNmiNotification = FeNmiFlsSeqErr
        McuEcmErrorSource83:
          McuEcmErrorMaskableInterrupt = false
          McuEcmErrorNonMaskableInterrupt = false
          McuEcmErrorInternalReset = false
          McuEcmErrorNMIDelayTimer = false
          McuEcmErrorMIDelayTimer = false
          McuEcmErrorOutputMask = true
        McuEcmErrorSource84:
          McuEcmErrorMaskableInterrupt = false
          McuEcmErrorNonMaskableInterrupt = false
          McuEcmErrorInternalReset = false
          McuEcmErrorNMIDelayTimer = false
          McuEcmErrorMIDelayTimer = false
          McuEcmErrorOutputMask = true
        McuEcmErrorSource87:
          McuEcmErrorMaskableInterrupt = false
          McuEcmErrorNonMaskableInterrupt = false
          McuEcmErrorInternalReset = false
          McuEcmErrorNMIDelayTimer = false
          McuEcmErrorMIDelayTimer = false
          McuEcmErrorOutputMask = true
        McuEcmErrorSource88:
          McuEcmErrorMaskableInterrupt = false
          McuEcmErrorNonMaskableInterrupt = true
          McuEcmErrorInternalReset = false
          McuEcmErrorNMIDelayTimer = false
          McuEcmErrorMIDelayTimer = false
          McuEcmErrorOutputMask = false
          McuNmiNotification = FeNmiModErrUsrModInactv
        McuEcmErrorSource89:
          McuEcmErrorMaskableInterrupt = false
          McuEcmErrorNonMaskableInterrupt = true
          McuEcmErrorInternalReset = false
          McuEcmErrorNMIDelayTimer = false
          McuEcmErrorMIDelayTimer = false
          McuEcmErrorOutputMask = false
          McuNmiNotification = FeNmiModErrProgmModActv
        McuEcmErrorSource90:
          McuEcmErrorMaskableInterrupt = false
          McuEcmErrorNonMaskableInterrupt = true
          McuEcmErrorInternalReset = false
          McuEcmErrorNMIDelayTimer = false
          McuEcmErrorMIDelayTimer = false
          McuEcmErrorOutputMask = false
          McuNmiNotification = FeNmiModErrDbgActv
        McuEcmErrorSource91:
          McuEcmErrorMaskableInterrupt = false
          McuEcmErrorNonMaskableInterrupt = true
          McuEcmErrorInternalReset = false
          McuEcmErrorNMIDelayTimer = false
          McuEcmErrorMIDelayTimer = false
          McuEcmErrorOutputMask = false
          McuNmiNotification = FeNmiModErrTestModActv
        McuEcmErrorSource92:
          McuEcmErrorMaskableInterrupt = false
          McuEcmErrorNonMaskableInterrupt = true
          McuEcmErrorInternalReset = false
          McuEcmErrorNMIDelayTimer = false
          McuEcmErrorMIDelayTimer = false
          McuEcmErrorOutputMask = false
          McuNmiNotification = FeNmiEcmMstChkrErr
        McuEcmErrorSource93: McuEcmErrorInternalReset=false, McuEcmErrorOutputMask=true
      McuDemEventParameterRefs:
        MCU_E_CLOCK_FAILURE = MCU_E_CLOCK_FAILURE
        MCU_E_WRITE_TIMEOUT_FAILURE = MCU_E_WRITE_TIMEOUT_FAILURE
        MCU_E_POWERDOWN_MODE_FAILURE = MCU_E_POWERDOWN_MODE_FAILURE
      McuModeSettingConf:
        McuMode = 1
        McuModeType = MCU_HALT_MODE
        McuMcanStopTrigger = false
        McuFlexrayStopTrigger = false
        McuGtmStopTrigger = false
        McuEthernetStopTrigger = false
        McuRsentStopTrigger = false
        McuHsUsrtStopTrigger = false
        McuCsihStopTrigger = false
        McuRlin3StopTrigger = false
        McuAdcStopTrigger = false
        McuMcanWakeUpTrigger = true
        McuFlexrayWakeupTrigger = false
        McuGtmWakeupTrigger = true
        McuEthernetWakeupTrigger = false
        McuRsentWakeupTrigger = true
        McuHsUsrtWakeupTrigger = true
        McuCsihWakeupTrigger = true
        McuRlin3WakeupTrigger = false
        McuAdcWakeupTrigger = true
        McuWakeUpFactorDetails: McuWakeUpFactorName=INTECMMI
      McuRamSectorSettingConf: McuRamDefaultValue=255, McuRamSectionBaseAddress=4275961856, McuRamSectionSize=256
