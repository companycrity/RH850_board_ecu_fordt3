AUTOSAR XML (schema 4-2-1)
package /ActiveEcuC
  module config WdgM: implementation-config-variant=VARIANT-PRE-COMPILE, module-description=WdgM_Impl
    WdgMConfigSet: WdgMInitialMode=WdgMMode
      WdgMMode:
        WdgMExpiredSupervisionCycleTol = 0
        WdgMModeId = 0
        WdgMSupervisionCycle = 0.004
        WdgMInitialTriggerModeId = 0
        WdgMModeCoreAssignment = 0
        WdgMTicksPerSecond = 250
        WdgMGlobalMemoryAppTaskRef = Appl10
        Sts_2ms_Appl10 (WdgMLocalStatusParams):
          WdgMFailedAliveSupervisionRefCycleTol = 0
          WdgMSupervisedEntityInitialMode = WDGM_LOCAL_STATUS_OK
          WdgMFailedDeadlineRefCycleTol = 0
          WdgMDeadlineReferenceCycle = 0
          WdgMFailedProgramFlowRefCycleTol = 0
          WdgMProgramFlowReferenceCycle = 0
          WdgMLocalStatusSupervisedEntityRef = SE_2ms_Appl10
        WdgMTrigger: WdgMWatchdogMode=WDGIF_SLOW_MODE, WdgMTriggerConditionValue=7, WdgMTriggerWindowStart=2, WdgMTriggerModeId=0, WdgMTriggerWatchdogRef=WdgMWatchdog
        Alv_4ms_Strt (WdgMAliveSupervision):
          WdgMExpectedAliveIndications = 1
          WdgMMaxMargin = 0
          WdgMMinMargin = 0
          WdgMSupervisionReferenceCycle = 1
          WdgMAliveSupervisionCheckpointRef = ChkPt_4ms_Appl10_Strt
        Alv_2ms_Strt (WdgMAliveSupervision):
          WdgMExpectedAliveIndications = 2
          WdgMMaxMargin = 0
          WdgMMinMargin = 0
          WdgMSupervisionReferenceCycle = 1
          WdgMAliveSupervisionCheckpointRef = ChkPt_2ms_Appl10_Strt
        3 x WdgMLocalStatusParams, all with WdgMFailedAliveSupervisionRefCycleTol=0, WdgMSupervisedEntityInitialMode=WDGM_LOCAL_STATUS_OK, WdgMFailedDeadlineRefCycleTol=0, WdgMDeadlineReferenceCycle=0, WdgMFailedProgramFlowRefCycleTol=0, WdgMProgramFlowReferenceCycle=0:
          Sts_4ms_Appl10: WdgMLocalStatusSupervisedEntityRef=SE_4ms_Appl10
          Sts_10ms_Appl10: WdgMLocalStatusSupervisedEntityRef=SE_10ms_Appl10
          Sts_100ms_Appl10: WdgMLocalStatusSupervisedEntityRef=SE_100ms_Appl10
        3 x WdgMAliveSupervision, all with WdgMMaxMargin=0, WdgMMinMargin=0:
          Alv_10ms_Strt: WdgMExpectedAliveIndications=2, WdgMSupervisionReferenceCycle=5, WdgMAliveSupervisionCheckpointRef=ChkPt_10ms_Appl10_Strt
          Alv_10ms_End: WdgMExpectedAliveIndications=2, WdgMSupervisionReferenceCycle=5, WdgMAliveSupervisionCheckpointRef=ChkPt_10msBSW_Appl10_End
          Alv_100ms_Strt: WdgMExpectedAliveIndications=1, WdgMSupervisionReferenceCycle=25, WdgMAliveSupervisionCheckpointRef=ChkPt_100ms_Appl10_Strt
        Sts_10msBSW_Appl10 (WdgMLocalStatusParams):
          WdgMFailedAliveSupervisionRefCycleTol = 0
          WdgMSupervisedEntityInitialMode = WDGM_LOCAL_STATUS_OK
          WdgMFailedDeadlineRefCycleTol = 0
          WdgMDeadlineReferenceCycle = 0
          WdgMFailedProgramFlowRefCycleTol = 0
          WdgMProgramFlowReferenceCycle = 0
          WdgMLocalStatusSupervisedEntityRef = SE_10msBSW_Appl10
        WdgMExternalLogicalSupervision: WdgMExternalCheckpointInitialRef=ChkPt_10ms_Appl10_End, WdgMExternalCheckpointFinalRef=ChkPt_GlobalFinal
          ExtTran_10ms_1 (WdgMExternalTransition): WdgMExternalTransitionDestRef=ChkPt_10msBSW_Appl10_Strt, WdgMExternalTransitionSourceRef=ChkPt_10ms_Appl10_End
      WdgMDemEventParameterRefs
    WdgMGeneral:
      WdgMDevErrorDetect = true
      WdgMDemReport = false
      WdgMImmediateReset = true
      WdgMOffModeEnabled = false
      WdgMVersionInfoApi = false
      WdgMDefensiveBehavior = true
      WdgMUseRte = true
      WdgMDemSupervisionReport = false
      WdgMFirstCycleAliveCounterReset = true
      WdgMAutosarDebugging = false
      WdgMUseOsSuspendInterrupt = true
      WdgMTimebaseSource = WDGM_INTERNAL_SOFTWARE_TICK
      WdgMSecondResetPath = true
      WdgMTickOverrunCorrection = true
      WdgMEntityDeactivationEnabled = true
      WdgMStateChangeNotification = false
      WdgMGenerateCPIdAsPortDefinedArgument = true
      WdgMUseOsCoreIdentification = false
      WdgMCallerIds: WdgMCallerId=0
      SE_2ms_Appl10 (WdgMSupervisedEntity):
        WdgMSupervisedEntityId = 1
        WdgMEnableEntityDeactivation = true
        WdgMInternalCheckpointInitialRef = ChkPt_2ms_Appl10_Strt
        WdgMAppTaskRef = Appl10
        WdgMInternallCheckpointFinalRef = ChkPt_2ms_Appl10_End
        3 x WdgMCheckpoint:
          ChkPt_2ms_Appl10_Strt: WdgMCheckpointId=0
          ChkPt_2ms_Appl10_End: WdgMCheckpointId=1
          ChkPt_GlobalFinal: WdgMCheckpointId=2
        IntTran_2ms_Appl10 (WdgMInternalTransition): WdgMInternalTransitionDestRef=ChkPt_2ms_Appl10_End, WdgMInternalTransitionSourceRef=ChkPt_2ms_Appl10_Strt
      WdgMWatchdog: WdgMWatchdogName=, WdgMWatchdogDeviceRef=WdgIfDevice
      4 x WdgMSupervisedEntity, all with WdgMEnableEntityDeactivation=true, WdgMAppTaskRef=Appl10:
        SE_4ms_Appl10: WdgMSupervisedEntityId=2, WdgMInternalCheckpointInitialRef=ChkPt_4ms_Appl10_Strt, WdgMInternallCheckpointFinalRef=ChkPt_4ms_Appl10_End
          ChkPt_4ms_Appl10_End (WdgMCheckpoint): WdgMCheckpointId=1
          ChkPt_4ms_Appl10_Strt (WdgMCheckpoint): WdgMCheckpointId=0
          IntTran_4ms_Appl10 (WdgMInternalTransition): WdgMInternalTransitionDestRef=ChkPt_4ms_Appl10_End, WdgMInternalTransitionSourceRef=ChkPt_4ms_Appl10_Strt
        SE_10ms_Appl10: WdgMSupervisedEntityId=3, WdgMInternalCheckpointInitialRef=ChkPt_10ms_Appl10_Strt, WdgMInternallCheckpointFinalRef=ChkPt_10ms_Appl10_End
          ChkPt_10ms_Appl10_Strt (WdgMCheckpoint): WdgMCheckpointId=0
          ChkPt_10ms_Appl10_End (WdgMCheckpoint): WdgMCheckpointId=1
          IntTran_10ms_Appl10 (WdgMInternalTransition): WdgMInternalTransitionDestRef=ChkPt_10ms_Appl10_End, WdgMInternalTransitionSourceRef=ChkPt_10ms_Appl10_Strt
        SE_10msBSW_Appl10: WdgMSupervisedEntityId=0, WdgMInternalCheckpointInitialRef=ChkPt_10msBSW_Appl10_Strt, WdgMInternallCheckpointFinalRef=ChkPt_10msBSW_Appl10_End
          ChkPt_10msBSW_Appl10_Strt (WdgMCheckpoint): WdgMCheckpointId=0
          ChkPt_10msBSW_Appl10_End (WdgMCheckpoint): WdgMCheckpointId=1
          IntTran_10msBSW_Appl10 (WdgMInternalTransition): WdgMInternalTransitionDestRef=ChkPt_10msBSW_Appl10_End, WdgMInternalTransitionSourceRef=ChkPt_10msBSW_Appl10_Strt
        SE_100ms_Appl10: WdgMSupervisedEntityId=4, WdgMInternalCheckpointInitialRef=ChkPt_100ms_Appl10_Strt, WdgMInternallCheckpointFinalRef=ChkPt_100ms_Appl10_End
          ChkPt_100ms_Appl10_Strt (WdgMCheckpoint): WdgMCheckpointId=0
          ChkPt_100ms_Appl10_End (WdgMCheckpoint): WdgMCheckpointId=1
          IntTran_100ms_Appl10 (WdgMInternalTransition): WdgMInternalTransitionDestRef=ChkPt_100ms_Appl10_End, WdgMInternalTransitionSourceRef=ChkPt_100ms_Appl10_Strt
