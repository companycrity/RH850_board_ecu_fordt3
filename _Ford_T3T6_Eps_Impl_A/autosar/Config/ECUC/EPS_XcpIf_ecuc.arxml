AUTOSAR XML (schema 4-2-1)
package /ActiveEcuC
  module config XcpIf: implementation-config-variant=VARIANT-PRE-COMPILE
    XcpIfCommon: XcpDriverSelection=AUTOSAR, TunSelnMngtOsApplicationRef=Appl10
