AUTOSAR XML (schema 4-2-1)
package /ActiveEcuC
  module config DiagcMgr: implementation-config-variant=VARIANT-PRE-COMPILE, module-description=DiagcMgr_Impl
    DiagcMgrGeneral: DIAGCMGR_DEMCHK=STD_OFF, DEMTOTNROFDTC=0
    138 x NTCNR, all with MfgNtcInhibInOper=false, MfgNtcInhibInNonOper=false, NtcPwrCycLtch=false, LtchgEna=false, LtchCntrThd=0, NTCOsApplicationRef=Appl10:
      NTCNR_0X{006..008}: Debounce=false
      NTCNR_0X00A: Debounce=false
      NTCNR_0X03A: Debounce=false
      NTCNR_0X0A0: Debounce=false
      NTCNR_0X0BF: Debounce=false
      NTCNR_0X087: Debounce=true
      NTCNR_0X{080..082}: Debounce=true
      NTCNR_0X05D: Debounce=true
      NTCNR_0X1ED: Debounce=false
      NTCNR_0X1EC: Debounce=false
      NTCNR_0X04D: Debounce=true
      NTCNR_0X03C: Debounce=true
      NTCNR_0X0B1: Debounce=true
      NTCNR_0X044: Debounce=true
      NTCNR_0X0B5: Debounce=true
      NTCNR_0X0B0: Debounce=true
      NTCNR_0X0B9: Debounce=false
      NTCNR_0X0A6: Debounce=true
      NTCNR_0X0A1: Debounce=false
      NTCNR_0X09C: Debounce=false
      NTCNR_0X042: Debounce=false
      NTCNR_0X043: Debounce=true
      NTCNR_0X0C4: Debounce=true
      NTCNR_0X0C7: Debounce=false
      NTCNR_0X0E1: Debounce=true
      NTCNR_0X0A7: Debounce=false
      NTCNR_0X0A2: Debounce=true
      NTCNR_0X0D7: Debounce=true
      NTCNR_0X1FF: Debounce=false
      NTCNR_0X090: Debounce=false
      NTCNR_0X075: Debounce=true
      NTCNR_0X039: Debounce=false
      NTCNR_0X020: Debounce=false
      NTCNR_0X1FA: Debounce=false
      NTCNR_0X{097..099}: Debounce=true
      NTCNR_0X02B: Debounce=true
      NTCNR_0X055: Debounce=true
      NTCNR_0X053: Debounce=false
      NTCNR_0X050: Debounce=true
      NTCNR_0X054: Debounce=false
      NTCNR_0X051: Debounce=true
      NTCNR_0X083: Debounce=true
      NTCNR_0X085: Debounce=true
      NTCNR_0X040: Debounce=false
      NTCNR_0X041: Debounce=false
      NTCNR_0X07C: Debounce=true
      NTCNR_0X07B: Debounce=true
      NTCNR_0X07D: Debounce=true
      NTCNR_0X07E: Debounce=true
      NTCNR_0X07F: Debounce=true
      NTCNR_0X070: Debounce=true
      NTCNR_0X0A3: Debounce=false
      NTCNR_0X0A4: Debounce=false
      NTCNR_0X0B2: Debounce=false
      NTCNR_0X0C6: Debounce=false
      NTCNR_0X0A9: Debounce=true
      NTCNR_0X1F{6..8}: Debounce=false
      NTCNR_0X03F: Debounce=false
      NTCNR_0X0D6: Debounce=false
      NTCNR_0X0AA: Debounce=false
      NTCNR_0X0AB: Debounce=false
      NTCNR_0X0AC: Debounce=false
      NTCNR_0X0AD: Debounce=false
      NTCNR_0X0AF: Debounce=false
      NTCNR_0X0AE: Debounce=false
      NTCNR_0X045: Debounce=true
      NTCNR_0X1E1: Debounce=false
      NTCNR_0X074: Debounce=true
      NTCNR_0X1E0: Debounce=false
      NTCNR_0X{002..004}: Debounce=false
      NTCNR_0X010: Debounce=false
      NTCNR_0X{012..019}: Debounce=false
      NTCNR_0X01A: Debounce=false
      NTCNR_0X01B: Debounce=false
      NTCNR_0X01D: Debounce=false
      NTCNR_0X{021..026}: Debounce=false
      NTCNR_0X028: Debounce=false
      NTCNR_0X029: Debounce=false
      NTCNR_0X02A: Debounce=false
      NTCNR_0X02C: Debounce=false
      NTCNR_0X02D: Debounce=false
      NTCNR_0X02E: Debounce=false
      NTCNR_0X02F: Debounce=false
      NTCNR_0X030: Debounce=false
      NTCNR_0X031: Debounce=false
      NTCNR_0X036: Debounce=false
      NTCNR_0X037: Debounce=false
      NTCNR_0X049: Debounce=false
      NTCNR_0X11D: Debounce=false
      NTCNR_0X11E: Debounce=false
      NTCNR_0X13C: Debounce=false
      NTCNR_0X13D: Debounce=false
      NTCNR_0X13E: Debounce=false
      NTCNR_0X13F: Debounce=false
      NTCNR_0X140: Debounce=false
      NTCNR_0X143: Debounce=false
      NTCNR_0X144: Debounce=false
      NTCNR_0X163: Debounce=false
      NTCNR_0X165: Debounce=false
      NTCNR_0X168: Debounce=false
      NTCNR_0X167: Debounce=false
      NTCNR_0X166: Debounce=false
      NTCNR_0X19A: Debounce=false
      NTCNR_0X16B: Debounce=false
      NTCNR_0X16C: Debounce=false
      NTCNR_0X16D: Debounce=false
      NTCNR_0X122: Debounce=false
      NTCNR_0X124: Debounce=false
      NTCNR_0X123: Debounce=false
      NTCNR_0X{071..073}: Debounce=true
      NTCNR_0X077: Debounce=true
      NTCNR_0X079: Debounce=true
      NTCNR_0X1E2: Debounce=false
      NTCNR_0X1E3: Debounce=false
    53 x DTCEnaCndn, all with Bit_15=false, Bit_14=false, Bit_13=false, Bit_12=false, Bit_11=false, Bit_10=false, Bit__9=false, Bit__8=false, Bit__7=false, Bit__6=false, Bit__5=false, Bit__4=false, Bit__3=false, Bit__2=false, Bit__1=false, Bit__0=false:
      DTCClass_DTC_0x502d00: DiagcMgrDTCIdx=10, DTC=DTCClass_DTC_0x502d00
      DTCClass_DTC_0x5b0049: DiagcMgrDTCIdx=15, DTC=DTCClass_DTC_0x5b0049
      DTCClass_DTC_0x5b0062: DiagcMgrDTCIdx=16, DTC=DTCClass_DTC_0x5b0062
      DTCClass_DTC_0x600b49: DiagcMgrDTCIdx=1, DTC=DTCClass_DTC_0x600b49
      DTCClass_DTC_0x600b62: DiagcMgrDTCIdx=2, DTC=DTCClass_DTC_0x600b62
      DTCClass_DTC_0x600c49: DiagcMgrDTCIdx=3, DTC=DTCClass_DTC_0x600c49
      DTCClass_DTC_0x600c62: DiagcMgrDTCIdx=4, DTC=DTCClass_DTC_0x600c62
      DTCClass_DTC_0x600d49: DiagcMgrDTCIdx=5, DTC=DTCClass_DTC_0x600d49
      DTCClass_DTC_0x600d62: DiagcMgrDTCIdx=6, DTC=DTCClass_DTC_0x600d62
      DTCClass_DTC_0x9d234b: DiagcMgrDTCIdx=11, DTC=DTCClass_DTC_0x9d234b
      DTCClass_DTC_0xc10000: DiagcMgrDTCIdx=27, DTC=DTCClass_DTC_0xc10000
      DTCClass_DTC_0xc10200: DiagcMgrDTCIdx=29, DTC=DTCClass_DTC_0xc10200
      DTCClass_DTC_0xc12100: DiagcMgrDTCIdx=26, DTC=DTCClass_DTC_0xc12100
      DTCClass_DTC_0xc12200: DiagcMgrDTCIdx=28, DTC=DTCClass_DTC_0xc12200
      DTCClass_DTC_0xc12600: DiagcMgrDTCIdx=37, DTC=DTCClass_DTC_0xc12600
      DTCClass_DTC_0xc14000: DiagcMgrDTCIdx=35, DTC=DTCClass_DTC_0xc14000
      DTCClass_DTC_0xc14600: DiagcMgrDTCIdx=36, DTC=DTCClass_DTC_0xc14600
      DTCClass_DTC_0xc15500: DiagcMgrDTCIdx=30, DTC=DTCClass_DTC_0xc15500
      DTCClass_DTC_0xc15900: DiagcMgrDTCIdx=31, DTC=DTCClass_DTC_0xc15900
      DTCClass_DTC_0xc23a00: DiagcMgrDTCIdx=32, DTC=DTCClass_DTC_0xc23a00
      DTCClass_DTC_0xc23b00: DiagcMgrDTCIdx=33, DTC=DTCClass_DTC_0xc23b00
      DTCClass_DTC_0xc25200: DiagcMgrDTCIdx=34, DTC=DTCClass_DTC_0xc25200
      DTCClass_DTC_0xc25300: DiagcMgrDTCIdx=38, DTC=DTCClass_DTC_0xc25300
      DTCClass_DTC_0xc25600: DiagcMgrDTCIdx=39, DTC=DTCClass_DTC_0xc25600
      DTCClass_DTC_0xc40100: DiagcMgrDTCIdx=42, DTC=DTCClass_DTC_0xc40100
      DTCClass_DTC_0xc40300: DiagcMgrDTCIdx=44, DTC=DTCClass_DTC_0xc40300
      DTCClass_DTC_0xc41500: DiagcMgrDTCIdx=40, DTC=DTCClass_DTC_0xc41500
      DTCClass_DTC_0xc41522: DiagcMgrDTCIdx=41, DTC=DTCClass_DTC_0xc41522
      DTCClass_DTC_0xc41600: DiagcMgrDTCIdx=43, DTC=DTCClass_DTC_0xc41600
      DTCClass_DTC_0xc42200: DiagcMgrDTCIdx=50, DTC=DTCClass_DTC_0xc42200
      DTCClass_DTC_0xc42300: DiagcMgrDTCIdx=45, DTC=DTCClass_DTC_0xc42300
      DTCClass_DTC_0xc42800: DiagcMgrDTCIdx=51, DTC=DTCClass_DTC_0xc42800
      DTCClass_DTC_0xc45a00: DiagcMgrDTCIdx=46, DTC=DTCClass_DTC_0xc45a00
      DTCClass_DTC_0xc53b00: DiagcMgrDTCIdx=47, DTC=DTCClass_DTC_0xc53b00
      DTCClass_DTC_0xc53c00: DiagcMgrDTCIdx=48, DTC=DTCClass_DTC_0xc53c00
      DTCClass_DTC_0xc55300: DiagcMgrDTCIdx=49, DTC=DTCClass_DTC_0xc55300
      DTCClass_DTC_0xc55400: DiagcMgrDTCIdx=52, DTC=DTCClass_DTC_0xc55400
      DTCClass_DTC_0xc55700: DiagcMgrDTCIdx=53, DTC=DTCClass_DTC_0xc55700
      DTCClass_DTC_0xe01478: DiagcMgrDTCIdx=19, DTC=DTCClass_DTC_0xe01478
      DTCClass_DTC_0xe01481: DiagcMgrDTCIdx=20, DTC=DTCClass_DTC_0xe01481
      DTCClass_DTC_0xe01492: DiagcMgrDTCIdx=21, DTC=DTCClass_DTC_0xe01492
      DTCClass_DTC_0xe01647: DiagcMgrDTCIdx=17, DTC=DTCClass_DTC_0xe01647
      DTCClass_DTC_0xe01648: DiagcMgrDTCIdx=18, DTC=DTCClass_DTC_0xe01648
      DTCClass_DTC_0xe10000: DiagcMgrDTCIdx=22, DTC=DTCClass_DTC_0xe10000
      DTCClass_DTC_0xe30055: DiagcMgrDTCIdx=23, DTC=DTCClass_DTC_0xe30055
      DTCClass_DTC_0xf00042: DiagcMgrDTCIdx=7, DTC=DTCClass_DTC_0xf00042
      DTCClass_DTC_0xf00049: DiagcMgrDTCIdx=8, DTC=DTCClass_DTC_0xf00049
      DTCClass_DTC_0xf00061: DiagcMgrDTCIdx=9, DTC=DTCClass_DTC_0xf00061
      DTCClass_DTC_0xf00168: DiagcMgrDTCIdx=25, DTC=DTCClass_DTC_0xf00168
      DTCClass_DTC_0xf00316: DiagcMgrDTCIdx=12, DTC=DTCClass_DTC_0xf00316
      DTCClass_DTC_0xf00317: DiagcMgrDTCIdx=13, DTC=DTCClass_DTC_0xf00317
      DTCClass_DTC_0xf00368: DiagcMgrDTCIdx=14, DTC=DTCClass_DTC_0xf00368
      DTCClass_DTC_0x511056: DiagcMgrDTCIdx=24, DTC=DTCClass_DTC_0x511056
    101 x NTCNR, all with MfgNtcInhibInOper=false, MfgNtcInhibInNonOper=false, NtcPwrCycLtch=false, LtchgEna=false, LtchCntrThd=0, NTCOsApplicationRef=Appl10:
      NTCNR_0X0E0: Debounce=false
      NTCNR_0X0E{2..7}: Debounce=false
      NTCNR_0X1F5: Debounce=false
      NTCNR_0X06E: Debounce=false
      NTCNR_0X078: Debounce=false
      NTCNR_0X076: Debounce=false
      NTCNR_0X06F: Debounce=false
      NTCNR_0X086: Debounce=false
      NTCNR_0X084: Debounce=false
      NTCNR_0X0F{0..4}: Debounce=false
      NTCNR_0X0BA: Debounce=false
      NTCNR_0X0BB: Debounce=false
      NTCNR_0X0BC: Debounce=false
      NTCNR_0X09B: Debounce=false
      NTCNR_0X0F{5..9}: Debounce=false
      NTCNR_0X0FA: Debounce=false
      NTCNR_0X0FB: Debounce=false
      NTCNR_0X0FC: Debounce=false
      NTCNR_0X0FD: Debounce=false
      NTCNR_0X0FE: Debounce=false
      NTCNR_0X1B9: Debounce=false
      NTCNR_0X1BA: Debounce=false
      NTCNR_0X1BB: Debounce=false
      NTCNR_0X1BC: Debounce=false
      NTCNR_0X1BD: Debounce=false
      NTCNR_0X1BE: Debounce=false
      NTCNR_0X1BF: Debounce=false
      NTCNR_0X1C{0..9}: Debounce=false
      NTCNR_0X1CA: Debounce=false
      NTCNR_0X1CB: Debounce=false
      NTCNR_0X1CC: Debounce=false
      NTCNR_0X1CD: Debounce=false
      NTCNR_0X1CE: Debounce=false
      NTCNR_0X1CF: Debounce=false
      NTCNR_0X1D{6..9}: Debounce=false
      NTCNR_0X1DA: Debounce=false
      NTCNR_0X048: Debounce=false
      NTCNR_0X0EA: Debounce=true
      NTCNR_0X10F: Debounce=false
      NTCNR_0X110: Debounce=false
      NTCNR_0X111: Debounce=false
      NTCNR_0X116: Debounce=false
      NTCNR_0X11A: Debounce=false
      NTCNR_0X11B: Debounce=false
      NTCNR_0X12E: Debounce=false
      NTCNR_0X141: Debounce=false
      NTCNR_0X142: Debounce=false
      NTCNR_0X14A: Debounce=false
      NTCNR_0X14B: Debounce=false
      NTCNR_0X14C: Debounce=false
      NTCNR_0X151: Debounce=false
      NTCNR_0X17F: Debounce=false
      NTCNR_0X133: Debounce=false
      NTCNR_0X18F: Debounce=false
      NTCNR_0X1A{4..9}: Debounce=false
      NTCNR_0X1AA: Debounce=false
      NTCNR_0X15A: Debounce=false
      NTCNR_0X15B: Debounce=false
      NTCNR_0X15C: Debounce=false
      NTCNR_0X15D: Debounce=false
      NTCNR_0X15E: Debounce=false
      NTCNR_0X15F: Debounce=false
      NTCNR_0X0E8: Debounce=false
      NTCNR_0X{105..109}: Debounce=false
      NTCNR_0X191: Debounce=false
      NTCNR_0X18D: Debounce=false
      NTCNR_0X18E: Debounce=false
