AUTOSAR XML (schema 4-2-1)
package /ActiveEcuC
  module config HwTq10Meas: implementation-config-variant=VARIANT-PRE-COMPILE
    HwTq10MeasGeneral: NTC_HwTq10MfgFlt=NTCNR_0X1E3, NTC_HwTq10PrtclFlt=NTCNR_0X079
