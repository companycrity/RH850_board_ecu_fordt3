AUTOSAR XML (schema 4-0-3)
package /ComponentTypes
  complex device driver sw component type CDD_ClkCfgAndMon
    behavior CDD_ClkCfgAndMon_InternalBehavior
      timing event CDD_ClkCfgAndMon_InitEvent: start-on-event=ClkCfgAndMonInit1, period=0
      runnable ClkCfgAndMonInit1
  swc implementation CDD_ClkCfgAndMon_Implementation: behavior=CDD_ClkCfgAndMon_InternalBehavior
    code-descriptors:
      code Default: artifact-descriptors=autosar-engineering-object={short-label=Default, category=SWSRC}
