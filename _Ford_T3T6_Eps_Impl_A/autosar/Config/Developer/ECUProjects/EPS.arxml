[part 2 of 2: packages /ECUCompositionTypes to /VehicleProject]
AUTOSAR XML (schema 4-0-3)
package /ECUCompositionTypes  (continued)
  composition sw component type ECU_Composition  (continued)
    connect CalRegn02Rt00GroupA.InertiaCmpVelDampgFilFrq -> InertiaCmpVel.InertiaCmpVelDampgFilFrq
    connect CalRegn02Rt00GroupA.InertiaCmpVelDampgFilFrqWhlImbRejctnOn -> InertiaCmpVel.InertiaCmpVelDampgFilFrqWhlImbRejctnOn
    connect CalRegn02Rt00GroupA.InertiaCmpVelDampgSpdBlndY -> InertiaCmpVel.InertiaCmpVelDampgSpdBlndY
    connect CalRegn02Rt00GroupA.InertiaCmpVelDampgWhlImbRejctnBlndX -> InertiaCmpVel.InertiaCmpVelDampgWhlImbRejctnBlndX
    connect CalRegn02Rt00GroupA.InertiaCmpVelDampgWhlImbRejctnBlndY -> InertiaCmpVel.InertiaCmpVelDampgWhlImbRejctnBlndY
    connect CalRegn02Rt00GroupB.EotProtnDampgVehSpdTbl -> AAACalRegn02Rt00GroupB_Dummy.EotProtnDampgVehSpdTbl
    connect CalRegn02Rt00GroupB.EotProtnDeltaTqThd -> AAACalRegn02Rt00GroupB_Dummy.EotProtnDeltaTqThd
    connect CalRegn02Rt00GroupB.EotProtnEntrGainVehSpdTbl -> AAACalRegn02Rt00GroupB_Dummy.EotProtnEntrGainVehSpdTbl
    connect CalRegn02Rt00GroupB.EotProtnEntrGainY -> AAACalRegn02Rt00GroupB_Dummy.EotProtnEntrGainY
    connect CalRegn02Rt00GroupB.EotProtnLoAuthyEntrGainY -> AAACalRegn02Rt00GroupB_Dummy.EotProtnLoAuthyEntrGainY
    connect CalRegn02Rt00GroupB.EotProtnMotSpdIncptY -> AAACalRegn02Rt00GroupB_Dummy.EotProtnMotSpdIncptY
    connect CalRegn02Rt00GroupB.EotProtnNormDampgY -> AAACalRegn02Rt00GroupB_Dummy.EotProtnNormDampgY
    connect CalRegn02Rt00GroupB.EotProtnSoftEndStopAuthyThd -> AAACalRegn02Rt00GroupB_Dummy.EotProtnSoftEndStopAuthyThd
    connect CalRegn02Rt00GroupB.RtnHwAgOffsCalcdX -> AAACalRegn02Rt00GroupB_Dummy.RtnHwAgOffsCalcdX
    connect CalRegn02Rt00GroupB.RtnHwAgOffsCalcdY -> AAACalRegn02Rt00GroupB_Dummy.RtnHwAgOffsCalcdY
    connect CalRegn02Rt00GroupB.RtnScaTqX -> AAACalRegn02Rt00GroupB_Dummy.RtnScaTqX
    connect CalRegn02Rt00GroupB.RtnScaTqY -> AAACalRegn02Rt00GroupB_Dummy.RtnScaTqY
    connect CalRegn02Rt00GroupB.RtnScaVelX -> AAACalRegn02Rt00GroupB_Dummy.RtnScaVelX
    connect CalRegn02Rt00GroupB.RtnScaVelY -> AAACalRegn02Rt00GroupB_Dummy.RtnScaVelY
    connect CalRegn02Rt00GroupB.RtnVehSpdSeln -> AAACalRegn02Rt00GroupB_Dummy.RtnVehSpdSeln
    connect CalRegn02Rt00GroupB.EotProtnDampgVehSpdTbl -> EotProtn.EotProtnDampgVehSpdTbl
    connect CalRegn02Rt00GroupB.EotProtnDeltaTqThd -> EotProtn.EotProtnDeltaTqThd
    connect CalRegn02Rt00GroupB.EotProtnEntrGainVehSpdTbl -> EotProtn.EotProtnEntrGainVehSpdTbl
    connect CalRegn02Rt00GroupB.EotProtnEntrGainY -> EotProtn.EotProtnEntrGainY
    connect CalRegn02Rt00GroupB.EotProtnLoAuthyEntrGainY -> EotProtn.EotProtnLoAuthyEntrGainY
    connect CalRegn02Rt00GroupB.EotProtnMotSpdIncptY -> EotProtn.EotProtnMotSpdIncptY
    connect CalRegn02Rt00GroupB.EotProtnNormDampgY -> EotProtn.EotProtnNormDampgY
    connect CalRegn02Rt00GroupB.EotProtnSoftEndStopAuthyThd -> EotProtn.EotProtnSoftEndStopAuthyThd
    connect CalRegn02Rt00GroupB.EotProtnSoftEndStopAuthyThd -> EotProtnFwl.EotProtnSoftEndStopAuthyThd
    connect CalRegn02Rt00GroupB.RtnHwAgOffsCalcdX -> Rtn.RtnHwAgOffsCalcdX
    connect CalRegn02Rt00GroupB.RtnHwAgOffsCalcdY -> Rtn.RtnHwAgOffsCalcdY
    connect CalRegn02Rt00GroupB.RtnScaTqX -> Rtn.RtnScaTqX
    connect CalRegn02Rt00GroupB.RtnScaTqY -> Rtn.RtnScaTqY
    connect CalRegn02Rt00GroupB.RtnScaVelX -> Rtn.RtnScaVelX
    connect CalRegn02Rt00GroupB.RtnScaVelY -> Rtn.RtnScaVelY
    connect CalRegn02Rt00GroupB.RtnVehSpdSeln -> Rtn.RtnVehSpdSeln
    connect CalRegn02Rt01GroupA.AssiHiFrqGainY -> AAACalRegn02Rt01GroupA_Dummy.AssiHiFrqGainY
    connect CalRegn02Rt01GroupA.AssiHiFrqHpFilFrqY -> AAACalRegn02Rt01GroupA_Dummy.AssiHiFrqHpFilFrqY
    connect CalRegn02Rt01GroupA.AssiHiFrqTqWhlImbRejctnTqX -> AAACalRegn02Rt01GroupA_Dummy.AssiHiFrqTqWhlImbRejctnTqX
    connect CalRegn02Rt01GroupA.AssiHiFrqTqX -> AAACalRegn02Rt01GroupA_Dummy.AssiHiFrqTqX
    connect CalRegn02Rt01GroupA.AssiHiFrqWhlImbRejctnBlndX -> AAACalRegn02Rt01GroupA_Dummy.AssiHiFrqWhlImbRejctnBlndX
    connect CalRegn02Rt01GroupA.AssiHiFrqWhlImbRejctnBlndY -> AAACalRegn02Rt01GroupA_Dummy.AssiHiFrqWhlImbRejctnBlndY
    connect CalRegn02Rt01GroupA.AssiHiFrqWhlImbRejctnGainY -> AAACalRegn02Rt01GroupA_Dummy.AssiHiFrqWhlImbRejctnGainY
    connect CalRegn02Rt01GroupA.AssiMotTqWhlImbRejctnMaxX -> AAACalRegn02Rt01GroupA_Dummy.AssiMotTqWhlImbRejctnMaxX
    connect CalRegn02Rt01GroupA.AssiMotTqWhlImbRejctnMaxY -> AAACalRegn02Rt01GroupA_Dummy.AssiMotTqWhlImbRejctnMaxY
    connect CalRegn02Rt01GroupA.AssiMotTqWhlImbRejctnMinX -> AAACalRegn02Rt01GroupA_Dummy.AssiMotTqWhlImbRejctnMinX
    connect CalRegn02Rt01GroupA.AssiMotTqWhlImbRejctnMinY -> AAACalRegn02Rt01GroupA_Dummy.AssiMotTqWhlImbRejctnMinY
    connect CalRegn02Rt01GroupA.AssiWhlImbRejctnBlndScaX -> AAACalRegn02Rt01GroupA_Dummy.AssiWhlImbRejctnBlndScaX
    connect CalRegn02Rt01GroupA.AssiWhlImbRejctnBlndScaY -> AAACalRegn02Rt01GroupA_Dummy.AssiWhlImbRejctnBlndScaY
    connect CalRegn02Rt01GroupA.DampgHwTqX -> AAACalRegn02Rt01GroupA_Dummy.DampgHwTqX
    connect CalRegn02Rt01GroupA.DampgHwTqY -> AAACalRegn02Rt01GroupA_Dummy.DampgHwTqY
    connect CalRegn02Rt01GroupA.DampgHydCoeff{1..4}ScaY -> AAACalRegn02Rt01GroupA_Dummy.DampgHydCoeff{1..4}ScaY
    connect CalRegn02Rt01GroupA.DampgMotVelX -> AAACalRegn02Rt01GroupA_Dummy.DampgMotVelX
    connect CalRegn02Rt01GroupA.DampgMotVelY -> AAACalRegn02Rt01GroupA_Dummy.DampgMotVelY
    connect CalRegn02Rt01GroupA.HysCmpEffLossY -> AAACalRegn02Rt01GroupA_Dummy.HysCmpEffLossY
    connect CalRegn02Rt01GroupA.HysCmpEffOffsY -> AAACalRegn02Rt01GroupA_Dummy.HysCmpEffOffsY
    connect CalRegn02Rt01GroupA.HysCmpFricWhlImbRejctnBlndX -> AAACalRegn02Rt01GroupA_Dummy.HysCmpFricWhlImbRejctnBlndX
    connect CalRegn02Rt01GroupA.HysCmpFricWhlImbRejctnBlndY -> AAACalRegn02Rt01GroupA_Dummy.HysCmpFricWhlImbRejctnBlndY
    connect CalRegn02Rt01GroupA.HysCmpFricWhlImbRejctnOffY -> AAACalRegn02Rt01GroupA_Dummy.HysCmpFricWhlImbRejctnOffY
    connect CalRegn02Rt01GroupA.HysCmpFricWhlImbRejctnOnY -> AAACalRegn02Rt01GroupA_Dummy.HysCmpFricWhlImbRejctnOnY
    connect CalRegn02Rt01GroupA.HysCmpHwTqScaX -> AAACalRegn02Rt01GroupA_Dummy.HysCmpHwTqScaX
    connect CalRegn02Rt01GroupA.HysCmpHwTqScaY -> AAACalRegn02Rt01GroupA_Dummy.HysCmpHwTqScaY
    connect CalRegn02Rt01GroupA.HysCmpHysSatnY -> AAACalRegn02Rt01GroupA_Dummy.HysCmpHysSatnY
    connect CalRegn02Rt01GroupA.HysCmpNegHysCmpScaX -> AAACalRegn02Rt01GroupA_Dummy.HysCmpNegHysCmpScaX
    connect CalRegn02Rt01GroupA.HysCmpNegHysCmpScaY -> AAACalRegn02Rt01GroupA_Dummy.HysCmpNegHysCmpScaY
    connect CalRegn02Rt01GroupA.HysCmpNegHysCmpX -> AAACalRegn02Rt01GroupA_Dummy.HysCmpNegHysCmpX
    connect CalRegn02Rt01GroupA.HysCmpNegHysCmpY -> AAACalRegn02Rt01GroupA_Dummy.HysCmpNegHysCmpY
    connect CalRegn02Rt01GroupA.HysCmpOutpLim -> AAACalRegn02Rt01GroupA_Dummy.HysCmpOutpLim
    connect CalRegn02Rt01GroupA.HysCmpRevGain -> AAACalRegn02Rt01GroupA_Dummy.HysCmpRevGain
    connect CalRegn02Rt01GroupA.HysCmpRiseX -> AAACalRegn02Rt01GroupA_Dummy.HysCmpRiseX
    connect CalRegn02Rt01GroupA.HysCmpRiseY -> AAACalRegn02Rt01GroupA_Dummy.HysCmpRiseY
    connect CalRegn02Rt01GroupA.InertiaCmpVelAssiBasdDampgStatY -> AAACalRegn02Rt01GroupA_Dummy.InertiaCmpVelAssiBasdDampgStatY
    connect CalRegn02Rt01GroupA.InertiaCmpVelDampgFilFrq -> AAACalRegn02Rt01GroupA_Dummy.InertiaCmpVelDampgFilFrq
    connect CalRegn02Rt01GroupA.InertiaCmpVelDampgFilFrqWhlImbRejctnOn -> AAACalRegn02Rt01GroupA_Dummy.InertiaCmpVelDampgFilFrqWhlImbRejctnOn
    connect CalRegn02Rt01GroupA.InertiaCmpVelDampgSpdBlndY -> AAACalRegn02Rt01GroupA_Dummy.InertiaCmpVelDampgSpdBlndY
    connect CalRegn02Rt01GroupA.InertiaCmpVelDampgWhlImbRejctnBlndX -> AAACalRegn02Rt01GroupA_Dummy.InertiaCmpVelDampgWhlImbRejctnBlndX
    connect CalRegn02Rt01GroupA.InertiaCmpVelDampgWhlImbRejctnBlndY -> AAACalRegn02Rt01GroupA_Dummy.InertiaCmpVelDampgWhlImbRejctnBlndY
    connect CalRegn02Rt01GroupB.EotProtnDampgVehSpdTbl -> AAACalRegn02Rt01GroupB_Dummy.EotProtnDampgVehSpdTbl
    connect CalRegn02Rt01GroupB.EotProtnDeltaTqThd -> AAACalRegn02Rt01GroupB_Dummy.EotProtnDeltaTqThd
    connect CalRegn02Rt01GroupB.EotProtnEntrGainVehSpdTbl -> AAACalRegn02Rt01GroupB_Dummy.EotProtnEntrGainVehSpdTbl
    connect CalRegn02Rt01GroupB.EotProtnEntrGainY -> AAACalRegn02Rt01GroupB_Dummy.EotProtnEntrGainY
    connect CalRegn02Rt01GroupB.EotProtnLoAuthyEntrGainY -> AAACalRegn02Rt01GroupB_Dummy.EotProtnLoAuthyEntrGainY
    connect CalRegn02Rt01GroupB.EotProtnMotSpdIncptY -> AAACalRegn02Rt01GroupB_Dummy.EotProtnMotSpdIncptY
    connect CalRegn02Rt01GroupB.EotProtnNormDampgY -> AAACalRegn02Rt01GroupB_Dummy.EotProtnNormDampgY
    connect CalRegn02Rt01GroupB.EotProtnSoftEndStopAuthyThd -> AAACalRegn02Rt01GroupB_Dummy.EotProtnSoftEndStopAuthyThd
    connect CalRegn02Rt01GroupB.RtnHwAgOffsCalcdX -> AAACalRegn02Rt01GroupB_Dummy.RtnHwAgOffsCalcdX
    connect CalRegn02Rt01GroupB.RtnHwAgOffsCalcdY -> AAACalRegn02Rt01GroupB_Dummy.RtnHwAgOffsCalcdY
    connect CalRegn02Rt01GroupB.RtnScaTqX -> AAACalRegn02Rt01GroupB_Dummy.RtnScaTqX
    connect CalRegn02Rt01GroupB.RtnScaTqY -> AAACalRegn02Rt01GroupB_Dummy.RtnScaTqY
    connect CalRegn02Rt01GroupB.RtnScaVelX -> AAACalRegn02Rt01GroupB_Dummy.RtnScaVelX
    connect CalRegn02Rt01GroupB.RtnScaVelY -> AAACalRegn02Rt01GroupB_Dummy.RtnScaVelY
    connect CalRegn02Rt01GroupB.RtnVehSpdSeln -> AAACalRegn02Rt01GroupB_Dummy.RtnVehSpdSeln
    connect CalRegn02Rt02GroupA.AssiHiFrqGainY -> AAACalRegn02Rt02GroupA_Dummy.AssiHiFrqGainY
    connect CalRegn02Rt02GroupA.AssiHiFrqHpFilFrqY -> AAACalRegn02Rt02GroupA_Dummy.AssiHiFrqHpFilFrqY
    connect CalRegn02Rt02GroupA.AssiHiFrqTqWhlImbRejctnTqX -> AAACalRegn02Rt02GroupA_Dummy.AssiHiFrqTqWhlImbRejctnTqX
    connect CalRegn02Rt02GroupA.AssiHiFrqTqX -> AAACalRegn02Rt02GroupA_Dummy.AssiHiFrqTqX
    connect CalRegn02Rt02GroupA.AssiHiFrqWhlImbRejctnBlndX -> AAACalRegn02Rt02GroupA_Dummy.AssiHiFrqWhlImbRejctnBlndX
    connect CalRegn02Rt02GroupA.AssiHiFrqWhlImbRejctnBlndY -> AAACalRegn02Rt02GroupA_Dummy.AssiHiFrqWhlImbRejctnBlndY
    connect CalRegn02Rt02GroupA.AssiHiFrqWhlImbRejctnGainY -> AAACalRegn02Rt02GroupA_Dummy.AssiHiFrqWhlImbRejctnGainY
    connect CalRegn02Rt02GroupA.AssiMotTqWhlImbRejctnMaxX -> AAACalRegn02Rt02GroupA_Dummy.AssiMotTqWhlImbRejctnMaxX
    connect CalRegn02Rt02GroupA.AssiMotTqWhlImbRejctnMaxY -> AAACalRegn02Rt02GroupA_Dummy.AssiMotTqWhlImbRejctnMaxY
    connect CalRegn02Rt02GroupA.AssiMotTqWhlImbRejctnMinX -> AAACalRegn02Rt02GroupA_Dummy.AssiMotTqWhlImbRejctnMinX
    connect CalRegn02Rt02GroupA.AssiMotTqWhlImbRejctnMinY -> AAACalRegn02Rt02GroupA_Dummy.AssiMotTqWhlImbRejctnMinY
    connect CalRegn02Rt02GroupA.AssiWhlImbRejctnBlndScaX -> AAACalRegn02Rt02GroupA_Dummy.AssiWhlImbRejctnBlndScaX
    connect CalRegn02Rt02GroupA.AssiWhlImbRejctnBlndScaY -> AAACalRegn02Rt02GroupA_Dummy.AssiWhlImbRejctnBlndScaY
    connect CalRegn02Rt02GroupA.DampgHwTqX -> AAACalRegn02Rt02GroupA_Dummy.DampgHwTqX
    connect CalRegn02Rt02GroupA.DampgHwTqY -> AAACalRegn02Rt02GroupA_Dummy.DampgHwTqY
    connect CalRegn02Rt02GroupA.DampgHydCoeff{1..4}ScaY -> AAACalRegn02Rt02GroupA_Dummy.DampgHydCoeff{1..4}ScaY
    connect CalRegn02Rt02GroupA.DampgMotVelX -> AAACalRegn02Rt02GroupA_Dummy.DampgMotVelX
    connect CalRegn02Rt02GroupA.DampgMotVelY -> AAACalRegn02Rt02GroupA_Dummy.DampgMotVelY
    connect CalRegn02Rt02GroupA.HysCmpEffLossY -> AAACalRegn02Rt02GroupA_Dummy.HysCmpEffLossY
    connect CalRegn02Rt02GroupA.HysCmpEffOffsY -> AAACalRegn02Rt02GroupA_Dummy.HysCmpEffOffsY
    connect CalRegn02Rt02GroupA.HysCmpFricWhlImbRejctnBlndX -> AAACalRegn02Rt02GroupA_Dummy.HysCmpFricWhlImbRejctnBlndX
    connect CalRegn02Rt02GroupA.HysCmpFricWhlImbRejctnBlndY -> AAACalRegn02Rt02GroupA_Dummy.HysCmpFricWhlImbRejctnBlndY
    connect CalRegn02Rt02GroupA.HysCmpFricWhlImbRejctnOffY -> AAACalRegn02Rt02GroupA_Dummy.HysCmpFricWhlImbRejctnOffY
    connect CalRegn02Rt02GroupA.HysCmpFricWhlImbRejctnOnY -> AAACalRegn02Rt02GroupA_Dummy.HysCmpFricWhlImbRejctnOnY
    connect CalRegn02Rt02GroupA.HysCmpHwTqScaX -> AAACalRegn02Rt02GroupA_Dummy.HysCmpHwTqScaX
    connect CalRegn02Rt02GroupA.HysCmpHwTqScaY -> AAACalRegn02Rt02GroupA_Dummy.HysCmpHwTqScaY
    connect CalRegn02Rt02GroupA.HysCmpHysSatnY -> AAACalRegn02Rt02GroupA_Dummy.HysCmpHysSatnY
    connect CalRegn02Rt02GroupA.HysCmpNegHysCmpScaX -> AAACalRegn02Rt02GroupA_Dummy.HysCmpNegHysCmpScaX
    connect CalRegn02Rt02GroupA.HysCmpNegHysCmpScaY -> AAACalRegn02Rt02GroupA_Dummy.HysCmpNegHysCmpScaY
    connect CalRegn02Rt02GroupA.HysCmpNegHysCmpX -> AAACalRegn02Rt02GroupA_Dummy.HysCmpNegHysCmpX
    connect CalRegn02Rt02GroupA.HysCmpNegHysCmpY -> AAACalRegn02Rt02GroupA_Dummy.HysCmpNegHysCmpY
    connect CalRegn02Rt02GroupA.HysCmpOutpLim -> AAACalRegn02Rt02GroupA_Dummy.HysCmpOutpLim
    connect CalRegn02Rt02GroupA.HysCmpRevGain -> AAACalRegn02Rt02GroupA_Dummy.HysCmpRevGain
    connect CalRegn02Rt02GroupA.HysCmpRiseX -> AAACalRegn02Rt02GroupA_Dummy.HysCmpRiseX
    connect CalRegn02Rt02GroupA.HysCmpRiseY -> AAACalRegn02Rt02GroupA_Dummy.HysCmpRiseY
    connect CalRegn02Rt02GroupA.InertiaCmpVelAssiBasdDampgStatY -> AAACalRegn02Rt02GroupA_Dummy.InertiaCmpVelAssiBasdDampgStatY
    connect CalRegn02Rt02GroupA.InertiaCmpVelDampgFilFrq -> AAACalRegn02Rt02GroupA_Dummy.InertiaCmpVelDampgFilFrq
    connect CalRegn02Rt02GroupA.InertiaCmpVelDampgFilFrqWhlImbRejctnOn -> AAACalRegn02Rt02GroupA_Dummy.InertiaCmpVelDampgFilFrqWhlImbRejctnOn
    connect CalRegn02Rt02GroupA.InertiaCmpVelDampgSpdBlndY -> AAACalRegn02Rt02GroupA_Dummy.InertiaCmpVelDampgSpdBlndY
    connect CalRegn02Rt02GroupA.InertiaCmpVelDampgWhlImbRejctnBlndX -> AAACalRegn02Rt02GroupA_Dummy.InertiaCmpVelDampgWhlImbRejctnBlndX
    connect CalRegn02Rt02GroupA.InertiaCmpVelDampgWhlImbRejctnBlndY -> AAACalRegn02Rt02GroupA_Dummy.InertiaCmpVelDampgWhlImbRejctnBlndY
    connect CalRegn02Rt02GroupB.EotProtnDampgVehSpdTbl -> AAACalRegn02Rt02GroupB_Dummy.EotProtnDampgVehSpdTbl
    connect CalRegn02Rt02GroupB.EotProtnDeltaTqThd -> AAACalRegn02Rt02GroupB_Dummy.EotProtnDeltaTqThd
    connect CalRegn02Rt02GroupB.EotProtnEntrGainVehSpdTbl -> AAACalRegn02Rt02GroupB_Dummy.EotProtnEntrGainVehSpdTbl
    connect CalRegn02Rt02GroupB.EotProtnEntrGainY -> AAACalRegn02Rt02GroupB_Dummy.EotProtnEntrGainY
    connect CalRegn02Rt02GroupB.EotProtnLoAuthyEntrGainY -> AAACalRegn02Rt02GroupB_Dummy.EotProtnLoAuthyEntrGainY
    connect CalRegn02Rt02GroupB.EotProtnMotSpdIncptY -> AAACalRegn02Rt02GroupB_Dummy.EotProtnMotSpdIncptY
    connect CalRegn02Rt02GroupB.EotProtnNormDampgY -> AAACalRegn02Rt02GroupB_Dummy.EotProtnNormDampgY
    connect CalRegn02Rt02GroupB.EotProtnSoftEndStopAuthyThd -> AAACalRegn02Rt02GroupB_Dummy.EotProtnSoftEndStopAuthyThd
    connect CalRegn02Rt02GroupB.RtnHwAgOffsCalcdX -> AAACalRegn02Rt02GroupB_Dummy.RtnHwAgOffsCalcdX
    connect CalRegn02Rt02GroupB.RtnHwAgOffsCalcdY -> AAACalRegn02Rt02GroupB_Dummy.RtnHwAgOffsCalcdY
    connect CalRegn02Rt02GroupB.RtnScaTqX -> AAACalRegn02Rt02GroupB_Dummy.RtnScaTqX
    connect CalRegn02Rt02GroupB.RtnScaTqY -> AAACalRegn02Rt02GroupB_Dummy.RtnScaTqY
    connect CalRegn02Rt02GroupB.RtnScaVelX -> AAACalRegn02Rt02GroupB_Dummy.RtnScaVelX
    connect CalRegn02Rt02GroupB.RtnScaVelY -> AAACalRegn02Rt02GroupB_Dummy.RtnScaVelY
    connect CalRegn02Rt02GroupB.RtnVehSpdSeln -> AAACalRegn02Rt02GroupB_Dummy.RtnVehSpdSeln
    connect CalRegn02Rt03GroupA.AssiHiFrqGainY -> AAACalRegn02Rt03GroupA_Dummy.AssiHiFrqGainY
    connect CalRegn02Rt03GroupA.AssiHiFrqHpFilFrqY -> AAACalRegn02Rt03GroupA_Dummy.AssiHiFrqHpFilFrqY
    connect CalRegn02Rt03GroupA.AssiHiFrqTqWhlImbRejctnTqX -> AAACalRegn02Rt03GroupA_Dummy.AssiHiFrqTqWhlImbRejctnTqX
    connect CalRegn02Rt03GroupA.AssiHiFrqTqX -> AAACalRegn02Rt03GroupA_Dummy.AssiHiFrqTqX
    connect CalRegn02Rt03GroupA.AssiHiFrqWhlImbRejctnBlndX -> AAACalRegn02Rt03GroupA_Dummy.AssiHiFrqWhlImbRejctnBlndX
    connect CalRegn02Rt03GroupA.AssiHiFrqWhlImbRejctnBlndY -> AAACalRegn02Rt03GroupA_Dummy.AssiHiFrqWhlImbRejctnBlndY
    connect CalRegn02Rt03GroupA.AssiHiFrqWhlImbRejctnGainY -> AAACalRegn02Rt03GroupA_Dummy.AssiHiFrqWhlImbRejctnGainY
    connect CalRegn02Rt03GroupA.AssiMotTqWhlImbRejctnMaxX -> AAACalRegn02Rt03GroupA_Dummy.AssiMotTqWhlImbRejctnMaxX
    connect CalRegn02Rt03GroupA.AssiMotTqWhlImbRejctnMaxY -> AAACalRegn02Rt03GroupA_Dummy.AssiMotTqWhlImbRejctnMaxY
    connect CalRegn02Rt03GroupA.AssiMotTqWhlImbRejctnMinX -> AAACalRegn02Rt03GroupA_Dummy.AssiMotTqWhlImbRejctnMinX
    connect CalRegn02Rt03GroupA.AssiMotTqWhlImbRejctnMinY -> AAACalRegn02Rt03GroupA_Dummy.AssiMotTqWhlImbRejctnMinY
    connect CalRegn02Rt03GroupA.AssiWhlImbRejctnBlndScaX -> AAACalRegn02Rt03GroupA_Dummy.AssiWhlImbRejctnBlndScaX
    connect CalRegn02Rt03GroupA.AssiWhlImbRejctnBlndScaY -> AAACalRegn02Rt03GroupA_Dummy.AssiWhlImbRejctnBlndScaY
    connect CalRegn02Rt03GroupA.DampgHwTqX -> AAACalRegn02Rt03GroupA_Dummy.DampgHwTqX
    connect CalRegn02Rt03GroupA.DampgHwTqY -> AAACalRegn02Rt03GroupA_Dummy.DampgHwTqY
    connect CalRegn02Rt03GroupA.DampgHydCoeff{1..4}ScaY -> AAACalRegn02Rt03GroupA_Dummy.DampgHydCoeff{1..4}ScaY
    connect CalRegn02Rt03GroupA.DampgMotVelX -> AAACalRegn02Rt03GroupA_Dummy.DampgMotVelX
    connect CalRegn02Rt03GroupA.DampgMotVelY -> AAACalRegn02Rt03GroupA_Dummy.DampgMotVelY
    connect CalRegn02Rt03GroupA.HysCmpEffLossY -> AAACalRegn02Rt03GroupA_Dummy.HysCmpEffLossY
    connect CalRegn02Rt03GroupA.HysCmpEffOffsY -> AAACalRegn02Rt03GroupA_Dummy.HysCmpEffOffsY
    connect CalRegn02Rt03GroupA.HysCmpFricWhlImbRejctnBlndX -> AAACalRegn02Rt03GroupA_Dummy.HysCmpFricWhlImbRejctnBlndX
    connect CalRegn02Rt03GroupA.HysCmpFricWhlImbRejctnBlndY -> AAACalRegn02Rt03GroupA_Dummy.HysCmpFricWhlImbRejctnBlndY
    connect CalRegn02Rt03GroupA.HysCmpFricWhlImbRejctnOffY -> AAACalRegn02Rt03GroupA_Dummy.HysCmpFricWhlImbRejctnOffY
    connect CalRegn02Rt03GroupA.HysCmpFricWhlImbRejctnOnY -> AAACalRegn02Rt03GroupA_Dummy.HysCmpFricWhlImbRejctnOnY
    connect CalRegn02Rt03GroupA.HysCmpHwTqScaX -> AAACalRegn02Rt03GroupA_Dummy.HysCmpHwTqScaX
    connect CalRegn02Rt03GroupA.HysCmpHwTqScaY -> AAACalRegn02Rt03GroupA_Dummy.HysCmpHwTqScaY
    connect CalRegn02Rt03GroupA.HysCmpHysSatnY -> AAACalRegn02Rt03GroupA_Dummy.HysCmpHysSatnY
    connect CalRegn02Rt03GroupA.HysCmpNegHysCmpScaX -> AAACalRegn02Rt03GroupA_Dummy.HysCmpNegHysCmpScaX
    connect CalRegn02Rt03GroupA.HysCmpNegHysCmpScaY -> AAACalRegn02Rt03GroupA_Dummy.HysCmpNegHysCmpScaY
    connect CalRegn02Rt03GroupA.HysCmpNegHysCmpX -> AAACalRegn02Rt03GroupA_Dummy.HysCmpNegHysCmpX
    connect CalRegn02Rt03GroupA.HysCmpNegHysCmpY -> AAACalRegn02Rt03GroupA_Dummy.HysCmpNegHysCmpY
    connect CalRegn02Rt03GroupA.HysCmpOutpLim -> AAACalRegn02Rt03GroupA_Dummy.HysCmpOutpLim
    connect CalRegn02Rt03GroupA.HysCmpRevGain -> AAACalRegn02Rt03GroupA_Dummy.HysCmpRevGain
    connect CalRegn02Rt03GroupA.HysCmpRiseX -> AAACalRegn02Rt03GroupA_Dummy.HysCmpRiseX
    connect CalRegn02Rt03GroupA.HysCmpRiseY -> AAACalRegn02Rt03GroupA_Dummy.HysCmpRiseY
    connect CalRegn02Rt03GroupA.InertiaCmpVelAssiBasdDampgStatY -> AAACalRegn02Rt03GroupA_Dummy.InertiaCmpVelAssiBasdDampgStatY
    connect CalRegn02Rt03GroupA.InertiaCmpVelDampgFilFrq -> AAACalRegn02Rt03GroupA_Dummy.InertiaCmpVelDampgFilFrq
    connect CalRegn02Rt03GroupA.InertiaCmpVelDampgFilFrqWhlImbRejctnOn -> AAACalRegn02Rt03GroupA_Dummy.InertiaCmpVelDampgFilFrqWhlImbRejctnOn
    connect CalRegn02Rt03GroupA.InertiaCmpVelDampgSpdBlndY -> AAACalRegn02Rt03GroupA_Dummy.InertiaCmpVelDampgSpdBlndY
    connect CalRegn02Rt03GroupA.InertiaCmpVelDampgWhlImbRejctnBlndX -> AAACalRegn02Rt03GroupA_Dummy.InertiaCmpVelDampgWhlImbRejctnBlndX
    connect CalRegn02Rt03GroupA.InertiaCmpVelDampgWhlImbRejctnBlndY -> AAACalRegn02Rt03GroupA_Dummy.InertiaCmpVelDampgWhlImbRejctnBlndY
    connect CalRegn02Rt03GroupB.EotProtnDampgVehSpdTbl -> AAACalRegn02Rt03GroupB_Dummy.EotProtnDampgVehSpdTbl
    connect CalRegn02Rt03GroupB.EotProtnDeltaTqThd -> AAACalRegn02Rt03GroupB_Dummy.EotProtnDeltaTqThd
    connect CalRegn02Rt03GroupB.EotProtnEntrGainVehSpdTbl -> AAACalRegn02Rt03GroupB_Dummy.EotProtnEntrGainVehSpdTbl
    connect CalRegn02Rt03GroupB.EotProtnEntrGainY -> AAACalRegn02Rt03GroupB_Dummy.EotProtnEntrGainY
    connect CalRegn02Rt03GroupB.EotProtnLoAuthyEntrGainY -> AAACalRegn02Rt03GroupB_Dummy.EotProtnLoAuthyEntrGainY
    connect CalRegn02Rt03GroupB.EotProtnMotSpdIncptY -> AAACalRegn02Rt03GroupB_Dummy.EotProtnMotSpdIncptY
    connect CalRegn02Rt03GroupB.EotProtnNormDampgY -> AAACalRegn02Rt03GroupB_Dummy.EotProtnNormDampgY
    connect CalRegn02Rt03GroupB.EotProtnSoftEndStopAuthyThd -> AAACalRegn02Rt03GroupB_Dummy.EotProtnSoftEndStopAuthyThd
    connect CalRegn02Rt03GroupB.RtnHwAgOffsCalcdX -> AAACalRegn02Rt03GroupB_Dummy.RtnHwAgOffsCalcdX
    connect CalRegn02Rt03GroupB.RtnHwAgOffsCalcdY -> AAACalRegn02Rt03GroupB_Dummy.RtnHwAgOffsCalcdY
    connect CalRegn02Rt03GroupB.RtnScaTqX -> AAACalRegn02Rt03GroupB_Dummy.RtnScaTqX
    connect CalRegn02Rt03GroupB.RtnScaTqY -> AAACalRegn02Rt03GroupB_Dummy.RtnScaTqY
    connect CalRegn02Rt03GroupB.RtnScaVelX -> AAACalRegn02Rt03GroupB_Dummy.RtnScaVelX
    connect CalRegn02Rt03GroupB.RtnScaVelY -> AAACalRegn02Rt03GroupB_Dummy.RtnScaVelY
    connect CalRegn02Rt03GroupB.RtnVehSpdSeln -> AAACalRegn02Rt03GroupB_Dummy.RtnVehSpdSeln
    connect CalRegn02Rt04GroupA.AssiHiFrqGainY -> AAACalRegn02Rt04GroupA_Dummy.AssiHiFrqGainY
    connect CalRegn02Rt04GroupA.AssiHiFrqHpFilFrqY -> AAACalRegn02Rt04GroupA_Dummy.AssiHiFrqHpFilFrqY
    connect CalRegn02Rt04GroupA.AssiHiFrqTqWhlImbRejctnTqX -> AAACalRegn02Rt04GroupA_Dummy.AssiHiFrqTqWhlImbRejctnTqX
    connect CalRegn02Rt04GroupA.AssiHiFrqTqX -> AAACalRegn02Rt04GroupA_Dummy.AssiHiFrqTqX
    connect CalRegn02Rt04GroupA.AssiHiFrqWhlImbRejctnBlndX -> AAACalRegn02Rt04GroupA_Dummy.AssiHiFrqWhlImbRejctnBlndX
    connect CalRegn02Rt04GroupA.AssiHiFrqWhlImbRejctnBlndY -> AAACalRegn02Rt04GroupA_Dummy.AssiHiFrqWhlImbRejctnBlndY
    connect CalRegn02Rt04GroupA.AssiHiFrqWhlImbRejctnGainY -> AAACalRegn02Rt04GroupA_Dummy.AssiHiFrqWhlImbRejctnGainY
    connect CalRegn02Rt04GroupA.AssiMotTqWhlImbRejctnMaxX -> AAACalRegn02Rt04GroupA_Dummy.AssiMotTqWhlImbRejctnMaxX
    connect CalRegn02Rt04GroupA.AssiMotTqWhlImbRejctnMaxY -> AAACalRegn02Rt04GroupA_Dummy.AssiMotTqWhlImbRejctnMaxY
    connect CalRegn02Rt04GroupA.AssiMotTqWhlImbRejctnMinX -> AAACalRegn02Rt04GroupA_Dummy.AssiMotTqWhlImbRejctnMinX
    connect CalRegn02Rt04GroupA.AssiMotTqWhlImbRejctnMinY -> AAACalRegn02Rt04GroupA_Dummy.AssiMotTqWhlImbRejctnMinY
    connect CalRegn02Rt04GroupA.AssiWhlImbRejctnBlndScaX -> AAACalRegn02Rt04GroupA_Dummy.AssiWhlImbRejctnBlndScaX
    connect CalRegn02Rt04GroupA.AssiWhlImbRejctnBlndScaY -> AAACalRegn02Rt04GroupA_Dummy.AssiWhlImbRejctnBlndScaY
    connect CalRegn02Rt04GroupA.DampgHwTqX -> AAACalRegn02Rt04GroupA_Dummy.DampgHwTqX
    connect CalRegn02Rt04GroupA.DampgHwTqY -> AAACalRegn02Rt04GroupA_Dummy.DampgHwTqY
    connect CalRegn02Rt04GroupA.DampgHydCoeff{1..4}ScaY -> AAACalRegn02Rt04GroupA_Dummy.DampgHydCoeff{1..4}ScaY
    connect CalRegn02Rt04GroupA.DampgMotVelX -> AAACalRegn02Rt04GroupA_Dummy.DampgMotVelX
    connect CalRegn02Rt04GroupA.DampgMotVelY -> AAACalRegn02Rt04GroupA_Dummy.DampgMotVelY
    connect CalRegn02Rt04GroupA.HysCmpEffLossY -> AAACalRegn02Rt04GroupA_Dummy.HysCmpEffLossY
    connect CalRegn02Rt04GroupA.HysCmpEffOffsY -> AAACalRegn02Rt04GroupA_Dummy.HysCmpEffOffsY
    connect CalRegn02Rt04GroupA.HysCmpFricWhlImbRejctnBlndX -> AAACalRegn02Rt04GroupA_Dummy.HysCmpFricWhlImbRejctnBlndX
    connect CalRegn02Rt04GroupA.HysCmpFricWhlImbRejctnBlndY -> AAACalRegn02Rt04GroupA_Dummy.HysCmpFricWhlImbRejctnBlndY
    connect CalRegn02Rt04GroupA.HysCmpFricWhlImbRejctnOffY -> AAACalRegn02Rt04GroupA_Dummy.HysCmpFricWhlImbRejctnOffY
    connect CalRegn02Rt04GroupA.HysCmpFricWhlImbRejctnOnY -> AAACalRegn02Rt04GroupA_Dummy.HysCmpFricWhlImbRejctnOnY
    connect CalRegn02Rt04GroupA.HysCmpHwTqScaX -> AAACalRegn02Rt04GroupA_Dummy.HysCmpHwTqScaX
    connect CalRegn02Rt04GroupA.HysCmpHwTqScaY -> AAACalRegn02Rt04GroupA_Dummy.HysCmpHwTqScaY
    connect CalRegn02Rt04GroupA.HysCmpHysSatnY -> AAACalRegn02Rt04GroupA_Dummy.HysCmpHysSatnY
    connect CalRegn02Rt04GroupA.HysCmpNegHysCmpScaX -> AAACalRegn02Rt04GroupA_Dummy.HysCmpNegHysCmpScaX
    connect CalRegn02Rt04GroupA.HysCmpNegHysCmpScaY -> AAACalRegn02Rt04GroupA_Dummy.HysCmpNegHysCmpScaY
    connect CalRegn02Rt04GroupA.HysCmpNegHysCmpX -> AAACalRegn02Rt04GroupA_Dummy.HysCmpNegHysCmpX
    connect CalRegn02Rt04GroupA.HysCmpNegHysCmpY -> AAACalRegn02Rt04GroupA_Dummy.HysCmpNegHysCmpY
    connect CalRegn02Rt04GroupA.HysCmpOutpLim -> AAACalRegn02Rt04GroupA_Dummy.HysCmpOutpLim
    connect CalRegn02Rt04GroupA.HysCmpRevGain -> AAACalRegn02Rt04GroupA_Dummy.HysCmpRevGain
    connect CalRegn02Rt04GroupA.HysCmpRiseX -> AAACalRegn02Rt04GroupA_Dummy.HysCmpRiseX
    connect CalRegn02Rt04GroupA.HysCmpRiseY -> AAACalRegn02Rt04GroupA_Dummy.HysCmpRiseY
    connect CalRegn02Rt04GroupA.InertiaCmpVelAssiBasdDampgStatY -> AAACalRegn02Rt04GroupA_Dummy.InertiaCmpVelAssiBasdDampgStatY
    connect CalRegn02Rt04GroupA.InertiaCmpVelDampgFilFrq -> AAACalRegn02Rt04GroupA_Dummy.InertiaCmpVelDampgFilFrq
    connect CalRegn02Rt04GroupA.InertiaCmpVelDampgFilFrqWhlImbRejctnOn -> AAACalRegn02Rt04GroupA_Dummy.InertiaCmpVelDampgFilFrqWhlImbRejctnOn
    connect CalRegn02Rt04GroupA.InertiaCmpVelDampgSpdBlndY -> AAACalRegn02Rt04GroupA_Dummy.InertiaCmpVelDampgSpdBlndY
    connect CalRegn02Rt04GroupA.InertiaCmpVelDampgWhlImbRejctnBlndX -> AAACalRegn02Rt04GroupA_Dummy.InertiaCmpVelDampgWhlImbRejctnBlndX
    connect CalRegn02Rt04GroupA.InertiaCmpVelDampgWhlImbRejctnBlndY -> AAACalRegn02Rt04GroupA_Dummy.InertiaCmpVelDampgWhlImbRejctnBlndY
    connect CalRegn02Rt04GroupB.EotProtnDampgVehSpdTbl -> AAACalRegn02Rt04GroupB_Dummy.EotProtnDampgVehSpdTbl
    connect CalRegn02Rt04GroupB.EotProtnDeltaTqThd -> AAACalRegn02Rt04GroupB_Dummy.EotProtnDeltaTqThd
    connect CalRegn02Rt04GroupB.EotProtnEntrGainVehSpdTbl -> AAACalRegn02Rt04GroupB_Dummy.EotProtnEntrGainVehSpdTbl
    connect CalRegn02Rt04GroupB.EotProtnEntrGainY -> AAACalRegn02Rt04GroupB_Dummy.EotProtnEntrGainY
    connect CalRegn02Rt04GroupB.EotProtnLoAuthyEntrGainY -> AAACalRegn02Rt04GroupB_Dummy.EotProtnLoAuthyEntrGainY
    connect CalRegn02Rt04GroupB.EotProtnMotSpdIncptY -> AAACalRegn02Rt04GroupB_Dummy.EotProtnMotSpdIncptY
    connect CalRegn02Rt04GroupB.EotProtnNormDampgY -> AAACalRegn02Rt04GroupB_Dummy.EotProtnNormDampgY
    connect CalRegn02Rt04GroupB.EotProtnSoftEndStopAuthyThd -> AAACalRegn02Rt04GroupB_Dummy.EotProtnSoftEndStopAuthyThd
    connect CalRegn02Rt04GroupB.RtnHwAgOffsCalcdX -> AAACalRegn02Rt04GroupB_Dummy.RtnHwAgOffsCalcdX
    connect CalRegn02Rt04GroupB.RtnHwAgOffsCalcdY -> AAACalRegn02Rt04GroupB_Dummy.RtnHwAgOffsCalcdY
    connect CalRegn02Rt04GroupB.RtnScaTqX -> AAACalRegn02Rt04GroupB_Dummy.RtnScaTqX
    connect CalRegn02Rt04GroupB.RtnScaTqY -> AAACalRegn02Rt04GroupB_Dummy.RtnScaTqY
    connect CalRegn02Rt04GroupB.RtnScaVelX -> AAACalRegn02Rt04GroupB_Dummy.RtnScaVelX
    connect CalRegn02Rt04GroupB.RtnScaVelY -> AAACalRegn02Rt04GroupB_Dummy.RtnScaVelY
    connect CalRegn02Rt04GroupB.RtnVehSpdSeln -> AAACalRegn02Rt04GroupB_Dummy.RtnVehSpdSeln
    connect CalRegn02Rt05GroupA.AssiHiFrqGainY -> AAACalRegn02Rt05GroupA_Dummy.AssiHiFrqGainY
    connect CalRegn02Rt05GroupA.AssiHiFrqHpFilFrqY -> AAACalRegn02Rt05GroupA_Dummy.AssiHiFrqHpFilFrqY
    connect CalRegn02Rt05GroupA.AssiHiFrqTqWhlImbRejctnTqX -> AAACalRegn02Rt05GroupA_Dummy.AssiHiFrqTqWhlImbRejctnTqX
    connect CalRegn02Rt05GroupA.AssiHiFrqTqX -> AAACalRegn02Rt05GroupA_Dummy.AssiHiFrqTqX
    connect CalRegn02Rt05GroupA.AssiHiFrqWhlImbRejctnBlndX -> AAACalRegn02Rt05GroupA_Dummy.AssiHiFrqWhlImbRejctnBlndX
    connect CalRegn02Rt05GroupA.AssiHiFrqWhlImbRejctnBlndY -> AAACalRegn02Rt05GroupA_Dummy.AssiHiFrqWhlImbRejctnBlndY
    connect CalRegn02Rt05GroupA.AssiHiFrqWhlImbRejctnGainY -> AAACalRegn02Rt05GroupA_Dummy.AssiHiFrqWhlImbRejctnGainY
    connect CalRegn02Rt05GroupA.AssiMotTqWhlImbRejctnMaxX -> AAACalRegn02Rt05GroupA_Dummy.AssiMotTqWhlImbRejctnMaxX
    connect CalRegn02Rt05GroupA.AssiMotTqWhlImbRejctnMaxY -> AAACalRegn02Rt05GroupA_Dummy.AssiMotTqWhlImbRejctnMaxY
    connect CalRegn02Rt05GroupA.AssiMotTqWhlImbRejctnMinX -> AAACalRegn02Rt05GroupA_Dummy.AssiMotTqWhlImbRejctnMinX
    connect CalRegn02Rt05GroupA.AssiMotTqWhlImbRejctnMinY -> AAACalRegn02Rt05GroupA_Dummy.AssiMotTqWhlImbRejctnMinY
    connect CalRegn02Rt05GroupA.AssiWhlImbRejctnBlndScaX -> AAACalRegn02Rt05GroupA_Dummy.AssiWhlImbRejctnBlndScaX
    connect CalRegn02Rt05GroupA.AssiWhlImbRejctnBlndScaY -> AAACalRegn02Rt05GroupA_Dummy.AssiWhlImbRejctnBlndScaY
    connect CalRegn02Rt05GroupA.DampgHwTqX -> AAACalRegn02Rt05GroupA_Dummy.DampgHwTqX
    connect CalRegn02Rt05GroupA.DampgHwTqY -> AAACalRegn02Rt05GroupA_Dummy.DampgHwTqY
    connect CalRegn02Rt05GroupA.DampgHydCoeff{1..4}ScaY -> AAACalRegn02Rt05GroupA_Dummy.DampgHydCoeff{1..4}ScaY
    connect CalRegn02Rt05GroupA.DampgMotVelX -> AAACalRegn02Rt05GroupA_Dummy.DampgMotVelX
    connect CalRegn02Rt05GroupA.DampgMotVelY -> AAACalRegn02Rt05GroupA_Dummy.DampgMotVelY
    connect CalRegn02Rt05GroupA.HysCmpEffLossY -> AAACalRegn02Rt05GroupA_Dummy.HysCmpEffLossY
    connect CalRegn02Rt05GroupA.HysCmpEffOffsY -> AAACalRegn02Rt05GroupA_Dummy.HysCmpEffOffsY
    connect CalRegn02Rt05GroupA.HysCmpFricWhlImbRejctnBlndX -> AAACalRegn02Rt05GroupA_Dummy.HysCmpFricWhlImbRejctnBlndX
    connect CalRegn02Rt05GroupA.HysCmpFricWhlImbRejctnBlndY -> AAACalRegn02Rt05GroupA_Dummy.HysCmpFricWhlImbRejctnBlndY
    connect CalRegn02Rt05GroupA.HysCmpFricWhlImbRejctnOffY -> AAACalRegn02Rt05GroupA_Dummy.HysCmpFricWhlImbRejctnOffY
    connect CalRegn02Rt05GroupA.HysCmpFricWhlImbRejctnOnY -> AAACalRegn02Rt05GroupA_Dummy.HysCmpFricWhlImbRejctnOnY
    connect CalRegn02Rt05GroupA.HysCmpHwTqScaX -> AAACalRegn02Rt05GroupA_Dummy.HysCmpHwTqScaX
    connect CalRegn02Rt05GroupA.HysCmpHwTqScaY -> AAACalRegn02Rt05GroupA_Dummy.HysCmpHwTqScaY
    connect CalRegn02Rt05GroupA.HysCmpHysSatnY -> AAACalRegn02Rt05GroupA_Dummy.HysCmpHysSatnY
    connect CalRegn02Rt05GroupA.HysCmpNegHysCmpScaX -> AAACalRegn02Rt05GroupA_Dummy.HysCmpNegHysCmpScaX
    connect CalRegn02Rt05GroupA.HysCmpNegHysCmpScaY -> AAACalRegn02Rt05GroupA_Dummy.HysCmpNegHysCmpScaY
    connect CalRegn02Rt05GroupA.HysCmpNegHysCmpX -> AAACalRegn02Rt05GroupA_Dummy.HysCmpNegHysCmpX
    connect CalRegn02Rt05GroupA.HysCmpNegHysCmpY -> AAACalRegn02Rt05GroupA_Dummy.HysCmpNegHysCmpY
    connect CalRegn02Rt05GroupA.HysCmpOutpLim -> AAACalRegn02Rt05GroupA_Dummy.HysCmpOutpLim
    connect CalRegn02Rt05GroupA.HysCmpRevGain -> AAACalRegn02Rt05GroupA_Dummy.HysCmpRevGain
    connect CalRegn02Rt05GroupA.HysCmpRiseX -> AAACalRegn02Rt05GroupA_Dummy.HysCmpRiseX
    connect CalRegn02Rt05GroupA.HysCmpRiseY -> AAACalRegn02Rt05GroupA_Dummy.HysCmpRiseY
    connect CalRegn02Rt05GroupA.InertiaCmpVelAssiBasdDampgStatY -> AAACalRegn02Rt05GroupA_Dummy.InertiaCmpVelAssiBasdDampgStatY
    connect CalRegn02Rt05GroupA.InertiaCmpVelDampgFilFrq -> AAACalRegn02Rt05GroupA_Dummy.InertiaCmpVelDampgFilFrq
    connect CalRegn02Rt05GroupA.InertiaCmpVelDampgFilFrqWhlImbRejctnOn -> AAACalRegn02Rt05GroupA_Dummy.InertiaCmpVelDampgFilFrqWhlImbRejctnOn
    connect CalRegn02Rt05GroupA.InertiaCmpVelDampgSpdBlndY -> AAACalRegn02Rt05GroupA_Dummy.InertiaCmpVelDampgSpdBlndY
    connect CalRegn02Rt05GroupA.InertiaCmpVelDampgWhlImbRejctnBlndX -> AAACalRegn02Rt05GroupA_Dummy.InertiaCmpVelDampgWhlImbRejctnBlndX
    connect CalRegn02Rt05GroupA.InertiaCmpVelDampgWhlImbRejctnBlndY -> AAACalRegn02Rt05GroupA_Dummy.InertiaCmpVelDampgWhlImbRejctnBlndY
    connect CalRegn02Rt05GroupB.EotProtnDampgVehSpdTbl -> AAACalRegn02Rt05GroupB_Dummy.EotProtnDampgVehSpdTbl
    connect CalRegn02Rt05GroupB.EotProtnDeltaTqThd -> AAACalRegn02Rt05GroupB_Dummy.EotProtnDeltaTqThd
    connect CalRegn02Rt05GroupB.EotProtnEntrGainVehSpdTbl -> AAACalRegn02Rt05GroupB_Dummy.EotProtnEntrGainVehSpdTbl
    connect CalRegn02Rt05GroupB.EotProtnEntrGainY -> AAACalRegn02Rt05GroupB_Dummy.EotProtnEntrGainY
    connect CalRegn02Rt05GroupB.EotProtnLoAuthyEntrGainY -> AAACalRegn02Rt05GroupB_Dummy.EotProtnLoAuthyEntrGainY
    connect CalRegn02Rt05GroupB.EotProtnMotSpdIncptY -> AAACalRegn02Rt05GroupB_Dummy.EotProtnMotSpdIncptY
    connect CalRegn02Rt05GroupB.EotProtnNormDampgY -> AAACalRegn02Rt05GroupB_Dummy.EotProtnNormDampgY
    connect CalRegn02Rt05GroupB.EotProtnSoftEndStopAuthyThd -> AAACalRegn02Rt05GroupB_Dummy.EotProtnSoftEndStopAuthyThd
    connect CalRegn02Rt05GroupB.RtnHwAgOffsCalcdX -> AAACalRegn02Rt05GroupB_Dummy.RtnHwAgOffsCalcdX
    connect CalRegn02Rt05GroupB.RtnHwAgOffsCalcdY -> AAACalRegn02Rt05GroupB_Dummy.RtnHwAgOffsCalcdY
    connect CalRegn02Rt05GroupB.RtnScaTqX -> AAACalRegn02Rt05GroupB_Dummy.RtnScaTqX
    connect CalRegn02Rt05GroupB.RtnScaTqY -> AAACalRegn02Rt05GroupB_Dummy.RtnScaTqY
    connect CalRegn02Rt05GroupB.RtnScaVelX -> AAACalRegn02Rt05GroupB_Dummy.RtnScaVelX
    connect CalRegn02Rt05GroupB.RtnScaVelY -> AAACalRegn02Rt05GroupB_Dummy.RtnScaVelY
    connect CalRegn02Rt05GroupB.RtnVehSpdSeln -> AAACalRegn02Rt05GroupB_Dummy.RtnVehSpdSeln
    connect CDD_CurrMeas.MotCurrEolCalSt -> CDD_GtmCfgAndUse.MotCurrEolCalSt
    connect CDD_CurrMeas.CurrMeasWrmIninTestCmpl -> CDD_MotCtrlMgr.CurrMeasWrmIninTestCmpl
    connect CDD_CurrMeas.MotCurrEolCalSt -> CDD_MotCtrlMgr.MotCurrEolCalSt
    connect CDD_CurrMeas.MotCurrQlfr1 -> CDD_MotCtrlMgr.MotCurrQlfr1
    connect CDD_CurrMeas.CurrMeasEolGainReq -> CmnMfgSrv.CurrMeasEolGainReq
    connect CDD_CurrMeas.CurrMeasEolGainStsReq -> CmnMfgSrv.CurrMeasEolGainStReq
    connect CDD_CurrMeas.CurrMeasEolOffsReq -> CmnMfgSrv.CurrMeasEolOffsReq
    connect CDD_CurrMeas.CurrMeasEolOffsStsReq -> CmnMfgSrv.CurrMeasEolOffsStReq
    connect CDD_CurrMeas.CurrMeasGainReadReqSngIvtr -> CmnMfgSrv.CurrMeasGainReadReqSngIvtr
    connect CDD_CurrMeas.CurrMeasGainWrReqSngIvtr -> CmnMfgSrv.CurrMeasGainWrReqSngIvtr
    connect CDD_CurrMeas.CurrMeasOffsReadReqSngIvtr -> CmnMfgSrv.CurrMeasOffsReadReqSngIvtr
    connect CDD_CurrMeas.CurrMeasOffsWrReqSngIvtr -> CmnMfgSrv.CurrMeasOffsWrReqSngIvtr
    connect CDD_CurrMeas.MotCurrEolCalSt -> CurrMeasCorrln.MotCurrEolCalSt
    connect CDD_CurrMeas.MotCurrEolCalSt -> MotCurrRegCfg.MotCurrEolCalSt
    connect CDD_CurrMeas.CurrMeasWrmIninTestCmpl -> PwrUpSeq.CurrMeasWrmIninTestCmpl
    connect CDD_DmaCfgAndUse.DmaEna2MilliSecToMotCtrlTrf -> CDD_MotCtrlMgr.DmaEna2MilliSecToMotCtrlTrf
    connect CDD_DmaCfgAndUse.DmaWaitForMotCtrlTo2MilliSecTrf -> CDD_MotCtrlMgr.DmaWaitForMotCtrlTo2MilliSecTrf
    connect CDD_EcmOutpAndDiagc.CtrlErrOut -> TmplMonr.CtrlErrOut
    connect CDD_ExcpnHndlg.GetMcuDiagcSpplData -> DiagcMgr.GetMcuDiagcSpplData
    connect CDD_FlsMem.SwApplCrc -> DiagcMgr.SwApplCrc
    connect CDD_FlsMem.CodFlsCrcChkCmpl -> PwrUpSeq.CodFlsCrcChkCmpl
    connect CDD_FordBlaBoxIfCmp1.FordActvNiblCtrlFeatSt -> FordCmdArbn.FordActvNiblCtrlFeatSt
    connect CDD_FordBlaBoxIfCmp1.FordLaneDprtrWarnFeatSt -> FordCmdArbn.FordLaneDprtrWarnFeatSt
    connect CDD_FordBlaBoxIfCmp1.FordLaneKeepAssiFeatSt -> FordCmdArbn.FordLaneKeepAssiFeatSt
    connect CDD_FordBlaBoxIfCmp1.FordLatCtrlFeatSt -> FordCmdArbn.FordLatCtrlFeatSt
    connect CDD_FordBlaBoxIfCmp1.FordPullDriftCmpFeatSt -> FordCmdArbn.FordPullDriftCmpFeatSt
    connect CDD_FordBlaBoxIfCmp1.FordPullDriftCmpLrngFeatSt -> FordCmdArbn.FordPullDriftCmpLrngFeatSt
    connect CDD_FordBlaBoxIfCmp1.FordLaneKeepAssiTqReq -> FordHwTqCmdOvrlLimr.FordLaneKeepAssiTqReq
    connect CDD_FordBlaBoxIfCmp1.FordActvNiblCtrlTqReq -> FordMotTqCmdOvrlLimr.FordActvNiblCtrlTqReq
    connect CDD_FordBlaBoxIfCmp1.FordLaneDprtrWarnTqReq -> FordMotTqCmdOvrlLimr.FordLaneDprtrWarnTqReq
    connect CDD_FordBlaBoxIfCmp1.FordLatCtrlTqReq -> FordMotTqCmdOvrlLimr.FordLatCtrlTqReq
    connect CDD_FordBlaBoxIfCmp1.FordPullDriftCmpTqReq -> FordMotTqCmdOvrlLimr.FordPullDriftCmpTqReq
    connect CDD_FordBlaBoxIfCmp1.FordVehVelMaxReqTrlrAid -> FordMsg082BusHiSpd.FordVehVelMaxReqTrlrAid
    connect CDD_FordBlaBoxIfCmp1.FordVehLaneAssiAvl -> FordMsg3CCBusHiSpd.FordVehLaneAssiAvl
    connect CDD_FordBlaBoxIfCmp1.FordVehLaneAssiHandsOff -> FordMsg3CCBusHiSpd.FordVehLaneAssiHandsOff
    connect CDD_FordBlaBoxIfCmp1.FordVehLaneAssiRejctn -> FordMsg3CCBusHiSpd.FordVehLaneAssiRejctn
    connect CDD_FordBlaBoxIfCmp1.FordVehLoSpdMtnCtrlBrkDecelEnaReq -> FordMsg3CCBusHiSpd.FordVehLoSpdMtnCtrlBrkDecelEna
    connect CDD_FordBlaBoxIfCmp1.FordVehTrfcJamAvdHandsOnConf -> FordMsg3CCBusHiSpd.FordVehTrfcJamAvdHandsOnConf
    connect CDD_FordBlaBoxIfCmp1.FordVehTrlrAgTarCalcn -> FordMsg3CCBusHiSpd.FordVehTrlrAgTarCalcn
    connect CDD_FordBlaBoxIfCmp1.FordVehLatCtrlLimSts -> FordMsg417BusHiSpd.FordVehLatCtrlLimSts
    connect CDD_FordBlaBoxIfCmp1.FordVehLatCtrlSteerSts -> FordMsg417BusHiSpd.FordVehLatCtrlSteerSts
    connect CDD_FordBlaBoxIfCmp2.FordEvasSteerAssiFeatSt -> FordCmdArbn.FordEvasSteerAssiFeatSt
    connect CDD_FordBlaBoxIfCmp2.FordSteerTqDstbcRejctnFeatSt -> FordCmdArbn.FordSteerTqDstbcRejctnFeatSt
    connect CDD_FordBlaBoxIfCmp2.FordEvasSteerAssiTqReq -> FordHwTqCmdOvrlLimr.FordEvasSteerAssiTqReq
    connect CDD_FordBlaBoxIfCmp2.FordSteerTqDstbcRejctnTqReq -> FordMotTqCmdOvrlLimr.FordSteerTqDstbcRejctnTqReq
    connect CDD_FordBlaBoxIfCmp2.FordVehEvasSteerAssiSts -> FordMsg417BusHiSpd.FordVehEvasSteerAssiSts
    connect CDD_FordT3T6McuCfg.BattVltg -> BattVltg.BattVltg
    connect CDD_FordT3T6McuCfg.BattVltgSwd1 -> BattVltg.BattVltgSwd1
    connect CDD_FordT3T6McuCfg.BattVltg -> BattVltgCorrln.BattVltg
    connect CDD_FordT3T6McuCfg.BattVltgAdcFaild -> BattVltgCorrln.BattVltgAdcFaild
    connect CDD_FordT3T6McuCfg.BattVltgSwd1 -> BattVltgCorrln.BattVltgSwd1
    connect CDD_FordT3T6McuCfg.BattVltgSwd1AdcFaild -> BattVltgCorrln.BattVltgSwd1AdcFaild
    connect CDD_FordT3T6McuCfg.MotAg5CosAdcFaild -> CDD_MotAg5Meas.MotAg5CosAdcFaild
    connect CDD_FordT3T6McuCfg.MotAg5SinAdcFaild -> CDD_MotAg5Meas.MotAg5SinAdcFaild
    connect CDD_FordT3T6McuCfg.MotAg6CosAdcFaild -> CDD_MotAg6Meas.MotAg6CosAdcFaild
    connect CDD_FordT3T6McuCfg.MotAg6SinAdcFaild -> CDD_MotAg6Meas.MotAg6SinAdcFaild
    connect CDD_FordT3T6McuCfg.MotAg2Cos -> CDD_MotCtrlMgr.MotAg2Cos
    connect CDD_FordT3T6McuCfg.MotAg2CosAdcFaild -> CDD_MotCtrlMgr.MotAg2CosAdcFaild
    connect CDD_FordT3T6McuCfg.MotAg2Sin -> CDD_MotCtrlMgr.MotAg2Sin
    connect CDD_FordT3T6McuCfg.MotAg2SinAdcFaild -> CDD_MotCtrlMgr.MotAg2SinAdcFaild
    connect CDD_FordT3T6McuCfg.MotAg5CosAdcFaild -> CDD_MotCtrlMgr.MotAg5CosAdcFaild
    connect CDD_FordT3T6McuCfg.MotAg5SinAdcFaild -> CDD_MotCtrlMgr.MotAg5SinAdcFaild
    connect CDD_FordT3T6McuCfg.MotAg6CosAdcFaild -> CDD_MotCtrlMgr.MotAg6CosAdcFaild
    connect CDD_FordT3T6McuCfg.MotAg6SinAdcFaild -> CDD_MotCtrlMgr.MotAg6SinAdcFaild
    connect CDD_FordT3T6McuCfg.MotCurrAdcVlyAAdcFaild -> CDD_MotCtrlMgr.MotCurrAdcVlyAAdcFaild
    connect CDD_FordT3T6McuCfg.MotCurrAdcVlyBAdcFaild -> CDD_MotCtrlMgr.MotCurrAdcVlyBAdcFaild
    connect CDD_FordT3T6McuCfg.MotCurrAdcVlyCAdcFaild -> CDD_MotCtrlMgr.MotCurrAdcVlyCAdcFaild
    connect CDD_FordT3T6McuCfg.EcuT -> EcuTMeas.EcuT
    connect CDD_FordT3T6McuCfg.EcuTAdcFaild -> EcuTMeas.EcuTAdcFaild
    connect CDD_FordT3T6McuCfg.HwAg1SnsrTyp -> HwAg1Meas.HwAg1SnsrTyp
    connect CDD_FordT3T6McuCfg.MotAg2Cos -> MotAg2Meas.MotAg2Cos
    connect CDD_FordT3T6McuCfg.MotAg2CosAdcFaild -> MotAg2Meas.MotAg2CosAdcFaild
    connect CDD_FordT3T6McuCfg.MotAg2Sin -> MotAg2Meas.MotAg2Sin
    connect CDD_FordT3T6McuCfg.MotAg2SinAdcFaild -> MotAg2Meas.MotAg2SinAdcFaild
    connect CDD_FordT3T6McuCfg.BattVltg -> PwrDiscnct.BattVltg
    connect CDD_FordT3T6McuCfg.BattVltgAdcFaild -> PwrDiscnct.BattVltgAdcFaild
    connect CDD_FordT3T6McuCfg.BattVltgSwd1 -> PwrDiscnct.BattVltgSwd1
    connect CDD_FordT3T6McuCfg.ChrgPmpDiag -> PwrDiscnct.ChrgPmpDiag
    connect CDD_FordT3T6McuCfg.ChrgPmpDiagAdcFaild -> PwrDiscnct.ChrgPmpDiagAdcFaild
    connect CDD_FordT3T6McuCfg.PwrDiscnctSwtDiag -> PwrDiscnct.PwrDiscnctSwtDiag
    connect CDD_FordT3T6McuCfg.MotDrvr1IninTestCmpl -> PwrUpSeq.MotDrvr1IninTestCmpl
    connect CDD_FordT3T6McuCfg.BattVltg -> SysPrfmncSts.BattVltg
    connect CDD_GtmCfgAndUse.PhaOnTiMeasdA -> GateDrv0Ctrl.PhaOnTiMeasdA
    connect CDD_GtmCfgAndUse.PhaOnTiMeasdB -> GateDrv0Ctrl.PhaOnTiMeasdB
    connect CDD_GtmCfgAndUse.PhaOnTiMeasdC -> GateDrv0Ctrl.PhaOnTiMeasdC
    connect CDD_GtmCfgAndUse.GtmGetSent1Data -> HwTq10Meas.GtmGetSent1Data
    connect CDD_GtmCfgAndUse.GtmGetSent0Data -> HwTq9Meas.GtmGetSent0Data
    connect CDD_HwTq1Meas.HwTq1 -> CmnMfgSrv.HwTq1
    connect CDD_HwTq1Meas.HwTq1MeasHwTq1AutTrim -> CmnMfgSrv.HwTq1MeasHwTq1AutTrim
    connect CDD_HwTq1Meas.HwTq1MeasHwTq1ClrTrim -> CmnMfgSrv.HwTq1MeasHwTq1ClrTrim
    connect CDD_HwTq1Meas.HwTq1MeasHwTq1ReadTrim -> CmnMfgSrv.HwTq1MeasHwTq1ReadTrim
    connect CDD_HwTq1Meas.HwTq1MeasHwTq1TrimPrfmdSts -> CmnMfgSrv.HwTq1MeasHwTq1TrimPrfmdSts
    connect CDD_HwTq1Meas.HwTq1MeasHwTq1WrTrim -> CmnMfgSrv.HwTq1MeasHwTq1WrTrim
    connect CDD_HwTq1Meas.RackLimrEotSig1Avl -> EotLrng.HwAgEotSig1Avl
    connect CDD_HwTq1Meas.RackLimrCcwEotSig1 -> EotLrng.HwAgEotSig1Ccw
    connect CDD_HwTq1Meas.RackLimrCwEotSig1 -> EotLrng.HwAgEotSig1Cw
    connect CDD_HwTq1Meas.HwTq1 -> HwTqArbn.HwTqB
    connect CDD_HwTq1Meas.HwTq1Qlfr -> HwTqArbn.HwTqBQlfr
    connect CDD_HwTq1Meas.HwTq1RollgCntr -> HwTqArbn.HwTqBRollgCntr
    connect CDD_HwTq1Meas.HwTq1 -> HwTqCorrln.HwTqB
    connect CDD_HwTq1Meas.HwTq1Qlfr -> HwTqCorrln.HwTqBQlfr
    connect CDD_HwTq1Meas.HwTq1RollgCntr -> HwTqCorrln.HwTqBRollgCntr
    connect CDD_HwTq8Meas.HwTq8 -> CmnMfgSrv.HwTq0
    connect CDD_HwTq8Meas.HwTq8AutTrim -> CmnMfgSrv.HwTq0MeasHwTq0AutTrim
    connect CDD_HwTq8Meas.HwTq8ClrTrim -> CmnMfgSrv.HwTq0MeasHwTq0ClrTrim
    connect CDD_HwTq8Meas.HwTq8ReadTrim -> CmnMfgSrv.HwTq0MeasHwTq0ReadTrim
    connect CDD_HwTq8Meas.HwTq8TrimPrfmdSts -> CmnMfgSrv.HwTq0MeasHwTq0TrimPrfmdSts
    connect CDD_HwTq8Meas.HwTq8WrTrim -> CmnMfgSrv.HwTq0MeasHwTq0WrTrim
    connect CDD_HwTq8Meas.RackLimrEotSig8Avl -> EotLrng.HwAgEotSig0Avl
    connect CDD_HwTq8Meas.RackLimrCcwEotSig8 -> EotLrng.HwAgEotSig0Ccw
    connect CDD_HwTq8Meas.RackLimrCwEotSig8 -> EotLrng.HwAgEotSig0Cw
    connect CDD_HwTq8Meas.HwTq8 -> HwTqArbn.HwTqA
    connect CDD_HwTq8Meas.HwTq8Qlfr -> HwTqArbn.HwTqAQlfr
    connect CDD_HwTq8Meas.HwTq8RollgCntr -> HwTqArbn.HwTqARollgCntr
    connect CDD_HwTq8Meas.HwTq8 -> HwTqCorrln.HwTqA
    connect CDD_HwTq8Meas.HwTq8Qlfr -> HwTqCorrln.HwTqAQlfr
    connect CDD_HwTq8Meas.HwTq8RollgCntr -> HwTqCorrln.HwTqARollgCntr
    connect CDD_McuDiagc.LoopCntr2MilliSec -> CDD_MotCtrlMgr.LoopCntr2MilliSec
    connect CDD_MotAg5Meas.MotAg5CosRtAmpRecpr -> CDD_MotCtrlMgr.MotAg5CosRtAmpRecpr
    connect CDD_MotAg5Meas.MotAg5CosRtOffs -> CDD_MotCtrlMgr.MotAg5CosRtOffs
    connect CDD_MotAg5Meas.MotAg5MeclQlfr -> CDD_MotCtrlMgr.MotAg5MeclQlfr
    connect CDD_MotAg5Meas.MotAg5MeclRollgCntr -> CDD_MotCtrlMgr.MotAg5MeclRollgCntr
    connect CDD_MotAg5Meas.MotAg5SinRtAmpRecpr -> CDD_MotCtrlMgr.MotAg5SinRtAmpRecpr
    connect CDD_MotAg5Meas.MotAg5SinRtOffs -> CDD_MotCtrlMgr.MotAg5SinRtOffs
    connect CDD_MotAg5Meas.MotAg5EolPrmRead -> CmnMfgSrv.MotAg5EolPrmRead
    connect CDD_MotAg5Meas.MotAg5EolPrmWr -> CmnMfgSrv.MotAg5EolPrmWr
    connect CDD_MotAg5Meas.MotAg5MeclQlfr -> MotAgCorrln.MotAgAMeclQlfr
    connect CDD_MotAg5Meas.MotAg5MeclRollgCntr -> MotAgCorrln.MotAgAMeclRollgCntr
    connect CDD_MotAg6Meas.MotAg6CosRtAmpRecpr -> CDD_MotCtrlMgr.MotAg6CosRtAmpRecpr
    connect CDD_MotAg6Meas.MotAg6CosRtOffs -> CDD_MotCtrlMgr.MotAg6CosRtOffs
    connect CDD_MotAg6Meas.MotAg6MeclQlfr -> CDD_MotCtrlMgr.MotAg6MeclQlfr
    connect CDD_MotAg6Meas.MotAg6MeclRollgCntr -> CDD_MotCtrlMgr.MotAg6MeclRollgCntr
    connect CDD_MotAg6Meas.MotAg6SinRtAmpRecpr -> CDD_MotCtrlMgr.MotAg6SinRtAmpRecpr
    connect CDD_MotAg6Meas.MotAg6SinRtOffs -> CDD_MotCtrlMgr.MotAg6SinRtOffs
    connect CDD_MotAg6Meas.MotAg6EolPrmRead -> CmnMfgSrv.MotAg6EolPrmRead
    connect CDD_MotAg6Meas.MotAg6EolPrmWr -> CmnMfgSrv.MotAg6EolPrmWr
    connect CDD_MotAg6Meas.MotAg6MeclQlfr -> MotAgCorrln.MotAgBMeclQlfr
    connect CDD_MotAg6Meas.MotAg6MeclRollgCntr -> MotAgCorrln.MotAgBMeclRollgCntr
    connect CDD_MotAgCmp.MotAgCmpBackEmfRead -> CmnMfgSrv.MotAgCmpBackEmfRead
    connect CDD_MotAgCmp.MotAgCmpBackEmfWr -> CmnMfgSrv.MotAgCmpBackEmfWr
    connect CDD_MotAgCmp.MotAgCumvAlgndMrf -> CmnMfgSrv.MotAgCumvAlgndMrf
    connect CDD_MotAgCmp.MotAgCumvAlgndMrf -> FordHwAgArbn.FordMotPosn
    connect CDD_MotAgCmp.MotAgCumvAlgndCrf -> HwAgSnsrls.MotAgCumvAlgndCrf
    connect CDD_MotAgCmp.MotAgCumvAlgndVld -> HwAgSnsrls.MotAgCumvAlgndVld
    connect CDD_MotAgCmp.MotAgCumvAlgndMrf -> MotQuadDetn.MotAgCumvAlgndMrf
    connect CDD_MotAgSwCal.SwCalGetPrm -> CmnMfgSrv.SwCalGetPrm
    connect CDD_MotAgSwCal.SwCalSetPrm -> CmnMfgSrv.SwCalSetPrm
    connect CDD_MotAgSwCal.SwCalStop -> CmnMfgSrv.SwCalStop
    connect CDD_MotAgSwCal.SwCalStrt -> CmnMfgSrv.SwCalStrt
    connect CDD_MotCtrlMgr.MotCurrAdcVlyA -> CDD_CurrMeas.MotCurrAdcVlyA
    connect CDD_MotCtrlMgr.MotCurrAdcVlyB -> CDD_CurrMeas.MotCurrAdcVlyB
    connect CDD_MotCtrlMgr.MotCurrAdcVlyC -> CDD_CurrMeas.MotCurrAdcVlyC
    connect CDD_MotCtrlMgr.Ntc5DErrCnt -> CDD_CurrMeas.Ntc5DErrCnt
    connect CDD_MotCtrlMgr.FastLoopCntr -> CDD_McuDiagc.FastLoopCntr
    connect CDD_MotCtrlMgr.SlowLoopCntr -> CDD_McuDiagc.SlowLoopCntr
    connect CDD_MotCtrlMgr.MotAg5Cos -> CDD_MotAg5Meas.MotAg5Cos
    connect CDD_MotCtrlMgr.MotAg5RawMecl -> CDD_MotAg5Meas.MotAg5RawMecl
    connect CDD_MotCtrlMgr.MotAg5Sin -> CDD_MotAg5Meas.MotAg5Sin
    connect CDD_MotCtrlMgr.MotAg6Cos -> CDD_MotAg6Meas.MotAg6Cos
    connect CDD_MotCtrlMgr.MotAg6RawMecl -> CDD_MotAg6Meas.MotAg6RawMecl
    connect CDD_MotCtrlMgr.MotAg6Sin -> CDD_MotAg6Meas.MotAg6Sin
    connect CDD_MotCtrlMgr.MotAgCumvAlgndMrfRev -> CDD_MotAgCmp.MotAgCumvAlgndMrfRev
    connect CDD_MotCtrlMgr.MotAgCumvInid -> CDD_MotAgCmp.MotAgCumvInid
    connect CDD_MotCtrlMgr.MotAgBuf -> CDD_MotVel.MotAgBuf
    connect CDD_MotCtrlMgr.MotAgBufIdx -> CDD_MotVel.MotAgBufIdx
    connect CDD_MotCtrlMgr.MotAgTiBuf -> CDD_MotVel.MotAgTiBuf
    connect CDD_MotCtrlMgr.MotCurrDax -> CmnMfgSrv.MotCurrDax
    connect CDD_MotCtrlMgr.MotCurrQax -> CmnMfgSrv.MotCurrQax
    connect CDD_MotCtrlMgr.MotCurrCorrdA -> CurrMeasCorrln.MotCurrCorrdA
    connect CDD_MotCtrlMgr.MotCurrCorrdB -> CurrMeasCorrln.MotCurrCorrdB
    connect CDD_MotCtrlMgr.MotCurrCorrdC -> CurrMeasCorrln.MotCurrCorrdC
    connect CDD_MotCtrlMgr.MotCurrRollgCntr1 -> CurrMeasCorrln.MotCurrRollgCntr1
    connect CDD_MotCtrlMgr.MotCurrQax -> CustDiag.MotCurrQax
    connect CDD_MotCtrlMgr.MotCurrDax -> ElecPwrCns.MotCurrDax
    connect CDD_MotCtrlMgr.MotCurrQax -> ElecPwrCns.MotCurrQax
    connect CDD_MotCtrlMgr.MotVltgDax -> ElecPwrCns.MotVltgDax
    connect CDD_MotCtrlMgr.MotVltgQax -> ElecPwrCns.MotVltgQax
    connect CDD_MotCtrlMgr.PhaOnTiSumA -> GateDrv0Ctrl.PhaOnTiSumA
    connect CDD_MotCtrlMgr.PhaOnTiSumB -> GateDrv0Ctrl.PhaOnTiSumB
    connect CDD_MotCtrlMgr.PhaOnTiSumC -> GateDrv0Ctrl.PhaOnTiSumC
    connect CDD_MotCtrlMgr.MotAg5Mecl -> MotAgCorrln.MotAgAMecl
    connect CDD_MotCtrlMgr.MotAg6Mecl -> MotAgCorrln.MotAgBMecl
    connect CDD_MotCtrlMgr.MotCurrDax -> MotCurrPeakEstimn.MotCurrDax
    connect CDD_MotCtrlMgr.MotCurrQax -> MotCurrPeakEstimn.MotCurrQax
    connect CDD_MotRplCoggCmd.GetMotCoggCmdPrm -> CmnMfgSrv.GetMotCoggCmdPrm
    connect CDD_MotRplCoggCmd.SetMotCoggCmdPrm -> CmnMfgSrv.SetMotCoggCmdPrm
    connect CDD_MotVel.MotVelMrf -> AssiSumLim.MotVelMrf
    connect CDD_MotVel.MotVelMrf -> CDD_CurrMeas.MotVelMrf
    connect CDD_MotVel.MotVelMrf -> CDD_MotAg5Meas.MotVelMrf
    connect CDD_MotVel.MotVelMrf -> CDD_MotAg6Meas.MotVelMrf
    connect CDD_MotVel.MotVelMrf -> CDD_MotCtrlMgr.MotVelMrf
    connect CDD_MotVel.MotVelMrf -> CmnMfgSrv.MotVelMrf
    connect CDD_MotVel.MotVelVld -> FordHwAgArbn.FordMotVelVld
    connect CDD_MotVel.MotVelVld -> HwAgSysArbn.MotVelVld
    connect CDD_MotVel.MotVelCrf -> ImcArbn.MotVel
    connect CDD_MotVel.MotVelCrf -> ImcSigArbn.MotVelCrf
    connect CDD_MotVel.MotVelMrf -> MotCurrRegCfg.MotVelMrf
    connect CDD_MotVel.MotVelMrf -> MotRefMdl.MotVelMrf
    connect CDD_MotVel.MotVelMrf -> MotRplCoggCfg.MotVelMrf
    connect CDD_MotVel.MotVelMrf -> PwrDiscnct.MotVelMrf
    connect CDD_MotVel.MotVelMrf -> PwrLimr.MotVelMrf
    connect CDD_NxtrTi.GetRefTmr1MicroSec32bit -> CDD_DmaCfgAndUse.GetRefTmr1MicroSec32bit
    connect CDD_NxtrTi.GetTiSpan1MicroSec32bit -> CDD_DmaCfgAndUse.GetTiSpan1MicroSec32bit
    connect CDD_NxtrTi.GetTiSpan100MicroSec32bit -> CDD_FlsMem.GetTiSpan100MicroSec32bit
    connect CDD_NxtrTi.GetRefTmr1MicroSec32bit -> CDD_FordT3T6McuCfg.GetRefTmr1MicroSec32bit
    connect CDD_NxtrTi.GetTiSpan1MicroSec32bit -> CDD_FordT3T6McuCfg.GetTiSpan1MicroSec32bit
    connect CDD_NxtrTi.GetRefTmr1MicroSec32bit -> CDD_HwTq1Meas.GetRefTmr1MicroSec32bit
    connect CDD_NxtrTi.GetTiSpan1MicroSec32bit -> CDD_HwTq1Meas.GetTiSpan1MicroSec32bit
    connect CDD_NxtrTi.GetRefTmr1MicroSec32bit -> CDD_HwTq8Meas.GetRefTmr1MicroSec32bit
    connect CDD_NxtrTi.GetTiSpan1MicroSec32bit -> CDD_HwTq8Meas.GetTiSpan1MicroSec32bit
    connect CDD_NxtrTi.GetRefTmr1MicroSec32bit -> CDD_MotAg5Meas.GetRefTmr1MicroSec32bit
    connect CDD_NxtrTi.GetRefTmr100MicroSec32bit -> CmnMfgSrv.GetRefTmr100MicroSec32bit1
    connect CDD_NxtrTi.GetTiSpan100MicroSec32bit -> CmnMfgSrv.GetTiSpan100MicroSec32bit1
    connect CDD_NxtrTi.GetRefTmr100MicroSec32bit -> CustDiag.GetRefTmr100MicroSec32bit
    connect CDD_NxtrTi.GetRefTmr100MicroSec32bit -> DualCtrlrOutpMgr.GetRefTmr100MicroSec32bit
    connect CDD_NxtrTi.GetTiSpan100MicroSec32bit -> DualCtrlrOutpMgr.GetTiSpan100MicroSec32bit
    connect CDD_NxtrTi.GetRefTmr100MicroSec32bit -> EotLrng.GetRefTmr100MicroSec32bit
    connect CDD_NxtrTi.GetTiSpan100MicroSec32bit -> EotLrng.GetTiSpan100MicroSec32bit
    connect CDD_NxtrTi.GetRefTmr100MicroSec32bit -> FltInj.GetRefTmr100MicroSec32bit
    connect CDD_NxtrTi.GetTiSpan100MicroSec32bit -> FltInj.GetTiSpan100MicroSec32bit
    connect CDD_NxtrTi.GetRefTmr100MicroSec32bit -> FordCanDtcInhb.GetRefTmr100MicroSec32bit
    connect CDD_NxtrTi.GetTiSpan100MicroSec32bit -> FordCanDtcInhb.GetTiSpan100MicroSec32bit
    connect CDD_NxtrTi.GetRefTmr100MicroSec32bit -> FordHwAgArbn.GetRefTmr100MicroSec32bit
    connect CDD_NxtrTi.GetTiSpan100MicroSec32bit -> FordHwAgArbn.GetTiSpan100MicroSec32bit
    connect CDD_NxtrTi.GetRefTmr100MicroSec32bit -> FordHwTqCdng.GetRefTmr100MicroSec32bit
    connect CDD_NxtrTi.GetTiSpan100MicroSec32bit -> FordHwTqCdng.GetTiSpan100MicroSec32bit
    connect CDD_NxtrTi.GetRefTmr100MicroSec32bit -> FordMotTqCmdOvrlLimr.GetRefTmr100MicroSec32bit
    connect CDD_NxtrTi.GetTiSpan100MicroSec32bit -> FordMotTqCmdOvrlLimr.GetTiSpan100MicroSec32bit
    connect CDD_NxtrTi.GetRefTmr100MicroSec32bit -> FordMsg077BusHiSpd.GetRefTmr100MicroSec32bit
    connect CDD_NxtrTi.GetTiSpan100MicroSec32bit -> FordMsg077BusHiSpd.GetTiSpan100MicroSec32bit
    connect CDD_NxtrTi.GetRefTmr100MicroSec32bit -> FordMsg07DBusHiSpd.GetRefTmr100MicroSec32bit
    connect CDD_NxtrTi.GetTiSpan100MicroSec32bit -> FordMsg07DBusHiSpd.GetTiSpan100MicroSec32bit
    connect CDD_NxtrTi.GetRefTmr100MicroSec32bit -> FordMsg083BusHiSpd.GetRefTmr100MicroSec32bit
    connect CDD_NxtrTi.GetTiSpan100MicroSec32bit -> FordMsg083BusHiSpd.GetTiSpan100MicroSec32bit
    connect CDD_NxtrTi.GetRefTmr100MicroSec32bit -> FordMsg091BusHiSpd.GetRefTmr100MicroSec32bit
    connect CDD_NxtrTi.GetTiSpan100MicroSec32bit -> FordMsg091BusHiSpd.GetTiSpan100MicroSec32bit
    connect CDD_NxtrTi.GetRefTmr100MicroSec32bit -> FordMsg167BusHiSpd.GetRefTmr100MicroSec32bit
    connect CDD_NxtrTi.GetTiSpan100MicroSec32bit -> FordMsg167BusHiSpd.GetTiSpan100MicroSec32bit
    connect CDD_NxtrTi.GetRefTmr100MicroSec32bit -> FordMsg202BusHiSpd.GetRefTmr100MicroSec32bit
    connect CDD_NxtrTi.GetTiSpan100MicroSec32bit -> FordMsg202BusHiSpd.GetTiSpan100MicroSec32bit
    connect CDD_NxtrTi.GetRefTmr100MicroSec32bit -> FordMsg213BusHiSpd.GetRefTmr100MicroSec32bit
    connect CDD_NxtrTi.GetTiSpan100MicroSec32bit -> FordMsg213BusHiSpd.GetTiSpan100MicroSec32bit
    connect CDD_NxtrTi.GetRefTmr100MicroSec32bit -> FordMsg215BusHiSpd.GetRefTmr100MicroSec32bit
    connect CDD_NxtrTi.GetTiSpan100MicroSec32bit -> FordMsg215BusHiSpd.GetTiSpan100MicroSec32bit
    connect CDD_NxtrTi.GetRefTmr100MicroSec32bit -> FordMsg216BusHiSpd.GetRefTmr100MicroSec32bit
    connect CDD_NxtrTi.GetTiSpan100MicroSec32bit -> FordMsg216BusHiSpd.GetTiSpan100MicroSec32bit
    connect CDD_NxtrTi.GetRefTmr100MicroSec32bit -> FordMsg217BusHiSpd.GetRefTmr100MicroSec32bit
    connect CDD_NxtrTi.GetTiSpan100MicroSec32bit -> FordMsg217BusHiSpd.GetTiSpan100MicroSec32bit
    connect CDD_NxtrTi.GetRefTmr100MicroSec32bit -> FordMsg230BusHiSpd.GetRefTmr100MicroSec32bit
    connect CDD_NxtrTi.GetTiSpan100MicroSec32bit -> FordMsg230BusHiSpd.GetTiSpan100MicroSec32bit
    connect CDD_NxtrTi.GetRefTmr100MicroSec32bit -> FordMsg2FDBusHiSpd.GetRefTmr100MicroSec32bit
    connect CDD_NxtrTi.GetTiSpan100MicroSec32bit -> FordMsg2FDBusHiSpd.GetTiSpan100MicroSec32bit
    connect CDD_NxtrTi.GetRefTmr100MicroSec32bit -> FordMsg3B3BusHiSpd.GetRefTmr100MicroSec32bit
    connect CDD_NxtrTi.GetTiSpan100MicroSec32bit -> FordMsg3B3BusHiSpd.GetTiSpan100MicroSec32bit
    connect CDD_NxtrTi.GetRefTmr100MicroSec32bit -> FordMsg3CABusHiSpd.GetRefTmr100MicroSec32bit
    connect CDD_NxtrTi.GetTiSpan100MicroSec32bit -> FordMsg3CABusHiSpd.GetTiSpan100MicroSec32bit
    connect CDD_NxtrTi.GetRefTmr100MicroSec32bit -> FordMsg3D3BusHiSpd.GetRefTmr100MicroSec32bit
    connect CDD_NxtrTi.GetTiSpan100MicroSec32bit -> FordMsg3D3BusHiSpd.GetTiSpan100MicroSec32bit
    connect CDD_NxtrTi.GetRefTmr100MicroSec32bit -> FordMsg3D7BusHiSpd.GetRefTmr100MicroSec32bit
    connect CDD_NxtrTi.GetTiSpan100MicroSec32bit -> FordMsg3D7BusHiSpd.GetTiSpan100MicroSec32bit
    connect CDD_NxtrTi.GetRefTmr100MicroSec32bit -> FordMsg40ABusHiSpd.GetRefTmr100MicroSec32bit
    connect CDD_NxtrTi.GetTiSpan100MicroSec32bit -> FordMsg40ABusHiSpd.GetTiSpan100MicroSec32bit
    connect CDD_NxtrTi.GetRefTmr100MicroSec32bit -> FordMsg414BusHiSpd.GetRefTmr100MicroSec32bit
    connect CDD_NxtrTi.GetTiSpan100MicroSec32bit -> FordMsg414BusHiSpd.GetTiSpan100MicroSec32bit
    connect CDD_NxtrTi.GetRefTmr100MicroSec32bit -> FordMsg415BusHiSpd.GetRefTmr100MicroSec32bit
    connect CDD_NxtrTi.GetTiSpan100MicroSec32bit -> FordMsg415BusHiSpd.GetTiSpan100MicroSec32bit
    connect CDD_NxtrTi.GetRefTmr100MicroSec32bit -> FordMsg41ABusHiSpd.GetRefTmr100MicroSec32bit
    connect CDD_NxtrTi.GetTiSpan100MicroSec32bit -> FordMsg41ABusHiSpd.GetTiSpan100MicroSec32bit
    connect CDD_NxtrTi.GetRefTmr100MicroSec32bit -> FordMsg41EBusHiSpd.GetRefTmr100MicroSec32bit
    connect CDD_NxtrTi.GetTiSpan100MicroSec32bit -> FordMsg41EBusHiSpd.GetTiSpan100MicroSec32bit
    connect CDD_NxtrTi.GetRefTmr100MicroSec32bit -> FordMsg430BusHiSpd.GetRefTmr100MicroSec32bit
    connect CDD_NxtrTi.GetTiSpan100MicroSec32bit -> FordMsg430BusHiSpd.GetTiSpan100MicroSec32bit
    connect CDD_NxtrTi.GetRefTmr100MicroSec32bit -> FordMsg443BusHiSpd.GetRefTmr100MicroSec32bit
    connect CDD_NxtrTi.GetTiSpan100MicroSec32bit -> FordMsg443BusHiSpd.GetTiSpan100MicroSec32bit
    connect CDD_NxtrTi.GetRefTmr100MicroSec32bit -> FordMsg459BusHiSpd.GetRefTmr100MicroSec32bit
    connect CDD_NxtrTi.GetTiSpan100MicroSec32bit -> FordMsg459BusHiSpd.GetTiSpan100MicroSec32bit
    connect CDD_NxtrTi.GetRefTmr100MicroSec32bit -> FordMsg47ABusHiSpd.GetRefTmr100MicroSec32bit
    connect CDD_NxtrTi.GetTiSpan100MicroSec32bit -> FordMsg47ABusHiSpd.GetTiSpan100MicroSec32bit
    connect CDD_NxtrTi.GetRefTmr100MicroSec32bit -> FordMsg4B0BusHiSpd.GetRefTmr100MicroSec32bit
    connect CDD_NxtrTi.GetTiSpan100MicroSec32bit -> FordMsg4B0BusHiSpd.GetTiSpan100MicroSec32bit
    connect CDD_NxtrTi.GetRefTmr100MicroSec32bit -> FordVltgIf.GetRefTmr100MicroSec32bit
    connect CDD_NxtrTi.GetTiSpan100MicroSec32bit -> FordVltgIf.GetTiSpan100MicroSec32bit
    connect CDD_NxtrTi.GetRefTmr1MicroSec32bit -> HwAg1Meas.GetRefTmr1MicroSec32bit
    connect CDD_NxtrTi.GetTiSpan1MicroSec32bit -> HwAg1Meas.GetTiSpan1MicroSec32bit
    connect CDD_NxtrTi.GetRefTmr100MicroSec32bit -> HwAgSnsrls.GetRefTmr100MicroSec32bit
    connect CDD_NxtrTi.GetTiSpan100MicroSec32bit -> HwAgSnsrls.GetTiSpan100MicroSec32bit
    connect CDD_NxtrTi.GetRefTmr100MicroSec32bit -> HwAgSysArbn.GetRefTmr100MicroSec32bit
    connect CDD_NxtrTi.GetTiSpan100MicroSec32bit -> HwAgSysArbn.GetTiSpan100MicroSec32bit
    connect CDD_NxtrTi.GetRefTmr100MicroSec32bit -> ImcArbn.GetRefTmr100MicroSec32bit
    connect CDD_NxtrTi.GetTiSpan100MicroSec32bit -> ImcArbn.GetTiSpan100MicroSec32bit
    connect CDD_NxtrTi.GetRefTmr100MicroSec32bit -> ImcSigArbn.GetRefTmr100MicroSec32bit
    connect CDD_NxtrTi.GetTiSpan100MicroSec32bit -> ImcSigArbn.GetTiSpan100MicroSec32bit
    connect CDD_NxtrTi.GetRefTmr100MicroSec32bit -> MotTqTranlDampg.GetRefTmr100MicroSec32bit
    connect CDD_NxtrTi.GetTiSpan100MicroSec32bit -> MotTqTranlDampg.GetTiSpan100MicroSec32bit
    connect CDD_NxtrTi.GetRefTmr100MicroSec32bit -> MotVelCtrl.GetRefTmr100MicroSec32bit
    connect CDD_NxtrTi.GetTiSpan100MicroSec32bit -> MotVelCtrl.GetTiSpan100MicroSec32bit
    connect CDD_NxtrTi.GetRefTmr100MicroSec32bit -> PwrLimr.GetRefTmr100MicroSec32bit
    connect CDD_NxtrTi.GetTiSpan100MicroSec32bit -> PwrLimr.GetTiSpan100MicroSec32bit
    connect CDD_NxtrTi.GetRefTmr100MicroSec32bit -> Swp.GetRefTmr100MicroSec32bit
    connect CDD_NxtrTi.GetTiSpan100MicroSec32bit -> Swp.GetTiSpan100MicroSec32bit
    connect CDD_NxtrTi.GetRefTmr100MicroSec32bit -> SysFricLrng.GetRefTmr100MicroSec32bit
    connect CDD_NxtrTi.GetTiSpan100MicroSec32bit -> SysFricLrng.GetTiSpan100MicroSec32bit
    connect CDD_NxtrTi.GetRefTmr1MicroSec32bit -> TmplMonr.GetRefTmr1MicroSec32bit
    connect CDD_NxtrTi.GetTiSpan1MicroSec32bit -> TmplMonr.GetTiSpan1MicroSec32bit
    connect CDD_SyncCrc.ResvCrcHwUnit -> CDD_FlsMem.ResvCrcHwUnit
    connect CDD_SyncCrc.Calc32BitCrc_u32 -> TunSelnMngt.Calc32BitCrc_u32
    connect CmnMfgSrv.AssiLnrGain -> Assi.AssiLnrGain
    connect CmnMfgSrv.AssiLnrGainEna -> Assi.AssiLnrGainEna
    connect CmnMfgSrv.SwCalStsCallBack -> CDD_MotAgSwCal.SwCalStsCallBack
    connect CmnMfgSrv.MfgEnaSt -> CDD_XcpIf.MfgEnaSt
    connect CmnMfgSrv.IgnCntr -> CustDiag.IgnCntr
    connect CmnMfgSrv.DampgCmdBasDi -> Dampg.DampgCmdBasDi
    connect CmnMfgSrv.IgnCntr -> DiagcMgr.IgnCntr
    connect CmnMfgSrv.MfgDiagcInhb -> DiagcMgr.MfgDiagcInhb
    connect CmnMfgSrv.MfgEnaSt -> DiagcMgr.MfgEnaSt
    connect CmnMfgSrv.CmnMfgSrvCmnMfgSrvMaiFct -> DiagSrv.CmnMfgSrvCmnMfgSrvMaiFct
    connect CmnMfgSrv.DutyCycThermProtnDi -> DutyCycThermProtn.DutyCycThermProtnDi
    connect CmnMfgSrv.EotProtnDi -> EotProtn.EotProtnDi
    connect CmnMfgSrv.EotProtnDi -> EotProtnFwl.EotProtnDi
    connect CmnMfgSrv.MfgEnaSt -> EotProtnFwl.MfgEnaSt
    connect CmnMfgSrv.SysStReqEnaOvrd -> FordSysSt.EngOnSerlComSrvDft
    connect CmnMfgSrv.SysStReqEnaOvrd -> FordSysSt.SysStReqEnaOvrd
    connect CmnMfgSrv.StallMotTqLimDi -> HiLoadStallLimr.StallMotTqLimDi
    connect CmnMfgSrv.HysCmpCmdDi -> HysCmp.HysCmpCmdDi
    connect CmnMfgSrv.InertiaCmpVelCmdDi -> InertiaCmpVel.InertiaCmpVelCmdDi
    connect CmnMfgSrv.LoaScaDi -> LoaMgr.LoaScaDi
    connect CmnMfgSrv.RtnCmdDi -> Rtn.RtnCmdDi
    connect CmnMfgSrv.MfgEnaSt -> RtnPahFwl.MfgEnaSt
    connect CmnMfgSrv.RtnCmdDi -> RtnPahFwl.RtnCmdDi
    connect CmnMfgSrv.SysMotTqCmdRampRateDi -> StOutpCtrl.SysMotTqCmdRampRateDi
    connect CmnMfgSrv.FricLrngDi -> SysFricLrng.FricLrngDi
    connect CmnMfgSrv.SysStImdtTranReqOff -> SysStMod.SysStImdtTranReqOff
    connect CmnMfgSrv.AssiMechTEstimnDi -> TEstimn.AssiMechTEstimnDi
    connect CmnMfgSrv.VehSpdOvrd -> VehSigCdng.VehSpdOvrd
    connect CmnMfgSrv.VehSpdOvrdEna -> VehSigCdng.VehSpdOvrdEna
    connect CmplncErr.CmplncErrMotToPinion -> HwAgSnsrls.CmplncErrMotToPinion
    connect CmplncErr.CmplncErrPinionToHw -> HwAgSysArbn.CmplncErrPinionToHw
    connect CurrMeasCorrln.CurrMeasCorrlnSts -> CDD_MotCtrlMgr.CurrMeasCorrlnSts
    connect CurrMeasCorrln.CurrMeasIdptSig -> LoaMgr.CurrMeasIdptSig
    connect CustDiag.FordEngTqClass -> CDD_FordBlaBoxIfCmn.EngTqClass
    connect CustDiag.FordActvNiblCtrlEnad -> CDD_FordBlaBoxIfCmn.FordActvNiblCtrlEnad
    connect CustDiag.FordBrkPlsRejctnEnad -> CDD_FordBlaBoxIfCmn.FordBrkPlsRejctnEnad
    connect CustDiag.FordEvasSteerAssiEnad -> CDD_FordBlaBoxIfCmn.FordEvasSteerAssiEnad
    connect CustDiag.FordLaneCentrAssiEnad -> CDD_FordBlaBoxIfCmn.FordLaneCentrAssiEnad
    connect CustDiag.FordLaneDprtrWarnEnad -> CDD_FordBlaBoxIfCmn.FordLaneDprtrWarnEnad
    connect CustDiag.FordLaneKeepAssiEnad -> CDD_FordBlaBoxIfCmn.FordLaneKeepAssiEnad
    connect CustDiag.FordPullDriftCmpEnad -> CDD_FordBlaBoxIfCmn.FordPullDriftCmpEnad
    connect CustDiag.FordResrchFctEnad -> CDD_FordBlaBoxIfCmn.FordResrchFctEnad
    connect CustDiag.FordTqSteerCmpEnad -> CDD_FordBlaBoxIfCmn.FordTqSteerCmpEnad
    connect CustDiag.FordTrfcJamAssiEnad -> CDD_FordBlaBoxIfCmn.FordTrfcJamAssiEnad
    connect CustDiag.FordSrvPullDriftCmpRstVal -> CDD_FordBlaBoxIfCmp1.FordSrvPullDriftCmpRstVal
    connect CustDiag.CustXcpEna -> CDD_XcpIf.CustXcpEna
    connect CustDiag.FordAbsPrsnt -> FordHwAgArbn.FordAbsPrsnt
    connect CustDiag.FordBrkPlsRejctnEnad -> FordMsg077BusHiSpd.FordBrkOscnRednEnad
    connect CustDiag.FordEvasSteerAssiEnad -> FordMsg077BusHiSpd.FordEvasSteerAssiEnad
    connect CustDiag.FordLaneCentrAssiEnad -> FordMsg077BusHiSpd.FordLaneCentrAssiEnad
    connect CustDiag.FordLaneKeepAssiEnad -> FordMsg077BusHiSpd.FordLaneKeepAssiEnad
    connect CustDiag.FordPullDriftCmpEnad -> FordMsg077BusHiSpd.FordPullDriftCmpEnad
    connect CustDiag.FordTqSteerCmpEnad -> FordMsg077BusHiSpd.FordTqSteerCmpEnad
    connect CustDiag.FordTrfcJamAssiEnad -> FordMsg077BusHiSpd.FordTrfcJamAssiEnad
    connect CustDiag.FordTrlrBackupAssiEnad -> FordMsg077BusHiSpd.FordTrlrBackUpAssiEnad
    connect CustDiag.FordBrkPlsRejctnEnad -> FordMsg07DBusHiSpd.FordBrkOscnRednEnad
    connect CustDiag.FordLaneDprtrWarnEnad -> FordMsg083BusHiSpd.FordLaneDetnWarnEnad
    connect CustDiag.FordLaneCentrAssiEnad -> FordMsg091BusHiSpd.FordLaneCentrAssiEnad
    connect CustDiag.FordTrfcJamAssiEnad -> FordMsg091BusHiSpd.FordTrfcJamAssiEnad
    connect CustDiag.FordBrkPlsRejctnEnad -> FordMsg167BusHiSpd.FordBrkOscnRednEnad
    connect CustDiag.FordTqSteerCmpEnad -> FordMsg167BusHiSpd.FordTqSteerCmpEnad
    connect CustDiag.FordAbsPrsnt -> FordMsg202BusHiSpd.FordAbsPrsnt
    connect CustDiag.FordBrkPlsRejctnEnad -> FordMsg202BusHiSpd.FordBrkOscnRednEnad
    connect CustDiag.FordTqSteerCmpEnad -> FordMsg202BusHiSpd.FordTqSteerCmpEnad
    connect CustDiag.FordBrkPlsRejctnEnad -> FordMsg213BusHiSpd.FordBrkOscnRednEnad
    connect CustDiag.FordEvasSteerAssiEnad -> FordMsg213BusHiSpd.FordEvasSteerAssiEnad
    connect CustDiag.FordLaneCentrAssiEnad -> FordMsg213BusHiSpd.FordLaneCentrAssiEnad
    connect CustDiag.FordLaneDprtrWarnEnad -> FordMsg213BusHiSpd.FordLaneDetnWarnEnad
    connect CustDiag.FordLaneKeepAssiEnad -> FordMsg213BusHiSpd.FordLkaEnad
    connect CustDiag.FordTrfcJamAssiEnad -> FordMsg213BusHiSpd.FordTrfcJamAssiEnad
    connect CustDiag.FordBrkPlsRejctnEnad -> FordMsg216BusHiSpd.FordBrkOscnRednEnad
    connect CustDiag.FordTqSteerCmpEnad -> FordMsg216BusHiSpd.FordTqSteerCmpEnad
    connect CustDiag.FordAbsPrsnt -> FordMsg217BusHiSpd.FordAbsPrsnt
    connect CustDiag.FordActvNiblCtrlEnad -> FordMsg217BusHiSpd.FordActvNiblCtrlEnad
    connect CustDiag.FordBrkPlsRejctnEnad -> FordMsg217BusHiSpd.FordBrkOscnRednEnad
    connect CustDiag.FordTqSteerCmpEnad -> FordMsg217BusHiSpd.FordTqSteerCmpEnad
    connect CustDiag.FordEvasSteerAssiEnad -> FordMsg2FDBusHiSpd.FordEvasSteerAssiEnad
    connect CustDiag.FordLaneDprtrWarnEnad -> FordMsg3CABusHiSpd.FordLaneDetnWarnEnad
    connect CustDiag.FordLaneKeepAssiEnad -> FordMsg3CABusHiSpd.FordLaneKeepAssiEnad
    connect CustDiag.FordLaneCentrAssiEnad -> FordMsg3D3BusHiSpd.FordLaneCentrAssiEnad
    connect CustDiag.FordTrfcJamAssiEnad -> FordMsg3D3BusHiSpd.FordTrfcJamAssiEnad
    connect CustDiag.FordEvasSteerAssiEnad -> FordMsg3D7BusHiSpd.FordEvasSteerAssiEnad
    connect CustDiag.FordAbsPrsnt -> FordMsg415BusHiSpd.FordAbsPrsnt
    connect CustDiag.FordSelDrvModEnad -> FordMsg41EBusHiSpd.FordSelDrvModEnad
    connect CustDiag.FordTrlrBackupAssiEnad -> FordMsg47ABusHiSpd.FordTrlrBackupAssiEnad
    connect CustDiag.FordBrkPlsRejctnEnad -> FordMsg4B0BusHiSpd.FordBrkOscnRednEnad
    connect CustDiag.FordEvasSteerAssiEnad -> FordMsg4B0BusHiSpd.FordEvasSteerAssiEnad
    connect CustDiag.FordLaneCentrAssiEnad -> FordMsg4B0BusHiSpd.FordLaneCentrAssiEnad
    connect CustDiag.FordTqSteerCmpEnad -> FordMsg4B0BusHiSpd.FordTqSteerCmpEnad
    connect CustDiag.FordLaneDprtrWarnEnad -> FordMsg4B0BusHiSpd.LaneDetnWarnEnad
    connect CustDiag.FordLaneKeepAssiEnad -> FordMsg4B0BusHiSpd.LaneKeepAssiEnad
    connect CustDiag.FordTrfcJamAssiEnad -> FordMsg4B0BusHiSpd.TrfcJamAssiEnad
    connect CustDiag.FordAbsPrsnt -> FordVehSpdArbn.FordAbsModlPrsnt
    connect CustDiag.FordEscPrsnt -> FordVehSpdArbn.FordEscModlPrsnt
    connect CustDiag.FordActvParkAssiEnad -> FordVltgIf.FordActvParkAssiEnad
    connect CustDiag.FordEvasSteerAssiEnad -> FordVltgIf.FordEvasSteerAssiEnad
    connect CustDiag.FordLaneCentrAssiEnad -> FordVltgIf.FordLaneCentrAssiEnad
    connect CustDiag.FordLaneDprtrWarnEnad -> FordVltgIf.FordLaneDprtrWarnEnad
    connect CustDiag.FordLaneKeepAssiEnad -> FordVltgIf.FordLaneKeepAssiEnad
    connect CustDiag.FordTrfcJamAssiEnad -> FordVltgIf.FordTrfcJamAssiEnad
    connect CustDiag.ClrDiagcReq -> ImcArbn.ClrDiagcReq
    connect CustDiag.FordAbsPrsnt -> ImcArbn.FordAbsPrsnt
    connect CustDiag.FordActvParkAssiEnad -> ImcArbn.FordActvParkAssiEnad
    connect CustDiag.FordActvRtnEnad -> ImcArbn.FordActvRtnEnad
    connect CustDiag.FordAfsEquid -> ImcArbn.FordAfsEquid
    connect CustDiag.FordDrvrSteerRcmdnEnad -> ImcArbn.FordDrvrSteerRcmdnEnad
    connect CustDiag.FordEngTqClass -> ImcArbn.FordEngTqClass
    connect CustDiag.FordEscPrsnt -> ImcArbn.FordEscPrsnt
    connect CustDiag.FordSelDrvModEnad -> ImcArbn.FordSelDrvModEnad
    connect CustDiag.FordSoftEndStopEnad -> ImcArbn.FordSoftEndStopEnad
    connect CustDiag.FordStrtStopSt -> ImcArbn.FordStrtStopSt
    connect CustDiag.RstReq -> ImcArbn.RstReq
    connect CustDiag.RtnDC00Req -> ImcArbn.RtnDC00Req
    connect CustDiag.FordActvRtnEnad -> Rtn.RtnCmdDiagcDi
    connect Dampg.DampgCmdBas -> DampgPahSum.DampgCmdBas
    connect DampgPahSum.DampgCmd -> AssiSumLim.DampgCmd
    connect DiagcMgr.CnvSnpshtData_u08 -> CDD_HwTq8Meas.CnvSnpshtData_u08
    connect DiagcMgr.CnvSnpshtData_f32 -> CDD_MotAg5Meas.CnvSnpshtData_f32
    connect DiagcMgr.CnvSnpshtData_logl -> CDD_MotAg5Meas.CnvSnpshtData_logl
    connect DiagcMgr.CnvSnpshtData_f32 -> CDD_MotAg6Meas.CnvSnpshtData_f32
    connect DiagcMgr.CnvSnpshtData_logl -> CDD_MotAg6Meas.CnvSnpshtData_logl
    connect DiagcMgr.ClrAllDiagc -> CmnMfgSrv.ClrAllDiagc
    connect DiagcMgr.ClrLtchCntrData -> CmnMfgSrv.ClrLtchCntrData
    connect DiagcMgr.ClrSnpshtData -> CmnMfgSrv.ClrSnpshtData
    connect DiagcMgr.ReadSnpshtData -> CmnMfgSrv.ReadExtdSnpshtData
    connect DiagcMgr.ReadLtchCntrData -> CmnMfgSrv.ReadLtchCntrData
    connect DiagcMgr.ReadNtcFltAry -> CmnMfgSrv.ReadNtcFltAry
    connect DiagcMgr.ReadNtcInfoAndDebCntr -> CmnMfgSrv.ReadNtcInfoAndDebCntr
    connect DiagcMgr.ReadSnpshtData -> CmnMfgSrv.ReadSnpshtData
    connect DiagcMgr.ClrAllDiagc -> CustDiag.ClrAllDiagc
    connect DiagcMgr.ClrLtchCntrData -> CustDiag.ClrLtchCntrData
    connect DiagcMgr.ClrDiagcFlgProxy -> DiagcMgrProxyAppl10.ClrDiagcFlgProxy
    connect DiagcMgr.DiagcMgrIninCore -> DiagcMgrProxyAppl10.DiagcMgrIninCore
    connect DiagcMgr.GetNtcActvCore -> DiagcMgrProxyAppl10.GetNtcActvCore
    connect DiagcMgr.GetNtcQlfrStsCore -> DiagcMgrProxyAppl10.GetNtcQlfrStsCore
    connect DiagcMgr.GetNtcStsCore -> DiagcMgrProxyAppl10.GetNtcStsCore
    connect DiagcMgr.SetNtcStsCore -> DiagcMgrProxyAppl10.SetNtcStsCore
    connect DiagcMgr.CnvSnpshtData_f32 -> EcuTMeas.CnvSnpshtData_f32
    connect DiagcMgr.CnvSnpshtData_logl -> EcuTMeas.CnvSnpshtData_logl
    connect DiagcMgr.ClrDiagcFlgProxy -> FordMsg07DBusHiSpd.ClrDiagcFlgProxy
    connect DiagcMgr.ClrDiagcFlgProxy -> FordMsg083BusHiSpd.ClrDiagcFlgProxy
    connect DiagcMgr.ClrDiagcFlgProxy -> FordMsg091BusHiSpd.ClrDiagcFlgProxy
    connect DiagcMgr.ClrDiagcFlgProxy -> FordMsg167BusHiSpd.ClrDiagcFlgProxy
    connect DiagcMgr.ClrDiagcFlgProxy -> FordMsg202BusHiSpd.ClrDiagcFlgProxy
    connect DiagcMgr.ClrDiagcFlgProxy -> FordMsg213BusHiSpd.ClrDiagcFlgProxy
    connect DiagcMgr.ClrDiagcFlgProxy -> FordMsg{215..217}BusHiSpd.ClrDiagcFlgProxy
    connect DiagcMgr.ClrDiagcFlgProxy -> FordMsg230BusHiSpd.ClrDiagcFlgProxy
    connect DiagcMgr.ClrDiagcFlgProxy -> FordMsg2FDBusHiSpd.ClrDiagcFlgProxy
    connect DiagcMgr.ClrDiagcFlgProxy -> FordMsg3B3BusHiSpd.ClrDiagcFlgProxy
    connect DiagcMgr.ClrDiagcFlgProxy -> FordMsg3CABusHiSpd.ClrDiagcFlgProxy
    connect DiagcMgr.ClrDiagcFlgProxy -> FordMsg3D3BusHiSpd.ClrDiagcFlgProxy
    connect DiagcMgr.ClrDiagcFlgProxy -> FordMsg3D7BusHiSpd.ClrDiagcFlgProxy
    connect DiagcMgr.ClrDiagcFlgProxy -> FordMsg40ABusHiSpd.ClrDiagcFlgProxy
    connect DiagcMgr.ClrDiagcFlgProxy -> FordMsg415BusHiSpd.ClrDiagcFlgProxy
    connect DiagcMgr.ClrDiagcFlgProxy -> FordMsg41ABusHiSpd.ClrDiagcFlgProxy
    connect DiagcMgr.ClrDiagcFlgProxy -> FordMsg41EBusHiSpd.ClrDiagcFlgProxy
    connect DiagcMgr.ClrDiagcFlgProxy -> FordMsg430BusHiSpd.ClrDiagcFlgProxy
    connect DiagcMgr.ClrDiagcFlgProxy -> FordMsg443BusHiSpd.ClrDiagcFlgProxy
    connect DiagcMgr.ClrDiagcFlgProxy -> FordMsg459BusHiSpd.ClrDiagcFlgProxy
    connect DiagcMgr.ClrDiagcFlgProxy -> FordMsg47ABusHiSpd.ClrDiagcFlgProxy
    connect DiagcMgr.ClrDiagcFlgProxy -> FordMsg4B0BusHiSpd.ClrDiagcFlgProxy
    connect DiagcMgr.DiagcStsNonRcvrlReqDiFltPrsnt -> ImcArbn.DiagcStsNonRcrvlReqDiFltPrsnt
    connect DiagcMgr.DiagcStsCtrldShtDwnFltPrsnt -> MotTqTranlDampg.DiagcStsCtrldShtDwnFltPrsnt
    connect DiagcMgr.CnvSnpshtData_f32 -> PwrDiscnct.CnvSnpshtData_f32
    connect DiagcMgr.DiagcStsCtrldShtDwnFltPrsnt -> StOutpCtrl.DiagcStsCtrldShtDwnFltPrsnt
    connect DiagcMgr.SysDiMotTqCmdSca -> StOutpCtrl.SysDiMotTqCmdSca
    connect DiagcMgr.SysDiRampRate -> StOutpCtrl.SysDiRampRate
    connect DiagcMgr.SysStFltOutpReqDi -> StOutpCtrl.SysStFltOutpReqDi
    connect DiagcMgr.SysStFltOutpReqDi -> SysStMod.SysStFltOutpReqDi
    connect DiagcMgrProxyAppl10.GetNtcQlfrSts10 -> AssiSumLim.GetNtcQlfrSts
    connect DiagcMgrProxyAppl10.SetNtcSts10 -> AssiSumLim.SetNtcSts
    connect DiagcMgrProxyAppl10.GetNtcQlfrSts10 -> BattVltgCorrln.GetNtcQlfrSts
    connect DiagcMgrProxyAppl10.SetNtcSts10 -> BattVltgCorrln.SetNtcSts
    connect DiagcMgrProxyAppl10.SetNtcSts10 -> CDD_CoreVltgMonr.SetNtcSts
    connect DiagcMgrProxyAppl10.GetNtcQlfrSts10 -> CDD_CurrMeas.GetNtcQlfrSts
    connect DiagcMgrProxyAppl10.SetNtcSts10 -> CDD_CurrMeas.SetNtcSts
    connect DiagcMgrProxyAppl10.SetNtcSts10 -> CDD_ExcpnHndlg.SetNtcSts
    connect DiagcMgrProxyAppl10.SetNtcStsAndSnpshtData10 -> CDD_ExcpnHndlg.SetNtcStsAndSnpshtData
    connect DiagcMgrProxyAppl10.SetNtcSts10 -> CDD_FlsMem.SetNtcSts
    connect DiagcMgrProxyAppl10.GetNtcQlfrSts10 -> CDD_HwTq1Meas.GetNtcQlfrSts
    connect DiagcMgrProxyAppl10.SetNtcSts10 -> CDD_HwTq1Meas.SetNtcSts
    connect DiagcMgrProxyAppl10.GetNtcQlfrSts10 -> CDD_HwTq8Meas.GetNtcQlfrSts
    connect DiagcMgrProxyAppl10.SetNtcStsAndSnpshtData10 -> CDD_HwTq8Meas.SetNtcStsAndSnpshtData
    connect DiagcMgrProxyAppl10.SetNtcSts10 -> CDD_McuDiagc.SetNtcSts
    connect DiagcMgrProxyAppl10.GetNtcQlfrSts10 -> CDD_MotAg5Meas.GetNtcQlfrSts
    connect DiagcMgrProxyAppl10.SetNtcStsAndSnpshtData10 -> CDD_MotAg5Meas.SetNtcStsAndSnpshtData
    connect DiagcMgrProxyAppl10.GetNtcQlfrSts10 -> CDD_MotAg6Meas.GetNtcQlfrSts
    connect DiagcMgrProxyAppl10.SetNtcStsAndSnpshtData10 -> CDD_MotAg6Meas.SetNtcStsAndSnpshtData
    connect DiagcMgrProxyAppl10.SetNtcSts10 -> CDD_NvMProxy.SetNtcSts
    connect DiagcMgrProxyAppl10.SetNtcSts10 -> CDD_NxtrTi.SetNtcSts
    connect DiagcMgrProxyAppl10.SetNtcSts10 -> CDD_RamMem.SetNtcSts
    connect DiagcMgrProxyAppl10.SetNtcSts10 -> CDD_VrfyCritReg.SetNtcSts
    connect DiagcMgrProxyAppl10.GetNtcSts10 -> CmnMfgSrv.GetNtcSts
    connect DiagcMgrProxyAppl10.GetNtcQlfrSts10 -> CurrMeasCorrln.GetNtcQlfrSts
    connect DiagcMgrProxyAppl10.SetNtcSts10 -> CurrMeasCorrln.SetNtcSts
    connect DiagcMgrProxyAppl10.SetNtcSts10 -> CustDiag.SetNtcSts
    connect DiagcMgrProxyAppl10.GetDiagcDataAppl10 -> DiagcMgr.GetDiagcDataAppl10
    connect DiagcMgrProxyAppl10.GetNtcDebCntrAppl10 -> DiagcMgr.GetNtcDebCntrAppl10
    connect DiagcMgrProxyAppl10.GetNtcInfoAppl10 -> DiagcMgr.GetNtcInfoAppl10
    connect DiagcMgrProxyAppl10.SetNtcSts10 -> DiagcMgr.SetNtcSts
    connect DiagcMgrProxyAppl10.SetNtcSts10 -> DualEcuIdn.SetNtcSts
    connect DiagcMgrProxyAppl10.SetNtcSts10 -> DutyCycThermProtn.SetNtcSts
    connect DiagcMgrProxyAppl10.GetNtcActv10 -> EcuTMeas.GetNtcActv
    connect DiagcMgrProxyAppl10.SetNtcStsAndSnpshtData10 -> EcuTMeas.SetNtcStsAndSnpshtData
    connect DiagcMgrProxyAppl10.GetNtcQlfrSts10 -> EotLrng.GetNtcQlfrSts
    connect DiagcMgrProxyAppl10.SetNtcSts10 -> EotLrng.SetNtcSts
    connect DiagcMgrProxyAppl10.SetNtcSts10 -> EotProtnFwl.SetNtcSts
    connect DiagcMgrProxyAppl10.SetNtcSts10 -> FordDualEcuFltDiagcCom.SetNtcSts
    connect DiagcMgrProxyAppl10.GetNtcActv10 -> FordHwAgArbn.GetNtcActv
    connect DiagcMgrProxyAppl10.SetNtcSts10 -> FordHwAgArbn.SetNtcSts
    connect DiagcMgrProxyAppl10.GetNtcQlfrSts10 -> FordHwTqCdng.GetNtcQlfrSts
    connect DiagcMgrProxyAppl10.SetNtcSts10 -> FordMotTqCmdOvrlLimr.SetNtcSts
    connect DiagcMgrProxyAppl10.SetNtcSts10 -> FordMsg077BusHiSpd.SetNtcSts
    connect DiagcMgrProxyAppl10.SetNtcSts10 -> FordMsg07DBusHiSpd.SetNtcSts
    connect DiagcMgrProxyAppl10.SetNtcSts10 -> FordMsg083BusHiSpd.SetNtcSts
    connect DiagcMgrProxyAppl10.SetNtcSts10 -> FordMsg091BusHiSpd.SetNtcSts
    connect DiagcMgrProxyAppl10.SetNtcSts10 -> FordMsg167BusHiSpd.SetNtcSts
    connect DiagcMgrProxyAppl10.SetNtcSts10 -> FordMsg202BusHiSpd.SetNtcSts
    connect DiagcMgrProxyAppl10.SetNtcSts10 -> FordMsg213BusHiSpd.SetNtcSts
    connect DiagcMgrProxyAppl10.SetNtcSts10 -> FordMsg{215..217}BusHiSpd.SetNtcSts
    connect DiagcMgrProxyAppl10.SetNtcSts10 -> FordMsg230BusHiSpd.SetNtcSts
    connect DiagcMgrProxyAppl10.SetNtcSts10 -> FordMsg2FDBusHiSpd.SetNtcSts
    connect DiagcMgrProxyAppl10.SetNtcSts10 -> FordMsg3B3BusHiSpd.SetNtcSts
    connect DiagcMgrProxyAppl10.SetNtcSts10 -> FordMsg3CABusHiSpd.SetNtcSts
    connect DiagcMgrProxyAppl10.SetNtcSts10 -> FordMsg3D3BusHiSpd.SetNtcSts
    connect DiagcMgrProxyAppl10.SetNtcSts10 -> FordMsg3D7BusHiSpd.SetNtcSts
    connect DiagcMgrProxyAppl10.SetNtcSts10 -> FordMsg40ABusHiSpd.SetNtcSts
    connect DiagcMgrProxyAppl10.SetNtcSts10 -> FordMsg415BusHiSpd.SetNtcSts
    connect DiagcMgrProxyAppl10.SetNtcSts10 -> FordMsg41ABusHiSpd.SetNtcSts
    connect DiagcMgrProxyAppl10.SetNtcSts10 -> FordMsg41EBusHiSpd.SetNtcSts
    connect DiagcMgrProxyAppl10.SetNtcSts10 -> FordMsg430BusHiSpd.SetNtcSts
    connect DiagcMgrProxyAppl10.SetNtcSts10 -> FordMsg443BusHiSpd.SetNtcSts
    connect DiagcMgrProxyAppl10.SetNtcSts10 -> FordMsg459BusHiSpd.SetNtcSts
    connect DiagcMgrProxyAppl10.SetNtcSts10 -> FordMsg47ABusHiSpd.SetNtcSts
    connect DiagcMgrProxyAppl10.SetNtcSts10 -> FordMsg4B0BusHiSpd.SetNtcSts
    connect DiagcMgrProxyAppl10.GetNtcQlfrSts10 -> FordSysSt.GetNtcQlfrSts
    connect DiagcMgrProxyAppl10.SetNtcSts10 -> FordVltgIf.SetNtcSts
    connect DiagcMgrProxyAppl10.GetNtcQlfrSts10 -> GateDrv0Ctrl.GetNtcQlfrSts
    connect DiagcMgrProxyAppl10.SetNtcSts10 -> GateDrv0Ctrl.SetNtcSts
    connect DiagcMgrProxyAppl10.SetNtcStsAndSnpshtData10 -> GateDrv0Ctrl.SetNtcStsAndSnpshtData
    connect DiagcMgrProxyAppl10.GetNtcQlfrSts10 -> HwAg1Meas.GetNtcQlfrSts
    connect DiagcMgrProxyAppl10.SetNtcSts10 -> HwAg1Meas.SetNtcSts
    connect DiagcMgrProxyAppl10.GetNtcQlfrSts10 -> HwAgSnsrls.GetNtcQlfrSts
    connect DiagcMgrProxyAppl10.GetNtcQlfrSts10 -> HwAgSysArbn.GetNtcQlfrSts
    connect DiagcMgrProxyAppl10.SetNtcSts10 -> HwAgSysArbn.SetNtcSts
    connect DiagcMgrProxyAppl10.GetNtcQlfrSts10 -> HwTq10Meas.GetNtcQlfrSts
    connect DiagcMgrProxyAppl10.SetNtcSts10 -> HwTq10Meas.SetNtcSts
    connect DiagcMgrProxyAppl10.SetNtcStsAndSnpshtData10 -> HwTq10Meas.SetNtcStsAndSnpshtData
    connect DiagcMgrProxyAppl10.GetNtcQlfrSts10 -> HwTq9Meas.GetNtcQlfrSts
    connect DiagcMgrProxyAppl10.SetNtcSts10 -> HwTq9Meas.SetNtcSts
    connect DiagcMgrProxyAppl10.SetNtcStsAndSnpshtData10 -> HwTq9Meas.SetNtcStsAndSnpshtData
    connect DiagcMgrProxyAppl10.GetNtcQlfrSts10 -> HwTqCorrln.GetNtcQlfrSts
    connect DiagcMgrProxyAppl10.SetNtcSts10 -> HwTqCorrln.SetNtcSts
    connect DiagcMgrProxyAppl10.SetNtcSts10 -> ImcArbn.SetNtcSts
    connect DiagcMgrProxyAppl10.SetNtcSts10 -> ImcSigArbn.SetNtcSts
    connect DiagcMgrProxyAppl10.SetNtcSts10 -> LoaMgr.SetNtcSts
    connect DiagcMgrProxyAppl10.GetNtcQlfrSts10 -> MotAg2Meas.GetNtcQlfrSts
    connect DiagcMgrProxyAppl10.SetNtcSts10 -> MotAg2Meas.SetNtcSts
    connect DiagcMgrProxyAppl10.GetNtcQlfrSts10 -> MotAgCorrln.GetNtcQlfrSts
    connect DiagcMgrProxyAppl10.SetNtcSts10 -> MotAgCorrln.SetNtcSts
    connect DiagcMgrProxyAppl10.SetNtcSts10 -> NxtrMath.SetNtcSts
    connect DiagcMgrProxyAppl10.SetNtcStsAndSnpshtData10 -> PwrDiscnct.SetNtcStsAndSnpshtData
    connect DiagcMgrProxyAppl10.SetNtcSts10 -> PwrLimr.SetNtcSts
    connect DiagcMgrProxyAppl10.SetNtcSts10 -> PwrSply.SetNtcSts
    connect DiagcMgrProxyAppl10.SetNtcSts10 -> RtnPahFwl.SetNtcSts
    connect DiagcMgrProxyAppl10.GetNtcQlfrSts10 -> SysFricLrng.GetNtcQlfrSts
    connect DiagcMgrProxyAppl10.SetNtcSts10 -> SysFricLrng.SetNtcSts
    connect DiagcMgrProxyAppl10.GetNtcQlfrSts10 -> SysPrfmncSts.GetNtcQlfrSts
    connect DiagcMgrProxyAppl10.SetNtcSts10 -> TmplMonr.SetNtcSts
    connect DiagcMgrProxyAppl10.SetNtcSts10 -> TunSelnMngt.SetNtcSts
    connect DiagcMgrStub.GetDiagcDataStub -> DiagcMgr.GetDiagcDataAppl{0..9}
    connect DiagcMgrStub.GetNtcDebCntrStub -> DiagcMgr.GetNtcDebCntrAppl{0..9}
    connect DiagcMgrStub.GetNtcInfoStub -> DiagcMgr.GetNtcInfoAppl{0..9}
    connect DualCtrlrOutpMgr.DualEcuMotCtrlMtgtnEna -> CDD_MotCtrlMgr.DualEcuMotCtrlMtgtnEna
    connect DualCtrlrOutpMgr.DualEcuFltMtgtnEna -> DutyCycThermProtn.DualEcuFltMtgtnEna
    connect DualCtrlrOutpMgr.DualEcuFltMtgtnEna -> HiLoadStallLimr.DualEcuFltMtgtnEna
    connect DualCtrlrOutpMgr.DualEcuMotCtrlMtgtnEna -> ImcArbn.DualEcuMotCtrlMtgtnEna
    connect DualCtrlrOutpMgr.DualEcuFltMtgtnEna -> MotCtrlPrmEstimn.DualEcuFltMtgtnEna
    connect DualCtrlrOutpMgr.DualEcuMotCtrlMtgtnEna -> MotCurrPeakEstimn.DualEcuMotCtrlMtgtnEna
    connect DualCtrlrOutpMgr.DualEcuMotCtrlMtgtnEna -> MotCurrRegCfg.DualEcuMotCtrlMtgtnEna
    connect DualCtrlrOutpMgr.DualEcuMotCtrlMtgtnEna -> MotRefMdl.DualEcuMotCtrlMtgtnEna
    connect DualCtrlrOutpMgr.DualEcuFltMtgtnSca -> PwrLimr.DualEcuFltMtgtnSca
    connect DualCtrlrOutpMgr.DualEcuFltMtgtnEna -> TEstimn.DualEcuFltMtgtnEna
    connect DualEcuIdn.EcuId -> CDD_FordBlaBoxIfCmn.EcuId
    connect DualEcuIdn.EcuId -> CDD_FordBlaBoxIfCmp1.EcuId
    connect DualEcuIdn.EcuId -> CDD_FordBlaBoxIfCmp2.EcuId
    connect DualEcuIdn.EcuId -> CDD_FordT3T6McuCfg.EcuId
    connect DualEcuIdn.EcuId -> CustDiag.EcuId
    connect DualEcuIdn.EcuId -> FordCmdArbn.EcuId
    connect DualEcuIdn.EcuId -> FordDualEcuFltDiagcCom.EcuId
    connect DualEcuIdn.EcuId -> FordHwTqCdng.EcuId
    connect DualEcuIdn.EcuId -> FordHwTqCmdOvrlLimr.EcuId
    connect DualEcuIdn.EcuId -> FordMotTqCmdOvrlLimr.EcuId
    connect DualEcuIdn.EcuId -> HwAgSnsrls.EcuId
    connect DualEcuIdn.EcuId -> HwAgSysArbn.EcuID
    connect DualEcuIdn.EcuId -> ImcArbn.EcuId
    connect DualEcuIdn.EcuId -> ImcSigArbn.EcuIdn
    connect DutyCycThermProtn.ThermLimSlowFilMax -> Assi.ThermLimSlowFilMax
    connect DutyCycThermProtn.ThermRednFac -> AssiSumLim.ThermRednFac
    connect DutyCycThermProtn.ThermMotTqLim -> LimrCdng.ThermMotTqLim
    connect DutyCycThermProtn.DutyCycThermProtnMaxOutp -> SysPrfmncSts.DutyCycThermProtnMaxOutp
    connect DutyCycThermProtn.ThermDutyCycProtnLoadDptLim -> SysPrfmncSts.ThermDutyCycProtnLoadDptLim
    connect DutyCycThermProtn.ThermDutyCycProtnTDptLim -> SysPrfmncSts.ThermDutyCycProtnTDptLim
    connect EcuTMeas.EcuTFild -> CDD_MotCtrlMgr.EcuTFild
    connect EcuTMeas.EcuTFild -> CmnMfgSrv.EcuTFild
    connect EcuTMeas.EcuTFild -> CustDiag.EcuTFild
    connect EcuTMeas.EcuTFild -> DiagcMgr.EcuTFild
    connect EcuTMeas.DiagcStsLimdTPrfmnc -> DutyCycThermProtn.DiagcStsLimdTPrfmnc
    connect EcuTMeas.EcuTFild -> DutyCycThermProtn.EcuTFild
    connect EcuTMeas.EcuTFild -> SysPrfmncSts.EcuTFild
    connect EcuTMeas.EcuTFild -> TEstimn.EcuTFild
    connect ElecPwrCns.SplyCurrEstim -> FordVltgIf.BattRtnCurr
    connect ElecPwrCns.SplyCurrEstim -> ImcArbn.BattRtnCurr
    connect EotLrng.GetHwAgOverTrvlCnt -> CmnMfgSrv.GetHwAgOverTrvlCnt
    connect EotLrng.RstHwAgOverTrvlCnt -> CmnMfgSrv.RstHwAgOverTrvlCnt
    connect EotLrng.RstMaxHwAgCwAndCcw -> CmnMfgSrv.RstMaxHwAgCwAndCcw
    connect EotLrng.RtnMaxHwAgCwAndCcw -> CmnMfgSrv.RtnMaxHwAgCwAndCcw
    connect EotLrng.SerlComRstEot -> CmnMfgSrv.SerlComRstEot
    connect EotLrng.SetHwAgOverTrvlCnt -> CmnMfgSrv.SetHwAgOverTrvlCnt
    connect EotLrng.HwAgCcwDetd -> EotProtn.HwAgCcwDetd
    connect EotLrng.HwAgCwDetd -> EotProtn.HwAgCwDetd
    connect EotLrng.HwAgEotCcw -> EotProtn.HwAgEotCcw
    connect EotLrng.HwAgEotCw -> EotProtn.HwAgEotCw
    connect EotLrng.HwAgEotCcw -> VehSpdLimr.HwAgEotCcw
    connect EotLrng.HwAgEotCw -> VehSpdLimr.HwAgEotCw
    connect EotProtn.EotActvCmd -> EotProtnFwl.EotActvCmd
    connect EotProtn.EotDampgCmd -> EotProtnFwl.EotDampgCmd
    connect EotProtn.EotAssiSca -> LimrCdng.EotAssiSca
    connect EotProtn.EotMotTqLim -> LimrCdng.EotMotTqLim
    connect EotProtnFwl.EotActvCmdLimd -> AssiSumLim.EotActvCmd
    connect EotProtnFwl.EotDampgCmdLimd -> AssiSumLim.EotDampgCmd
    connect FltInj.FltInj_f32 -> Assi.FltInj_f32
    connect FltInj.FltInj_f32 -> CDD_CurrMeas.FltInj_f32
    connect FltInj.FltInj_u08 -> CDD_CurrMeas.FltInj_u08
    connect FltInj.FltInj_f32 -> CDD_HwTq1Meas.FltInj_f32
    connect FltInj.FltInj_f32 -> CDD_HwTq8Meas.FltInj_f32
    connect FltInj.FltInj_u08 -> CDD_HwTq8Meas.FltInj_u08
    connect FltInj.FltInj_u08 -> CurrMeasCorrln.FltInj_u08
    connect FltInj.FltInj_f32 -> Dampg.FltInj_f32
    connect FltInj.FltInj_u08 -> HwAgCorrln.FltInj_u08
    connect FltInj.FltInj_f32 -> HwAgSysArbn.FltInj_f32
    connect FltInj.FltInj_u08 -> HwTqCorrln.FltInj_u08
    connect FltInj.FltInj_f32 -> HysCmp.FltInj_f32
    connect FltInj.FltInj_f32 -> InertiaCmpVel.FltInj_f32
    connect FltInj.FltInj_f32 -> LimrCdng.FltInj_f32
    connect FltInj.FltInj_f32 -> MotAg2Meas.FltInj_f32
    connect FltInj.FltInj_u08 -> MotAgCorrln.FltInj_u08
    connect FltInj.FltInj_f32 -> Rtn.FltInj_f32
    connect FltInj.FltInj_f32 -> StabyCmp.FltInj_f32
    connect FltInj.FltInj_f32 -> SysFricLrng.FltInj_f32
    connect FltInj.FltInj_f32 -> VehSigCdng.FltInj_f32
    connect FordCanDtcInhb.FordEpsLifeCycMod -> CustDiag.FordEpsLifeCycMod
    connect FordCanDtcInhb.FordCanDtcInhb -> FordMsg077BusHiSpd.FordCanDtcInhb
    connect FordCanDtcInhb.FordEpsLifeCycMod -> FordMsg077BusHiSpd.FordEpsLifeCycMod
    connect FordCanDtcInhb.FordCanDtcInhb -> FordMsg07DBusHiSpd.FordCanDtcInhb
    connect FordCanDtcInhb.FordEpsLifeCycMod -> FordMsg07DBusHiSpd.FordEpsLifeCycMod
    connect FordCanDtcInhb.FordCanDtcInhb -> FordMsg083BusHiSpd.FordCanDtcInhb
    connect FordCanDtcInhb.FordEpsLifeCycMod -> FordMsg083BusHiSpd.FordEpsLifeCycMod
    connect FordCanDtcInhb.FordCanDtcInhb -> FordMsg091BusHiSpd.FordCanDtcInhb
    connect FordCanDtcInhb.FordEpsLifeCycMod -> FordMsg091BusHiSpd.FordEpsLifeCycMod
    connect FordCanDtcInhb.FordCanDtcInhb8 -> FordMsg167BusHiSpd.FordCanDtcInhb
    connect FordCanDtcInhb.FordEpsLifeCycMod -> FordMsg167BusHiSpd.FordEpsLifeCycMod
    connect FordCanDtcInhb.FordCanDtcInhb8 -> FordMsg202BusHiSpd.FordCanDtcInhb
    connect FordCanDtcInhb.FordEpsLifeCycMod -> FordMsg202BusHiSpd.FordEpsLifeCycMod
    connect FordCanDtcInhb.FordCanDtcInhb -> FordMsg213BusHiSpd.FordCanDtcInhb
    connect FordCanDtcInhb.FordEpsLifeCycMod -> FordMsg213BusHiSpd.FordEpsLifeCycMod
    connect FordCanDtcInhb.FordCanDtcInhb -> FordMsg215BusHiSpd.FordCanDtcInhb
    connect FordCanDtcInhb.FordEpsLifeCycMod -> FordMsg215BusHiSpd.FordEpsLifeCycMod
    connect FordCanDtcInhb.FordCanDtcInhb -> FordMsg216BusHiSpd.FordCanDtcInhb
    connect FordCanDtcInhb.FordEpsLifeCycMod -> FordMsg216BusHiSpd.FordEpsLifeCycMod
    connect FordCanDtcInhb.FordCanDtcInhb8 -> FordMsg217BusHiSpd.FordCanDtcInhb
    connect FordCanDtcInhb.FordEpsLifeCycMod -> FordMsg217BusHiSpd.FordEpsLifeCycMod
    connect FordCanDtcInhb.FordCanDtcInhb -> FordMsg230BusHiSpd.FordCanDtcInhb
    connect FordCanDtcInhb.FordEpsLifeCycMod -> FordMsg230BusHiSpd.FordEpsLifeCycMod
    connect FordCanDtcInhb.FordCanDtcInhb -> FordMsg2FDBusHiSpd.FordCanDtcInhb
    connect FordCanDtcInhb.FordEpsLifeCycMod -> FordMsg2FDBusHiSpd.FordEpsLifeCycMod
    connect FordCanDtcInhb.FordCanDtcInhb8 -> FordMsg3B3BusHiSpd.FordCanDtcInhb
    connect FordCanDtcInhb.FordEpsLifeCycMod -> FordMsg3B3BusHiSpd.FordEpsLifeCycMod
    connect FordCanDtcInhb.FordCanDtcInhb -> FordMsg3CABusHiSpd.FordCanDtcInhb
    connect FordCanDtcInhb.FordEpsLifeCycMod -> FordMsg3CABusHiSpd.FordEpsLifeCycMod
    connect FordCanDtcInhb.FordCanDtcInhb -> FordMsg3D3BusHiSpd.FordCanDtcInhb
    connect FordCanDtcInhb.FordEpsLifeCycMod -> FordMsg3D3BusHiSpd.FordEpsLifeCycMod
    connect FordCanDtcInhb.FordCanDtcInhb -> FordMsg3D7BusHiSpd.FordCanDtcInhb
    connect FordCanDtcInhb.FordEpsLifeCycMod -> FordMsg3D7BusHiSpd.FordEpsLifeCycMod
    connect FordCanDtcInhb.FordCanDtcInhb8 -> FordMsg40ABusHiSpd.FordCanDtcInhb
    connect FordCanDtcInhb.FordEpsLifeCycMod -> FordMsg40ABusHiSpd.FordEpsLifeCycMod
    connect FordCanDtcInhb.FordCanDtcInhb8 -> FordMsg415BusHiSpd.FordCanDtcInhb
    connect FordCanDtcInhb.FordEpsLifeCycMod -> FordMsg415BusHiSpd.FordEpsLifeCycMod
    connect FordCanDtcInhb.FordCanDtcInhb -> FordMsg41ABusHiSpd.FordCanDtcInhb
    connect FordCanDtcInhb.FordEpsLifeCycMod -> FordMsg41ABusHiSpd.FordEpsLifeCycMod
    connect FordCanDtcInhb.FordCanDtcInhb -> FordMsg41EBusHiSpd.FordCanDtcInhb
    connect FordCanDtcInhb.FordEpsLifeCycMod -> FordMsg41EBusHiSpd.FordEpsLifeCycMod
    connect FordCanDtcInhb.FordCanDtcInhb8 -> FordMsg430BusHiSpd.FordCanDtcInhb
    connect FordCanDtcInhb.FordEpsLifeCycMod -> FordMsg430BusHiSpd.FordEpsLifeCycMod
    connect FordCanDtcInhb.FordCanDtcInhb -> FordMsg443BusHiSpd.FordCanDtcInhb
    connect FordCanDtcInhb.FordEpsLifeCycMod -> FordMsg443BusHiSpd.FordEpsLifeCycMod
    connect FordCanDtcInhb.FordCanDtcInhb -> FordMsg459BusHiSpd.FordCanDtcInhb
    connect FordCanDtcInhb.FordEpsLifeCycMod -> FordMsg459BusHiSpd.FordEpsLifeCycMod
    connect FordCanDtcInhb.FordCanDtcInhb -> FordMsg47ABusHiSpd.FordCanDtcInhb
    connect FordCanDtcInhb.FordEpsLifeCycMod -> FordMsg47ABusHiSpd.FordEpsLifeCycMod
    connect FordCanDtcInhb.FordCanDtcInhb -> FordMsg4B0BusHiSpd.FordCanDtcInhb
    connect FordCanDtcInhb.FordEpsLifeCycMod -> FordMsg4B0BusHiSpd.FordEpsLifeCycMod
    connect FordCmdArbn.FordActvNiblCtrlArbnCmd -> CDD_FordBlaBoxIfCmp1.FordActvNiblCtrlArbnCmd
    connect FordCmdArbn.FordLaneDprtrWarnArbnCmd -> CDD_FordBlaBoxIfCmp1.FordLaneDprtrWarnArbnCmd
    connect FordCmdArbn.FordLaneKeepAssiArbnCmd -> CDD_FordBlaBoxIfCmp1.FordLaneKeepAssiArbnCmd
    connect FordCmdArbn.FordLatCtrlArbnCmd -> CDD_FordBlaBoxIfCmp1.FordLatCtrlArbnCmd
    connect FordCmdArbn.FordPullDriftCmpArbnCmd -> CDD_FordBlaBoxIfCmp1.FordPullDriftCmpArbnCmd
    connect FordCmdArbn.FordPullDriftCmpLrngArbnCmd -> CDD_FordBlaBoxIfCmp1.FordPullDriftCmpLrngArbnCmd
    connect FordCmdArbn.FordEvasSteerAssiArbnCmd -> CDD_FordBlaBoxIfCmp2.FordEvasSteerAssiArbnCmd
    connect FordCmdArbn.FordSteerTqDstbcRejctnArbnCmd -> CDD_FordBlaBoxIfCmp2.FordSteerTqDstbcRejctnArbnCmd
    connect FordCmdArbn.FordDrvrSteerRcmdnArbnCmd -> FordHwTqCmdOvrlLimr.FordDrvrSteerRcmdnArbnCmd
    connect FordCmdArbn.FordEvasSteerAssiArbnCmd -> FordHwTqCmdOvrlLimr.FordEvasSteerAssiArbnCmd
    connect FordCmdArbn.FordLaneKeepAssiArbnCmd -> FordHwTqCmdOvrlLimr.FordLaneKeepAssiArbnCmd
    connect FordCmdArbn.FordActvNiblCtrlArbnCmd -> FordMotTqCmdOvrlLimr.FordActvNiblCtrlArbnCmd
    connect FordCmdArbn.FordLaneDprtrWarnArbnCmd -> FordMotTqCmdOvrlLimr.FordLaneDprtrWarnArbnCmd
    connect FordCmdArbn.FordLatCtrlArbnCmd -> FordMotTqCmdOvrlLimr.FordLatCtrlArbnCmd
    connect FordCmdArbn.FordPullDriftCmpArbnCmd -> FordMotTqCmdOvrlLimr.FordPullDriftCmpArbnCmd
    connect FordCmdArbn.FordSteerTqDstbcRejctnArbnCmd -> FordMotTqCmdOvrlLimr.FordSteerTqDstbcRejctnArbnCmd
    connect FordCmdArbn.FordActvNiblCtrlArbnCmd -> ImcArbn.FordActvNiblCtrlArbnCmd
    connect FordCmdArbn.FordDrvrSteerRcmdnArbnCmd -> ImcArbn.FordDrvrSteerRcmdnArbnCmd
    connect FordCmdArbn.FordEvasSteerAssiArbnCmd -> ImcArbn.FordEvasSteerAssiArbnCmd
    connect FordCmdArbn.FordExtAgCtrlArbnCmd -> ImcArbn.FordExtAgCtrlArbnCmd
    connect FordCmdArbn.FordLaneDprtrWarnArbnCmd -> ImcArbn.FordLaneDprtrWarnArbnCmd
    connect FordCmdArbn.FordLaneKeepAssiArbnCmd -> ImcArbn.FordLaneKeepAssiArbnCmd
    connect FordCmdArbn.FordLatCtrlArbnCmd -> ImcArbn.FordLatCtrlArbnCmd
    connect FordCmdArbn.FordPullDriftCmpArbnCmd -> ImcArbn.FordPullDriftCmpArbnCmd
    connect FordCmdArbn.FordPullDriftCmpLrngArbnCmd -> ImcArbn.FordPullDriftCmpLrngArbnCmd
    connect FordCmdArbn.FordSpare{1..3}ArbnCmd -> ImcArbn.FordSpare{1..3}ArbnCmd
    connect FordCmdArbn.FordSteerTqDstbcRejctnArbnCmd -> ImcArbn.FordSteerTqDstbcRejctnArbnCmd
    connect FordDualEcuFltDiagcCom.FordCtcIdx -> ImcArbn.FordCtcIdx
    connect FordDualEcuFltDiagcCom.FordCtcSts -> ImcArbn.FordCtcSts
    connect FordHwAgArbn.FordCmpdHwPosn -> CDD_FordBlaBoxIfCmn.FordCmpdHwPosn
    connect FordHwAgArbn.FordCmpdHwPosnQlyFac8 -> CDD_FordBlaBoxIfCmn.FordCmpdHwPosnQlyFac
    connect FordHwAgArbn.FordHwVelVld -> CDD_FordBlaBoxIfCmn.FordHwVelVld
    connect FordHwAgArbn.FordRelHwPosn -> CDD_FordBlaBoxIfCmn.FordRelHwPosn
    connect FordHwAgArbn.FordRelHwPosnVld -> CDD_FordBlaBoxIfCmn.FordRelHwPosnVld
    connect FordHwAgArbn.FordCmpdHwPosntoSerlCom -> CustDiag.FordCmpdHwPosn
    connect FordHwAgArbn.FordCmpdHwPosntoSerlCom -> FordMsg07EBusHiSpd.CmpdSteerPinionAg
    connect FordHwAgArbn.FordCmpdHwPosnQlyFac -> FordMsg07EBusHiSpd.CmpdSteerPinionAgQlyFac
    connect FordHwAgArbn.FordRelHwPosntoSerlCom -> FordMsg07EBusHiSpd.RelSteerPinionAg
    connect FordHwTqCdng.FordAppldFinalMotTq -> CDD_FordBlaBoxIfCmn.FordAppldFinalMotTq
    connect FordHwTqCdng.FordAppldFinalMotTqVld -> CDD_FordBlaBoxIfCmn.FordAppldFinalMotTqVld
    connect FordHwTqCdng.FordBoostCrvAssiTq -> CDD_FordBlaBoxIfCmn.FordBoostCrvAssiTq
    connect FordHwTqCdng.FordBoostCrvInpTq -> CDD_FordBlaBoxIfCmn.FordBoostCrvInpTq
    connect FordHwTqCdng.FordInpTqRaw -> CDD_FordBlaBoxIfCmn.FordInpTqRaw
    connect FordHwTqCdng.FordInpTqRawVld -> CDD_FordBlaBoxIfCmn.FordInpTqRawVld
    connect FordHwTqCdng.FordMaxAsscTq -> CDD_FordBlaBoxIfCmn.FordMaxAsscTq
    connect FordHwTqCdng.FordReqdFinalMotTq -> CDD_FordBlaBoxIfCmn.FordReqdFinalMotTq
    connect FordHwTqCdng.FordAppldFinalMotTq -> CustDiag.FordAppldFinalMotTq
    connect FordHwTqCdng.FordInpTqRaw -> CustDiag.FordInpTqRaw
    connect FordHwTqCdng.FordMaxAsscTq -> FordVltgIf.FordMaxAsscTq
    connect FordHwTqCmdOvrlLimr.FordColTqOvrl -> Assi.HwTqOvrl
    connect FordHwTqCmdOvrlLimr.FordColTqOvrl -> FordHwTqCdng.HwTqOvrl
    connect FordHwTqCmdOvrlLimr.FordColTqOvrl -> HysCmp.HwTqOvrl
    connect FordHwTqCmdOvrlLimr.FordColTqOvrl -> ImcArbn.FordColTqOvrl
    connect FordMotTqCmdOvrlLimr.FordMotTqCmdOvrl -> AssiSumLim.MotTqCmdOvrl
    connect FordMotTqCmdOvrlLimr.FordMotTqCmdOvrl -> ImcArbn.FordMotTqCmdOvrl
    connect FordMsg077BusHiSpd.FordVehLatACmpdRaw -> CDD_FordBlaBoxIfCmn.FordVehLatACmpdRaw
    connect FordMsg077BusHiSpd.FordVehLatACmpdVld -> CDD_FordBlaBoxIfCmn.FordVehLatACmpdVld
    connect FordMsg077BusHiSpd.FordVehLgtACmpdRaw -> CDD_FordBlaBoxIfCmn.FordVehLgtACmpdRaw
    connect FordMsg077BusHiSpd.FordVehLgtACmpdVld -> CDD_FordBlaBoxIfCmn.FordVehLgtACmpdVld
    connect FordMsg077BusHiSpd.FordVehSpdOverGndRaw -> CDD_FordBlaBoxIfCmn.FordVehSpdOverGndRaw
    connect FordMsg077BusHiSpd.FordVehSpdOverGndVld -> CDD_FordBlaBoxIfCmn.FordVehSpdOverGndVld
    connect FordMsg077BusHiSpd.FordVehYawRateCmpdRaw -> CDD_FordBlaBoxIfCmn.FordVehYawRateCmpdRaw
    connect FordMsg07DBusHiSpd.FordVehActBrkTqRaw -> CDD_FordBlaBoxIfCmn.FordVehActBrkTqRaw
    connect FordMsg07DBusHiSpd.FordVehBrkTqVld -> CDD_FordBlaBoxIfCmn.FordVehBrkTqVld
    connect FordMsg07DBusHiSpd.FordVehVertACmpdRaw -> CDD_FordBlaBoxIfCmn.FordVehVertACmpdRaw
    connect FordMsg083BusHiSpd.FordVehTurnSigSwtStsRaw -> CDD_FordBlaBoxIfCmn.FordVehTurnSigSwtStsRaw
    connect FordMsg083BusHiSpd.FordVehTurnSigVld -> CDD_FordBlaBoxIfCmn.FordVehTurnSigVld
    connect FordMsg091BusHiSpd.FordVehYawRateRaw -> CDD_FordBlaBoxIfCmn.FordVehYawRateRaw
    connect FordMsg091BusHiSpd.FordVehYawRateRawVld -> CDD_FordBlaBoxIfCmn.FordVehYawRateRawVld
    connect FordMsg091BusHiSpd.FordVehYawRate -> VehSigCdng.VehYawRateSerlCom
    connect FordMsg091BusHiSpd.FordVehYawRateRawVld -> VehSigCdng.VehYawRateVldSerlCom
    connect FordMsg167BusHiSpd.FordVehPrpnWhlTqRaw -> CDD_FordBlaBoxIfCmn.FordVehPrpnWhlTqRaw
    connect FordMsg167BusHiSpd.FordVehPrpnWhlTqVld -> CDD_FordBlaBoxIfCmn.FordVehPrpnWhlTqVld
    connect FordMsg167BusHiSpd.FordVehElecPwrSts -> FordCanDtcInhb.FordVehElecPwrSts
    connect FordMsg167BusHiSpd.FordVehPwrpkTqSts -> FordCanDtcInhb.FordVehPwrpkTqSts
    connect FordMsg167BusHiSpd.FordVehPwrpkTqSts -> FordSysSt.FordVehPwrpkTqSts
    connect FordMsg167BusHiSpd.FordVehElecPwrSts -> FordVltgIf.FordVehElecPwrSts
    connect FordMsg167BusHiSpd.FordVehPwrpkTqSts -> FordVltgIf.FordVehPwrpkTqSts
    connect FordMsg202BusHiSpd.FordVehGearRvsStsRaw -> CDD_FordBlaBoxIfCmn.FordVehGearRvsStsRaw
    connect FordMsg202BusHiSpd.FordVehGearRvsStsVld -> CDD_FordBlaBoxIfCmn.FordVehGearRvsStsVld
    connect FordMsg202BusHiSpd.FordVehTrlrAidAvlRaw -> CDD_FordBlaBoxIfCmn.FordVehTrlrAidAvlRaw
    connect FordMsg202BusHiSpd.FordVehTrlrBackupAssiAvlVld -> CDD_FordBlaBoxIfCmn.FordVehTrlrBackupAssiAvlVld
    connect FordMsg202BusHiSpd.FordVehSpdEngModl -> FordHwAgArbn.FordEngVehSpd
    connect FordMsg202BusHiSpd.FordVehSpdEngModl -> FordVehSpdArbn.FordVehSpdEngModl
    connect FordMsg202BusHiSpd.FordVehSpdEngModLoQlyVld -> FordVehSpdArbn.FordVehSpdEngModlLoQlyVld
    connect FordMsg202BusHiSpd.FordVehSpdEngModlVld -> FordVehSpdArbn.FordVehSpdEngModlVld
    connect FordMsg213BusHiSpd.FordVehAbsActv -> CDD_FordBlaBoxIfCmn.FordVehAbsActv
    connect FordMsg213BusHiSpd.FordVehAbsEscStsVld -> CDD_FordBlaBoxIfCmn.FordVehAbsEscStsVld
    connect FordMsg213BusHiSpd.FordVehCllsnMtgtnByBrkgDenied -> CDD_FordBlaBoxIfCmn.FordVehCllsnMtgtnByBrkgDenied
    connect FordMsg213BusHiSpd.FordVehCllsnMtgtnByBrkgDisad -> CDD_FordBlaBoxIfCmn.FordVehCllsnMtgtnByBrkgDisad
    connect FordMsg213BusHiSpd.FordVehEscActv -> CDD_FordBlaBoxIfCmn.FordVehEscActv
    connect FordMsg215BusHiSpd.FordVehTrlrAidModReqVld -> CDD_FordBlaBoxIfCmn.FordVehTrlrAidModReqVld
    connect FordMsg216BusHiSpd.FordVehFrntLeWhlCntrDirVld -> CDD_FordBlaBoxIfCmn.FordVehFrntLeWhlCntrDirVld
    connect FordMsg216BusHiSpd.FordVehFrntLeWhlDirRaw -> CDD_FordBlaBoxIfCmn.FordVehFrntLeWhlDirRaw
    connect FordMsg216BusHiSpd.FordVehFrntRiWhlCntrDirVld -> CDD_FordBlaBoxIfCmn.FordVehFrntRiWhlCntrDirVld
    connect FordMsg216BusHiSpd.FordVehFrntRiWhlDirRaw -> CDD_FordBlaBoxIfCmn.FordVehFrntRiWhlDirRaw
    connect FordMsg216BusHiSpd.FordVehReLeWhlCntrDirVld -> CDD_FordBlaBoxIfCmn.FordVehReLeWhlCntrDirVld
    connect FordMsg216BusHiSpd.FordVehReLeWhlDirRaw -> CDD_FordBlaBoxIfCmn.FordVehReLeWhlDirRaw
    connect FordMsg216BusHiSpd.FordVehReRiWhlCntrDirVld -> CDD_FordBlaBoxIfCmn.FordVehReRiWhlCntrDirVld
    connect FordMsg216BusHiSpd.FordVehReRiWhlDirRaw -> CDD_FordBlaBoxIfCmn.FordVehReRiWhlDirRaw
    connect FordMsg217BusHiSpd.FordVehFrntLeWhlSpdRaw -> CDD_FordBlaBoxIfCmn.FordVehFrntLeWhlSpdRaw
    connect FordMsg217BusHiSpd.FordVehFrntLeWhlSpdVld -> CDD_FordBlaBoxIfCmn.FordVehFrntLeWhlSpdVld
    connect FordMsg217BusHiSpd.FordVehFrntRiWhlSpdRaw -> CDD_FordBlaBoxIfCmn.FordVehFrntRiWhlSpdRaw
    connect FordMsg217BusHiSpd.FordVehFrntRiWhlSpdVld -> CDD_FordBlaBoxIfCmn.FordVehFrntRiWhlSpdVld
    connect FordMsg217BusHiSpd.FordVehReLeWhlSpdRaw -> CDD_FordBlaBoxIfCmn.FordVehReLeWhlSpdRaw
    connect FordMsg217BusHiSpd.FordVehReLeWhlSpdVld -> CDD_FordBlaBoxIfCmn.FordVehReLeWhlSpdVld
    connect FordMsg217BusHiSpd.FordVehReRiWhlSpdRaw -> CDD_FordBlaBoxIfCmn.FordVehReRiWhlSpdRaw
    connect FordMsg217BusHiSpd.FordVehReRiWhlSpdVld -> CDD_FordBlaBoxIfCmn.FordVehReRiWhlSpdVld
    connect FordMsg217BusHiSpd.FordVehFrntLeWhlSpd -> FordVehSpdArbn.FordVehFrntLeWhlSpd
    connect FordMsg217BusHiSpd.FordVehFrntLeWhlSpdVld -> FordVehSpdArbn.FordVehFrntLeWhlSpdVld
    connect FordMsg217BusHiSpd.FordVehFrntRiWhlSpd -> FordVehSpdArbn.FordVehFrntRiWhlSpd
    connect FordMsg217BusHiSpd.FordVehFrntRiWhlSpdVld -> FordVehSpdArbn.FordVehFrntRiWhlSpdVld
    connect FordMsg217BusHiSpd.FordVehReLeWhlSpd -> FordVehSpdArbn.FordVehReLeWhlSpd
    connect FordMsg217BusHiSpd.FordVehReLeWhlSpdVld -> FordVehSpdArbn.FordVehReLeWhlSpdVld
    connect FordMsg217BusHiSpd.FordVehReRiWhlSpd -> FordVehSpdArbn.FordVehReRiWhlSpd
    connect FordMsg217BusHiSpd.FordVehReRiWhlSpdVld -> FordVehSpdArbn.FordVehReRiWhlSpdVld
    connect FordMsg230BusHiSpd.FordVehGearLvrPosnVldInt -> CDD_FordBlaBoxIfCmn.FordVehGearLvrPosnVldInt
    connect FordMsg2FDBusHiSpd.FordVehEvasSteerAssiReq -> CDD_FordBlaBoxIfCmn.FordVehEvasSteerAssiReq
    connect FordMsg2FDBusHiSpd.FordVehEvasSteerAssiReqVld -> CDD_FordBlaBoxIfCmn.FordVehEvasSteerAssiReqVld
    connect FordMsg3B3BusHiSpd.FordVehIgnStsVld -> CDD_FordBlaBoxIfCmn.FordVehIgnStsVld
    connect FordMsg3B3BusHiSpd.FordVehIgnSts -> FordCanDtcInhb.FordVehIgnStsQly
    connect FordMsg3B3BusHiSpd.FordVehLifeCycMod -> FordCanDtcInhb.FordVehLifeCycModQly
    connect FordMsg3B3BusHiSpd.FordVehIgnSts -> FordVltgIf.FordVehIgnStsQly
    connect FordMsg3CABusHiSpd.FordVehLaneAssiImgProcgModlAVld -> CDD_FordBlaBoxIfCmn.FordVehLaneAssiImgProcgModlAVld
    connect FordMsg3CABusHiSpd.FordVehLaneDetnWarnInten -> CDD_FordBlaBoxIfCmn.FordVehLaneDetnWarnInten
    connect FordMsg3CABusHiSpd.FordVehLaneDetnWarnSts -> CDD_FordBlaBoxIfCmn.FordVehLaneDetnWarnSts
    connect FordMsg3CABusHiSpd.FordVehLaneKeepSysCrvtRaw -> CDD_FordBlaBoxIfCmn.FordVehLaneKeepSysCrvtRaw
    connect FordMsg3CABusHiSpd.FordVehLaneKeepSysRampTyp -> CDD_FordBlaBoxIfCmn.FordVehLaneKeepSysRampTyp
    connect FordMsg3CABusHiSpd.FordVehLaneKeepSysReqdAgRaw -> CDD_FordBlaBoxIfCmn.FordVehLaneKeepSysReqdAgRaw
    connect FordMsg3CABusHiSpd.FordVehLaneKeepSysSts -> CDD_FordBlaBoxIfCmn.FordVehLaneKeepSysSts
    connect FordMsg3D3BusHiSpd.FordVehLatCtrlCrvtRateRaw -> CDD_FordBlaBoxIfCmn.FordVehLatCtrlCrvtRateRaw
    connect FordMsg3D3BusHiSpd.FordVehLatCtrlCrvtRaw -> CDD_FordBlaBoxIfCmn.FordVehLatCtrlCrvtRaw
    connect FordMsg3D3BusHiSpd.FordVehLatCtrlHandsOffDetnTqStimlsReq -> CDD_FordBlaBoxIfCmn.FordVehLatCtrlHandsOffDetnTqStimlsReq
    connect FordMsg3D3BusHiSpd.FordVehLatCtrlImgProcrModlAVld -> CDD_FordBlaBoxIfCmn.FordVehLatCtrlImgProcrModlAVld
    connect FordMsg3D3BusHiSpd.FordVehLatCtrlPahOffsRaw -> CDD_FordBlaBoxIfCmn.FordVehLatCtrlPahOffsRaw
    connect FordMsg3D3BusHiSpd.FordVehLatCtrlPahRaw -> CDD_FordBlaBoxIfCmn.FordVehLatCtrlPahRaw
    connect FordMsg3D3BusHiSpd.FordVehLatCtrlPrcsn -> CDD_FordBlaBoxIfCmn.FordVehLatCtrlPrcsn
    connect FordMsg3D3BusHiSpd.FordVehLatCtrlRampTyp -> CDD_FordBlaBoxIfCmn.FordVehLatCtrlRampTyp
    connect FordMsg3D3BusHiSpd.FordVehLatCtrlReq -> CDD_FordBlaBoxIfCmn.FordVehLatCtrlReq
    connect FordMsg3D3BusHiSpd.FordVehLatCtrlRingMax -> CDD_FordBlaBoxIfCmn.FordVehLatCtrlRingMax
    connect FordMsg3D7BusHiSpd.FordVehCllsnMtgtnByBrkgLatDstRaw -> CDD_FordBlaBoxIfCmn.FordVehCllsnMtgtnByBrkgLatDstRaw
    connect FordMsg3D7BusHiSpd.FordVehCllsnMtgtnByBrkgLgtDstRaw -> CDD_FordBlaBoxIfCmn.FordVehCllsnMtgtnByBrkgLgtDstRaw
    connect FordMsg3D7BusHiSpd.FordVehCllsnMtgtnByBrkgObjDataConfLvlRaw -> CDD_FordBlaBoxIfCmn.FordVehCllsnMtgtnByBrkgObjDataConfLvlRaw
    connect FordMsg3D7BusHiSpd.FordVehCllsnMtgtnByBrkgObjTypClassnRaw -> CDD_FordBlaBoxIfCmn.FordVehCllsnMtgtnByBrkgObjTypClassnRaw
    connect FordMsg3D7BusHiSpd.FordVehCllsnMtgtnByBrkgRelLatVelRaw -> CDD_FordBlaBoxIfCmn.FordVehCllsnMtgtnByBrkgRelLatVelRaw
    connect FordMsg3D7BusHiSpd.FordVehCllsnMtgtnByBrkgRelLgtVelRaw -> CDD_FordBlaBoxIfCmn.FordVehCllsnMtgtnByBrkgRelLgtVelRaw
    connect FordMsg3D7BusHiSpd.FordVehCllsnMtgtnByBrkgTiToCllsnRaw -> CDD_FordBlaBoxIfCmn.FordVehCllsnMtgtnByBrkgTiToCllsnRaw
    connect FordMsg3D7BusHiSpd.FordVehEvasSteerAssiImgProcrModlAVld -> CDD_FordBlaBoxIfCmn.FordVehEvasSteerAssiImgProcrModlAVld
    connect FordMsg40ABusHiSpd.FordVehTireCircum -> CDD_FordBlaBoxIfCmn.FordVehTireCircum
    connect FordMsg40ABusHiSpd.FordVehGlbRealTi -> CustDiag.FordVehGlbRealTi
    connect FordMsg40ABusHiSpd.FordVehIdnNr -> CustDiag.FordVehIdnNr
    connect FordMsg40ABusHiSpd.FordVehTireCircum -> FordVehSpdArbn.FordVehTireCircumIn
    connect FordMsg414BusHiSpd.FordVehSteerPinionAgOffsRaw -> CDD_FordBlaBoxIfCmn.FordVehSteerPinionAgOffsRaw
    connect FordMsg414BusHiSpd.FordVehSteerPinionAgOffsVld -> CDD_FordBlaBoxIfCmn.FordVehSteerPinionAgOffsVld
    connect FordMsg414BusHiSpd.FordVehSteerPinionOffsStsRaw -> CDD_FordBlaBoxIfCmn.FordVehSteerPinionOffsStsRaw
    connect FordMsg414BusHiSpd.FordVehSteerPinionAgOffs -> CustDiag.FordVehSteerPinionAgOffs
    connect FordMsg414BusHiSpd.FordVehSteerPinionAgOffs -> FordHwAgArbn.FordSteerPinionOffs
    connect FordMsg414BusHiSpd.FordVehSteerPinionOffsSts -> FordHwAgArbn.FordSteerPinionOffsSts
    connect FordMsg414BusHiSpd.FordVehSteerPinionAgOffsVld -> FordHwAgArbn.FordVehSteerPinionAgOffsVld
    connect FordMsg415BusHiSpd.FordVehLoSpdMtnCtrlBrkSprtStsRaw -> CDD_FordBlaBoxIfCmn.FordVehLoSpdMtnCtrlBrkSprtStsRaw
    connect FordMsg415BusHiSpd.FordVehLoSpdMtnCtrlBrkSprtVld -> CDD_FordBlaBoxIfCmn.FordVehLoSpdMtnCtrlBrkSprtVld
    connect FordMsg415BusHiSpd.FordVehSpdBrkModlRaw -> CDD_FordBlaBoxIfCmn.FordVehSpdBrkModlRaw
    connect FordMsg415BusHiSpd.FordVehSpdBrkModl -> FordVehSpdArbn.FordVehSpdBrkModl
    connect FordMsg415BusHiSpd.FordVehSpdBrkModlLoQlyVld -> FordVehSpdArbn.FordVehSpdBrkModlLoQlyVld
    connect FordMsg415BusHiSpd.FordVehSpdBrkModlVld -> FordVehSpdArbn.FordVehSpdBrkModlVld
    connect FordMsg41EBusHiSpd.FordVehSelDrvModChassisVld -> CDD_FordBlaBoxIfCmn.FordVehSelDrvModChassisVld
    connect FordMsg430BusHiSpd.FordVehOdom -> CustDiag.FordVehOdom
    connect FordMsg459BusHiSpd.FordVehTrlrAidAcqSts -> CDD_FordBlaBoxIfCmn.FordVehTrlrAidAcqSts
    connect FordMsg459BusHiSpd.FordVehTrlrAidHitchAg -> CDD_FordBlaBoxIfCmn.FordVehTrlrAidHitchAg
    connect FordMsg459BusHiSpd.FordVehTrlrAidIdnVal -> CDD_FordBlaBoxIfCmn.FordVehTrlrAidIdnVal
    connect FordMsg459BusHiSpd.FordVehTrlrAidTrakgSt -> CDD_FordBlaBoxIfCmn.FordVehTrlrAidTrakgSt
    connect FordMsg459BusHiSpd.FordVehTrlrAidTrakgStVld -> CDD_FordBlaBoxIfCmn.FordVehTrlrAidTrakgStVld
    connect FordMsg459BusHiSpd.FordVehTrlrAidTrlrRvsGuidcSts -> CDD_FordBlaBoxIfCmn.FordVehTrlrAidTrlrRvsGuidcSts
    connect FordMsg459BusHiSpd.FordVehTrlrBallToAxle -> CDD_FordBlaBoxIfCmn.FordVehTrlrBallToAxle
    connect FordMsg459BusHiSpd.FordVehTrlrHitchAgVld -> CDD_FordBlaBoxIfCmn.FordVehTrlrHitchAgVld
    connect FordMsg459BusHiSpd.FordVehTrlrHitchRateVld -> CDD_FordBlaBoxIfCmn.FordVehTrlrHitchRateVld
    connect FordMsg459BusHiSpd.FordVehTrlrTarVld -> CDD_FordBlaBoxIfCmn.FordVehTrlrTarVld
    connect FordMsg47ABusHiSpd.FordVehTrlrAidKnobBtn -> CDD_FordBlaBoxIfCmn.FordVehTrlrAidKnobBtn
    connect FordMsg47ABusHiSpd.FordVehTrlrAidKnobPosn -> CDD_FordBlaBoxIfCmn.FordVehTrlrAidKnobPosn
    connect FordMsg4B0BusHiSpd.FordVehYawStabyRaw -> CDD_FordBlaBoxIfCmn.FordVehYawStabyRaw
    connect FordMsg4B0BusHiSpd.FordVehYawStabyVld -> CDD_FordBlaBoxIfCmn.FordVehYawStabyVld
    connect FordSysSt.FordEpsSysSt -> CustDiag.FordEpsSysSt
    connect FordSysSt.FordEpsSysSt -> FordCanDtcInhb.FordEpsSysSt
    connect FordSysSt.FordEpsFailr -> FordMsg082BusHiSpd.FordElecPwrAssidSteerFailr
    connect FordSysSt.FordSteerModlSts -> FordMsg082BusHiSpd.FordSteerModlSts
    connect FordSysSt.FordEpsSysSt -> FordVltgIf.FordEpsSysSt
    connect FordSysSt.OperScaFctr -> StOutpCtrl.SysOperMotTqCmdSca
    connect FordSysSt.OperRampRate -> StOutpCtrl.SysOperRampRate
    connect FordSysSt.FordPwrSplyEnaReq -> SysStMod.PwrSplyEnaReq
    connect FordSysSt.SysStReqEna -> SysStMod.SysStReqEna
    connect FordVehSpdArbn.FordVehSpd -> CDD_FordBlaBoxIfCmn.FordVehSpd
    connect FordVehSpdArbn.FordVehSpdLoQly -> CustDiag.FordVehSpdLoQly
    connect FordVehSpdArbn.FordVehSpdLoQlyVld -> CustDiag.FordVehSpdLoQlyVld
    connect FordVehSpdArbn.FordVehSpd -> VehSigCdng.VehSpdSerlCom
    connect FordVehSpdArbn.FordVehSpdVld -> VehSigCdng.VehSpdVldSerlCom
    connect FordVltgIf.FordInhbBattVltgDiagc -> BattVltgCorrln.InhbBattVltgDiagc
    connect FordVltgIf.FordEpsCurr -> CustDiag.FordEpsCurr
    connect FordVltgIf.FordEpsVltg -> CustDiag.FordEpsVltg
    connect FordVltgIf.FordMaxBattCurr -> CustDiag.FordMaxBattCurr
    connect FordVltgIf.FordMinBattVltg -> CustDiag.FordMinBattVltg
    connect FordVltgIf.FordEpsCurr -> FordMsg082BusHiSpd.ElecPwrSteerCurr
    connect FordVltgIf.FordEpsVltg -> FordMsg082BusHiSpd.ElecPwrSteerVltg
    connect FordVltgIf.FordVltgOperRamp -> FordSysSt.FordVltgOperRamp
    connect FordVltgIf.FordVltgOperScar -> FordSysSt.FordVltgOperScar
    connect FordVltgIf.FordVltgOperSt -> FordSysSt.FordVltgOperSt
    connect GateDrv0Ctrl.DiagcStsIvtr1Inactv -> BattVltgCorrln.DiagcStsIvtr1Inactv
    connect GateDrv0Ctrl.DiagcStsIvtr1Inactv -> CDD_CurrMeas.DiagcStsIvtr1Inactv
    connect GateDrv0Ctrl.IvtrFetFltPha -> CDD_GtmCfgAndUse.IvtrFetFltPha
    connect GateDrv0Ctrl.DiagcStsIvtr1Inactv -> CDD_MotCtrlMgr.DiagcStsIvtr1Inactv
    connect GateDrv0Ctrl.IvtrFetFltPha -> CDD_MotCtrlMgr.IvtrFetFltPha
    connect GateDrv0Ctrl.IvtrFetFltTyp -> CDD_MotCtrlMgr.IvtrFetFltTyp
    connect GateDrv0Ctrl.DiagcStsIvtr1Inactv -> CurrMeasCorrln.DiagcStsIvtr1Inactv
    connect GateDrv0Ctrl.DiagcStsIvtr1Inactv -> LoaMgr.DiagcStsIvtr1Inactv
    connect GateDrv0Ctrl.IvtrFetFltTyp -> LoaMgr.IvtrFetFltTyp
    connect GateDrv0Ctrl.MotDrvr0IninTestCmpl -> PwrUpSeq.MotDrvr0IninTestCmpl
    connect GateDrv0Ctrl.DiagcStsIvtr1Inactv -> ShtdwnMech.DiagcStsIvtr1Inactv
    connect HiLoadStallLimr.StallMotTqLim -> LimrCdng.StallMotTqLim
    connect HiLoadStallLimr.StallMotTqLim -> SysPrfmncSts.StallMotTqLim
    connect HwAg1Meas.HwAg1 -> CmnMfgSrv.HwAg1
    connect HwAg1Meas.HwAg1ClrLtch -> CmnMfgSrv.HwAg1ClrLtch
    connect HwAg1Meas.HwAg1AutTrim -> CmnMfgSrv.HwAg1MeasHwAg1AutoTrim
    connect HwAg1Meas.HwAg1ClrTrim -> CmnMfgSrv.HwAg1MeasHwAg1ClrTrim
    connect HwAg1Meas.HwAg1ReadTrim -> CmnMfgSrv.HwAg1MeasHwAg1ReadTrim
    connect HwAg1Meas.HwAg1TrimPrfmdSts -> CmnMfgSrv.HwAg1MeasHwAg1TrimPrfmdSts
    connect HwAg1Meas.HwAg1WrTrim -> CmnMfgSrv.HwAg1MeasHwAg1WrTrim
    connect HwAg1Meas.HwAg1 -> HwAgArbn.HwAgA
    connect HwAg1Meas.HwAg1Qlfr -> HwAgArbn.HwAgAQlfr
    connect HwAg1Meas.HwAg1RollgCntr -> HwAgArbn.HwAgARollgCntr
    connect HwAg1Meas.HwAg1Qlfr -> HwAgCorrln.HwAgAQlfr
    connect HwAg1Meas.HwAg1RollgCntr -> HwAgCorrln.HwAgARollgCntr
    connect HwAgArbn.HwAg -> HwAgSysArbn.HwAg
    connect HwAgArbn.HwAg -> HwAgSysArbn.HwAgCorrd
    connect HwAgCorrln.HwAgIdptSig -> FordHwAgArbn.HwAgIdptSig
    connect HwAgCorrln.HwAgCorrlnSt -> HwAgArbn.HwAgCorrlnSt
    connect HwAgCorrln.HwAgIdptSig -> HwAgSysArbn.HwAgIdptSig
    connect HwAgSnsrls.FSnsrlsHwCentr -> CmnMfgSrv.FSnsrlsHwCentr
    connect HwAgSnsrls.RstSnsrlsHwCentr -> CmnMfgSrv.RstSnsrlsHwCentr
    connect HwAgSnsrls.HwAgSnsrls -> HwAgSysArbn.HwAgSnsrls
    connect HwAgSnsrls.HwAgSnsrlsConf -> HwAgSysArbn.HwAgSnsrlsConf
    connect HwAgSysArbn.HwVel -> CDD_FordBlaBoxIfCmn.HwVel
    connect HwAgSysArbn.HwAgFinal -> CmnMfgSrv.HwAg
    connect HwAgSysArbn.PinionAg -> CmnMfgSrv.PinionAg
    connect HwAgSysArbn.HwVelToSerlCom -> CustDiag.HwVelToSerlCom
    connect HwAgSysArbn.PinionAgConf -> EotLrng.HwAgAuthy
    connect HwAgSysArbn.PinionAgConf -> EotProtn.HwAgAuthy
    connect HwAgSysArbn.PinionAgConf -> EotProtnFwl.PinionAgConf
    connect HwAgSysArbn.HwVel -> FltInj.HwVel
    connect HwAgSysArbn.HwAgNotCorrd -> FordHwAgArbn.FordSnsrInp
    connect HwAgSysArbn.HwVel -> FordMotTqCmdOvrlLimr.HwVel
    connect HwAgSysArbn.PinionAg -> HwAgSnsrls.PinionAg
    connect HwAgSysArbn.PinionAgConf -> HwAgSnsrls.PinionAgConf
    connect HwAgSysArbn.HwAgFinal -> ImcArbn.HwAg
    connect HwAgSysArbn.HwAgToMotAgCorrlnFltFld -> ImcArbn.HwAgToMotAgCorrlnFltFld
    connect HwAgSysArbn.PinionAg -> ImcArbn.PinionAg
    connect HwAgSysArbn.PinionAgConf -> ImcArbn.PinionAgConf
    connect HwAgSysArbn.HwAgFinal -> ImcSigArbn.HwAg
    connect HwAgSysArbn.PinionAgConf -> Rtn.HwAgAuthySca
    connect HwAgSysArbn.HwVel -> Rtn.HwVel
    connect HwAgSysArbn.PinionAgConf -> SysFricLrng.HwAgAuthy
    connect HwAgSysArbn.HwVel -> SysFricLrng.HwVel
    connect HwAgSysArbn.HwVel -> TEstimn.HwVel
    connect HwAgSysArbn.PinionAgConf -> TqLoa.PinionAgConf
    connect HwAgSysArbn.HwVel -> TunSelnAuthy.HwVel
    connect HwAgSysArbn.PinionAgConf -> VehSpdLimr.HwAgAuthy
    connect HwTq10Meas.HwTq10 -> CmnMfgSrv.HwTq3
    connect HwTq10Meas.HwTq10MeasHwTq10AutTrim -> CmnMfgSrv.HwTq3MeasHwTq3AutTrim
    connect HwTq10Meas.HwTq10MeasHwTq10ClrTrim -> CmnMfgSrv.HwTq3MeasHwTq3ClrTrim
    connect HwTq10Meas.HwTq10MeasHwTq10ReadTrim -> CmnMfgSrv.HwTq3MeasHwTq3ReadTrim
    connect HwTq10Meas.HwTq10MeasHwTq10TrimPrfmdSts -> CmnMfgSrv.HwTq3MeasHwTq3TrimPrfmdSts
    connect HwTq10Meas.HwTq10MeasHwTq10WrTrim -> CmnMfgSrv.HwTq3MeasHwTq3WrTrim
    connect HwTq10Meas.HwTq10 -> HwTqArbn.HwTqD
    connect HwTq10Meas.HwTq10Qlfr -> HwTqArbn.HwTqDQlfr
    connect HwTq10Meas.HwTq10RollgCntr -> HwTqArbn.HwTqDRollgCntr
    connect HwTq10Meas.HwTq10 -> HwTqCorrln.HwTqD
    connect HwTq10Meas.HwTq10Qlfr -> HwTqCorrln.HwTqDQlfr
    connect HwTq10Meas.HwTq10RollgCntr -> HwTqCorrln.HwTqDRollgCntr
    connect HwTq9Meas.HwTq9 -> CmnMfgSrv.HwTq2
    connect HwTq9Meas.HwTq9MeasHwTq9AutTrim -> CmnMfgSrv.HwTq2MeasHwTq2AutTrim
    connect HwTq9Meas.HwTq9MeasHwTq9ClrTrim -> CmnMfgSrv.HwTq2MeasHwTq2ClrTrim
    connect HwTq9Meas.HwTq9MeasHwTq9ReadTrim -> CmnMfgSrv.HwTq2MeasHwTq2ReadTrim
    connect HwTq9Meas.HwTq9MeasHwTq9TrimPrfmdSts -> CmnMfgSrv.HwTq2MeasHwTq2TrimPrfmdSts
    connect HwTq9Meas.HwTq9MeasHwTq9WrTrim -> CmnMfgSrv.HwTq2MeasHwTq2WrTrim
    connect HwTq9Meas.HwTq9 -> HwTqArbn.HwTqC
    connect HwTq9Meas.HwTq9Qlfr -> HwTqArbn.HwTqCQlfr
    connect HwTq9Meas.HwTq9RollgCntr -> HwTqArbn.HwTqCRollgCntr
    connect HwTq9Meas.HwTq9 -> HwTqCorrln.HwTqC
    connect HwTq9Meas.HwTq9Qlfr -> HwTqCorrln.HwTqCQlfr
    connect HwTq9Meas.HwTq9RollgCntr -> HwTqCorrln.HwTqCRollgCntr
    connect HwTqArbn.HwTq -> Swp.HwTq
    connect HwTqCorrln.HwTqCorrlnSts -> HwTqArbn.HwTqCorrlnSts
    connect HwTqCorrln.HwTqIdptSig -> LoaMgr.HwTqIdptSig
    connect HysCmp.HysCmpCmd -> AssiPahSum.HysCmpCmd
    connect ImcArbn.GetTxRateGroup -> CDD_Uart0CfgAndUse.GetTxRateGroup
    connect ImcArbn.SetRxSigGroup -> CDD_Uart0CfgAndUse.SetRxSigGroup
    connect ImcArbn.GetTxRateGroup -> CDD_Uart1CfgAndUse.GetTxRateGroup
    connect ImcArbn.SetRxSigGroup -> CDD_Uart1CfgAndUse.SetRxSigGroup
    connect ImcArbn.GetSigImcData_logl -> CustDiag.GetSigImcData_logl
    connect ImcArbn.GetSigImcData_u08 -> CustDiag.GetSigImcData_u08
    connect ImcArbn.GetSigImcData_logl -> DualCtrlrOutpMgr.GetSigImcData_logl
    connect ImcArbn.GetSigImcData_u08 -> DualEcuIdn.GetSigImcData_u08
    connect ImcArbn.GetSigImcData_u08 -> FordCmdArbn.GetSigImcData_u08
    connect ImcArbn.GetSigImcData_u08 -> FordDualEcuFltDiagcCom.GetSigImcData_u08
    connect ImcArbn.GetSigImcData_f32 -> FordHwTqCmdOvrlLimr.GetSigImcData_f32
    connect ImcArbn.GetSigImcData_f32 -> FordVltgIf.GetSigImcData_f32
    connect ImcArbn.GetSigImcData_f32 -> HwAgSnsrls.GetSigImcData_f32
    connect ImcArbn.GetSigImcData_f32 -> HwAgSysArbn.GetSigImcData_f32
    connect ImcArbn.GetSigImcData_logl -> HwAgSysArbn.GetSigImcData_logl
    connect ImcArbn.GetSigImcData_f32 -> ImcSigArbn.GetImcSigData_f32
    connect ImcArbn.GetSigImcData_logl -> ImcSigArbn.GetImcSigData_logl
    connect ImcArbn.GetSigImcData_u08 -> ImcSigArbn.GetImcSigData_u08
    connect ImcSigArbn.HwTqImcCorrd -> Assi.HwTq
    connect ImcSigArbn.VehSpdImcCorrd -> Assi.VehSpd
    connect ImcSigArbn.HwTqImcCorrd -> AssiHiFrq.HwTq
    connect ImcSigArbn.VehSpdImcCorrd -> AssiHiFrq.VehSpd
    connect ImcSigArbn.VehSpdImcCorrd -> AssiSumLim.VehSpd
    connect ImcSigArbn.VehSpdImcCorrd -> CDD_CurrMeas.VehSpd
    connect ImcSigArbn.VehSpdImcCorrd -> CDD_FordBlaBoxIfCmn.VehSpd
    connect ImcSigArbn.VehSpdImcCorrd -> CDD_FordBlaBoxIfCmp1.VehSpd
    connect ImcSigArbn.HwTqImcCorrd -> CmnMfgSrv.HwTq
    connect ImcSigArbn.HwTqImcCorrd -> CmplncErr.HwTq
    connect ImcSigArbn.VehSpdImcCorrd -> CustDiag.VehSpd
    connect ImcSigArbn.HwTqImcCorrd -> Dampg.HwTq
    connect ImcSigArbn.MotVelCrfImcCorrd -> Dampg.MotVelCrf
    connect ImcSigArbn.VehSpdImcCorrd -> Dampg.VehSpd
    connect ImcSigArbn.HwTqImcCorrd -> DiagcMgr.HwTq
    connect ImcSigArbn.HwAgImcCorrd -> DrvrTqEstimn.HwAg
    connect ImcSigArbn.HwTqImcCorrd -> DrvrTqEstimn.HwTq
    connect ImcSigArbn.MotVelCrfImcCorrd -> DrvrTqEstimn.MotVelCrf
    connect ImcSigArbn.ImcSysSt -> DualCtrlrOutpMgr.ImcSysSt
    connect ImcSigArbn.VehSpdImcCorrd -> DualCtrlrOutpMgr.VehSpd
    connect ImcSigArbn.MotVelCrfImcCorrd -> DutyCycThermProtn.MotVelCrf
    connect ImcSigArbn.HwAgImcCorrd -> EotLrng.HwAg
    connect ImcSigArbn.HwTqImcCorrd -> EotLrng.HwTq
    connect ImcSigArbn.MotVelCrfImcCorrd -> EotLrng.MotVelCrf
    connect ImcSigArbn.HwAgImcCorrd -> EotProtn.HwAg
    connect ImcSigArbn.HwTqImcCorrd -> EotProtn.HwTq
    connect ImcSigArbn.MotVelCrfImcCorrd -> EotProtn.MotVelCrf
    connect ImcSigArbn.VehSpdImcCorrd -> EotProtn.VehSpd
    connect ImcSigArbn.HwAgImcCorrd -> EotProtnFwl.HwAg
    connect ImcSigArbn.MotVelCrfImcCorrd -> EotProtnFwl.MotVelCrf
    connect ImcSigArbn.VehSpdImcCorrd -> EotProtnFwl.VehSpd
    connect ImcSigArbn.HwTqImcCorrd -> FordHwAgArbn.FordInpTq
    connect ImcSigArbn.VehSpdImcCorrd -> FordHwTqCdng.FordVehSpd
    connect ImcSigArbn.HwTqImcCorrd -> FordHwTqCdng.HwTq
    connect ImcSigArbn.VehSpdImcCorrd -> FordHwTqCmdOvrlLimr.FildVehSpd
    connect ImcSigArbn.HwTqImcCorrd -> FordMotTqCmdOvrlLimr.FildHwTq
    connect ImcSigArbn.VehSpdImcCorrd -> FordMotTqCmdOvrlLimr.FildVehSpd
    connect ImcSigArbn.VehSpdImcCorrd -> FordSysSt.FordVehSpd
    connect ImcSigArbn.VehSpdImcCorrd -> FordVltgIf.FordVehSpd
    connect ImcSigArbn.MotVelCrfImcCorrd -> HiLoadStallLimr.MotVelCrf
    connect ImcSigArbn.HwTqImcCorrd -> HwAgSnsrls.HwTq
    connect ImcSigArbn.MotVelCrfImcCorrd -> HwAgSnsrls.MotVelCrf
    connect ImcSigArbn.VehSpdImcCorrd -> HwAgSnsrls.VehSpd
    connect ImcSigArbn.HwTqImcCorrd -> HwAgSysArbn.HwTq
    connect ImcSigArbn.MotVelCrfImcCorrd -> HwAgSysArbn.MotVelCrf
    connect ImcSigArbn.HwTqImcCorrd -> HysCmp.HwTq
    connect ImcSigArbn.VehSpdImcCorrd -> HysCmp.VehSpd
    connect ImcSigArbn.HwTqImcCorrd -> InertiaCmpVel.HwTq
    connect ImcSigArbn.MotVelCrfImcCorrd -> InertiaCmpVel.MotVelCrf
    connect ImcSigArbn.VehSpdImcCorrd -> InertiaCmpVel.VehSpd
    connect ImcSigArbn.VehSpdImcCorrd -> LimrCdng.VehSpd
    connect ImcSigArbn.VehSpdImcCorrd -> MotCurrRegCfg.VehSpd
    connect ImcSigArbn.HwAgImcCorrd -> MotTqTranlDampg.HwAg
    connect ImcSigArbn.MotVelCrfImcCorrd -> MotTqTranlDampg.MotVelCrf
    connect ImcSigArbn.VehSpdImcCorrd -> MotTqTranlDampg.VehSpd
    connect ImcSigArbn.MotVelCrfImcCorrd -> MotVelCtrl.MotVelCrf
    connect ImcSigArbn.HwAgImcCorrd -> PosnTrakgServo.HwAg
    connect ImcSigArbn.HwTqImcCorrd -> PosnTrakgServo.HwTq
    connect ImcSigArbn.MotVelCrfImcCorrd -> PosnTrakgServo.MotVelCrf
    connect ImcSigArbn.PosnServoIntgtrOffs -> PosnTrakgServo.PosnServoIntgtrOffs
    connect ImcSigArbn.PosnTrakgArbnFltMtgtnEna -> PosnTrakgServo.PosnTrakgArbnFltMtgtnEna
    connect ImcSigArbn.VehSpdImcCorrd -> PosnTrakgServo.VehSpd
    connect ImcSigArbn.HwAgImcCorrd -> Rtn.HwAg
    connect ImcSigArbn.HwTqImcCorrd -> Rtn.HwTq
    connect ImcSigArbn.VehSpdImcCorrd -> Rtn.VehSpd
    connect ImcSigArbn.HwAgImcCorrd -> RtnPahFwl.HwAg
    connect ImcSigArbn.VehSpdImcCorrd -> RtnPahFwl.VehSpd
    connect ImcSigArbn.HwTqImcCorrd -> StabyCmp.HwTq
    connect ImcSigArbn.VehSpdImcCorrd -> StabyCmp.VehSpd
    connect ImcSigArbn.HwAgImcCorrd -> SysFricLrng.HwAg
    connect ImcSigArbn.HwTqImcCorrd -> SysFricLrng.HwTq
    connect ImcSigArbn.VehSpdImcCorrd -> SysFricLrng.VehSpd
    connect ImcSigArbn.MotVelCrfImcCorrd -> TqLoa.MotVelCrf
    connect ImcSigArbn.HwAgImcCorrd -> TqLoa.PinionAg
    connect ImcSigArbn.VehSpdImcCorrd -> TqLoa.VehSpd
    connect ImcSigArbn.HwTqImcCorrd -> TunSelnAuthy.HwTq
    connect ImcSigArbn.VehSpdImcCorrd -> TunSelnAuthy.VehSpd
    connect ImcSigArbn.HwAgImcCorrd -> VehSpdLimr.HwAg
    connect ImcSigArbn.VehSpdImcCorrd -> VehSpdLimr.VehSpd
    connect InertiaCmpVel.InertiaCmpVelCmd -> DampgPahSum.InertiaCmpVelCmd
    connect IoHwAb.SetFctGpioPhaALowrCmd -> CDD_GtmCfgAndUse.IoHwAb_SetFctGpioPhaALowrCmd
    connect IoHwAb.SetFctGpioPhaAUpprCmd -> CDD_GtmCfgAndUse.IoHwAb_SetFctGpioPhaAUpprCmd
    connect IoHwAb.SetFctGpioPhaBLowrCmd -> CDD_GtmCfgAndUse.IoHwAb_SetFctGpioPhaBLowrCmd
    connect IoHwAb.SetFctGpioPhaBUpprCmd -> CDD_GtmCfgAndUse.IoHwAb_SetFctGpioPhaBUpprCmd
    connect IoHwAb.SetFctGpioPhaCLowrCmd -> CDD_GtmCfgAndUse.IoHwAb_SetFctGpioPhaCLowrCmd
    connect IoHwAb.SetFctGpioPhaCUpprCmd -> CDD_GtmCfgAndUse.IoHwAb_SetFctGpioPhaCUpprCmd
    connect IoHwAb.SetFctPeriphPhaALowrCmd -> CDD_GtmCfgAndUse.IoHwAb_SetFctPeriphPhaALowrCmd
    connect IoHwAb.SetFctPeriphPhaAUpprCmd -> CDD_GtmCfgAndUse.IoHwAb_SetFctPeriphPhaAUpprCmd
    connect IoHwAb.SetFctPeriphPhaBLowrCmd -> CDD_GtmCfgAndUse.IoHwAb_SetFctPeriphPhaBLowrCmd
    connect IoHwAb.SetFctPeriphPhaBUpprCmd -> CDD_GtmCfgAndUse.IoHwAb_SetFctPeriphPhaBUpprCmd
    connect IoHwAb.SetFctPeriphPhaCLowrCmd -> CDD_GtmCfgAndUse.IoHwAb_SetFctPeriphPhaCLowrCmd
    connect IoHwAb.SetFctPeriphPhaCUpprCmd -> CDD_GtmCfgAndUse.IoHwAb_SetFctPeriphPhaCUpprCmd
    connect IoHwAb.SetGpioPhaALowrCmd -> CDD_GtmCfgAndUse.IoHwAb_SetGpioPhaALowrCmd
    connect IoHwAb.SetGpioPhaAUpprCmd -> CDD_GtmCfgAndUse.IoHwAb_SetGpioPhaAUpprCmd
    connect IoHwAb.SetGpioPhaBLowrCmd -> CDD_GtmCfgAndUse.IoHwAb_SetGpioPhaBLowrCmd
    connect IoHwAb.SetGpioPhaBUpprCmd -> CDD_GtmCfgAndUse.IoHwAb_SetGpioPhaBUpprCmd
    connect IoHwAb.SetGpioPhaCLowrCmd -> CDD_GtmCfgAndUse.IoHwAb_SetGpioPhaCLowrCmd
    connect IoHwAb.SetGpioPhaCUpprCmd -> CDD_GtmCfgAndUse.IoHwAb_SetGpioPhaCUpprCmd
    connect IoHwAb.SetFctPrphlHwTqB -> CDD_HwTq1Meas.IoHwAb_SetFctPrphlHwTq1
    connect IoHwAb.SetFctPrphlHwTqA -> CDD_HwTq8Meas.IoHwAb_SetFctPrphlHwTq8
    connect IoHwAb.GetGpioEcuIdnPin1 -> DualEcuIdn.IoHwAb_GetGpioEcuIdnPin1
    connect IoHwAb.GetGpioEcuIdnPin2 -> DualEcuIdn.IoHwAb_GetGpioEcuIdnPin2
    connect IoHwAb.GetGpioMcuEna -> FordCanDtcInhb.GetGpioMcuEna
    connect IoHwAb.GetGpioMcuEna -> FordHwAgArbn.GetGpioMcuEna
    connect IoHwAb.GetGpioMcuEna -> FordSysSt.GetGpioMcuEna
    connect IoHwAb.GetGpioMotDrvr0Diag -> GateDrv0Ctrl.IoHwAb_GetGpioMotDrvr0Diag
    connect IoHwAb.SetGpioGateDrv0Rst -> GateDrv0Ctrl.IoHwAb_SetGpioGateDrv0Rst
    connect IoHwAb.SetGpioSysFlt2A -> GateDrv0Ctrl.IoHwAb_SetGpioSysFlt2A
    connect IoHwAb.SetFctPrphlHwAg1 -> HwAg1Meas.IoHwAb_SetFctPrphlHwAg1
    connect IoHwAb.SetGpioPwrTurnOffCtrl -> PwrUpSeq.IoHwAb_SetGpioPwrTurnOffCtrl
    connect IoHwAb.SetGpioSysFlt2A -> ShtdwnMech.IoHwAb_SetGpioSysFlt2A
    connect IoHwAb.GetGpioPwrOutpEnaFb -> TmplMonr.IoHwAb_GetGpioPwrOutpEnaFb
    connect IoHwAb.SetGpioTmplMonrWdg -> TmplMonr.IoHwAb_SetGpioTmplMonrWdg
    connect LimrCdng.EotAssiScaCdnd -> AssiSumLim.EotAssiSca
    connect LimrCdng.EotMotTqLimCdnd -> AssiSumLim.EotMotTqLim
    connect LimrCdng.StallMotTqLimCdnd -> AssiSumLim.StallMotTqLim
    connect LimrCdng.SysMotTqCmdScaCdnd -> AssiSumLim.SysMotTqCmdSca
    connect LimrCdng.ThermMotTqLimCdnd -> AssiSumLim.ThermMotTqLim
    connect LimrCdng.VehSpdMotTqLimCdnd -> AssiSumLim.VehSpdMotTqLim
    connect LoaMgr.HwTqLoaMtgtnEna -> AssiSumLim.HwTqLoaMtgtnEna
    connect LoaMgr.MotAndThermProtnLoaMod -> CDD_MotCtrlMgr.MotAndThermProtnLoaMod
    connect LoaMgr.MotAndThermProtnLoaMod -> DualCtrlrOutpMgr.MotAndThermProtnLoaMod
    connect LoaMgr.MotAndThermProtnLoaMod -> DutyCycThermProtn.MotAndThermProtnLoaMod
    connect LoaMgr.MotAndThermProtnLoaMod -> ElecPwrCns.MotAndThermProtnLoaMod
    connect LoaMgr.LoaSt -> FordSysSt.LoaSt
    connect LoaMgr.MotAndThermProtnLoaMod -> HiLoadStallLimr.MotAndThermProtnLoaMod
    connect LoaMgr.MotAndThermProtnLoaMod -> MotCtrlPrmEstimn.MotAndThermProtnLoaMod
    connect LoaMgr.MotAndThermProtnLoaMod -> MotCurrPeakEstimn.MotAndThermProtnLoaMod
    connect LoaMgr.MotAndThermProtnLoaMod -> MotCurrRegCfg.MotAndThermProtnLoaMod
    connect LoaMgr.MotAndThermProtnLoaMod -> MotRefMdl.MotAndThermProtnLoaMod
    connect LoaMgr.LoaSt -> MotTqTranlDampg.LoaSt
    connect LoaMgr.MotAndThermProtnLoaMod -> PwrLimr.MotAndThermProtnLoaMod
    connect LoaMgr.LoaRateLim -> StOutpCtrl.LoaRateLim
    connect LoaMgr.LoaSca -> StOutpCtrl.LoaSca
    connect LoaMgr.LoaSt -> SysPrfmncSts.LoaSt
    connect LoaMgr.MotAndThermProtnLoaMod -> TEstimn.MotAndThermProtnLoaMod
    connect LoaMgr.MotAgLoaMtgtnEna -> TqLoa.MotAgLoaMtgtnEna
    connect MotAg2Meas.MotAg2Mecl -> CmnMfgSrv.MotAg2Mecl
    connect MotAg2Meas.MotAg2MeasEolPrmRead -> CmnMfgSrv.MotAgMeasEolPrmRead
    connect MotAg2Meas.MotAg2MeasEolPrmWr -> CmnMfgSrv.MotAgMeasEolPrmWr
    connect MotAg2Meas.MotAg2Mecl -> MotAgCorrln.MotAgCMecl
    connect MotAg2Meas.MotAg2MeclQlfr -> MotAgCorrln.MotAgCMeclQlfr
    connect MotAg2Meas.MotAg2MeclRollgCntr -> MotAgCorrln.MotAgCMeclRollgCntr
    connect MotAgCorrln.MotAgMeclCorrlnSt -> CDD_MotCtrlMgr.MotAgMeclCorrlnSt
    connect MotAgCorrln.MotAgMeclIdptSig -> CDD_MotVel.MotAgMeclIdptSig
    connect MotAgCorrln.MotAgMeclIdptSig -> HwAgSnsrls.MotAgMeclIdptSig
    connect MotAgCorrln.MotAgMeclIdptSig -> LoaMgr.MotAgMeclIdptSig
    connect MotCtrlPrmEstimn.MotInduDaxEstimdIvs -> CDD_MotCtrlMgr.MotInduDaxEstimdIvs
    connect MotCtrlPrmEstimn.MotInduQaxEstimdIvs -> CDD_MotCtrlMgr.MotInduQaxEstimdIvs
    connect MotCtrlPrmEstimn.MotREstimd -> CDD_MotCtrlMgr.MotREstimd
    connect MotCtrlPrmEstimn.GetMotPrmNomEol -> CmnMfgSrv.GetMotPrmNomEol
    connect MotCtrlPrmEstimn.SetMotPrmNomEol -> CmnMfgSrv.SetMotPrmNomEol
    connect MotCtrlPrmEstimn.MotInduDaxEstimd -> MotCurrRegCfg.MotInduDaxEstimd
    connect MotCtrlPrmEstimn.MotInduQaxEstimd -> MotCurrRegCfg.MotInduQaxEstimd
    connect MotCtrlPrmEstimn.MotREstimd -> MotCurrRegCfg.MotREstimd
    connect MotCtrlPrmEstimn.MotBackEmfConEstimd -> MotRefMdl.MotBackEmfConEstimd
    connect MotCtrlPrmEstimn.MotInduDaxEstimd -> MotRefMdl.MotInduDaxEstimd
    connect MotCtrlPrmEstimn.MotInduQaxEstimd -> MotRefMdl.MotInduQaxEstimd
    connect MotCtrlPrmEstimn.MotREstimd -> MotRefMdl.MotREstimd
    connect MotCtrlPrmEstimn.MotBackEmfConEstimd -> MotRplCoggCfg.MotBackEmfConEstimd
    connect MotCtrlPrmEstimn.MotInduDaxEstimd -> MotRplCoggCfg.MotInduDaxEstimd
    connect MotCtrlPrmEstimn.MotInduQaxEstimd -> MotRplCoggCfg.MotInduQaxEstimd
    connect MotCtrlPrmEstimn.MotBackEmfConEstimd -> PwrLimr.MotBackEmfConEstimd
    connect MotCurrPeakEstimn.MotCurrPeakEstimd -> DutyCycThermProtn.MotCurrPeakEstimd
    connect MotCurrPeakEstimn.MotCurrPeakEstimdFild -> DutyCycThermProtn.MotCurrPeakEstimdFild
    connect MotCurrPeakEstimn.MotCurrPeakEstimd -> TEstimn.MotCurrPeakEstimd
    connect MotCurrRegCfg.MotAgElecDly -> CDD_MotCtrlMgr.MotAgElecDly
    connect MotCurrRegCfg.MotDampgDax -> CDD_MotCtrlMgr.MotDampgDax
    connect MotCurrRegCfg.MotDampgQax -> CDD_MotCtrlMgr.MotDampgQax
    connect MotCurrRegCfg.MotIntglGainDax -> CDD_MotCtrlMgr.MotIntglGainDax
    connect MotCurrRegCfg.MotIntglGainQax -> CDD_MotCtrlMgr.MotIntglGainQax
    connect MotCurrRegCfg.MotPropGainDax -> CDD_MotCtrlMgr.MotPropGainDax
    connect MotCurrRegCfg.MotPropGainQax -> CDD_MotCtrlMgr.MotPropGainQax
    connect MotQuadDetn.MotQuad -> MotRefMdl.MotQuad
    connect MotRefMdl.MotBackEmfVltg -> CDD_MotCtrlMgr.MotBackEmfVltg
    connect MotRefMdl.MotCurrDaxCmd -> CDD_MotCtrlMgr.MotCurrDaxCmd
    connect MotRefMdl.MotCurrDaxMax -> CDD_MotCtrlMgr.MotCurrDaxMax
    connect MotRefMdl.MotCurrQaxCmd -> CDD_MotCtrlMgr.MotCurrQaxCmd
    connect MotRefMdl.MotReacncDax -> CDD_MotCtrlMgr.MotReacncDax
    connect MotRefMdl.MotReacncQax -> CDD_MotCtrlMgr.MotReacncQax
    connect MotRefMdl.MotVltgDaxFf -> CDD_MotCtrlMgr.MotVltgDaxFf
    connect MotRefMdl.MotVltgQaxFf -> CDD_MotCtrlMgr.MotVltgQaxFf
    connect MotRefMdl.MotCurrDaxCmd -> ElecPwrCns.MotCurrDaxCmd
    connect MotRefMdl.MotCurrQaxCmd -> ElecPwrCns.MotCurrQaxCmd
    connect MotRefMdl.MotCurrDaxCmd -> MotCtrlPrmEstimn.MotCurrDaxCmd
    connect MotRefMdl.MotCurrQaxCmd -> MotCtrlPrmEstimn.MotCurrQaxCmd
    connect MotRefMdl.MotCurrDaxCmd -> MotCurrPeakEstimn.MotCurrDaxCmd
    connect MotRefMdl.MotCurrQaxCmd -> MotCurrPeakEstimn.MotCurrQaxCmd
    connect MotRefMdl.MotCurrDaxCmd -> MotRplCoggCfg.MotCurrDaxCmd
    connect MotRefMdl.MotCurrQaxCmd -> MotRplCoggCfg.MotCurrQaxCmd
    connect MotRplCoggCfg.MotAgElecDlyRpl -> CDD_MotCtrlMgr.MotAgElecDlyRpl
    connect MotRplCoggCfg.MotCurrQaxToMotTqGain -> CDD_MotCtrlMgr.MotCurrQaxToMotTqGain
    connect MotRplCoggCfg.MotTqRplCoggOrder1Mgn -> CDD_MotCtrlMgr.MotTqRplCoggOrder1Mgn
    connect MotRplCoggCfg.MotTqRplCoggOrder1Pha -> CDD_MotCtrlMgr.MotTqRplCoggOrder1Pha
    connect MotRplCoggCfg.MotTqRplCoggOrder2Mgn -> CDD_MotCtrlMgr.MotTqRplCoggOrder2Mgn
    connect MotRplCoggCfg.MotTqRplCoggOrder2Pha -> CDD_MotCtrlMgr.MotTqRplCoggOrder2Pha
    connect MotRplCoggCfg.MotTqRplCoggOrder3Mgn -> CDD_MotCtrlMgr.MotTqRplCoggOrder3Mgn
    connect MotRplCoggCfg.MotTqRplCoggOrder3Pha -> CDD_MotCtrlMgr.MotTqRplCoggOrder3Pha
    connect MotRplCoggCfg.GetMotRplCoggPrm -> CmnMfgSrv.GetMotRplCoggPrm
    connect MotRplCoggCfg.SetMotRplCoggPrm -> CmnMfgSrv.SetMotRplCoggPrm
    connect MotTqCmdSca.GetMotTqCmdSca -> CmnMfgSrv.GetMotTqCmdSca
    connect MotTqCmdSca.SetMotTqCmdSca -> CmnMfgSrv.SetMotTqCmdSca
    connect MotTqCmdSca.MotTqCmdMrfScad -> DiagcMgr.MotTqCmdMrfScad
    connect MotTqCmdSca.MotTqCmdMrfScad -> MotQuadDetn.MotTqCmd
    connect MotTqCmdSca.MotTqCmdMrfScad -> MotRefMdl.MotTqCmdMrfScad
    connect MotTqCmdSca.MotTqCmdMrfScad -> MotRplCoggCfg.MotTqCmdMrfScad
    connect MotTqTranlDampg.MotTqCmdCrfDampd -> CmplncErr.MotTqCmdCrf
    connect MotTqTranlDampg.MotTqCmdCrfDampd -> HwAgSnsrls.MotTqCmdCrf
    connect MotTqTranlDampg.MotTqCmdMrfDampd -> PwrLimr.MotTqCmdMrf
    connect MotTqTranlDampg.MotTqTranlDampgCmpl -> StOutpCtrl.MotTqTranlDampgCmpl
    connect MotTqTranlDampg.MotTqCmdCrfDampd -> SysFricLrng.MotTqCmdCrf
    connect MotVelCtrl.GetCtrlPrm -> CmnMfgSrv.GetCtrlPrm
    connect MotVelCtrl.SetCtrlPrm -> CmnMfgSrv.SetCtrlPrm
    connect MotVelCtrl.StopCtrl -> CmnMfgSrv.StopCtrl
    connect MotVelCtrl.StrtCtrl -> CmnMfgSrv.StrtCtrl
    connect NxtrCalIds.NxtrCalIdsCalDevlpRd -> CmnMfgSrv.NxtrCalIdsCalDevlpRd
    connect NxtrCalIds.NxtrCalIdsCalRelRd -> CmnMfgSrv.NxtrCalIdsCalRelRd
    connect NxtrSwIds.NxtrSwIdsPsrInfoRd -> CmnMfgSrv.NxtrSwIdsPsrInfoRd
    connect NxtrSwIds.NxtrSwIdsSwBuildDateTiRd -> CmnMfgSrv.NxtrSwIdsSwBuildDateTiRd
    connect NxtrSwIds.NxtrSwIdsSwRelInfoRd -> CmnMfgSrv.NxtrSwIdsSwRelInfoRd
    connect NxtrSwIds.NxtrSwIdsSwRelNrRd -> CmnMfgSrv.NxtrSwIdsSwRelNrRd
    connect NxtrSwIds.NxtrSwIdsSwRelVerRd -> CmnMfgSrv.NxtrSwIdsSwRelVerRd
    connect PolarityCfg.HwTq1Polarity -> CDD_HwTq1Meas.HwTq1Polarity
    connect PolarityCfg.HwTq0Polarity -> CDD_HwTq8Meas.HwTq8Polarity
    connect PolarityCfg.AssiMechPolarity -> CDD_MotAgCmp.AssiMechPolarity
    connect PolarityCfg.MotAgMecl5Polarity -> CDD_MotCtrlMgr.MotAgMecl5Polarity
    connect PolarityCfg.MotAgMecl6Polarity -> CDD_MotCtrlMgr.MotAgMecl6Polarity
    connect PolarityCfg.MotElecMeclPolarity -> CDD_MotCtrlMgr.MotElecMeclPolarity
    connect PolarityCfg.AssiMechPolarity -> CDD_MotVel.AssiMechPolarity
    connect PolarityCfg.MotElecMeclPolarity -> CDD_SinVltgGenn.MotElecMeclPolarity
    connect PolarityCfg.PolarityCfgRead -> CmnMfgSrv.PolarityCfgRead
    connect PolarityCfg.PolarityCfgWr -> CmnMfgSrv.PolarityCfgWr
    connect PolarityCfg.AssiMechPolarity -> DrvrTqEstimn.AssiMechPolarity
    connect PolarityCfg.HwAg1Polarity -> HwAg1Meas.HwAg1Polarity
    connect PolarityCfg.HwTq3Polarity -> HwTq10Meas.HwTq10Polarity
    connect PolarityCfg.HwTq2Polarity -> HwTq9Meas.HwTq9Polarity
    connect PolarityCfg.MotAgMecl2Polarity -> MotAg2Meas.MotAgMecl2Polarity
    connect PolarityCfg.AssiMechPolarity -> MotTqTranlDampg.AssiMechPolarity
    connect PosnTrakgServo.PosnServoIntgtrSt -> ImcArbn.PosnServoIntgtrSt
    connect PosnTrakgServo.PosnServoIntgtrSt -> ImcSigArbn.PosnServoIntgtrSt
    connect PwrDiscnct.PwrDiscnctATestCmpl -> PwrUpSeq.PwrDiscnctATestCmpl
    connect PwrDiscnct.PwrDiscnctBTestCmpl -> PwrUpSeq.PwrDiscnctBTestCmpl
    connect PwrLimr.PwrLimrRednFac -> AssiSumLim.PwrLimrRednFac
    connect PwrLimr.MotTqCmdPwrLimd -> DrvrTqEstimn.MotTqCmdPwrLimd
    connect PwrLimr.MotTqCmdPwrLimd -> FordHwTqCdng.MotTqCmdPwrLimd
    connect PwrLimr.MotTqCmdPwrLimd -> MotTqCmdSca.MotTqCmdMrf
    connect PwrUpSeq.StrtUpSt -> BattVltgCorrln.StrtUpSt
    connect PwrUpSeq.StrtUpSt -> CDD_CurrMeas.StrtUpSt
    connect PwrUpSeq.SysStWrmIninCmpl -> FordSysSt.SysStWrmIninCmpl
    connect PwrUpSeq.StrtUpSt -> GateDrv0Ctrl.StrtUpSt
    connect PwrUpSeq.StrtUpSt -> PwrDiscnct.StrtUpSt
    connect PwrUpSeq.StrtUpSt -> ShtdwnMech.StrtUpSt
    connect PwrUpSeq.StrtUpSt -> SysStMod.StrtUpSt
    connect PwrUpSeq.SysStWrmIninCmpl -> SysStMod.SysStWrmIninCmpl
    connect PwrUpSeq.StrtUpSt -> TmplMonr.StrtUpSt
    connect Rtn.RtnCmd -> RtnPahFwl.RtnCmd
    connect RtnPahFwl.RtnCmdLimd -> AssiSumLim.RtnCmd
    connect StabyCmp.AssiCmd -> AssiSumLim.AssiCmd
    connect StabyCmp.AssiCmd -> FordHwTqCdng.AssiCmd
    connect StackMeas.StackMeasClr -> CmnMfgSrv.StackMeasClr
    connect StackMeas.StackMeasRead -> CmnMfgSrv.StackMeasRead
    connect StOutpCtrl.SysMotTqCmdSca -> EotProtn.SysMotTqCmdSca
    connect StOutpCtrl.SysMotTqCmdSca -> LimrCdng.SysMotTqCmdSca
    connect StOutpCtrl.SysStReqDi -> SysStMod.SysStReqDi
    connect Swp.MotTqCmdSwp -> CmnMfgSrv.MotTqCmd
    connect Swp.MotTqCmdSwp -> FordHwTqCdng.MotTqCmd
    connect Swp.HwTqSwp -> ImcArbn.HwTq
    connect Swp.HwTqSwp -> ImcSigArbn.HwTq
    connect Swp.MotTqCmdSwp -> MotTqTranlDampg.MotTqCmdCrf
    connect Swp.HwTqSwp -> VehSigCdng.HwTq
    connect SysFricLrng.ClrFricLrngOperMod -> CmnMfgSrv.ClrFricLrngOperMod
    connect SysFricLrng.GetFricData -> CmnMfgSrv.GetFricData
    connect SysFricLrng.GetFricLrngData -> CmnMfgSrv.GetFricLrngData
    connect SysFricLrng.GetFricOffsOutpDi -> CmnMfgSrv.GetFricOffsOutpDi
    connect SysFricLrng.InitFricLrngTbl -> CmnMfgSrv.InitFricLrngTbl
    connect SysFricLrng.SetFricData -> CmnMfgSrv.SetFricData
    connect SysFricLrng.SetFricLrngData -> CmnMfgSrv.SetFricLrngData
    connect SysFricLrng.SetFricOffsOutpDi -> CmnMfgSrv.SetFricOffsOutpDi
    connect SysFricLrng.SysFricOffs -> HysCmp.SysFricOffs
    connect SysStMod.SysSt -> BattVltgCorrln.SysSt
    connect SysStMod.SysSt -> CDD_CurrMeas.SysSt
    connect SysStMod.SysSt -> CDD_GtmCfgAndUse.SysSt
    connect SysStMod.SysSt -> CDD_MotCtrlMgr.SysSt
    connect SysStMod.SysSt -> CmnMfgSrv.SysSt
    connect SysStMod.SysSt -> CurrMeasCorrln.SysSt
    connect SysStMod.SysSt -> DiagcMgr.SysSt
    connect SysStMod.SysSt -> DualCtrlrOutpMgr.SysSt
    connect SysStMod.SysSt -> FordSysSt.SysSt
    connect SysStMod.SysSt -> FordVltgIf.FordSysSt
    connect SysStMod.SysSt -> GateDrv0Ctrl.SysSt
    connect SysStMod.SysSt -> ImcArbn.SysSt
    connect SysStMod.SysSt -> MotTqTranlDampg.SysSt
    connect SysStMod.SysSt -> PwrDiscnct.SysSt
    connect SysStMod.SysSt -> PwrSply.SysSt
    connect SysStMod.SysSt -> PwrUpSeq.SysSt
    connect SysStMod.SysSt -> SysPrfmncSts.SysSt
    connect SysStMod.SysSt -> TmplMonr.SysSt
    connect TEstimn.AssiMechT -> Dampg.AssiMechT
    connect TEstimn.MotFetT -> DutyCycThermProtn.MotFetT
    connect TEstimn.MotMagT -> DutyCycThermProtn.MotMagT
    connect TEstimn.MotWidgT -> DutyCycThermProtn.MotWidgT
    connect TEstimn.AssiMechT -> HysCmp.AssiMechT
    connect TEstimn.MotFetT -> MotCtrlPrmEstimn.MotFetT
    connect TEstimn.MotMagT -> MotCtrlPrmEstimn.MotMagT
    connect TEstimn.MotWidgT -> MotCtrlPrmEstimn.MotWidgT
    connect TEstimn.AssiMechT -> Rtn.AssiMechT
    connect TEstimn.AssiMechT -> SysFricLrng.AssiMechT
    connect TmplMonr.TmplMonrIninTestCmpl -> PwrUpSeq.TmplMonIninTestCmpl
    connect TqLoa.TqLoaCmd -> AssiSumLim.TqLoaCmd
    connect TqLoa.TqLoaAvl -> LoaMgr.TqLoaAvl
    connect TunSelnAuthy.XcpCalChgReq -> CDD_XcpIf.XcpCalChgReq
    connect TunSelnAuthy.RtCalChgReq -> TunSelnMngt.RtCalChgReq
    connect TunSelnMngt.ActvGroup -> CDD_XcpIf.ActvGroup
    connect TunSelnMngt.ActvIninIdx -> CDD_XcpIf.ActvIninIdx
    connect TunSelnMngt.ActvRtIdx -> CDD_XcpIf.ActvRtIdx
    connect TunSelnMngt.CalCopySts -> CDD_XcpIf.CalCopySts
    connect TunSelnMngt.CopyCalPageReq -> CDD_XcpIf.CopyCalPageReq
    connect TunSelnMngt.GetCalPageReq -> CDD_XcpIf.GetCalPageReq
    connect TunSelnMngt.GetSegInfoReq -> CDD_XcpIf.GetSegInfoReq
    connect TunSelnMngt.OnlineTunRamAdrMpg -> CDD_XcpIf.OnlineTunRamAdrMpg
    connect TunSelnMngt.SetCalPageReq -> CDD_XcpIf.SetCalPageReq
    connect VehSigCdng.VehSpdVld -> CDD_CurrMeas.VehSpdVld
    connect VehSigCdng.VehSpdVld -> CDD_FordBlaBoxIfCmn.VehSpdVld
    connect VehSigCdng.VehSpd -> CDD_MotCtrlMgr.VehSpd
    connect VehSigCdng.VehSpdVld -> FordHwTqCmdOvrlLimr.VehSpdVld
    connect VehSigCdng.VehSpdVld -> FordMotTqCmdOvrlLimr.VehSpdVld
    connect VehSigCdng.VehSpdVld -> FordSysSt.FordVehSpdVld
    connect VehSigCdng.VehSpdVld -> FordVltgIf.FordVehSpdVld
    connect VehSigCdng.VehSpdVld -> HwAgSnsrls.VehSpdVld
    connect VehSigCdng.VehYawRate -> HwAgSnsrls.VehYawRate
    connect VehSigCdng.VehYawRateVld -> HwAgSnsrls.VehYawRateVld
    connect VehSigCdng.VehSpd -> ImcArbn.VehSpd
    connect VehSigCdng.VehSpdVld -> ImcArbn.VehSpdVld
    connect VehSigCdng.VehSpd -> ImcSigArbn.VehSpd
    connect VehSigCdng.VehLgtA -> InertiaCmpVel.VehLgtA
    connect VehSigCdng.VehSpdVld -> Rtn.VehSpdVld
    connect VehSigCdng.VehSpd -> Swp.VehSpd
    connect VehSigCdng.VehSpdVld -> Swp.VehSpdVld
    connect VehSigCdng.VehLatA -> SysFricLrng.VehLatA
    connect VehSigCdng.VehSpdVld -> SysFricLrng.VehSpdVld
    connect VehSigCdng.VehSpdVld -> SysPrfmncSts.VehSpdVld
    connect VehSigCdng.VehLatA -> TqLoa.VehLatA
    connect VehSigCdng.VehLatAVld -> TqLoa.VehLatAVld
    connect VehSigCdng.VehSpdVld -> TqLoa.VehSpdVld
    connect VehSpdLimr.VehSpdMotTqLim -> LimrCdng.VehSpdMotTqLim
    delegate FordMsg213BusHiSpd.Ford_AbsActv_B_Actl <-> outer port Ford_AbsActv_B_Actl
    delegate FordMsg07DBusHiSpd.Ford_BrkTot_Tq_Actl <-> outer port Ford_BrkTot_Tq_Actl
    delegate FordMsg213BusHiSpd.Ford_CmbbBrkDis_B_Actl <-> outer port Ford_CmbbBrkDis_B_Actl
    delegate FordMsg213BusHiSpd.Ford_CmbbDeny_B_ActlBrk <-> outer port Ford_CmbbDeny_B_ActlBrk
    delegate FordMsg3D7BusHiSpd.Ford_CmbbObjClass_D_Stat1 <-> outer port Ford_CmbbObjClass_D_Stat
    delegate FordMsg3D7BusHiSpd.Ford_CmbbObjColl_T_Actl <-> outer port Ford_CmbbObjColl_T_Actl
    delegate FordMsg3D7BusHiSpd.Ford_CmbbObjConfdnc_D_Stat1 <-> outer port Ford_CmbbObjConfdnc_D_Stat
    delegate FordMsg3D7BusHiSpd.Ford_CmbbObjDistLat_L_Actl <-> outer port Ford_CmbbObjDistLat_L_Actl
    delegate FordMsg3D7BusHiSpd.Ford_CmbbObjDistLong_L_Actl <-> outer port Ford_CmbbObjDistLong_L_Actl
    delegate FordMsg3D7BusHiSpd.Ford_CmbbObjRelLat_V_Actl <-> outer port Ford_CmbbObjRelLat_V_Actl
    delegate FordMsg3D7BusHiSpd.Ford_CmbbObjRelLong_V_Actl <-> outer port Ford_CmbbObjRelLong_V_Actl
    delegate FordMsg082BusHiSpd.Ford_DrvSte_Tq_Actl <-> outer port Ford_DrvSte_Tq_Actl
    delegate FordMsg082BusHiSpd.Ford_DrvSteActv_B_Stat1 <-> outer port Ford_DrvSteActv_B_Stat
    delegate FordMsg167BusHiSpd.Ford_ElPw_D_Stat1 <-> outer port Ford_ElPw_D_Stat
    delegate FordMsg167BusHiSpd.Ford_ElPw_D_StatStrtStop1 <-> outer port Ford_ElPw_D_StatStrtStop
    delegate FordMsg082BusHiSpd.Ford_EPAS_Failure1 <-> outer port Ford_EPAS_Failure
    delegate FordMsg3D7BusHiSpd.Ford_EsaEnbl_D2_Rq1 <-> outer port Ford_EsaEnbl_D2_Rq
    delegate FordMsg2FDBusHiSpd.Ford_EsaOn_B_Rq1 <-> outer port Ford_EsaOn_B_Rq
    delegate FordMsg417BusHiSpd.Ford_EsaOn_B_Stat1 <-> outer port Ford_EsaOn_B_Stat
    delegate FordMsg230BusHiSpd.Ford_GearLvrPos_D_Actl <-> outer port Ford_GearLvrPos_D_Actl
    delegate FordMsg202BusHiSpd.Ford_GearRvrse_D_Actl1 <-> outer port Ford_GearRvrse_D_Actl
    delegate FordMsg3D3BusHiSpd.Ford_HandsOffCnfm_B_Rq <-> outer port Ford_HandsOffCnfm_B_Rq
    delegate FordMsg459BusHiSpd.Ford_HitchToVehAxle_L_Calc <-> outer port Ford_HitchToVehAxle_L_Calc
    delegate FordMsg3B3BusHiSpd.Ford_Ignition_Status1 <-> outer port Ford_Ignition_Status
    delegate FordMsg3CCBusHiSpd.Ford_LaActAvail_D_Actl <-> outer port Ford_LaActAvail_D_Actl
    delegate FordMsg3CCBusHiSpd.Ford_LaActDeny_B_Actl <-> outer port Ford_LaActDeny_B_Actl
    delegate FordMsg3CABusHiSpd.Ford_LaCurvature_No_Calc <-> outer port Ford_LaCurvature_No_Calc
    delegate FordMsg3CCBusHiSpd.Ford_LaHandsOff_B_Actl <-> outer port Ford_LaHandsOff_B_Actl
    delegate FordMsg3CABusHiSpd.Ford_LaRampType_B_Req <-> outer port Ford_LaRampType_B_Req
    delegate FordMsg3CABusHiSpd.Ford_LaRefAng_No_Req <-> outer port Ford_LaRefAng_No_Req
    delegate FordMsg3D3BusHiSpd.Ford_LatCtl_D_Rq <-> outer port Ford_LatCtl_D_Rq
    delegate FordMsg3D3BusHiSpd.Ford_LatCtlCurv_No_Actl <-> outer port Ford_LatCtlCurv_No_Actl
    delegate FordMsg3D3BusHiSpd.Ford_LatCtlCurv_NoRate_Actl <-> outer port Ford_LatCtlCurv_NoRate_Actl
    delegate FordMsg417BusHiSpd.Ford_LatCtlLim_D_Stat1 <-> outer port Ford_LatCtlLim_D_Stat
    delegate FordMsg3D3BusHiSpd.Ford_LatCtlPath_An_Actl <-> outer port Ford_LatCtlPath_An_Actl
    delegate FordMsg3D3BusHiSpd.Ford_LatCtlPathOffst_L_Actl <-> outer port Ford_LatCtlPathOffst_L_Actl
    delegate FordMsg3D3BusHiSpd.Ford_LatCtlPrecision_D_Rq <-> outer port Ford_LatCtlPrecision_D_Rq
    delegate FordMsg3D3BusHiSpd.Ford_LatCtlRampType_D_Rq <-> outer port Ford_LatCtlRampType_D_Rq
    delegate FordMsg3D3BusHiSpd.Ford_LatCtlRng_L_Max <-> outer port Ford_LatCtlRng_L_Max
    delegate FordMsg417BusHiSpd.Ford_LatCtlSte_D_Stat1 <-> outer port Ford_LatCtlSte_D_Stat
    delegate FordMsg3CABusHiSpd.Ford_LdwActvIntns_D_Req <-> outer port Ford_LdwActvIntns_D_Req
    delegate FordMsg3CABusHiSpd.Ford_LdwActvStats_D_Req <-> outer port Ford_LdwActvStats_D_Req
    delegate FordMsg3B3BusHiSpd.Ford_LifeCycMde_D_Actl1 <-> outer port Ford_LifeCycMde_D_Actl
    delegate FordMsg3CABusHiSpd.Ford_LkaActvStats_D2_Req <-> outer port Ford_LkaActvStats_D2_Req
    delegate FordMsg3CCBusHiSpd.Ford_LsmcBrk_Tq_Rq <-> outer port Ford_LsmcBrk_Tq_Rq
    delegate FordMsg415BusHiSpd.Ford_LsmcBrkDecel_D_Stat1 <-> outer port Ford_LsmcBrkDecel_D_Stat
    delegate FordMsg3CCBusHiSpd.Ford_LsmcBrkDecelEnbl_D_Rq <-> outer port Ford_LsmcBrkDecelEnbl_D_Rq
    delegate FordMsg430BusHiSpd.Ford_OdometerMasterValue <-> outer port Ford_OdometerMasterValue
    delegate FordMsg41ABusHiSpd.FordOutdAirTSts <-> outer port Ford_Outside_Air_Temp_Stat
    delegate FordMsg167BusHiSpd.Ford_PrplWhlTot2_Tq_Actl <-> outer port Ford_PrplWhlTot2_Tq_Actl
    delegate FordMsg167BusHiSpd.Ford_PwPckTq_D_Stat1 <-> outer port Ford_PwPckTq_D_Stat
    delegate FordMsg082BusHiSpd.Ford_SAPPAngleControlStat{1..6}_1 <-> outer port Ford_SAPPAngleControlStat{1..6}
    delegate FordMsg41EBusHiSpd.Ford_SelDrvMdeChassis2_D_Rq1 <-> outer port Ford_SelDrvMdeChassis2_D_Rq
    delegate FordMsg417BusHiSpd.Ford_SelDrvMdeSte_D_Stat1 <-> outer port Ford_SelDrvMdeSte_D_Stat
    delegate FordMsg213BusHiSpd.Ford_StabCtlBrkActv_B_Actl <-> outer port Ford_StabCtlBrkActv_B_Actl
    delegate FordMsg082BusHiSpd.Ford_SteeringColumnTorque <-> outer port Ford_SteeringColumnTorque
    delegate FordMsg082BusHiSpd.Ford_SteMdule_D_Stat1 <-> outer port Ford_SteMdule_D_Stat
    delegate FordMsg082BusHiSpd.Ford_SteMdule_I_Est <-> outer port Ford_SteMdule_I_Est
    delegate FordMsg082BusHiSpd.Ford_SteMdule_U_Meas <-> outer port Ford_SteMdule_U_Meas
    delegate FordMsg07EBusHiSpd.Ford_StePinAn_No_Cnt <-> outer port Ford_StePinAn_No_Cnt
    delegate FordMsg07EBusHiSpd.Ford_StePinAn_No_Cs <-> outer port Ford_StePinAn_No_Cs
    delegate FordMsg07EBusHiSpd.Ford_StePinComp_An_Est <-> outer port Ford_StePinComp_An_Est
    delegate FordMsg07EBusHiSpd.Ford_StePinCompAnEst_D_Qf <-> outer port Ford_StePinCompAnEst_D_Qf
    delegate FordMsg414BusHiSpd.Ford_StePinOffst_An_Est <-> outer port Ford_StePinOffst_An_Est
    delegate FordMsg414BusHiSpd.Ford_StePinOffst_D_Stat <-> outer port Ford_StePinOffst_D_Stat
    delegate FordMsg414BusHiSpd.Ford_StePinOffst_No_Cnt <-> outer port Ford_StePinOffst_No_Cnt
    delegate FordMsg414BusHiSpd.Ford_StePinOffst_No_Cs <-> outer port Ford_StePinOffst_No_Cs
    delegate FordMsg07EBusHiSpd.Ford_StePinRelInit_An_Sns <-> outer port Ford_StePinRelInit_An_Sns
    delegate FordMsg07EBusHiSpd.Ford_StePw_B_Rq <-> outer port Ford_StePw_B_Rq
    delegate FordMsg3CCBusHiSpd.Ford_TjaHandsOnCnfdnc_B_Est <-> outer port Ford_TjaHandsOnCnfdnc_B_Est
    delegate FordMsg459BusHiSpd.Ford_TrlrAid_An3_Actl <-> outer port Ford_TrlrAid_An3_Actl
    delegate FordMsg459BusHiSpd.Ford_TrlrAid_AnRate2_Actl <-> outer port Ford_TrlrAid_AnRate2_Actl
    delegate FordMsg459BusHiSpd.Ford_TrlrAid_D2_Stat <-> outer port Ford_TrlrAid_D2_Stat
    delegate FordMsg47ABusHiSpd.Ford_TrlrAidCtl_U_RqDrv <-> outer port Ford_TrlrAidCtl_U_RqDrv
    delegate FordMsg417BusHiSpd.Ford_TrlrAidEnbl_D2_Stat1 <-> outer port Ford_TrlrAidEnbl_D2_Stat
    delegate FordMsg215BusHiSpd.Ford_TrlrAidMde_D_Rq <-> outer port Ford_TrlrAidMde_D_Rq
    delegate FordMsg417BusHiSpd.Ford_TrlrAidMsgTxt_D2_Rq1 <-> outer port Ford_TrlrAidMsgTxt_D2_Rq
    delegate FordMsg47ABusHiSpd.Ford_TrlrAidSwtch_D_RqDrv1 <-> outer port Ford_TrlrAidSwtch_D_RqDrv
    delegate FordMsg459BusHiSpd.Ford_TrlrAidTrgtId_No_Actl <-> outer port Ford_TrlrAidTrgtId_No_Actl
    delegate FordMsg3CCBusHiSpd.Ford_TrlrAn_An_TrgtCalc <-> outer port Ford_TrlrAn_An_TrgtCalc
    delegate FordMsg082BusHiSpd.Ford_TrlrHitchLamp_D_Rqst1 <-> outer port Ford_TrlrHitchLamp_D_Rqst
    delegate FordMsg443BusHiSpd.Ford_TrlrLampCnnct_B_Actl1 <-> outer port Ford_TrlrLampCnnct_B_Actl
    delegate FordMsg459BusHiSpd.Ford_TrlrRvrse_D_Stat <-> outer port Ford_TrlrRvrse_D_Stat
    delegate FordMsg459BusHiSpd.Ford_TrlrTrgtAcquire_D_Stat <-> outer port Ford_TrlrTrgtAcquire_D_Stat
    delegate FordMsg083BusHiSpd.Ford_TurnLghtSwtch_D_Stat <-> outer port Ford_TurnLghtSwtch_D_Stat
    delegate FordMsg415BusHiSpd.Ford_Veh_V_ActlBrk <-> outer port Ford_Veh_V_ActlBrk
    delegate FordMsg202BusHiSpd.Ford_Veh_V_ActlEng <-> outer port Ford_Veh_V_ActlEng
    delegate FordMsg082BusHiSpd.Ford_Veh_V_RqMxTrlrAid <-> outer port Ford_Veh_V_RqMxTrlrAid
    delegate FordMsg40ABusHiSpd.Ford_VehGGCCData <-> outer port Ford_VehicleGGCCData
    delegate FordMsg077BusHiSpd.Ford_VehLatComp_A_Actl <-> outer port Ford_VehLatComp_A_Actl
    delegate FordMsg077BusHiSpd.Ford_VehLongComp_A_Actl <-> outer port Ford_VehLongComp_A_Actl
    delegate FordMsg077BusHiSpd.Ford_VehOverGnd_V_Est <-> outer port Ford_VehOverGnd_V_Est
    delegate FordMsg415BusHiSpd.Ford_VehVActlBrk_D_Qf1 <-> outer port Ford_VehVActlBrk_D_Qf
    delegate FordMsg415BusHiSpd.Ford_VehVActlBrk_No_Cnt <-> outer port Ford_VehVActlBrk_No_Cnt
    delegate FordMsg415BusHiSpd.Ford_VehVActlBrk_No_Cs <-> outer port Ford_VehVActlBrk_No_Cs
    delegate FordMsg202BusHiSpd.Ford_VehVActlEng_D_Qf1 <-> outer port Ford_VehVActlEng_D_Qf
    delegate FordMsg202BusHiSpd.Ford_VehVActlEng_No_Cnt <-> outer port Ford_VehVActlEng_No_Cnt
    delegate FordMsg202BusHiSpd.Ford_VehVActlEng_No_Cs <-> outer port Ford_VehVActlEng_No_Cs
    delegate FordMsg07DBusHiSpd.Ford_VehVertComp_A_Actl <-> outer port Ford_VehVertComp_A_Actl
    delegate FordMsg202BusHiSpd.Ford_VehVTrlrAid_B_Avail1 <-> outer port Ford_VehVTrlrAid_B_Avail
    delegate FordMsg082BusHiSpd.Ford_VehVTrlrAid_B_Rq1 <-> outer port Ford_VehVTrlrAid_B_Rq
    delegate FordMsg091BusHiSpd.Ford_VehYaw_W_Actl <-> outer port Ford_VehYaw_W_Actl
    delegate FordMsg077BusHiSpd.Ford_VehYawComp_W_Actl <-> outer port Ford_VehYawComp_W_Actl
    delegate FordMsg216BusHiSpd.Ford_WhlDirFl_D_Actl <-> outer port Ford_WhlDirFl_D_Actl
    delegate FordMsg216BusHiSpd.Ford_WhlDirFr_D_Actl <-> outer port Ford_WhlDirFr_D_Actl
    delegate FordMsg216BusHiSpd.Ford_WhlDirRl_D_Actl <-> outer port Ford_WhlDirRl_D_Actl
    delegate FordMsg216BusHiSpd.Ford_WhlDirRr_D_Actl <-> outer port Ford_WhlDirRr_D_Actl
    delegate FordMsg217BusHiSpd.Ford_WhlFl_W_Meas <-> outer port Ford_WhlFl_W_Meas
    delegate FordMsg217BusHiSpd.Ford_WhlFr_W_Meas <-> outer port Ford_WhlFr_W_Meas
    delegate FordMsg217BusHiSpd.Ford_WhlRl_W_Meas <-> outer port Ford_WhlRl_W_Meas
    delegate FordMsg216BusHiSpd.Ford_WhlRotatFl_No_Cnt <-> outer port Ford_WhlRotatFl_No_Cnt
    delegate FordMsg216BusHiSpd.Ford_WhlRotatFr_No_Cnt <-> outer port Ford_WhlRotatFr_No_Cnt
    delegate FordMsg216BusHiSpd.Ford_WhlRotatRl_No_Cnt <-> outer port Ford_WhlRotatRl_No_Cnt
    delegate FordMsg216BusHiSpd.Ford_WhlRotatRr_No_Cnt <-> outer port Ford_WhlRotatRr_No_Cnt
    delegate FordMsg217BusHiSpd.Ford_WhlRr_W_Meas <-> outer port Ford_WhlRr_W_Meas
    delegate FordMsg4B0BusHiSpd.Ford_YawStabilityIndex <-> outer port Ford_YawStabilityIndex
package /EndToEndProtections
  end to end protection set EndToEndConnections
package /VehicleProject
  system System: category=SYSTEM_EXTRACT
    system mapping System_MPPNG
      data-mappings:
        data-element=ECU_Composition.Ford_HitchToTrlrAxle_L_Calc.Ford_HitchToTrlrAxle_L_Calc, system-signal=HitchToTrlrAxle_L_Calc
        data-element=ECU_Composition.Ford_SAPPAngleControlStat2.Ford_SAPPAngleControlStat2, system-signal=SAPPAngleControlStat2
        data-element=ECU_Composition.Ford_EsaEnbl_D2_Rq.Ford_EsaEnbl_D2_Rq, system-signal=EsaEnbl_D2_Rq
        data-element=ECU_Composition.Ford_TrlrHitchYaw_D_Stat.Ford_TrlrHitchYaw_D_Stat, system-signal=TrlrHitchYaw_D_Stat
        data-element=ECU_Composition.Ford_DeliverySubProjectNumber.Ford_DeliverySubProjectNumber, system-signal=DeliverySubProjectNumber
        data-element=ECU_Composition.Ford_GearLvrPos_D_Actl.Ford_GearLvrPos_D_Actl, system-signal=GearLvrPos_D_Actl
        data-element=ECU_Composition.Ford_BpedDrvAppl_D_Actl.Ford_BpedDrvAppl_D_Actl, system-signal=BpedDrvAppl_D_Actl
        data-element=ECU_Composition.Ford_VehVTrlrAid_B_Avail.Ford_VehVTrlrAid_B_Avail, system-signal=VehVTrlrAid_B_Avail
        data-element=ECU_Composition.Ford_PrplWhlTot2_Tq_Actl.Ford_PrplWhlTot2_Tq_Actl, system-signal=PrplWhlTot2_Tq_Actl
        data-element=ECU_Composition.Ford_TrlrAidEnbl_D2_Stat.Ford_TrlrAidEnbl_D2_Stat, system-signal=TrlrAidEnbl_D2_Stat
        data-element=ECU_Composition.Ford_LatCtlCurv_No_Actl.Ford_LatCtlCurv_No_Actl, system-signal=LatCtlCurv_No_Actl
        data-element=ECU_Composition.Ford_StePinOffst_No_Cnt.Ford_StePinOffst_No_Cnt, system-signal=StePinOffst_No_Cnt
        data-element=ECU_Composition.Ford_SAPPAngleControlStat4.Ford_SAPPAngleControlStat4, system-signal=SAPPAngleControlStat4
        data-element=ECU_Composition.Ford_LaHandsOff_B_Actl.Ford_LaHandsOff_B_Actl, system-signal=LaHandsOff_B_Actl
        data-element=ECU_Composition.Ford_StePinCompAnEst_D_Qf.Ford_StePinCompAnEst_D_Qf, system-signal=StePinCompAnEst_D_Qf
        data-element=ECU_Composition.Ford_ElPw_D_StatStrtStop.Ford_ElPw_D_StatStrtStop, system-signal=ElPw_D_StatStrtStop
        data-element=ECU_Composition.Ford_TrlrHitYaw_AnRate_Actl.Ford_TrlrHitYaw_AnRate_Actl, system-signal=TrlrHitYaw_AnRate_Actl
        data-element=ECU_Composition.Ford_TrlrAid_AnRate2_Actl.Ford_TrlrAid_AnRate2_Actl, system-signal=TrlrAid_AnRate2_Actl
        data-element=ECU_Composition.Ford_CmbbDeny_B_ActlBrk.Ford_CmbbDeny_B_ActlBrk, system-signal=CmbbDeny_B_ActlBrk
        data-element=ECU_Composition.Ford_LkaActvStats_D2_Req.Ford_LkaActvStats_D2_Req, system-signal=LkaActvStats_D2_Req
        data-element=ECU_Composition.Ford_WhlRotatFr_No_Cnt.Ford_WhlRotatFr_No_Cnt, system-signal=WhlRotatFr_No_Cnt
        data-element=ECU_Composition.Ford_LdwActvIntns_D_Req.Ford_LdwActvIntns_D_Req, system-signal=LdwActvIntns_D_Req
        data-element=ECU_Composition.Ford_TrlrAidTrlrId_No_Rq.Ford_TrlrAidTrlrId_No_Rq, system-signal=TrlrAidTrlrId_No_Rq
        data-element=ECU_Composition.Ford_VehYaw_W_Actl.Ford_VehYaw_W_Actl, system-signal=VehYaw_W_Actl
        data-element=ECU_Composition.Ford_Ignition_Status.Ford_Ignition_Status, system-signal=Ignition_Status
        data-element=ECU_Composition.Ford_LatCtlPath_An_Actl.Ford_LatCtlPath_An_Actl, system-signal=LatCtlPath_An_Actl
        data-element=ECU_Composition.Ford_FileVersionYear.Ford_FileVersionYear, system-signal=FileVersionYear
        data-element=ECU_Composition.Ford_WhlRotatFl_No_Cnt.Ford_WhlRotatFl_No_Cnt, system-signal=WhlRotatFl_No_Cnt
        data-element=ECU_Composition.Ford_CmbbObjDistLat_L_Actl.Ford_CmbbObjDistLat_L_Actl, system-signal=CmbbObjDistLat_L_Actl
        data-element=ECU_Composition.Ford_BrkTot_Tq_Actl.Ford_BrkTot_Tq_Actl, system-signal=BrkTot_Tq_Actl
        data-element=ECU_Composition.Ford_ExtSteeringAngleReq2.Ford_ExtSteeringAngleReq2, system-signal=ExtSteeringAngleReq2
        data-element=ECU_Composition.Ford_TrlrAidEnbl_D2_Rq.Ford_TrlrAidEnbl_D2_Rq, system-signal=TrlrAidEnbl_D2_Rq
        data-element=ECU_Composition.Ford_Veh_V_ActlEng.Ford_Veh_V_ActlEng, system-signal=Veh_V_ActlEng
        data-element=ECU_Composition.Ford_LdwActvStats_D_Req.Ford_LdwActvStats_D_Req, system-signal=LdwActvStats_D_Req
        data-element=ECU_Composition.Ford_VehVertComp_A_Actl.Ford_VehVertComp_A_Actl, system-signal=VehVertComp_A_Actl
        data-element=ECU_Composition.Ford_FileVersionMonth.Ford_FileVersionMonth, system-signal=FileVersionMonth
        data-element=ECU_Composition.Ford_TrlrAidTrgtId_No_Actl.Ford_TrlrAidTrgtId_No_Actl, system-signal=TrlrAidTrgtId_No_Actl
        data-element=ECU_Composition.Ford_WhlFl_W_Meas.Ford_WhlFl_W_Meas, system-signal=WhlFl_W_Meas
        data-element=ECU_Composition.Ford_SteMdule_I_Est.Ford_SteMdule_I_Est, system-signal=SteMdule_I_Est
        data-element=ECU_Composition.Ford_ApedPos_Pc_ActlArb.Ford_ApedPos_Pc_ActlArb, system-signal=ApedPos_Pc_ActlArb
        data-element=ECU_Composition.Ford_Veh_V_RqMxTrlrAid.Ford_Veh_V_RqMxTrlrAid, system-signal=Veh_V_RqMxTrlrAid
        data-element=ECU_Composition.Ford_TrlrRvrse_D_Stat.Ford_TrlrRvrse_D_Stat, system-signal=TrlrRvrse_D_Stat
        data-element=ECU_Composition.Ford_TrlrHitchLamp_D_Rqst.Ford_TrlrHitchLamp_D_Rqst, system-signal=TrlrHitchLamp_D_Rqst
        data-element=ECU_Composition.Ford_SelDrvMdeChassis2_D_Rq.Ford_SelDrvMdeChassis2_D_Rq, system-signal=SelDrvMdeChassis2_D_Rq
        data-element=ECU_Composition.Ford_HitchToVehAxle_L_Calc.Ford_HitchToVehAxle_L_Calc, system-signal=HitchToVehAxle_L_Calc
        data-element=ECU_Composition.Ford_LaRefAng_No_Req.Ford_LaRefAng_No_Req, system-signal=LaRefAng_No_Req
        data-element=ECU_Composition.Ford_SAPPAngleControlStat5.Ford_SAPPAngleControlStat5, system-signal=SAPPAngleControlStat5
        data-element=ECU_Composition.Ford_ApaSys_D_Stat.Ford_ApaSys_D_Stat, system-signal=ApaSys_D_Stat
        data-element=ECU_Composition.Ford_LatCtlPrecision_D_Rq.Ford_LatCtlPrecision_D_Rq, system-signal=LatCtlPrecision_D_Rq
        data-element=ECU_Composition.Ford_SAPPAngleControlStat6.Ford_SAPPAngleControlStat6, system-signal=SAPPAngleControlStat6
        data-element=ECU_Composition.Ford_TrlrHitchYaw_An_Actl.Ford_TrlrHitchYaw_An_Actl, system-signal=TrlrHitchYaw_An_Actl
        data-element=ECU_Composition.Ford_BPedDrvAppl_D_QF.Ford_BPedDrvAppl_D_QF, system-signal=BPedDrvAppl_D_QF
        data-element=ECU_Composition.Ford_LatCtlSte_D_Stat.Ford_LatCtlSte_D_Stat, system-signal=LatCtlSte_D_Stat
        data-element=ECU_Composition.Ford_TrlrAidMde_D_Rq.Ford_TrlrAidMde_D_Rq, system-signal=TrlrAidMde_D_Rq
        data-element=ECU_Composition.Ford_StePinAn_No_Cs.Ford_StePinAn_No_Cs, system-signal=StePinAn_No_Cs
        data-element=ECU_Composition.Ford_DrvSte_Tq_Rq.Ford_DrvSte_Tq_Rq, system-signal=DrvSte_Tq_Rq
        data-element=ECU_Composition.Ford_TjaHandsOnCnfdnc_B_Est.Ford_TjaHandsOnCnfdnc_B_Est, system-signal=TjaHandsOnCnfdnc_B_Est
        data-element=ECU_Composition.Ford_VehLongComp_A_Actl.Ford_VehLongComp_A_Actl, system-signal=VehLongComp_A_Actl
        data-element=ECU_Composition.Ford_StePinAn_No_Cnt.Ford_StePinAn_No_Cnt, system-signal=StePinAn_No_Cnt
        data-element=ECU_Composition.Ford_TrlrAn_An_TrgtCalc.Ford_TrlrAn_An_TrgtCalc, system-signal=TrlrAn_An_TrgtCalc
        data-element=ECU_Composition.Ford_WhlRl_W_Meas.Ford_WhlRl_W_Meas, system-signal=WhlRl_W_Meas
        data-element=ECU_Composition.Ford_TrlrRvrseEnbl_D2_Stat.Ford_TrlrRvrseEnbl_D2_Stat, system-signal=TrlrRvrseEnbl_D2_Stat
        data-element=ECU_Composition.Ford_SteeringColumnTorque.Ford_SteeringColumnTorque, system-signal=SteeringColumnTorque
        data-element=ECU_Composition.Ford_VehVActlBrk_No_Cnt.Ford_VehVActlBrk_No_Cnt, system-signal=VehVActlBrk_No_Cnt
        data-element=ECU_Composition.Ford_WhlDirFl_D_Actl.Ford_WhlDirFl_D_Actl, system-signal=WhlDirFl_D_Actl
        data-element=ECU_Composition.Ford_SteWhlRelCalib_An_Sns.Ford_SteWhlRelCalib_An_Sns, system-signal=SteWhlRelCalib_An_Sns
        data-element=ECU_Composition.Ford_ElPw_D_Stat.Ford_ElPw_D_Stat, system-signal=ElPw_D_Stat
        data-element=ECU_Composition.Ford_LsmcBrk_Tq_Rq.Ford_LsmcBrk_Tq_Rq, system-signal=LsmcBrk_Tq_Rq
        data-element=ECU_Composition.Ford_TrlrAxleToBmpr_L_Actl.Ford_TrlrAxleToBmpr_L_Actl, system-signal=TrlrAxleToBmpr_L_Actl
        data-element=ECU_Composition.Ford_EPAS_Failure.Ford_EPAS_Failure, system-signal=EPAS_Failure
        data-element=ECU_Composition.Ford_StePinRelInit_An_Sns.Ford_StePinRelInit_An_Sns, system-signal=StePinRelInit_An_Sns
        data-element=ECU_Composition.Ford_TrlrAn_An_WarnCalc.Ford_TrlrAn_An_WarnCalc, system-signal=TrlrAn_An_WarnCalc
        data-element=ECU_Composition.Ford_TurnLghtSwtch_D_Stat.Ford_TurnLghtSwtch_D_Stat, system-signal=TurnLghtSwtch_D_Stat
        data-element=ECU_Composition.Ford_TrlrAidCancl_B_Rq.Ford_TrlrAidCancl_B_Rq, system-signal=TrlrAidCancl_B_Rq
        data-element=ECU_Composition.Ford_LifeCycMde_D_Actl.Ford_LifeCycMde_D_Actl, system-signal=LifeCycMde_D_Actl
        data-element=ECU_Composition.Ford_LatCtlLim_D_Stat.Ford_LatCtlLim_D_Stat, system-signal=LatCtlLim_D_Stat
        data-element=ECU_Composition.Ford_TrlrSnsId_No_Actl.Ford_TrlrSnsId_No_Actl, system-signal=TrlrSnsId_No_Actl
        data-element=ECU_Composition.Ford_VehVTrlrAid_B_Rq.Ford_VehVTrlrAid_B_Rq, system-signal=VehVTrlrAid_B_Rq
        data-element=ECU_Composition.Ford_LaRampType_B_Req.Ford_LaRampType_B_Req, system-signal=LaRampType_B_Req
        data-element=ECU_Composition.Ford_VehLatComp_A_Actl.Ford_VehLatComp_A_Actl, system-signal=VehLatComp_A_Actl
        data-element=ECU_Composition.Ford_LatCtlRampType_D_Rq.Ford_LatCtlRampType_D_Rq, system-signal=LatCtlRampType_D_Rq
        data-element=ECU_Composition.Ford_OdometerMasterValue.Ford_OdometerMasterValue, system-signal=OdometerMasterValue
        data-element=ECU_Composition.Ford_TrlrLampCnnct_B_Actl.Ford_TrlrLampCnnct_B_Actl, system-signal=TrlrLampCnnct_B_Actl
        data-element=ECU_Composition.Ford_EngAout_N_Actl.Ford_EngAout_N_Actl, system-signal=EngAout_N_Actl
        data-element=ECU_Composition.Ford_LsmcBrkDecelEnbl_D_Rq.Ford_LsmcBrkDecelEnbl_D_Rq, system-signal=LsmcBrkDecelEnbl_D_Rq
        data-element=ECU_Composition.Ford_BattULo_U_Actl.Ford_BattULo_U_Actl, system-signal=BattULo_U_Actl
        data-element=ECU_Composition.Ford_CmbbBrkDis_B_Actl.Ford_CmbbBrkDis_B_Actl, system-signal=CmbbBrkDis_B_Actl
        data-element=ECU_Composition.Ford_TrlrAnOffst_An2_Calc.Ford_TrlrAnOffst_An2_Calc, system-signal=TrlrAnOffst_An2_Calc
        data-element=ECU_Composition.Ford_VehVActlEng_No_Cnt.Ford_VehVActlEng_No_Cnt, system-signal=VehVActlEng_No_Cnt
        data-element=ECU_Composition.Ford_LaActAvail_D_Actl.Ford_LaActAvail_D_Actl, system-signal=LaActAvail_D_Actl
        data-element=ECU_Composition.Ford_TrlrBrkActCnnct_B_Actl.Ford_TrlrBrkActCnnct_B_Actl, system-signal=TrlrBrkActCnnct_B_Actl
        data-element=ECU_Composition.Ford_DrvSte_D_Stat.Ford_DrvSte_D_Stat, system-signal=DrvSte_D_Stat
        data-element=ECU_Composition.Ford_CmbbObjDistLong_L_Actl.Ford_CmbbObjDistLong_L_Actl, system-signal=CmbbObjDistLong_L_Actl
        data-element=ECU_Composition.Ford_TrlrAidSwtch_D_RqDrv.Ford_TrlrAidSwtch_D_RqDrv, system-signal=TrlrAidSwtch_D_RqDrv
        data-element=ECU_Composition.Ford_SteMdule_D_Stat.Ford_SteMdule_D_Stat, system-signal=SteMdule_D_Stat
        data-element=ECU_Composition.Ford_LkaDrvOvrrd_D_Rq.Ford_LkaDrvOvrrd_D_Rq, system-signal=LkaDrvOvrrd_D_Rq
        data-element=ECU_Composition.Ford_TrlrAid_An3_Actl.Ford_TrlrAid_An3_Actl, system-signal=TrlrAid_An3_Actl
        data-element=ECU_Composition.Ford_FileVersionNumber.Ford_FileVersionNumber, system-signal=FileVersionNumber
        data-element=ECU_Composition.Ford_YawStabilityIndex.Ford_YawStabilityIndex, system-signal=YawStabilityIndex
        data-element=ECU_Composition.Ford_WhlRotatRr_No_Cnt.Ford_WhlRotatRr_No_Cnt, system-signal=WhlRotatRr_No_Cnt
        data-element=ECU_Composition.Ford_TrlrAidCtl_U_RqDrv.Ford_TrlrAidCtl_U_RqDrv, system-signal=TrlrAidCtl_U_RqDrv
        data-element=ECU_Composition.Ford_DeliveryIdle.Ford_DeliveryIdle, system-signal=DeliveryIdle
        data-element=ECU_Composition.Ford_CmbbObjRelLong_V_Actl.Ford_CmbbObjRelLong_V_Actl, system-signal=CmbbObjRelLong_V_Actl
        data-element=ECU_Composition.Ford_PwPckTq_D_Stat.Ford_PwPckTq_D_Stat, system-signal=PwPckTq_D_Stat
        data-element=ECU_Composition.Ford_CmbbObjConfdnc_D_Stat.Ford_CmbbObjConfdnc_D_Stat, system-signal=CmbbObjConfdnc_D_Stat
        data-element=ECU_Composition.Ford_DeliveryNumber.Ford_DeliveryNumber, system-signal=DeliveryNumber
        data-element=ECU_Composition.Ford_VehOverGnd_V_Est.Ford_VehOverGnd_V_Est, system-signal=VehOverGnd_V_Est
        data-element=ECU_Composition.Ford_LaActDeny_B_Actl.Ford_LaActDeny_B_Actl, system-signal=LaActDeny_B_Actl
        data-element=ECU_Composition.Ford_LatCtlRng_L_Max.Ford_LatCtlRng_L_Max, system-signal=LatCtlRng_L_Max
        data-element=ECU_Composition.Ford_TrlrAnOffstDir_D_Mem.Ford_TrlrAnOffstDir_D_Mem, system-signal=TrlrAnOffstDir_D_Mem
        data-element=ECU_Composition.Ford_LatCtlPathOffst_L_Actl.Ford_LatCtlPathOffst_L_Actl, system-signal=LatCtlPathOffst_L_Actl
        data-element=ECU_Composition.Ford_CmbbObjColl_T_Actl.Ford_CmbbObjColl_T_Actl, system-signal=CmbbObjColl_T_Actl
        data-element=ECU_Composition.Ford_TrnRng_D_Rq.Ford_TrnRng_D_Rq, system-signal=TrnRng_D_Rq
        data-element=ECU_Composition.Ford_WhlDirRl_D_Actl.Ford_WhlDirRl_D_Actl, system-signal=WhlDirRl_D_Actl
        data-element=ECU_Composition.Ford_VehicleGGCCData.Ford_VehicleGGCCData, system-signal=VehicleGGCCData
        data-element=ECU_Composition.Ford_VehYawComp_W_Actl.Ford_VehYawComp_W_Actl, system-signal=VehYawComp_W_Actl
        data-element=ECU_Composition.Ford_CmbbObjRelLat_V_Actl.Ford_CmbbObjRelLat_V_Actl, system-signal=CmbbObjRelLat_V_Actl
        data-element=ECU_Composition.Ford_EPASExtAngleStatReq.Ford_EPASExtAngleStatReq, system-signal=EPASExtAngleStatReq
        data-element=ECU_Composition.Ford_WhlDirFr_D_Actl.Ford_WhlDirFr_D_Actl, system-signal=WhlDirFr_D_Actl
        data-element=ECU_Composition.Ford_GearRvrse_D_Actl.Ford_GearRvrse_D_Actl, system-signal=GearRvrse_D_Actl
        data-element=ECU_Composition.Ford_TrlrRvrseCancl_B_Rq.Ford_TrlrRvrseCancl_B_Rq, system-signal=TrlrRvrseCancl_B_Rq
        data-element=ECU_Composition.Ford_TrlrYaw_W_Actl.Ford_TrlrYaw_W_Actl, system-signal=TrlrYaw_W_Actl
        data-element=ECU_Composition.Ford_WhlRotatRl_No_Cnt.Ford_WhlRotatRl_No_Cnt, system-signal=WhlRotatRl_No_Cnt
        data-element=ECU_Composition.Ford_SteMdule_U_Meas.Ford_SteMdule_U_Meas, system-signal=SteMdule_U_Meas
        data-element=ECU_Composition.Ford_FileVersionDay.Ford_FileVersionDay, system-signal=FileVersionDay
        data-element=ECU_Composition.Ford_StabCtlBrkActv_B_Actl.Ford_StabCtlBrkActv_B_Actl, system-signal=StabCtlBrkActv_B_Actl
        data-element=ECU_Composition.Ford_WhlFr_W_Meas.Ford_WhlFr_W_Meas, system-signal=WhlFr_W_Meas
        data-element=ECU_Composition.Ford_VehVActlBrk_D_Qf.Ford_VehVActlBrk_D_Qf, system-signal=VehVActlBrk_D_Qf
        data-element=ECU_Composition.Ford_TrlrAidTrgtId_No_Rq.Ford_TrlrAidTrgtId_No_Rq, system-signal=TrlrAidTrgtId_No_Rq
        data-element=ECU_Composition.Ford_GearPos_D_Actl.Ford_GearPos_D_Actl, system-signal=GearPos_D_Actl
        data-element=ECU_Composition.Ford_EsaOn_B_Stat.Ford_EsaOn_B_Stat, system-signal=EsaOn_B_Stat
        data-element=ECU_Composition.Ford_TrlrTrgtAcquire_D_Stat.Ford_TrlrTrgtAcquire_D_Stat, system-signal=TrlrTrgtAcquire_D_Stat
        data-element=ECU_Composition.Ford_ApedPosPcActl_D_Qf.Ford_ApedPosPcActl_D_Qf, system-signal=ApedPosPcActl_D_Qf
        data-element=ECU_Composition.Ford_WhlRr_W_Meas.Ford_WhlRr_W_Meas, system-signal=WhlRr_W_Meas
        data-element=ECU_Composition.Ford_LatCtlCurv_NoRate_Actl.Ford_LatCtlCurv_NoRate_Actl, system-signal=LatCtlCurv_NoRate_Actl
        data-element=ECU_Composition.Ford_DrvSte_Tq_Actl.Ford_DrvSte_Tq_Actl, system-signal=DrvSte_Tq_Actl
        data-element=ECU_Composition.Ford_TrlrRvrseMsgTxt_D2_Rq.Ford_TrlrRvrseMsgTxt_D2_Rq, system-signal=TrlrRvrseMsgTxt_D2_Rq
        data-element=ECU_Composition.Ford_CmbbObjClass_D_Stat.Ford_CmbbObjClass_D_Stat, system-signal=CmbbObjClass_D_Stat
        data-element=ECU_Composition.Ford_TrlrAn_An_MxCalc.Ford_TrlrAn_An_MxCalc, system-signal=TrlrAn_An_MxCalc
        data-element=ECU_Composition.Ford_StePinComp_An_Est.Ford_StePinComp_An_Est, system-signal=StePinComp_An_Est
        data-element=ECU_Composition.Ford_TrlrYawWActl_D_Qf.Ford_TrlrYawWActl_D_Qf, system-signal=TrlrYawWActl_D_Qf
        data-element=ECU_Composition.Ford_DeliverySipNumber.Ford_DeliverySipNumber, system-signal=DeliverySipNumber
        data-element=ECU_Composition.Ford_LatCtl_D_Rq.Ford_LatCtl_D_Rq, system-signal=LatCtl_D_Rq
        data-element=ECU_Composition.Ford_TrlrAidMsgTxt_D2_Rq.Ford_TrlrAidMsgTxt_D2_Rq, system-signal=TrlrAidMsgTxt_D2_Rq
        data-element=ECU_Composition.Ford_Veh_V_ActlBrk.Ford_Veh_V_ActlBrk, system-signal=Veh_V_ActlBrk
        data-element=ECU_Composition.Ford_TrlrIdType_D_Stat.Ford_TrlrIdType_D_Stat, system-signal=TrlrIdType_D_Stat
        data-element=ECU_Composition.Ford_SAPPAngleControlStat1.Ford_SAPPAngleControlStat1, system-signal=SAPPAngleControlStat1
        data-element=ECU_Composition.Ford_TrlrId_No_Actl.Ford_TrlrId_No_Actl, system-signal=TrlrId_No_Actl
        data-element=ECU_Composition.Ford_EsaOn_B_Rq.Ford_EsaOn_B_Rq, system-signal=EsaOn_B_Rq
        data-element=ECU_Composition.Ford_StePinOffst_D_Stat.Ford_StePinOffst_D_Stat, system-signal=StePinOffst_D_Stat
        data-element=ECU_Composition.Ford_StePw_B_Rq.Ford_StePw_B_Rq, system-signal=StePw_B_Rq
        data-element=ECU_Composition.Ford_TrlrAid_D2_Stat.Ford_TrlrAid_D2_Stat, system-signal=TrlrAid_D2_Stat
        data-element=ECU_Composition.Ford_HandsOffCnfm_B_Rq.Ford_HandsOffCnfm_B_Rq, system-signal=HandsOffCnfm_B_Rq
        data-element=ECU_Composition.Ford_StePinOffst_An_Est.Ford_StePinOffst_An_Est, system-signal=StePinOffst_An_Est
        data-element=ECU_Composition.Ford_LsmcBrkDecel_D_Stat.Ford_LsmcBrkDecel_D_Stat, system-signal=LsmcBrkDecel_D_Stat
        data-element=ECU_Composition.Ford_TrlrAidSetup_D2_Rq.Ford_TrlrAidSetup_D2_Rq, system-signal=TrlrAidSetup_D2_Rq
        data-element=ECU_Composition.Ford_VehVActlEng_No_Cs.Ford_VehVActlEng_No_Cs, system-signal=VehVActlEng_No_Cs
        data-element=ECU_Composition.Ford_AbsActv_B_Actl.Ford_AbsActv_B_Actl, system-signal=AbsActv_B_Actl
        data-element=ECU_Composition.Ford_VehVActlEng_D_Qf.Ford_VehVActlEng_D_Qf, system-signal=VehVActlEng_D_Qf
        data-element=ECU_Composition.Ford_VehVActlBrk_No_Cs.Ford_VehVActlBrk_No_Cs, system-signal=VehVActlBrk_No_Cs
        data-element=ECU_Composition.Ford_WhlDirRr_D_Actl.Ford_WhlDirRr_D_Actl, system-signal=WhlDirRr_D_Actl
        data-element=ECU_Composition.Ford_StePinOffst_No_Cs.Ford_StePinOffst_No_Cs, system-signal=StePinOffst_No_Cs
        data-element=ECU_Composition.Ford_SAPPAngleControlStat3.Ford_SAPPAngleControlStat3, system-signal=SAPPAngleControlStat3
        data-element=ECU_Composition.Ford_TrlrAidSetup_D2_Stat.Ford_TrlrAidSetup_D2_Stat, system-signal=TrlrAidSetup_D2_Stat
        data-element=ECU_Composition.Ford_SelDrvMdeSte_D_Stat.Ford_SelDrvMdeSte_D_Stat, system-signal=SelDrvMdeSte_D_Stat
        data-element=ECU_Composition.Ford_DrvSteActv_B_Stat.Ford_DrvSteActv_B_Stat, system-signal=DrvSteActv_B_Stat
        data-element=ECU_Composition.Ford_LaCurvature_No_Calc.Ford_LaCurvature_No_Calc, system-signal=LaCurvature_No_Calc
        data-element=ECU_Composition.Ford_Outside_Air_Temp_Stat.Ford_Outside_Air_Temp_Stat, system-signal=Outside_Air_Temp_Stat
    root-software-compositions:
      root sw composition prototype ECU_Composition: software-composition=ECU_Composition
