AUTOSAR XML (schema 4-0-3)
package /DaVinci/PKG_ECU
  ecu instance MotCtrlMgr
package /ECUCompositionTypes
  composition sw component type ECU_Composition
    component CDD_MotCtrlMgr: type=CDD_MotCtrlMgr
package /EndToEndProtections
  end to end protection set EndToEndConnections
package /Systems
  system MotCtrlMgr: category=SYSTEM_EXTRACT
    system mapping MotCtrlMgr_MPPNG
    root-software-compositions:
      root sw composition prototype EcuSwComposition: software-composition=ECU_Composition
