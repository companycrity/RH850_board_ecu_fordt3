AUTOSAR XML (schema 4-0-3)
package /PortInterfaces
  client server interface DmaEna2MilliSecToMotCtrlTrf
    operation Oper
  client server interface DmaWaitForMotCtrlTo2MilliSecTrf
    operation Oper: possible-error=E_NOT_OK
    error E_NOT_OK: error-code=1
  35 x sender receiver interface:
    ReadMotCtrlWriteTwoMsbool: invalidation-policy{data-element=ReadMotCtrlWriteTwoMsbool/Logl, handle-invalid=DONT-INVALIDATE}
      data Logl: sw-calibration-access=READ-ONLY, type=boolean
    ReadMotCtrlWriteTwoMsEnum: invalidation-policy{data-element=ReadMotCtrlWriteTwoMsEnum/Val, handle-invalid=DONT-INVALIDATE}
      data Val: sw-calibration-access=READ-ONLY, type=TestEnum_u32
    ReadMotCtrlWriteTwoMsf32: invalidation-policy{data-element=ReadMotCtrlWriteTwoMsf32/Val, handle-invalid=DONT-INVALIDATE}
      data Val: sw-calibration-access=READ-ONLY, type=float32
    ReadMotCtrlWriteTwoMss08: invalidation-policy{data-element=ReadMotCtrlWriteTwoMss08/Val, handle-invalid=DONT-INVALIDATE}
      data Val: sw-calibration-access=READ-ONLY, type=sint8
    ReadMotCtrlWriteTwoMss16: invalidation-policy{data-element=ReadMotCtrlWriteTwoMss16/Val, handle-invalid=DONT-INVALIDATE}
      data Val: sw-calibration-access=READ-ONLY, type=sint16
    ReadMotCtrlWriteTwoMss32: invalidation-policy{data-element=ReadMotCtrlWriteTwoMss32/Val, handle-invalid=DONT-INVALIDATE}
      data Val: sw-calibration-access=READ-ONLY, type=sint32
    ReadMotCtrlWriteTwoMss32Ary: invalidation-policy{data-element=ReadMotCtrlWriteTwoMss32Ary/Ary1D, handle-invalid=DONT-INVALIDATE}
      data Ary1D: sw-calibration-access=READ-ONLY, type=Ary_s32
    ReadMotCtrlWriteTwoMsu08: invalidation-policy{data-element=ReadMotCtrlWriteTwoMsu08/Val, handle-invalid=DONT-INVALIDATE}
      data Val: sw-calibration-access=READ-ONLY, type=uint8
    ReadMotCtrlWriteTwoMsu16: invalidation-policy{data-element=ReadMotCtrlWriteTwoMsu16/Val, handle-invalid=DONT-INVALIDATE}
      data Val: sw-calibration-access=READ-ONLY, type=uint16
    ReadMotCtrlWriteTwoMsu32: invalidation-policy{data-element=ReadMotCtrlWriteTwoMsu32/Val, handle-invalid=DONT-INVALIDATE}
      data Val: sw-calibration-access=READ-ONLY, type=uint32
    Signal0: invalidation-policy{data-element=Signal0/Logl, handle-invalid=DONT-INVALIDATE}
      data Logl: sw-calibration-access=READ-ONLY, type=boolean
    Signal2: invalidation-policy{data-element=Signal2/Val, handle-invalid=DONT-INVALIDATE}
      data Val: sw-calibration-access=READ-ONLY, type=sint8
    Signal3: invalidation-policy{data-element=Signal3/Val, handle-invalid=DONT-INVALIDATE}
      data Val: sw-calibration-access=READ-ONLY, type=sint8
    Signal4: invalidation-policy{data-element=Signal4/Val, handle-invalid=DONT-INVALIDATE}
      data Val: sw-calibration-access=READ-ONLY, type=sint8
    Signal5: invalidation-policy{data-element=Signal5/Logl, handle-invalid=DONT-INVALIDATE}
      data Logl: sw-calibration-access=READ-ONLY, type=boolean
    WriteMotCtrlReadMotCtrlReadTwoMsbool: invalidation-policy{data-element=WriteMotCtrlReadMotCtrlReadTwoMsbool/Logl, handle-invalid=DONT-INVALIDATE}
      data Logl: sw-calibration-access=READ-ONLY, type=boolean
    WriteMotCtrlReadMotCtrlReadTwoMsEnum: invalidation-policy{data-element=WriteMotCtrlReadMotCtrlReadTwoMsEnum/Val, handle-invalid=DONT-INVALIDATE}
      data Val: sw-calibration-access=READ-ONLY, type=TestEnum_u16
    WriteMotCtrlReadMotCtrlReadTwoMsf32: invalidation-policy{data-element=WriteMotCtrlReadMotCtrlReadTwoMsf32/Val, handle-invalid=DONT-INVALIDATE}
      data Val: sw-calibration-access=READ-ONLY, type=float32
    WriteMotCtrlReadMotCtrlReadTwoMss08: invalidation-policy{data-element=WriteMotCtrlReadMotCtrlReadTwoMss08/Val, handle-invalid=DONT-INVALIDATE}
      data Val: sw-calibration-access=READ-ONLY, type=sint8
    WriteMotCtrlReadMotCtrlReadTwoMss16: invalidation-policy{data-element=WriteMotCtrlReadMotCtrlReadTwoMss16/Val, handle-invalid=DONT-INVALIDATE}
      data Val: sw-calibration-access=READ-ONLY, type=sint16
    WriteMotCtrlReadMotCtrlReadTwoMss32: invalidation-policy{data-element=WriteMotCtrlReadMotCtrlReadTwoMss32/Val, handle-invalid=DONT-INVALIDATE}
      data Val: sw-calibration-access=READ-ONLY, type=sint32
    WriteMotCtrlReadMotCtrlReadTwoMsu08: invalidation-policy{data-element=WriteMotCtrlReadMotCtrlReadTwoMsu08/Val, handle-invalid=DONT-INVALIDATE}
      data Val: sw-calibration-access=READ-ONLY, type=uint8
    WriteMotCtrlReadMotCtrlReadTwoMsu16: invalidation-policy{data-element=WriteMotCtrlReadMotCtrlReadTwoMsu16/Val, handle-invalid=DONT-INVALIDATE}
      data Val: sw-calibration-access=READ-ONLY, type=uint16
    WriteMotCtrlReadMotCtrlReadTwoMsu16Ary: invalidation-policy{data-element=WriteMotCtrlReadMotCtrlReadTwoMsu16Ary/Ary1D, handle-invalid=DONT-INVALIDATE}
      data Ary1D: sw-calibration-access=READ-ONLY, type=Ary_u16
    WriteMotCtrlReadMotCtrlReadTwoMsu32: invalidation-policy{data-element=WriteMotCtrlReadMotCtrlReadTwoMsu32/Val, handle-invalid=DONT-INVALIDATE}
      data Val: sw-calibration-access=READ-ONLY, type=uint32
    WriteMotCtrlReadTwoMsbool: invalidation-policy{data-element=WriteMotCtrlReadTwoMsbool/Logl, handle-invalid=DONT-INVALIDATE}
      data Logl: sw-calibration-access=READ-ONLY, type=boolean
    WriteMotCtrlReadTwoMsEnum: invalidation-policy{data-element=WriteMotCtrlReadTwoMsEnum/Val, handle-invalid=DONT-INVALIDATE}
      data Val: sw-calibration-access=READ-ONLY, type=TestEnum_u16
    WriteMotCtrlReadTwoMsf32: invalidation-policy{data-element=WriteMotCtrlReadTwoMsf32/Val, handle-invalid=DONT-INVALIDATE}
      data Val: sw-calibration-access=READ-ONLY, type=float32
    WriteMotCtrlReadTwoMss08: invalidation-policy{data-element=WriteMotCtrlReadTwoMss08/Val, handle-invalid=DONT-INVALIDATE}
      data Val: sw-calibration-access=READ-ONLY, type=sint8
    WriteMotCtrlReadTwoMss16: invalidation-policy{data-element=WriteMotCtrlReadTwoMss16/Val, handle-invalid=DONT-INVALIDATE}
      data Val: sw-calibration-access=READ-ONLY, type=sint16
    WriteMotCtrlReadTwoMss32: invalidation-policy{data-element=WriteMotCtrlReadTwoMss32/Val, handle-invalid=DONT-INVALIDATE}
      data Val: sw-calibration-access=READ-ONLY, type=sint32
    WriteMotCtrlReadTwoMsu08: invalidation-policy{data-element=WriteMotCtrlReadTwoMsu08/Val, handle-invalid=DONT-INVALIDATE}
      data Val: sw-calibration-access=READ-ONLY, type=uint8
    WriteMotCtrlReadTwoMsu16: invalidation-policy{data-element=WriteMotCtrlReadTwoMsu16/Val, handle-invalid=DONT-INVALIDATE}
      data Val: sw-calibration-access=READ-ONLY, type=uint16
    WriteMotCtrlReadTwoMsu32: invalidation-policy{data-element=WriteMotCtrlReadTwoMsu32/Val, handle-invalid=DONT-INVALIDATE}
      data Val: sw-calibration-access=READ-ONLY, type=uint32
    WriteMotCtrlReadTwoMsu32Ary: invalidation-policy{data-element=WriteMotCtrlReadTwoMsu32Ary/Ary1D, handle-invalid=DONT-INVALIDATE}
      data Ary1D: sw-calibration-access=READ-ONLY, type=Ary_u32
