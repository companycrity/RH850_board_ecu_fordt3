AUTOSAR XML (schema 4-0-3)
standard types defined: boolean, uint8
package /DataType/Unit
  unit U_SED: display-name=SED, factor-si-to-unit=1, offset-si-to-unit=0
package /Ford/DataTypes
  6 x impl type, all with category=VALUE, sw-calibration-access=READ-ONLY:
    Ford_EsaOn_B_Stat: base-type=boolean, compu {phys=raw for raw 0..1, 0=Cx0_Off, 1=Cx1_On; unit SED}
    Ford_LatCtlLim_D_Stat: base-type=uint8, compu {phys=raw for raw 0..3, 0=Cx0_LimitNotReached, 1=Cx1_LimitClose, 2=Cx2_LimitReached, 3=Cx3_LimitWithDriverActive; unit SED}, range raw 0..3
    Ford_LatCtlSte_D_Stat: base-type=uint8, compu {phys=raw for raw 0..7, 0=Cx0_Unavailable, 1=Cx1_Available, 2=Cx2_ContLatControlInProgress, 3=Cx3_RampOut, 4=Cx4_Denied, 5=Cx5_NotUsed1, 6=Cx6_NotUsed2, 7=Cx7_NotUsed3; unit SED}, range raw 0..7
    Ford_SelDrvMdeSte_D_Stat: base-type=uint8, compu {phys=raw for raw 0..3, 0=Cx0_NotAvailable, 1=Cx1_Available, 2=Cx2_TemporarilyNotAvailable, 3=Cx3_Faulty; unit SED}, range raw 0..3
    Ford_TrlrAidEnbl_D2_Stat: base-type=uint8, compu {phys=raw for raw 0..7, 0=Cx0_Inactive, 1=Cx1_TbaActive, 2=Cx2_TbaSetup, 3=Cx3_TbaOffTrgSetup, 4=Cx4_TbaOffTrgActive, 5=Cx5_TbaActiveExpertAvail, 6=Cx6_TbaActiveExpertActive, 7=Cx7_NotUsed_1; unit SED}, range raw 0..7
    Ford_TrlrAidMsgTxt_D2_Rq:
      base-type=uint8
      compu {phys=raw for raw 0..63, 0=Cx00_NoMessage, 1=Cx01_Message1, 2=Cx02_Message2, 3=Cx03_Message3, 4=Cx04_Message4, 5=Cx05_Message5, 6=Cx06_Message6, 7=Cx07_Message7, 8=Cx08_Message8, 9=Cx09_Message9, 10=Cx0A_Message10, 11=Cx0B_Message11, 12=Cx0C_Message12, 13=Cx0D_Message13, 14=Cx0E_Message14, 15=Cx0F_Message15, 16=Cx10_Message16, 17=Cx11_Message17, 18=Cx12_Message18, 19=Cx13_Message19, 20=Cx14_Message20, 21=Cx15_Message21, 22=Cx16_Message22, 23=Cx17_Message23, 24=Cx18_Message24, 25=Cx19_Message25, 26=Cx1A_Message26, 27=Cx1B_Message27, 28=Cx1C_Message28, 29=Cx1D_Message29, 30=Cx1E_Message30, 31=Cx1F_Message31, 35=Cx23_Message35, 40=Cx28_Message40, 45=Cx2D_Message45, 50=Cx32_Message50, 55=Cx37_Message55, 60=Cx3C_Message60, 61=Cx3D_Message61, 62=Cx3E_Message62, 63=Cx3F_Message63; unit SED}
      range raw 0..63
