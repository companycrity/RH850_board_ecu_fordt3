AUTOSAR XML (schema 4-0-3)
package /Ford/PortInterfaces
  6 x sender receiver interface:
    Ford_EsaOn_B_Stat: invalidation-policy{data-element=Ford_EsaOn_B_Stat, handle-invalid=DONT-INVALIDATE}
      data Ford_EsaOn_B_Stat: sw-calibration-access=READ-ONLY, type=Ford_EsaOn_B_Stat
    Ford_LatCtlLim_D_Stat: invalidation-policy{data-element=Ford_LatCtlLim_D_Stat, handle-invalid=DONT-INVALIDATE}
      data Ford_LatCtlLim_D_Stat: sw-calibration-access=READ-ONLY, type=Ford_LatCtlLim_D_Stat
    Ford_LatCtlSte_D_Stat: invalidation-policy{data-element=Ford_LatCtlSte_D_Stat, handle-invalid=DONT-INVALIDATE}
      data Ford_LatCtlSte_D_Stat: sw-calibration-access=READ-ONLY, type=Ford_LatCtlSte_D_Stat
    Ford_SelDrvMdeSte_D_Stat: invalidation-policy{data-element=Ford_SelDrvMdeSte_D_Stat, handle-invalid=DONT-INVALIDATE}
      data Ford_SelDrvMdeSte_D_Stat: sw-calibration-access=READ-ONLY, type=Ford_SelDrvMdeSte_D_Stat
    Ford_TrlrAidEnbl_D2_Stat: invalidation-policy{data-element=Ford_TrlrAidEnbl_D2_Stat, handle-invalid=DONT-INVALIDATE}
      data Ford_TrlrAidEnbl_D2_Stat: sw-calibration-access=READ-ONLY, type=Ford_TrlrAidEnbl_D2_Stat
    Ford_TrlrAidMsgTxt_D2_Rq: invalidation-policy{data-element=Ford_TrlrAidMsgTxt_D2_Rq, handle-invalid=DONT-INVALIDATE}
      data Ford_TrlrAidMsgTxt_D2_Rq: sw-calibration-access=READ-ONLY, type=Ford_TrlrAidMsgTxt_D2_Rq
