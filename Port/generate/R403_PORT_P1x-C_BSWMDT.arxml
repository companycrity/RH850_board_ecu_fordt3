AUTOSAR XML (schema 4-0-3)
# COPYRIGHT
# Copyright(c) 2015-2017  Renesas Electronics Corporation
# 4. Copyright Information is updated.
package /Renesas/EcucDefs_Port
  bsw implementation Port_Impl: programming-language=C, sw-version=1.0.4, vendor-id=59, ar-release-version=4.0.3, behavior=BswInternalBehavior_0, vendor-api-infix=Renesas
    code-descriptors:
      code Port_Code: artifact-descriptors=autosar-engineering-object={short-label=artifactDescriptor, category=artifactDescriptorCategory}
    resource consumption ResourceConsumption
      memory section CODE: sw-addrmethod=CODE
  bsw module description Port: module-id=124
    provided-entrys:
      Port_Init
      Port_SetPinDirection
      Port_RefreshPortDirection
      Port_GetVersionInfo
      Port_SetPinMode
      Port_SetToDioMode
      Port_SetToAlternateMode
      Port_SetPinDefaultMode
      Port_SetPinDefaultDirection
    bsw internal behavior BswInternalBehavior_0
      6 x exclusive area:
        PORT_SET_PIN_MODE_PROTECTION
        PORT_SET_PIN_DEFAULT_MODE_PROTECTION
        PORT_SET_PIN_DEFAULT_DIR_PROTECTION
        PORT_SET_PIN_DIR_PROTECTION
        PORT_SET_TO_DIO_ALT_PROTECTION
        PORT_REFRESHPORT_INTERNAL_PROTECTION
      9 x bsw called entity:
        BswCalledEntity_0: implemented-entry=Port_Init
        BswCalledEntity_1: can-enter-exclusive-area=PORT_SET_PIN_DIR_PROTECTION, implemented-entry=Port_SetPinDirection
        BswCalledEntity_2: can-enter-exclusive-area=PORT_REFRESHPORT_INTERNAL_PROTECTION, implemented-entry=Port_RefreshPortDirection
        BswCalledEntity_3: can-enter-exclusive-area=PORT_SET_PIN_MODE_PROTECTION, implemented-entry=Port_SetPinMode
        BswCalledEntity_4: can-enter-exclusive-area=PORT_SET_TO_DIO_ALT_PROTECTION, implemented-entry=Port_SetToDioMode
        BswCalledEntity_5: can-enter-exclusive-area=PORT_SET_TO_DIO_ALT_PROTECTION, implemented-entry=Port_SetToAlternateMode
        BswCalledEntity_6: can-enter-exclusive-area=PORT_SET_PIN_DEFAULT_MODE_PROTECTION, implemented-entry=Port_SetPinDefaultMode
        BswCalledEntity_7: can-enter-exclusive-area=PORT_SET_PIN_DEFAULT_DIR_PROTECTION, implemented-entry=Port_SetPinDefaultDirection
        BswCalledEntity_8: implemented-entry=Port_GetVersionInfo
  9 x bsw module entry, all with is-synchronous=true, call-type=REGULAR, execution-context=TASK, sw-service-impl-policy=STANDARD:
    Port_Init: service-id=0, is-reentrant=false
    Port_SetPinDirection: service-id=1, is-reentrant=true
    Port_RefreshPortDirection: service-id=2, is-reentrant=false
    Port_SetPinMode: service-id=4, is-reentrant=true
    Port_SetToDioMode: service-id=5, is-reentrant=true
    Port_SetToAlternateMode: service-id=6, is-reentrant=true
    Port_SetPinDefaultMode: service-id=7, is-reentrant=true
    Port_SetPinDefaultDirection: service-id=8, is-reentrant=true
    Port_GetVersionInfo: service-id=3, is-reentrant=false
