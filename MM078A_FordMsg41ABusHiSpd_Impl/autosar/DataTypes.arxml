AUTOSAR XML (schema 4-0-3)
standard types defined: boolean, float32, uint16, uint32, uint8, boolean_CompuMethod, boolean_DataConstr, float32_DataConstr, uint16_DataConstr, uint32_DataConstr, uint8_DataConstr
package /DataType/Unit
  unit U_Degrees_C: display-name=Degrees C, factor-si-to-unit=1, offset-si-to-unit=0
package /Ford/DataTypes
  impl type Ford_Outside_Air_Temp_Stat: category=VALUE, base-type=DataType/uint8, sw-calibration-access=READ-ONLY, compu {254=CxFE_Unknown, 255=CxFF_Invalid, phys=raw for raw 0..255; unit Degrees C} "Source signal range: [0,253]"
package /Nexteer/DataTypes
  impl type NtcNr1: compu {1..511=NTCNR_0X001..NTCNR_0X1FF}, implementation-data-type=uint16, type-emitter=RTE
  impl type NtcSts1: compu {0=NTCSTS_PASSD, 1=NTCSTS_FAILD, 2=NTCSTS_PREPASSD, 3=NTCSTS_PREFAILD}, implementation-data-type=uint8, type-emitter=RTE
  impl type u16p0: implementation-data-type=uint16, type-emitter=RTE
