AUTOSAR XML (schema 4-0-3)
# COPYRIGHT
# Copyright (c) 2016 by Vector Informatik GmbH. All rights reserved.
# This software is copyright protected and proprietary to Vector Informatik GmbH.
# Vector Informatik GmbH grants to you only those rights as set out in the license conditions.
package /MICROSAR  # EcuM Preconfiguration
  module config EcuM_Pre: definition=EcuM
  module config EcuM_Rec: definition=EcuM, implementation-config-variant=VARIANT-PRE-COMPILE
