AUTOSAR XML (schema 4-0-3)
package /Ford/PortInterfaces
  7 x sender receiver interface:
    Ford_HitchToVehAxle_L_Calc: invalidation-policy{data-element=Ford_HitchToVehAxle_L_Calc, handle-invalid=DONT-INVALIDATE}
      data Ford_HitchToVehAxle_L_Calc: sw-calibration-access=READ-ONLY, type=Ford_HitchToVehAxle_L_Calc
    Ford_TrlrAid_An3_Actl: invalidation-policy{data-element=Ford_TrlrAid_An3_Actl, handle-invalid=DONT-INVALIDATE}
      data Ford_TrlrAid_An3_Actl: sw-calibration-access=READ-ONLY, type=Ford_TrlrAid_An3_Actl
    Ford_TrlrAid_AnRate2_Actl: invalidation-policy{data-element=Ford_TrlrAid_AnRate2_Actl, handle-invalid=DONT-INVALIDATE}
      data Ford_TrlrAid_AnRate2_Actl: sw-calibration-access=READ-ONLY, type=Ford_TrlrAid_AnRate2_Actl
    Ford_TrlrAid_D2_Stat: invalidation-policy{data-element=Ford_TrlrAid_D2_Stat, handle-invalid=DONT-INVALIDATE}
      data Ford_TrlrAid_D2_Stat: sw-calibration-access=READ-ONLY, type=Ford_TrlrAid_D2_Stat
    Ford_TrlrAidTrgtId_No_Actl: invalidation-policy{data-element=Ford_TrlrAidTrgtId_No_Actl, handle-invalid=DONT-INVALIDATE}
      data Ford_TrlrAidTrgtId_No_Actl: sw-calibration-access=READ-ONLY, type=Ford_TrlrAidTrgtId_No_Actl
    Ford_TrlrRvrse_D_Stat: invalidation-policy{data-element=Ford_TrlrRvrse_D_Stat, handle-invalid=DONT-INVALIDATE}
      data Ford_TrlrRvrse_D_Stat: sw-calibration-access=READ-ONLY, type=Ford_TrlrRvrse_D_Stat
    Ford_TrlrTrgtAcquire_D_Stat: invalidation-policy{data-element=Ford_TrlrTrgtAcquire_D_Stat, handle-invalid=DONT-INVALIDATE}
      data Ford_TrlrTrgtAcquire_D_Stat: sw-calibration-access=READ-ONLY, type=Ford_TrlrTrgtAcquire_D_Stat
package /Nexteer/Calibrations
  parameter interface uint16_CalPortIf1
    parameter data prototype Val: sw-calibration-access=READ-WRITE, type=uint16
package /Nexteer/PortInterfaces
  client server interface GetRefTmr100MicroSec32bit_PortIf1
    operation Oper
      arg RefTmr_Arg: type=uint32, direction=OUT, server-argument-impl-policy=USE-ARGUMENT-TYPE
  client server interface GetTiSpan100MicroSec32bit_PortIf1
    operation Oper
      arg RefTmr_Arg: type=uint32, direction=IN, server-argument-impl-policy=USE-ARGUMENT-TYPE
      arg TiSpan_Arg: type=uint32, direction=OUT, server-argument-impl-policy=USE-ARGUMENT-TYPE
  client server interface SetNtcSts_PortIf1
    operation Oper: possible-error=E_NOT_OK
      4 x arg, all with direction=IN, server-argument-impl-policy=USE-ARGUMENT-TYPE:
        NtcNr_Arg: type=NtcNr1
        NtcStInfo_Arg: type=uint8
        NtcSts_Arg: type=NtcSts1
        DebStep_Arg: type=uint16
    error E_NOT_OK: error-code=1
  sender receiver interface boolean_PortIf1: invalidation-policy{data-element=Logl, handle-invalid=DONT-INVALIDATE}
    data Logl: sw-calibration-access=READ-ONLY, type=boolean
  sender receiver interface uint16_PortIf1: invalidation-policy{data-element=uint16_PortIf1/Val, handle-invalid=DONT-INVALIDATE}
    data Val: sw-calibration-access=READ-ONLY, type=uint16
  sender receiver interface uint8_PortIf1: invalidation-policy{data-element=uint8_PortIf1/Val, handle-invalid=DONT-INVALIDATE}
    data Val: sw-calibration-access=READ-ONLY, type=uint8
