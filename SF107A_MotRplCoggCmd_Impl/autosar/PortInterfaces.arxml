AUTOSAR XML (schema 4-0-3)
package /Nexteer/Calibrations
  parameter interface uint8_CalPortIf1
    parameter data prototype Val: sw-calibration-access=READ-WRITE, type=uint8
package /Nexteer/NvMProxy_swc/Interfaces
  client server interface NvMService_AC3_SRBS: is-service=true
    6 x operation, all with possible-error=E_NOT_OK:
      EraseBlock
      GetErrorStatus
        arg ErrorStatus: type=NvM_RequestResultType, direction=OUT
      InvalidateNvBlock
      ReadBlock
        arg DstPtr: type=dtRef_VOID, direction=IN
      SetRamBlockStatus
        arg RamBlockStatus: type=Boolean, direction=IN
      WriteBlock
        arg SrcPtr: type=dtRef_const_VOID, direction=IN
    error E_NOT_OK: error-code=1
package /Nexteer/PortInterfaces
  client server interface GetMotCoggCmdPrm_PortIf1
    operation Oper
      arg MotCoggCmdY_Arg: type=Ary1D_s1p14_128, direction=OUT
      arg Idx_Arg: type=uint8, direction=IN
  client server interface SetMotCoggCmdPrm_PortIf1
    operation Oper
      arg MotCoggCmdY_Arg: type=Ary1D_s1p14_128, direction=IN
      arg Idx_Arg: type=uint8, direction=IN
