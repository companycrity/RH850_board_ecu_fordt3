AUTOSAR XML (schema 4-0-3)
standard types defined: float32_DataConstr, float64_DataConstr, sint16_DataConstr, sint32_DataConstr, sint8_DataConstr, uint16_DataConstr, uint32_DataConstr, uint8_DataConstr, boolean, float32, float64, sint16, sint32, sint8, uint16, uint32, uint8
package /Nexteer/DataTypes
  18 x impl type, all with type-emitter=RTE:
    Ary1D_s4p11_12: category=ARRAY, sw-calibration-access=READ-ONLY
      element Element: array-size=12, array-size-semantics=FIXED-SIZE, implementation-data-type=s4p11
    Ary1D_s8p7_12: category=ARRAY, sw-calibration-access=READ-ONLY
      element Element: array-size=12, array-size-semantics=FIXED-SIZE, implementation-data-type=s8p7
    Ary1D_u11p5_12: category=ARRAY, sw-calibration-access=READ-ONLY
      element Element: array-size=12, array-size-semantics=FIXED-SIZE, implementation-data-type=u11p5
    Ary1D_u12p4_12: category=ARRAY, sw-calibration-access=READ-ONLY
      element Element: array-size=12, array-size-semantics=FIXED-SIZE, implementation-data-type=u12p4
    Ary1D_u15p1_12: category=ARRAY, sw-calibration-access=READ-ONLY
      element Element: array-size=12, array-size-semantics=FIXED-SIZE, implementation-data-type=u15p1
    Ary1D_u2p14_10: category=ARRAY, sw-calibration-access=READ-ONLY
      element Element: array-size=10, array-size-semantics=FIXED-SIZE, implementation-data-type=u2p14
    Ary1D_u2p14_12: category=ARRAY, sw-calibration-access=READ-ONLY
      element Element: array-size=12, array-size-semantics=FIXED-SIZE, implementation-data-type=u2p14
    Ary1D_u8p8_10: category=ARRAY, sw-calibration-access=READ-ONLY
      element Element: array-size=10, array-size-semantics=FIXED-SIZE, implementation-data-type=u8p8
    Ary1D_u8p8_12: category=ARRAY, sw-calibration-access=READ-ONLY
      element Element: array-size=12, array-size-semantics=FIXED-SIZE, implementation-data-type=u8p8
    Ary1D_u9p7_12: category=ARRAY, sw-calibration-access=READ-ONLY
      element Element: array-size=12, array-size-semantics=FIXED-SIZE, implementation-data-type=u9p7
    s4p11: implementation-data-type=sint16
    s8p7: implementation-data-type=sint16
    u11p5: implementation-data-type=uint16
    u12p4: implementation-data-type=uint16
    u15p1: implementation-data-type=uint16
    u2p14: implementation-data-type=uint16
    u8p8: implementation-data-type=uint16
    u9p7: implementation-data-type=uint16
package /Nexteer/Units
  unit FixdPt: factor-si-to-unit=1, offset-si-to-unit=0
