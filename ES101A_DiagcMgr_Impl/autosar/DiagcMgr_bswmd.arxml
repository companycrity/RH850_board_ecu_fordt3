AUTOSAR XML (schema 4-0-3)
package /Nexteer/EcucDefs_DiagcMgr
  ecuc definition collection NexteerParameterDefinition_DiagcMgr: module=DiagcMgr
  module definition DiagcMgr: category=VENDOR_SPECIFIC_MODULE_DEFINITION, refined-module-def=DiagcMgr, variants pre-compile  # Configuration of the DiagcMgr module.
    container NTCNR [0..511]  # Container with NTC number properties
      boolean Debounce: origin=NEXTEER  # Set to true if NTC is type debounce Indicated by third member of each element in DIAGCMGRNTCMAP_CNT_REC array
      boolean MfgNtcInhibInOper: origin=NEXTEER, default-value=0  # 'Mfg NTC Inhibit Operate State' field for the corresponding NTC from the NTC Master List Corresponds to NTCPPTY bit2: MFGINHBINENAST_CNT_U08
      boolean MfgNtcInhibInNonOper: origin=NEXTEER, default-value=0  # 'Mfg NTC Inhibit Non-Operate States' field for the corresponding NTC from the NTC Master List Corresponds to NTCPPTY bit1: MFGINHBNOTINENAST_CNT_U08
      boolean NtcPwrCycLtch: origin=NEXTEER, default-value=0  # 'NTC Power Cycle Latch' field for the corresponding NTC from the NTC Master List. Corresponds to NTCPPTY bit0:STSLOCKDTHISIGNCYC
      boolean LtchgEna: origin=NEXTEER, default-value=0  # Set to True if this should be a latching NTC ( in DIAGCMGRLISTOFLTCHGNTC_CNT_ENUM array) Also set corresponding threshold to the desired value for program Note: Only a maximum of 20 NTCs can have this set to true.
      integer LtchCntrThd: 0..255, origin=NEXTEER, default-value=0  # Latch Counter Threshold - only applicable when LtchgEna is true. Need to set to valid value for every single NTC that has latching enabled. DIAGCMGRNTCLTCHCNTRTHD_CNT_U08 array has the thresholds corresponding to NTCs in DIAGCMGRLISTOFLTCHGNTC_CNT_ENUM array.
      symbolic name reference NTCOsApplicationRef: destination=OsApplication  # NTC Os Application | This defines the application corresponding to a particular NTC.
    container DTCEnaCndn [0..255]  # DTC Enable Condition | Container with DTC ENABLE Criteria with the 16-bit Enable Mask Bit for DTC.
      integer DiagcMgrDTCIdx: 1..255, origin=NEXTEER  # Value represents index value DiagcMgr uses internally for NTC mapping to DTCs to the Event ID that the Dem identifies for a particular DTC
      boolean Bit_15: origin=NEXTEER  # Set to true in order to set Bit_15
      boolean Bit_14: origin=NEXTEER  # Set to true in order to set Bit_14
      boolean Bit_13: origin=NEXTEER  # Set to true in order to set Bit_13
      boolean Bit_12: origin=NEXTEER  # Set to true in order to set Bit_12
      boolean Bit_11: origin=NEXTEER  # Set to true in order to set Bit_11
      boolean Bit_10: origin=NEXTEER  # Set to true in order to set Bit_10
      boolean Bit__9: origin=NEXTEER  # Set to true in order to set Bit_9
      boolean Bit__8: origin=NEXTEER  # Set to true in order to set Bit_8
      boolean Bit__7: origin=NEXTEER  # Set to true in order to set Bit_7
      boolean Bit__6: origin=NEXTEER  # Set to true in order to set Bit_6
      boolean Bit__5: origin=NEXTEER  # Set to true in order to set Bit_5
      boolean Bit__4: origin=NEXTEER  # Set to true in order to set Bit_4
      boolean Bit__3: origin=NEXTEER  # Set to true in order to set Bit_3
      boolean Bit__2: origin=NEXTEER  # Set to true in order to set Bit_2
      boolean Bit__1: origin=NEXTEER  # Set to true in order to set Bit_1
      boolean Bit__0: origin=NEXTEER  # Set to true in order to set Bit_0
      symbolic name reference DTC [0..1]: destination=DemDTCClass  # Dem DTC Class | This defines the DEM DTC Class.
    container DiagcMgrGeneral  # Container with general DiagcMgr configuration
      enumeration DIAGCMGR_DEMCHK: {STD_ON, STD_OFF}, set at pre-compile, default-value=STD_ON  # Diagnostic Manager DEM Check
      string DEMTOTNROFDTC: set at pre-compile in variant pre-compile / link in variant link-time / post-build in variant post-build, origin=Nexteer  # Dem Total Number Of DTCs | This configuration parameter is used for a DET check. This needs to be configured to an expression that would result in the total number DTCs that are configured in the system based on generated Dem code. For example, if the Dem generated a table that was sized to be the total number of configured DTCs, this could be configured to "TblSize_m(DemDtcTable)". If the Dem generated a #define for the total number of DTCs, this could be configured to "DemTotalNumberOfDtcs". This parameter should NOT be configured to be a hard coded constant or to something not generated by the Dem.
  bsw implementation DiagcMgr_Impl: programming-language=C, used-code-generator=EXTERNAL, behavior=DiagcMgrBehavior, vendor-specific-module-def=DiagcMgr
