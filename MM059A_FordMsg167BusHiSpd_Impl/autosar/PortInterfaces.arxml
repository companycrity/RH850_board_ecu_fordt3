AUTOSAR XML (schema 4-0-3)
package /Ford/PortInterfaces
  4 x sender receiver interface:
    Ford_ElPw_D_Stat: invalidation-policy{data-element=Ford_ElPw_D_Stat, handle-invalid=DONT-INVALIDATE}
      data Ford_ElPw_D_Stat: sw-calibration-access=READ-ONLY, type=Ford_ElPw_D_Stat
    Ford_ElPw_D_StatStrtStop: invalidation-policy{data-element=Ford_ElPw_D_StatStrtStop, handle-invalid=DONT-INVALIDATE}
      data Ford_ElPw_D_StatStrtStop: sw-calibration-access=READ-ONLY, type=Ford_ElPw_D_StatStrtStop
    Ford_PrplWhlTot2_Tq_Actl: invalidation-policy{data-element=Ford_PrplWhlTot2_Tq_Actl, handle-invalid=DONT-INVALIDATE}
      data Ford_PrplWhlTot2_Tq_Actl: sw-calibration-access=READ-ONLY, type=Ford_PrplWhlTot2_Tq_Actl
    Ford_PwPckTq_D_Stat: invalidation-policy{data-element=Ford_PwPckTq_D_Stat, handle-invalid=DONT-INVALIDATE}
      data Ford_PwPckTq_D_Stat: sw-calibration-access=READ-ONLY, type=Ford_PwPckTq_D_Stat
package /Nexteer/Calibrations
  parameter interface uint16_CalPortIf1
    parameter data prototype Val: sw-calibration-access=READ-WRITE, type=uint16
package /Nexteer/PortInterfaces
  client server interface GetRefTmr100MicroSec32bit_PortIf1
    operation Oper
      arg RefTmr_Arg: type=uint32, direction=OUT, server-argument-impl-policy=USE-ARGUMENT-TYPE
  client server interface GetTiSpan100MicroSec32bit_PortIf1
    operation Oper
      arg RefTmr_Arg: type=uint32, direction=IN, server-argument-impl-policy=USE-ARGUMENT-TYPE
      arg TiSpan_Arg: type=uint32, direction=OUT, server-argument-impl-policy=USE-ARGUMENT-TYPE
  client server interface SetNtcSts_PortIf1
    operation Oper: possible-error=E_NOT_OK
      4 x arg, all with direction=IN, server-argument-impl-policy=USE-ARGUMENT-TYPE:
        NtcNr_Arg: type=NtcNr1
        NtcStInfo_Arg: type=uint8
        NtcSts_Arg: type=NtcSts1
        DebStep_Arg: type=uint16
    error E_NOT_OK: error-code=1
  4 x sender receiver interface:
    boolean_PortIf1: invalidation-policy{data-element=Logl, handle-invalid=DONT-INVALIDATE}
      data Logl: sw-calibration-access=READ-ONLY, type=boolean
    float32_PortIf1: invalidation-policy{data-element=float32_PortIf1/Val, handle-invalid=DONT-INVALIDATE}
      data Val: sw-calibration-access=READ-ONLY, type=float32
    uint16_PortIf1: invalidation-policy{data-element=uint16_PortIf1/Val, handle-invalid=DONT-INVALIDATE}
      data Val: sw-calibration-access=READ-ONLY, type=uint16
    uint8_PortIf1: invalidation-policy{data-element=uint8_PortIf1/Val, handle-invalid=DONT-INVALIDATE}
      data Val: sw-calibration-access=READ-ONLY, type=uint8
