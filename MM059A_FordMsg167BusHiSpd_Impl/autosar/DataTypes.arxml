AUTOSAR XML (schema 4-0-3)
standard types defined: boolean, float32, uint16, uint32, uint8, boolean_CompuMethod, boolean_DataConstr, float32_DataConstr, uint16_DataConstr, uint32_DataConstr, uint8_DataConstr
package /DataType/Unit
  unit U_Nm: display-name=Nm, factor-si-to-unit=1, offset-si-to-unit=0
  unit U_SED: display-name=SED, factor-si-to-unit=1, offset-si-to-unit=0
package /Ford/DataTypes
  4 x impl type, all with category=VALUE, sw-calibration-access=READ-ONLY:
    Ford_ElPw_D_Stat: base-type=DataType/uint8, compu {phys=raw for raw 0..7, 0=Cx0_Not_Supported, 1=Cx1_Supported, 2=Cx2_Not_Supported_Imminent, 3=Cx3_LV_Event_In_Progress, 4=Cx4_Fault_Limited, 5=Cx5_NotUsed_1, 6=Cx6_NotUsed_2, 7=Cx7_NotUsed_3; unit SED}, range raw 0..7
    Ford_ElPw_D_StatStrtStop:
      base-type=DataType/uint8
      compu {phys=raw for raw 0..15, 0=Cx0_Not_Supported, 1=Cx1_Supported_All, 2=Cx2_Not_Supported_Imminent, 3=Cx3_LV_Event_in_Progress, 4=Cx4_Fault_Limited, 5=Cx5_Limited_Support, 6=Cx6_Supported_Level_1, 7=Cx7_Supported_Level_2, 8=Cx8_Supported_Level_3, 9=Cx9_Supported_Level_4, 10=CxA_NotUsed1, 11=CxB_NotUsed2, 12=CxC_NotUsed3, 13=CxD_NotUsed4, 14=CxE_NotUsed5, 15=CxF_NotUsed6; unit SED}
      range raw 0..15
    Ford_PrplWhlTot2_Tq_Actl: base-type=DataType/uint16, compu {65534=CxFFFE_NoDataExists, 65535=CxFFFF_Fault, phys=raw*4-131072 for raw 0..65535; unit Nm} "Source signal range: [0,65533]"
    Ford_PwPckTq_D_Stat: base-type=DataType/uint8, compu {phys=raw for raw 0..3, 0=Cx0_PwPckOff_TqNotAvailable, 1=Cx1_PwPckOn_TqNotAvailable, 2=Cx2_StartInPrgrss_TqNotAvail, 3=Cx3_PwPckOn_TqAvailable; unit SED}, range raw 0..3
package /Nexteer/DataTypes
  impl type NtcNr1: compu {1..511=NTCNR_0X001..NTCNR_0X1FF}, implementation-data-type=uint16, type-emitter=RTE
  impl type NtcSts1: compu {0=NTCSTS_PASSD, 1=NTCSTS_FAILD, 2=NTCSTS_PREPASSD, 3=NTCSTS_PREFAILD}, implementation-data-type=uint8, type-emitter=RTE
