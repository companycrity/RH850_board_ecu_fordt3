AUTOSAR XML (schema 4-0-3)
# COPYRIGHT
# Copyright(c) 2015 - 2017 Renesas Electronics Corporation
package /Renesas/EcucDefs_Fls
  bsw implementation Fls_Impl: programming-language=C, sw-version=1.0.2, vendor-id=59, ar-release-version=4.0.3, behavior=BswInternalBehavior_0, vendor-api-infix=Renesas, vendor-specific-module-def=Fls
  bsw module description Fls: module-id=92
    bsw internal behavior BswInternalBehavior_0
      exclusive area FLS_DRIVERSTATE_DATA_PROTECTION
      exclusive area FLS_REGISTER_PROTECTION
      exclusive area FLS_CODE_FLASH_DISABLED
      bsw schedulable entity Fls_MainFunction: can-enter-exclusive-area=[FLS_DRIVERSTATE_DATA_PROTECTION, FLS_REGISTER_PROTECTION], implemented-entry=Fls_MainFunction, minimum-start-interval=0.00000085
      14 x bsw called entity:
        BswCalledEntity_0: can-enter-exclusive-area=[FLS_REGISTER_PROTECTION, FLS_CODE_FLASH_DISABLED], implemented-entry=Fls_Init
        BswCalledEntity_1: can-enter-exclusive-area=[FLS_DRIVERSTATE_DATA_PROTECTION, FLS_REGISTER_PROTECTION], implemented-entry=Fls_Erase
        BswCalledEntity_2: can-enter-exclusive-area=[FLS_DRIVERSTATE_DATA_PROTECTION, FLS_REGISTER_PROTECTION], implemented-entry=Fls_Write
        BswCalledEntity_3: can-enter-exclusive-area=FLS_DRIVERSTATE_DATA_PROTECTION, implemented-entry=Fls_Cancel
        BswCalledEntity_4: implemented-entry=Fls_GetStatus
        BswCalledEntity_5: implemented-entry=Fls_GetJobResult
        BswCalledEntity_6: can-enter-exclusive-area=FLS_DRIVERSTATE_DATA_PROTECTION, implemented-entry=Fls_Read
        BswCalledEntity_7: can-enter-exclusive-area=FLS_DRIVERSTATE_DATA_PROTECTION, implemented-entry=Fls_Compare
        BswCalledEntity_8: implemented-entry=Fls_SetMode
        BswCalledEntity_9: can-enter-exclusive-area=FLS_DRIVERSTATE_DATA_PROTECTION, implemented-entry=Fls_ReadImmediate
        BswCalledEntity_10: can-enter-exclusive-area=FLS_DRIVERSTATE_DATA_PROTECTION, implemented-entry=Fls_BlankCheck
        BswCalledEntity_11: implemented-entry=Fls_Suspend
        BswCalledEntity_12: implemented-entry=Fls_Resume
        BswCalledEntity_13: implemented-entry=Fls_GetVersionInfo
      bsw timing event Evt_Fls_MainFunction: starts-on-event=Fls_MainFunction, period=0.01
  15 x bsw module entry, all with execution-context=TASK, sw-service-impl-policy=STANDARD:
    Fls_MainFunction: is-reentrant=false, is-synchronous=false, call-type=SCHEDULED, service-id=0x6
    Fls_Init: is-reentrant=false, is-synchronous=true, call-type=REGULAR, service-id=0x0
    Fls_Erase: is-reentrant=false, is-synchronous=false, call-type=REGULAR, service-id=0x1
    Fls_Write: is-reentrant=false, is-synchronous=false, call-type=REGULAR, service-id=0x2
    Fls_Cancel: is-reentrant=false, is-synchronous=true, call-type=REGULAR, service-id=0x3
    Fls_GetStatus: is-reentrant=true, is-synchronous=true, call-type=REGULAR, service-id=0x4
    Fls_GetJobResult: is-reentrant=true, is-synchronous=true, call-type=REGULAR, service-id=0x5
    Fls_Read: is-reentrant=false, is-synchronous=false, call-type=REGULAR, service-id=0x7
    Fls_Compare: is-reentrant=false, is-synchronous=false, call-type=REGULAR, service-id=0x8
    Fls_SetMode: is-reentrant=false, is-synchronous=true, call-type=REGULAR, service-id=0x9
    Fls_ReadImmediate: is-reentrant=false, is-synchronous=false, call-type=REGULAR, service-id=0x11
    Fls_BlankCheck: is-reentrant=false, is-synchronous=false, call-type=REGULAR, service-id=0x12
    Fls_Suspend: is-reentrant=false, is-synchronous=false, call-type=REGULAR, service-id=0x13
    Fls_Resume: is-reentrant=false, is-synchronous=false, call-type=REGULAR, service-id=0x14
    Fls_GetVersionInfo: is-reentrant=true, is-synchronous=true, call-type=REGULAR, service-id=0x10
