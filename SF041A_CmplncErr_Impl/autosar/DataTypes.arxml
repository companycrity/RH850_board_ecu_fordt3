AUTOSAR XML (schema 4-0-3)
standard types defined: float32_DataConstr, float64_DataConstr, sint16_DataConstr, sint32_DataConstr, sint8_DataConstr, uint16_DataConstr, uint32_DataConstr, uint8_DataConstr, boolean, float32, float64, sint16, sint32, sint8, uint16, uint32, uint8
package /Nexteer/DataTypes
  6 x impl type, all with type-emitter=RTE:
    Ary1D_u1p15_6: category=ARRAY, sw-calibration-access=READ-ONLY
      element Element: array-size=6, array-size-semantics=FIXED-SIZE, implementation-data-type=u1p15
    Ary1D_u5p11_6: category=ARRAY, sw-calibration-access=READ-ONLY
      element Element: array-size=6, array-size-semantics=FIXED-SIZE, implementation-data-type=u5p11
    Ary1D_u8p8_6: category=ARRAY, sw-calibration-access=READ-ONLY
      element Element: array-size=6, array-size-semantics=FIXED-SIZE, implementation-data-type=u8p8
    u1p15: implementation-data-type=uint16
    u5p11: implementation-data-type=uint16
    u8p8: implementation-data-type=uint16
