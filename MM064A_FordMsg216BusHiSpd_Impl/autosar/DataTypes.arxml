AUTOSAR XML (schema 4-0-3)
standard types defined: boolean, uint16, uint32, uint8, boolean_CompuMethod, boolean_DataConstr, uint16_DataConstr, uint32_DataConstr, uint8_DataConstr
package /DataType/Unit
  unit U_SED: display-name=SED, factor-si-to-unit=1, offset-si-to-unit=0
  unit Unitless: display-name=Unitless, factor-si-to-unit=1, offset-si-to-unit=0
package /Ford/DataTypes
  8 x impl type, all with category=VALUE, base-type=DataType/uint8, sw-calibration-access=READ-ONLY:
    Ford_WhlDirFl_D_Actl: compu {phys=raw for raw 0..3, 0=Cx0_Forward, 1=Cx1_Backward, 2=Cx2_Unknown, 3=Cx3_Failed; unit SED}, range raw 0..3
    Ford_WhlDirFr_D_Actl: compu {phys=raw for raw 0..3, 0=Cx0_Forward, 1=Cx1_Backward, 2=Cx2_Unknown, 3=Cx3_Failed; unit SED}, range raw 0..3
    Ford_WhlDirRl_D_Actl: compu {phys=raw for raw 0..3, 0=Cx0_Forward, 1=Cx1_Backward, 2=Cx2_Unknown, 3=Cx3_Failed; unit SED}, range raw 0..3
    Ford_WhlDirRr_D_Actl: compu {phys=raw for raw 0..3, 0=Cx0_Forward, 1=Cx1_Backward, 2=Cx2_Unknown, 3=Cx3_Failed; unit SED}, range raw 0..3
    Ford_WhlRotatFl_No_Cnt: compu {phys=raw for raw 0..255; unit Unitless}
    Ford_WhlRotatFr_No_Cnt: compu {phys=raw for raw 0..255; unit Unitless}
    Ford_WhlRotatRl_No_Cnt: compu {phys=raw for raw 0..255; unit Unitless}
    Ford_WhlRotatRr_No_Cnt: compu {phys=raw for raw 0..255; unit Unitless}
package /Nexteer/DataTypes
  impl type FordVehWhlDirRaw1: compu {0=FORDVEHWHLDIRRAW_FWD, 1=FORDVEHWHLDIRRAW_BACKW, 2=FORDVEHWHLDIRRAW_UKWN, 3=FORDVEHWHLDIRRAW_FAILD}, implementation-data-type=uint8, type-emitter=RTE
  impl type NtcNr1: compu {1..511=NTCNR_0X001..NTCNR_0X1FF}, implementation-data-type=uint16, type-emitter=RTE
  impl type NtcSts1: compu {0=NTCSTS_PASSD, 1=NTCSTS_FAILD, 2=NTCSTS_PREPASSD, 3=NTCSTS_PREFAILD}, implementation-data-type=uint8, type-emitter=RTE
