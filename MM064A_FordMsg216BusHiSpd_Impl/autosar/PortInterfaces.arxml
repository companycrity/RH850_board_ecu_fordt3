AUTOSAR XML (schema 4-0-3)
package /Ford/PortInterfaces
  8 x sender receiver interface:
    Ford_WhlDirFl_D_Actl: invalidation-policy{data-element=Ford_WhlDirFl_D_Actl, handle-invalid=DONT-INVALIDATE}
      data Ford_WhlDirFl_D_Actl: sw-calibration-access=READ-ONLY, type=Ford_WhlDirFl_D_Actl
    Ford_WhlDirFr_D_Actl: invalidation-policy{data-element=Ford_WhlDirFr_D_Actl, handle-invalid=DONT-INVALIDATE}
      data Ford_WhlDirFr_D_Actl: sw-calibration-access=READ-ONLY, type=Ford_WhlDirFr_D_Actl
    Ford_WhlDirRl_D_Actl: invalidation-policy{data-element=Ford_WhlDirRl_D_Actl, handle-invalid=DONT-INVALIDATE}
      data Ford_WhlDirRl_D_Actl: sw-calibration-access=READ-ONLY, type=Ford_WhlDirRl_D_Actl
    Ford_WhlDirRr_D_Actl: invalidation-policy{data-element=Ford_WhlDirRr_D_Actl, handle-invalid=DONT-INVALIDATE}
      data Ford_WhlDirRr_D_Actl: sw-calibration-access=READ-ONLY, type=Ford_WhlDirRr_D_Actl
    Ford_WhlRotatFl_No_Cnt: invalidation-policy{data-element=Ford_WhlRotatFl_No_Cnt, handle-invalid=DONT-INVALIDATE}
      data Ford_WhlRotatFl_No_Cnt: sw-calibration-access=READ-ONLY, type=Ford_WhlRotatFl_No_Cnt
    Ford_WhlRotatFr_No_Cnt: invalidation-policy{data-element=Ford_WhlRotatFr_No_Cnt, handle-invalid=DONT-INVALIDATE}
      data Ford_WhlRotatFr_No_Cnt: sw-calibration-access=READ-ONLY, type=Ford_WhlRotatFr_No_Cnt
    Ford_WhlRotatRl_No_Cnt: invalidation-policy{data-element=Ford_WhlRotatRl_No_Cnt, handle-invalid=DONT-INVALIDATE}
      data Ford_WhlRotatRl_No_Cnt: sw-calibration-access=READ-ONLY, type=Ford_WhlRotatRl_No_Cnt
    Ford_WhlRotatRr_No_Cnt: invalidation-policy{data-element=Ford_WhlRotatRr_No_Cnt, handle-invalid=DONT-INVALIDATE}
      data Ford_WhlRotatRr_No_Cnt: sw-calibration-access=READ-ONLY, type=Ford_WhlRotatRr_No_Cnt
package /Nexteer/Calibrations
  parameter interface uint16_CalPortIf1
    parameter data prototype Val: sw-calibration-access=READ-WRITE, type=uint16
package /Nexteer/PortInterfaces
  client server interface GetRefTmr100MicroSec32bit_PortIf1
    operation Oper
      arg RefTmr_Arg: type=uint32, direction=OUT, server-argument-impl-policy=USE-ARGUMENT-TYPE
  client server interface GetTiSpan100MicroSec32bit_PortIf1
    operation Oper
      arg RefTmr_Arg: type=uint32, direction=IN, server-argument-impl-policy=USE-ARGUMENT-TYPE
      arg TiSpan_Arg: type=uint32, direction=OUT, server-argument-impl-policy=USE-ARGUMENT-TYPE
  client server interface SetNtcSts_PortIf1
    operation Oper: possible-error=E_NOT_OK
      4 x arg, all with direction=IN, server-argument-impl-policy=USE-ARGUMENT-TYPE:
        NtcNr_Arg: type=NtcNr1
        NtcStInfo_Arg: type=uint8
        NtcSts_Arg: type=NtcSts1
        DebStep_Arg: type=uint16
    error E_NOT_OK: error-code=1
  sender receiver interface boolean_PortIf1: invalidation-policy{data-element=Logl, handle-invalid=DONT-INVALIDATE}
    data Logl: sw-calibration-access=READ-ONLY, type=boolean
  sender receiver interface FordVehWhlDirRaw1_PortIf1: invalidation-policy{data-element=FordVehWhlDirRaw1_PortIf1/Val, handle-invalid=DONT-INVALIDATE}
    data Val: type=FordVehWhlDirRaw1
  sender receiver interface uint8_PortIf1: invalidation-policy{data-element=uint8_PortIf1/Val, handle-invalid=DONT-INVALIDATE}
    data Val: sw-calibration-access=READ-ONLY, type=uint8
