AUTOSAR XML (schema 4-0-3)
standard types defined: float32_DataConstr, float64_DataConstr, sint16_DataConstr, sint32_DataConstr, sint8_DataConstr, uint16_DataConstr, uint32_DataConstr, uint8_DataConstr, boolean, float32, float64, sint16, sint32, sint8, uint16, uint32, uint8
package /Nexteer/DataTypes
  18 x impl type:
    Ary1D_u1p15_5: category=ARRAY, sw-calibration-access=READ-ONLY, type-emitter=RTE
      element Element: array-size=5, array-size-semantics=FIXED-SIZE, implementation-data-type=u1p15
    Ary1D_u3p13_13: category=ARRAY, sw-calibration-access=READ-ONLY, type-emitter=RTE
      element Element: array-size=13, array-size-semantics=FIXED-SIZE, implementation-data-type=u3p13
    Ary1D_u4p12_5: category=ARRAY, sw-calibration-access=READ-ONLY, type-emitter=RTE
      element Element: array-size=5, array-size-semantics=FIXED-SIZE, implementation-data-type=u4p12
    Ary1D_u5p11_13: category=ARRAY, sw-calibration-access=READ-ONLY, type-emitter=RTE
      element Element: array-size=13, array-size-semantics=FIXED-SIZE, implementation-data-type=u5p11
    Ary1D_u7p9_12: category=ARRAY, sw-calibration-access=READ-ONLY, type-emitter=RTE
      element Element: array-size=12, array-size-semantics=FIXED-SIZE, implementation-data-type=u7p9
    Ary1D_u9p7_12: category=ARRAY, sw-calibration-access=READ-ONLY, type-emitter=RTE
      element Element: array-size=12, array-size-semantics=FIXED-SIZE, implementation-data-type=u9p7
    Ary2D_u1p15_12_5: category=ARRAY, sw-calibration-access=READ-ONLY, type-emitter=RTE
      element Element: array-size=12, array-size-semantics=FIXED-SIZE, implementation-data-type=Ary1D_u1p15_5
    Ary2D_u3p13_12_13: category=ARRAY, sw-calibration-access=READ-ONLY, type-emitter=RTE
      element Element: array-size=12, array-size-semantics=FIXED-SIZE, implementation-data-type=Ary1D_u3p13_13
    Ary2D_u4p12_12_5: category=ARRAY, sw-calibration-access=READ-ONLY, type-emitter=RTE
      element Element: array-size=12, array-size-semantics=FIXED-SIZE, implementation-data-type=Ary1D_u4p12_5
    Ary2D_u5p11_12_13: category=ARRAY, sw-calibration-access=READ-ONLY, type-emitter=RTE
      element Element: array-size=12, array-size-semantics=FIXED-SIZE, implementation-data-type=Ary1D_u5p11_13
    FilHpRec1: category=STRUCTURE, sw-calibration-access=READ-ONLY, type-emitter=NxtrFil
      element FilLpRec: implementation-data-type=FilLpRec1
      element CorrnFac: implementation-data-type=float32
    FilLpRec1: category=STRUCTURE, sw-calibration-access=READ-ONLY, type-emitter=NxtrFil
      element FilSt: implementation-data-type=float32
      element FilGain: implementation-data-type=float32
      symbol props FilLpRec1
    u1p15: implementation-data-type=uint16, type-emitter=RTE
    u3p13: implementation-data-type=uint16, type-emitter=RTE
    u4p12: implementation-data-type=uint16, type-emitter=RTE
    u5p11: implementation-data-type=uint16, type-emitter=RTE
    u7p9: implementation-data-type=uint16, type-emitter=RTE
    u9p7: implementation-data-type=uint16, type-emitter=RTE
