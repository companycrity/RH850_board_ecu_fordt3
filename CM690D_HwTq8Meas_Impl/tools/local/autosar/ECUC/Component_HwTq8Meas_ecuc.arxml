AUTOSAR XML (schema 4-0-3)
package /ActiveEcuC
  module config HwTq8Meas: implementation-config-variant=VARIANT-PRE-COMPILE
    HwTq8MeasGeneral: HwTq8MfgFltNtcNr=NTCNR_0X1E0, HwTq8PrtclFltNtcNr=NTCNR_0X073
