AUTOSAR XML (schema 4-0-3)
package /Nexteer/Calibrations
  parameter interface Ary1D_u13p3_8_CalPortIf1
    parameter data prototype Ary1D: sw-calibration-access=READ-WRITE, type=Ary1D_u13p3_8
  parameter interface Ary1D_u16_8_CalPortIf1
    parameter data prototype Ary1D: sw-calibration-access=READ-WRITE, type=Ary1D_u16_8
  parameter interface float32_CalPortIf1
    parameter data prototype Val: sw-calibration-access=READ-WRITE, type=float32
package /Nexteer/PortInterfaces
  client server interface GetSigImcData_f32_PortIf1
    operation Oper: possible-error=GetSigImcData_f32_PortIf1/E_NOT_OK
      arg SigId_Arg: type=uint16, direction=IN, server-argument-impl-policy=USE-ARGUMENT-TYPE
      arg Data_Arg: type=float32, direction=OUT, server-argument-impl-policy=USE-ARGUMENT-TYPE
      arg Sts_Arg: type=ImcArbnRxSts1, direction=OUT, server-argument-impl-policy=USE-ARGUMENT-TYPE
    error E_NOT_OK: error-code=1
  client server interface GetSigImcData_logl_PortIf1
    operation Oper: possible-error=GetSigImcData_logl_PortIf1/E_NOT_OK
      arg SigId_Arg: type=uint16, direction=IN, server-argument-impl-policy=USE-ARGUMENT-TYPE
      arg Data_Arg: type=boolean, direction=OUT, server-argument-impl-policy=USE-ARGUMENT-TYPE
      arg Sts_Arg: type=ImcArbnRxSts1, direction=OUT, server-argument-impl-policy=USE-ARGUMENT-TYPE
    error E_NOT_OK: error-code=1
  4 x sender receiver interface:
    boolean_PortIf1: invalidation-policy{data-element=Logl, handle-invalid=DONT-INVALIDATE}
      data Logl: sw-calibration-access=READ-ONLY, type=boolean
    float32_PortIf1: invalidation-policy{data-element=float32_PortIf1/Val, handle-invalid=DONT-INVALIDATE}
      data Val: sw-calibration-access=READ-ONLY, type=float32
    FordArbnCmd1_PortIf1: invalidation-policy{data-element=FordArbnCmd1_PortIf1/Val, handle-invalid=DONT-INVALIDATE}
      data Val: type=FordArbnCmd1
    uint8_PortIf1: invalidation-policy{data-element=uint8_PortIf1/Val, handle-invalid=DONT-INVALIDATE}
      data Val: sw-calibration-access=READ-ONLY, type=uint8
