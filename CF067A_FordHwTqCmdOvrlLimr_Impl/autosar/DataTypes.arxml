AUTOSAR XML (schema 4-0-3)
standard types defined: boolean, float32, uint16, uint8, boolean_CompuMethod, boolean_DataConstr, float32_DataConstr, uint16_DataConstr, uint8_DataConstr
package /Nexteer/DataTypes
  5 x impl type, all with type-emitter=RTE:
    Ary1D_u13p3_8: category=ARRAY, sw-calibration-access=READ-ONLY
      element Element: array-size=8, array-size-semantics=FIXED-SIZE, implementation-data-type=u13p3
    Ary1D_u16_8: category=ARRAY, sw-calibration-access=READ-ONLY
      element Element: array-size=8, array-size-semantics=FIXED-SIZE, implementation-data-type=uint16
    FordArbnCmd1: compu {0=Cx0_PASSIVE, 3=Cx3_ACTIVE, 5=Cx5_LOCKED, 99=Cx99_DONT_CARE}, implementation-data-type=uint8
    ImcArbnRxSts1: compu {0=IMCARBNRXSTS_NODATA, 1=IMCARBNRXSTS_VLD, phys=raw for raw 2}, implementation-data-type=uint8
    u13p3: implementation-data-type=uint16
