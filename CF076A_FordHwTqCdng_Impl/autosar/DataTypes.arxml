AUTOSAR XML (schema 4-0-3)
standard types defined: boolean, dtRef_const_VOID, dtRef_VOID, float32, float64, sint16, sint16_least, sint32, sint32_least, sint64, sint8, sint8_least, uint16, uint16_least, uint32, uint32_least, uint64, uint8, uint8_least, boolean_CompuMethod, boolean_DataConstr, float32_DataConstr, float64_DataConstr, sint16_DataConstr, sint16_least_DataConstr, sint32_DataConstr, sint32_least_DataConstr, sint64_DataConstr, sint8_DataConstr, sint8_least_DataConstr, uint16_DataConstr, uint16_least_DataConstr, uint32_DataConstr, uint32_least_DataConstr, uint64_DataConstr, uint8_DataConstr, uint8_least_DataConstr
package /Nexteer/DataTypes
  468 x impl type:
    AdrMpgReqTyp1: compu {phys=raw for raw 0, phys=raw for raw 1}, implementation-data-type=ImplementationDataTypes/uint8, type-emitter=RTE
    AnHwTqScaFacRec1: category=STRUCTURE, sw-calibration-access=READ-ONLY, type-emitter=RTE
      element SnsrSca: implementation-data-type=float32
      element SnsrScaPrfmdSts: implementation-data-type=boolean
    Ary1D_CrcHwStsRec1_4: category=ARRAY, sw-calibration-access=READ-ONLY, type-emitter=RTE
      element Element: array-size=4, array-size-semantics=FIXED-SIZE, implementation-data-type=CrcHwStsRec1
    Ary1D_CrcHwStsRec1_8: category=ARRAY, sw-calibration-access=READ-ONLY, type-emitter=RTE  # OBSOLETE
      element Element: array-size=8, array-size-semantics=FIXED-SIZE, implementation-data-type=CrcHwStsRec1
    Ary1D_CrcHwStsRec2_8: category=ARRAY, sw-calibration-access=READ-ONLY, type-emitter=RTE
      element Element: array-size=8, array-size-semantics=FIXED-SIZE, implementation-data-type=CrcHwStsRec2
    Ary1D_f32_12: category=ARRAY, sw-calibration-access=READ-ONLY, type-emitter=RTE
      element Element: array-size=12, array-size-semantics=FIXED-SIZE, implementation-data-type=float32
    Ary1D_f32_2: category=ARRAY, sw-calibration-access=READ-ONLY, type-emitter=RTE
      element Element: array-size=2, array-size-semantics=FIXED-SIZE, implementation-data-type=float32
    Ary1D_f32_26: category=ARRAY, sw-calibration-access=READ-ONLY, type-emitter=RTE
      element Element: array-size=26, array-size-semantics=FIXED-SIZE, implementation-data-type=float32
    Ary1D_f32_3: category=ARRAY, sw-calibration-access=READ-ONLY, type-emitter=RTE
      element Element: array-size=3, array-size-semantics=FIXED-SIZE, implementation-data-type=float32
    Ary1D_f32_30: category=ARRAY, sw-calibration-access=READ-ONLY, type-emitter=RTE
      element Element: array-size=30, array-size-semantics=FIXED-SIZE, implementation-data-type=float32
    Ary1D_f32_4: category=ARRAY, sw-calibration-access=READ-ONLY, type-emitter=RTE
      element Element: array-size=4, array-size-semantics=FIXED-SIZE, implementation-data-type=float32
    Ary1D_f32_5: category=ARRAY, sw-calibration-access=READ-ONLY, type-emitter=RTE
      element Element: array-size=5, array-size-semantics=FIXED-SIZE, implementation-data-type=float32
    Ary1D_f32_72: category=ARRAY, sw-calibration-access=READ-ONLY, type-emitter=RTE
      element Element: array-size=72, array-size-semantics=FIXED-SIZE, implementation-data-type=float32
    Ary1D_f32_8: category=ARRAY, sw-calibration-access=READ-ONLY, type-emitter=RTE
      element Element: array-size=8, array-size-semantics=FIXED-SIZE, implementation-data-type=float32
    Ary1D_f32_StHlthSigStc1: category=ARRAY, sw-calibration-access=READ-ONLY, type-emitter=StHlthSigStc
      element Element: array-size=65535, array-size-semantics=VARIABLE-SIZE, implementation-data-type=float32
    Ary1D_GmSteerAgCtrlDiSt1_7: category=ARRAY, sw-calibration-access=READ-ONLY, type-emitter=RTE
      element Element: array-size=7, array-size-semantics=FIXED-SIZE, compu-method=GmSteerAgCtrlDiSt1, implementation-data-type=GmSteerAgCtrlDiSt1
    Ary1D_logl_2: category=ARRAY, sw-calibration-access=READ-ONLY, type-emitter=RTE
      element Element: array-size=2, array-size-semantics=FIXED-SIZE, implementation-data-type=boolean
    Ary1D_logl_3: category=ARRAY, sw-calibration-access=READ-ONLY, type-emitter=RTE
      element Element: array-size=3, array-size-semantics=FIXED-SIZE, implementation-data-type=boolean
    Ary1D_logl_4_01: category=ARRAY, sw-calibration-access=READ-ONLY, type-emitter=RTE
      element Element: array-size=4, array-size-semantics=FIXED-SIZE, implementation-data-type=boolean
    Ary1D_NtcFltInfoRec2_20: category=ARRAY, sw-calibration-access=READ-ONLY, type-emitter=RTE
      element Element: array-size=20, array-size-semantics=FIXED-SIZE, implementation-data-type=NtcFltInfoRec2
    Ary1D_ReadFltInfoRec1_20: category=ARRAY, sw-calibration-access=READ-ONLY, type-emitter=RTE
      element Element: array-size=20, array-size-semantics=FIXED-SIZE, implementation-data-type=ReadFltInfoRec1
    Ary1D_s10p5_8: category=ARRAY, sw-calibration-access=READ-ONLY, type-emitter=RTE
      element Element: array-size=8, array-size-semantics=FIXED-SIZE, implementation-data-type=s10p5
    Ary1D_s11p4_11: category=ARRAY, sw-calibration-access=READ-ONLY, type-emitter=RTE
      element Element: array-size=11, array-size-semantics=FIXED-SIZE, implementation-data-type=s11p4
    Ary1D_s11p4_14: category=ARRAY, sw-calibration-access=READ-ONLY, type-emitter=RTE
      element Element: array-size=14, array-size-semantics=FIXED-SIZE, implementation-data-type=s11p4
    Ary1D_s11p4_5: category=ARRAY, sw-calibration-access=READ-ONLY, type-emitter=RTE
      element Element: array-size=5, array-size-semantics=FIXED-SIZE, implementation-data-type=s11p4
    Ary1D_s14p1_8: category=ARRAY, sw-calibration-access=READ-ONLY, type-emitter=RTE
      element Element: array-size=8, array-size-semantics=FIXED-SIZE, implementation-data-type=s14p1
    Ary1D_s15p0_21: category=ARRAY, sw-calibration-access=READ-ONLY, type-emitter=RTE
      element Element: array-size=21, array-size-semantics=FIXED-SIZE, implementation-data-type=s15p0
    Ary1D_s15p0_4: category=ARRAY, sw-calibration-access=READ-ONLY, type-emitter=RTE
      element Element: array-size=4, array-size-semantics=FIXED-SIZE, implementation-data-type=s15p0
    Ary1D_s16_22: category=ARRAY, sw-calibration-access=READ-ONLY, type-emitter=RTE
      element Element: array-size=22, array-size-semantics=FIXED-SIZE, implementation-data-type=sint16
    Ary1D_s1p14_12: category=ARRAY, sw-calibration-access=READ-ONLY, type-emitter=RTE
      element Element: array-size=12, array-size-semantics=FIXED-SIZE, implementation-data-type=s1p14
    Ary1D_s1p14_128: category=ARRAY, sw-calibration-access=READ-ONLY, type-emitter=RTE
      element Element: array-size=128, array-size-semantics=FIXED-SIZE, implementation-data-type=s1p14
    Ary1D_s1p14_512: category=ARRAY, sw-calibration-access=READ-ONLY, type-emitter=RTE
      element Element: array-size=512, array-size-semantics=FIXED-SIZE, implementation-data-type=s1p14
    Ary1D_s2p13_1024: category=ARRAY, sw-calibration-access=READ-ONLY, type-emitter=RTE
      element Element: array-size=1024, array-size-semantics=FIXED-SIZE, implementation-data-type=s2p13
    Ary1D_s2p13_1025: category=ARRAY, sw-calibration-access=READ-ONLY, type-emitter=RTE
      element Element: array-size=1025, array-size-semantics=FIXED-SIZE, implementation-data-type=s2p13
    Ary1D_s2p13_21: category=ARRAY, sw-calibration-access=READ-ONLY, type-emitter=RTE
      element Element: array-size=21, array-size-semantics=FIXED-SIZE, implementation-data-type=s2p13
    Ary1D_s4p11_11: category=ARRAY, sw-calibration-access=READ-ONLY, type-emitter=RTE
      element Element: array-size=11, array-size-semantics=FIXED-SIZE, implementation-data-type=s4p11
    Ary1D_s4p11_12: category=ARRAY, sw-calibration-access=READ-ONLY, type-emitter=RTE
      element Element: array-size=12, array-size-semantics=FIXED-SIZE, implementation-data-type=s4p11
    Ary1D_s4p11_13: category=ARRAY, sw-calibration-access=READ-ONLY, type-emitter=RTE
      element Element: array-size=13, array-size-semantics=FIXED-SIZE, implementation-data-type=s4p11
    Ary1D_s4p11_20: category=ARRAY, sw-calibration-access=READ-ONLY, type-emitter=RTE
      element Element: array-size=20, array-size-semantics=FIXED-SIZE, implementation-data-type=s4p11
    Ary1D_s4p11_4: category=ARRAY, sw-calibration-access=READ-ONLY, type-emitter=RTE
      element Element: array-size=4, array-size-semantics=FIXED-SIZE, implementation-data-type=s4p11
    Ary1D_s4p11_5: category=ARRAY, sw-calibration-access=READ-ONLY, type-emitter=RTE
      element Element: array-size=5, array-size-semantics=FIXED-SIZE, implementation-data-type=s4p11
    Ary1D_s4p11_8: category=ARRAY, sw-calibration-access=READ-ONLY, type-emitter=RTE
      element Element: array-size=8, array-size-semantics=FIXED-SIZE, implementation-data-type=s4p11
    Ary1D_s7p8_11: category=ARRAY, sw-calibration-access=READ-ONLY, type-emitter=RTE
      element Element: array-size=11, array-size-semantics=FIXED-SIZE, implementation-data-type=s7p8
    Ary1D_s7p8_12: category=ARRAY, sw-calibration-access=READ-ONLY, type-emitter=RTE
      element Element: array-size=12, array-size-semantics=FIXED-SIZE, implementation-data-type=s7p8
    Ary1D_s7p8_20: category=ARRAY, sw-calibration-access=READ-ONLY, type-emitter=RTE
      element Element: array-size=20, array-size-semantics=FIXED-SIZE, implementation-data-type=s7p8
    Ary1D_s7p8_5: category=ARRAY, sw-calibration-access=READ-ONLY, type-emitter=RTE
      element Element: array-size=5, array-size-semantics=FIXED-SIZE, implementation-data-type=s7p8
    Ary1D_s7p8_6: category=ARRAY, sw-calibration-access=READ-ONLY, type-emitter=RTE
      element Element: array-size=6, array-size-semantics=FIXED-SIZE, implementation-data-type=s7p8
    Ary1D_s8p7_12: category=ARRAY, sw-calibration-access=READ-ONLY, type-emitter=RTE
      element Element: array-size=12, array-size-semantics=FIXED-SIZE, implementation-data-type=s8p7
    Ary1D_s8p7_14: category=ARRAY, sw-calibration-access=READ-ONLY, type-emitter=RTE
      element Element: array-size=14, array-size-semantics=FIXED-SIZE, implementation-data-type=s8p7
    Ary1D_s8p7_21: category=ARRAY, sw-calibration-access=READ-ONLY, type-emitter=RTE
      element Element: array-size=21, array-size-semantics=FIXED-SIZE, implementation-data-type=s8p7
    Ary1D_s8p7_3: category=ARRAY, sw-calibration-access=READ-ONLY, type-emitter=RTE
      element Element: array-size=3, array-size-semantics=FIXED-SIZE, implementation-data-type=s8p7
    Ary1D_sm5p12_128: category=ARRAY, sw-calibration-access=READ-ONLY, type-emitter=RTE
      element Element: array-size=128, array-size-semantics=FIXED-SIZE, implementation-data-type=sm5p12
    Ary1D_sm6p13_144: category=ARRAY, sw-calibration-access=READ-ONLY, type-emitter=RTE
      element Element: array-size=144, array-size-semantics=FIXED-SIZE, implementation-data-type=sm6p13
    Ary1D_SnpshtDataRec2_8: category=ARRAY, sw-calibration-access=READ-ONLY, type-emitter=RTE
      element Element: array-size=8, array-size-semantics=FIXED-SIZE, implementation-data-type=SnpshtDataRec2
    Ary1D_u08_12: category=ARRAY, sw-calibration-access=READ-ONLY, type-emitter=RTE
      element Element: array-size=12, array-size-semantics=FIXED-SIZE, implementation-data-type=ImplementationDataTypes/uint8
    Ary1D_u08_17: category=ARRAY, sw-calibration-access=READ-ONLY, type-emitter=RTE
      element Element: array-size=17, array-size-semantics=FIXED-SIZE, implementation-data-type=ImplementationDataTypes/uint8
    Ary1D_u08_2: category=ARRAY, sw-calibration-access=READ-ONLY, type-emitter=RTE
      element Element: array-size=2, array-size-semantics=FIXED-SIZE, implementation-data-type=ImplementationDataTypes/uint8
    Ary1D_u08_20: category=ARRAY, sw-calibration-access=READ-ONLY, type-emitter=RTE
      element Element: array-size=20, array-size-semantics=FIXED-SIZE, implementation-data-type=ImplementationDataTypes/uint8
    Ary1D_u08_22: category=ARRAY, sw-calibration-access=READ-ONLY, type-emitter=RTE
      element Element: array-size=22, array-size-semantics=FIXED-SIZE, implementation-data-type=ImplementationDataTypes/uint8
    Ary1D_u08_225: category=ARRAY, sw-calibration-access=READ-ONLY, type-emitter=RTE
      element Element: array-size=225, array-size-semantics=FIXED-SIZE, implementation-data-type=ImplementationDataTypes/uint8
    Ary1D_u08_255: category=ARRAY, sw-calibration-access=READ-ONLY, type-emitter=StHlthSigStc
      element Element: array-size=255, array-size-semantics=FIXED-SIZE, implementation-data-type=ImplementationDataTypes/uint8
    Ary1D_u08_3: category=ARRAY, sw-calibration-access=READ-ONLY, type-emitter=RTE
      element Element: array-size=3, array-size-semantics=FIXED-SIZE, implementation-data-type=ImplementationDataTypes/uint8
    Ary1D_u08_5: category=ARRAY, sw-calibration-access=READ-ONLY, type-emitter=RTE
      element Element: array-size=5, array-size-semantics=FIXED-SIZE, implementation-data-type=ImplementationDataTypes/uint8
    Ary1D_u08_6: category=ARRAY, sw-calibration-access=READ-ONLY, type-emitter=RTE
      element Element: array-size=6, array-size-semantics=FIXED-SIZE, implementation-data-type=ImplementationDataTypes/uint8
    Ary1D_u08_8: category=ARRAY, sw-calibration-access=READ-ONLY, type-emitter=RTE
      element Element: array-size=8, array-size-semantics=FIXED-SIZE, implementation-data-type=ImplementationDataTypes/uint8
    Ary1D_u08_CmnMfgSrvIf: category=ARRAY, type-emitter=CmnMfgSrvIf
      element Element: array-size=65535, array-size-semantics=VARIABLE-SIZE, implementation-data-type=PlatformTypes/uint8
    Ary1D_u08_StHlthSigStc1: category=ARRAY, type-emitter=StHlthSigStc
      element Element: array-size=65535, array-size-semantics=VARIABLE-SIZE, implementation-data-type=ImplementationDataTypes/uint8
    Ary1D_u0p16_10: category=ARRAY, sw-calibration-access=READ-ONLY, type-emitter=RTE
      element Element: array-size=10, array-size-semantics=FIXED-SIZE, implementation-data-type=u0p16
    Ary1D_u0p16_2: category=ARRAY, sw-calibration-access=READ-ONLY, type-emitter=RTE
      element Element: array-size=2, array-size-semantics=FIXED-SIZE, implementation-data-type=u0p16
    Ary1D_u0p16_3: category=ARRAY, sw-calibration-access=READ-ONLY, type-emitter=RTE
      element Element: array-size=3, array-size-semantics=FIXED-SIZE, implementation-data-type=u0p16
    Ary1D_u0p16_8: category=ARRAY, sw-calibration-access=READ-ONLY, type-emitter=RTE
      element Element: array-size=8, array-size-semantics=FIXED-SIZE, implementation-data-type=u0p16
    Ary1D_u10p6_10: category=ARRAY, sw-calibration-access=READ-ONLY, type-emitter=RTE
      element Element: array-size=10, array-size-semantics=FIXED-SIZE, implementation-data-type=u10p6
    Ary1D_u10p6_12: category=ARRAY, sw-calibration-access=READ-ONLY, type-emitter=RTE
      element Element: array-size=12, array-size-semantics=FIXED-SIZE, implementation-data-type=u10p6
    Ary1D_u10p6_13: category=ARRAY, sw-calibration-access=READ-ONLY, type-emitter=RTE
      element Element: array-size=13, array-size-semantics=FIXED-SIZE, implementation-data-type=u10p6
    Ary1D_u10p6_2: category=ARRAY, sw-calibration-access=READ-ONLY, type-emitter=RTE
      element Element: array-size=2, array-size-semantics=FIXED-SIZE, implementation-data-type=u10p6
    Ary1D_u10p6_3: category=ARRAY, sw-calibration-access=READ-ONLY, type-emitter=RTE
      element Element: array-size=3, array-size-semantics=FIXED-SIZE, implementation-data-type=u10p6
    Ary1D_u10p6_4: category=ARRAY, sw-calibration-access=READ-ONLY, type-emitter=RTE
      element Element: array-size=4, array-size-semantics=FIXED-SIZE, implementation-data-type=u10p6
    Ary1D_u10p6_5: category=ARRAY, sw-calibration-access=READ-ONLY, type-emitter=RTE
      element Element: array-size=5, array-size-semantics=FIXED-SIZE, implementation-data-type=u10p6
    Ary1D_u10p6_7: category=ARRAY, sw-calibration-access=READ-ONLY, type-emitter=RTE
      element Element: array-size=7, array-size-semantics=FIXED-SIZE, implementation-data-type=u10p6
    Ary1D_u10p6_8: category=ARRAY, sw-calibration-access=READ-ONLY, type-emitter=RTE
      element Element: array-size=8, array-size-semantics=FIXED-SIZE, implementation-data-type=u10p6
    Ary1D_u10p6_9: category=ARRAY, sw-calibration-access=READ-ONLY, type-emitter=RTE
      element Element: array-size=9, array-size-semantics=FIXED-SIZE, implementation-data-type=u10p6
    Ary1D_u11p5_10: category=ARRAY, sw-calibration-access=READ-ONLY, type-emitter=RTE
      element Element: array-size=10, array-size-semantics=FIXED-SIZE, implementation-data-type=u11p5
    Ary1D_u11p5_11: category=ARRAY, sw-calibration-access=READ-ONLY, type-emitter=RTE
      element Element: array-size=11, array-size-semantics=FIXED-SIZE, implementation-data-type=u11p5
    Ary1D_u11p5_12: category=ARRAY, sw-calibration-access=READ-ONLY, type-emitter=RTE
      element Element: array-size=12, array-size-semantics=FIXED-SIZE, implementation-data-type=u11p5
    Ary1D_u11p5_13: category=ARRAY, sw-calibration-access=READ-ONLY, type-emitter=RTE
      element Element: array-size=13, array-size-semantics=FIXED-SIZE, implementation-data-type=u11p5
    Ary1D_u11p5_4: category=ARRAY, sw-calibration-access=READ-ONLY, type-emitter=RTE
      element Element: array-size=4, array-size-semantics=FIXED-SIZE, implementation-data-type=u11p5
    Ary1D_u11p5_5: category=ARRAY, sw-calibration-access=READ-ONLY, type-emitter=RTE
      element Element: array-size=5, array-size-semantics=FIXED-SIZE, implementation-data-type=u11p5
    Ary1D_u11p5_6: category=ARRAY, sw-calibration-access=READ-ONLY, type-emitter=RTE
      element Element: array-size=6, array-size-semantics=FIXED-SIZE, implementation-data-type=u11p5
    Ary1D_u11p5_7: category=ARRAY, sw-calibration-access=READ-ONLY, type-emitter=RTE
      element Element: array-size=7, array-size-semantics=FIXED-SIZE, implementation-data-type=u11p5
    Ary1D_u11p5_8: category=ARRAY, sw-calibration-access=READ-ONLY, type-emitter=RTE
      element Element: array-size=8, array-size-semantics=FIXED-SIZE, implementation-data-type=u11p5
    Ary1D_u11p5_9: category=ARRAY, sw-calibration-access=READ-ONLY, type-emitter=RTE
      element Element: array-size=9, array-size-semantics=FIXED-SIZE, implementation-data-type=u11p5
    Ary1D_u12p4_12: category=ARRAY, sw-calibration-access=READ-ONLY, type-emitter=RTE
      element Element: array-size=12, array-size-semantics=FIXED-SIZE, implementation-data-type=u12p4
    Ary1D_u12p4_13: category=ARRAY, sw-calibration-access=READ-ONLY, type-emitter=RTE
      element Element: array-size=13, array-size-semantics=FIXED-SIZE, implementation-data-type=u12p4
    Ary1D_u12p4_16: category=ARRAY, sw-calibration-access=READ-ONLY, type-emitter=RTE
      element Element: array-size=16, array-size-semantics=FIXED-SIZE, implementation-data-type=u12p4
    Ary1D_u12p4_2: category=ARRAY, sw-calibration-access=READ-ONLY, type-emitter=RTE
      element Element: array-size=2, array-size-semantics=FIXED-SIZE, implementation-data-type=u12p4
    Ary1D_u12p4_4: category=ARRAY, sw-calibration-access=READ-ONLY, type-emitter=RTE
      element Element: array-size=4, array-size-semantics=FIXED-SIZE, implementation-data-type=u12p4
    Ary1D_u12p4_7: category=ARRAY, sw-calibration-access=READ-ONLY, type-emitter=RTE
      element Element: array-size=7, array-size-semantics=FIXED-SIZE, implementation-data-type=u12p4
    Ary1D_u12p4_9: category=ARRAY, sw-calibration-access=READ-ONLY, type-emitter=RTE
      element Element: array-size=9, array-size-semantics=FIXED-SIZE, implementation-data-type=u12p4
    Ary1D_u13p3_2: category=ARRAY, sw-calibration-access=READ-ONLY, type-emitter=RTE
      element Element: array-size=2, array-size-semantics=FIXED-SIZE, implementation-data-type=u13p3
    Ary1D_u13p3_4: category=ARRAY, sw-calibration-access=READ-ONLY, type-emitter=RTE
      element Element: array-size=4, array-size-semantics=FIXED-SIZE, implementation-data-type=u13p3
    Ary1D_u13p3_6: category=ARRAY, sw-calibration-access=READ-ONLY, type-emitter=RTE
      element Element: array-size=6, array-size-semantics=FIXED-SIZE, implementation-data-type=u13p3
    Ary1D_u15p1_10: category=ARRAY, sw-calibration-access=READ-ONLY, type-emitter=RTE
      element Element: array-size=10, array-size-semantics=FIXED-SIZE, implementation-data-type=u15p1
    Ary1D_u15p1_12: category=ARRAY, sw-calibration-access=READ-ONLY, type-emitter=RTE
      element Element: array-size=12, array-size-semantics=FIXED-SIZE, implementation-data-type=u15p1
    Ary1D_u15p1_24: category=ARRAY, sw-calibration-access=READ-ONLY, type-emitter=RTE
      element Element: array-size=24, array-size-semantics=FIXED-SIZE, implementation-data-type=u15p1
    Ary1D_u15p1_4: category=ARRAY, sw-calibration-access=READ-ONLY, type-emitter=RTE
      element Element: array-size=4, array-size-semantics=FIXED-SIZE, implementation-data-type=u15p1
    Ary1D_u15p1_9: category=ARRAY, sw-calibration-access=READ-ONLY, type-emitter=RTE
      element Element: array-size=9, array-size-semantics=FIXED-SIZE, implementation-data-type=u15p1
    Ary1D_u16_12: category=ARRAY, sw-calibration-access=READ-ONLY, type-emitter=RTE
      element Element: array-size=12, array-size-semantics=FIXED-SIZE, implementation-data-type=ImplementationDataTypes/uint16
    Ary1D_u16_257: category=ARRAY, sw-calibration-access=READ-ONLY, type-emitter=RTE
      element Element: array-size=257, array-size-semantics=FIXED-SIZE, implementation-data-type=ImplementationDataTypes/uint16
    Ary1D_u16_3: category=ARRAY, sw-calibration-access=READ-ONLY, type-emitter=RTE
      element Element: array-size=3, array-size-semantics=FIXED-SIZE, implementation-data-type=ImplementationDataTypes/uint16
    Ary1D_u16_5: category=ARRAY, sw-calibration-access=READ-ONLY, type-emitter=RTE
      element Element: array-size=5, array-size-semantics=FIXED-SIZE, implementation-data-type=ImplementationDataTypes/uint16
    Ary1D_u16_512: category=ARRAY, sw-calibration-access=READ-ONLY, type-emitter=RTE
      element Element: array-size=512, array-size-semantics=FIXED-SIZE, implementation-data-type=ImplementationDataTypes/uint16
    Ary1D_u16p0_2: category=ARRAY, sw-calibration-access=READ-ONLY, type-emitter=RTE
      element Element: array-size=2, array-size-semantics=FIXED-SIZE, implementation-data-type=u16p0
    Ary1D_u16p0_20: category=ARRAY, sw-calibration-access=READ-ONLY, type-emitter=RTE
      element Element: array-size=20, array-size-semantics=FIXED-SIZE, implementation-data-type=u16p0
    Ary1D_u16p0_22: category=ARRAY, sw-calibration-access=READ-ONLY, type-emitter=RTE
      element Element: array-size=22, array-size-semantics=FIXED-SIZE, implementation-data-type=u16p0
    Ary1D_u16p0_8: category=ARRAY, sw-calibration-access=READ-ONLY, type-emitter=RTE
      element Element: array-size=8, array-size-semantics=FIXED-SIZE, implementation-data-type=u16p0
    Ary1D_u1p15_10: category=ARRAY, sw-calibration-access=READ-ONLY, type-emitter=RTE
      element Element: array-size=10, array-size-semantics=FIXED-SIZE, implementation-data-type=u1p15
    Ary1D_u1p15_11: category=ARRAY, sw-calibration-access=READ-ONLY, type-emitter=RTE
      element Element: array-size=11, array-size-semantics=FIXED-SIZE, implementation-data-type=u1p15
    Ary1D_u1p15_12: category=ARRAY, sw-calibration-access=READ-ONLY, type-emitter=RTE
      element Element: array-size=12, array-size-semantics=FIXED-SIZE, implementation-data-type=u1p15
    Ary1D_u1p15_2: category=ARRAY, sw-calibration-access=READ-ONLY, type-emitter=RTE
      element Element: array-size=2, array-size-semantics=FIXED-SIZE, implementation-data-type=u1p15
    Ary1D_u1p15_21: category=ARRAY, sw-calibration-access=READ-ONLY, type-emitter=RTE
      element Element: array-size=21, array-size-semantics=FIXED-SIZE, implementation-data-type=u1p15
    Ary1D_u1p15_4: category=ARRAY, sw-calibration-access=READ-ONLY, type-emitter=RTE
      element Element: array-size=4, array-size-semantics=FIXED-SIZE, implementation-data-type=u1p15
    Ary1D_u1p15_5: category=ARRAY, sw-calibration-access=READ-ONLY, type-emitter=RTE
      element Element: array-size=5, array-size-semantics=FIXED-SIZE, implementation-data-type=u1p15
    Ary1D_u1p15_6: category=ARRAY, sw-calibration-access=READ-ONLY, type-emitter=RTE
      element Element: array-size=6, array-size-semantics=FIXED-SIZE, implementation-data-type=u1p15
    Ary1D_u1p15_9: category=ARRAY, sw-calibration-access=READ-ONLY, type-emitter=RTE
      element Element: array-size=9, array-size-semantics=FIXED-SIZE, implementation-data-type=u1p15
    Ary1D_u2p14_10: category=ARRAY, sw-calibration-access=READ-ONLY, type-emitter=RTE
      element Element: array-size=10, array-size-semantics=FIXED-SIZE, implementation-data-type=u2p14
    Ary1D_u2p14_11: category=ARRAY, sw-calibration-access=READ-ONLY, type-emitter=RTE
      element Element: array-size=11, array-size-semantics=FIXED-SIZE, implementation-data-type=u2p14
    Ary1D_u2p14_12: category=ARRAY, sw-calibration-access=READ-ONLY, type-emitter=RTE
      element Element: array-size=12, array-size-semantics=FIXED-SIZE, implementation-data-type=u2p14
    Ary1D_u2p14_16: category=ARRAY, sw-calibration-access=READ-ONLY, type-emitter=RTE
      element Element: array-size=16, array-size-semantics=FIXED-SIZE, implementation-data-type=u2p14
    Ary1D_u2p14_2: category=ARRAY, sw-calibration-access=READ-ONLY, type-emitter=RTE
      element Element: array-size=2, array-size-semantics=FIXED-SIZE, implementation-data-type=u2p14
    Ary1D_u2p14_3: category=ARRAY, sw-calibration-access=READ-ONLY, type-emitter=RTE
      element Element: array-size=3, array-size-semantics=FIXED-SIZE, implementation-data-type=u2p14
    Ary1D_u2p14_4: category=ARRAY, sw-calibration-access=READ-ONLY, type-emitter=RTE
      element Element: array-size=4, array-size-semantics=FIXED-SIZE, implementation-data-type=u2p14
    Ary1D_u2p14_5: category=ARRAY, sw-calibration-access=READ-ONLY, type-emitter=RTE
      element Element: array-size=5, array-size-semantics=FIXED-SIZE, implementation-data-type=u2p14
    Ary1D_u2p14_6: category=ARRAY, sw-calibration-access=READ-ONLY, type-emitter=RTE
      element Element: array-size=6, array-size-semantics=FIXED-SIZE, implementation-data-type=u2p14
    Ary1D_u2p14_7: category=ARRAY, sw-calibration-access=READ-ONLY, type-emitter=RTE
      element Element: array-size=7, array-size-semantics=FIXED-SIZE, implementation-data-type=u2p14
    Ary1D_u2p14_8: category=ARRAY, sw-calibration-access=READ-ONLY, type-emitter=RTE
      element Element: array-size=8, array-size-semantics=FIXED-SIZE, implementation-data-type=u2p14
    Ary1D_u2p14_9: category=ARRAY, sw-calibration-access=READ-ONLY, type-emitter=RTE
      element Element: array-size=9, array-size-semantics=FIXED-SIZE, implementation-data-type=u2p14
    Ary1D_u32_2: category=ARRAY, sw-calibration-access=READ-ONLY, type-emitter=RTE
      element Element: array-size=2, array-size-semantics=FIXED-SIZE, implementation-data-type=uint32
    Ary1D_u32_4: category=ARRAY, sw-calibration-access=READ-ONLY, type-emitter=RTE
      element Element: array-size=4, array-size-semantics=FIXED-SIZE, implementation-data-type=uint32
    Ary1D_u32_5: category=ARRAY, sw-calibration-access=READ-ONLY, type-emitter=RTE
      element Element: array-size=5, array-size-semantics=FIXED-SIZE, implementation-data-type=uint32
    Ary1D_u32_50: category=ARRAY, sw-calibration-access=READ-ONLY, type-emitter=StHlthSigStc
      element Element: array-size=50, array-size-semantics=FIXED-SIZE, implementation-data-type=uint32
    Ary1D_u32_512: category=ARRAY, sw-calibration-access=READ-ONLY, type-emitter=RTE
      element Element: array-size=512, array-size-semantics=FIXED-SIZE, implementation-data-type=uint32
    Ary1D_u32_8: category=ARRAY, sw-calibration-access=READ-ONLY, type-emitter=RTE
      element Element: array-size=8, array-size-semantics=FIXED-SIZE, implementation-data-type=uint32
    Ary1D_u32_StHlthSigStc1: category=ARRAY, type-emitter=StHlthSigStc
      element Element: array-size=65535, array-size-semantics=VARIABLE-SIZE, implementation-data-type=uint32
    Ary1D_u3p13_10: category=ARRAY, sw-calibration-access=READ-ONLY, type-emitter=RTE
      element Element: array-size=10, array-size-semantics=FIXED-SIZE, implementation-data-type=u3p13
    Ary1D_u3p13_13: category=ARRAY, sw-calibration-access=READ-ONLY, type-emitter=RTE
      element Element: array-size=13, array-size-semantics=FIXED-SIZE, implementation-data-type=u3p13
    Ary1D_u3p13_5: category=ARRAY, sw-calibration-access=READ-ONLY, type-emitter=RTE
      element Element: array-size=5, array-size-semantics=FIXED-SIZE, implementation-data-type=u3p13
    Ary1D_u3p13_50: category=ARRAY, sw-calibration-access=READ-ONLY, type-emitter=RTE
      element Element: array-size=50, array-size-semantics=FIXED-SIZE, implementation-data-type=u3p13
    Ary1D_u3p13_8: category=ARRAY, sw-calibration-access=READ-ONLY, type-emitter=RTE
      element Element: array-size=8, array-size-semantics=FIXED-SIZE, implementation-data-type=u3p13
    Ary1D_u4p12_10: category=ARRAY, sw-calibration-access=READ-ONLY, type-emitter=RTE
      element Element: array-size=10, array-size-semantics=FIXED-SIZE, implementation-data-type=u4p12
    Ary1D_u4p12_11: category=ARRAY, sw-calibration-access=READ-ONLY, type-emitter=RTE
      element Element: array-size=11, array-size-semantics=FIXED-SIZE, implementation-data-type=u4p12
    Ary1D_u4p12_12: category=ARRAY, sw-calibration-access=READ-ONLY, type-emitter=RTE
      element Element: array-size=12, array-size-semantics=FIXED-SIZE, implementation-data-type=u4p12
    Ary1D_u4p12_13: category=ARRAY, sw-calibration-access=READ-ONLY, type-emitter=RTE
      element Element: array-size=13, array-size-semantics=FIXED-SIZE, implementation-data-type=u4p12
    Ary1D_u4p12_14: category=ARRAY, sw-calibration-access=READ-ONLY, type-emitter=RTE
      element Element: array-size=14, array-size-semantics=FIXED-SIZE, implementation-data-type=u4p12
    Ary1D_u4p12_2: category=ARRAY, sw-calibration-access=READ-ONLY, type-emitter=RTE
      element Element: array-size=2, array-size-semantics=FIXED-SIZE, implementation-data-type=u4p12
    Ary1D_u4p12_20: category=ARRAY, sw-calibration-access=READ-ONLY, type-emitter=RTE
      element Element: array-size=20, array-size-semantics=FIXED-SIZE, implementation-data-type=u4p12
    Ary1D_u4p12_21: category=ARRAY, sw-calibration-access=READ-ONLY, type-emitter=RTE
      element Element: array-size=21, array-size-semantics=FIXED-SIZE, implementation-data-type=u4p12
    Ary1D_u4p12_24: category=ARRAY, sw-calibration-access=READ-ONLY, type-emitter=RTE
      element Element: array-size=24, array-size-semantics=FIXED-SIZE, implementation-data-type=u4p12
    Ary1D_u4p12_3: category=ARRAY, sw-calibration-access=READ-ONLY, type-emitter=RTE
      element Element: array-size=3, array-size-semantics=FIXED-SIZE, implementation-data-type=u4p12
    Ary1D_u4p12_4: category=ARRAY, sw-calibration-access=READ-ONLY, type-emitter=RTE
      element Element: array-size=4, array-size-semantics=FIXED-SIZE, implementation-data-type=u4p12
    Ary1D_u4p12_5: category=ARRAY, sw-calibration-access=READ-ONLY, type-emitter=RTE
      element Element: array-size=5, array-size-semantics=FIXED-SIZE, implementation-data-type=u4p12
    Ary1D_u4p12_6: category=ARRAY, sw-calibration-access=READ-ONLY, type-emitter=RTE
      element Element: array-size=6, array-size-semantics=FIXED-SIZE, implementation-data-type=u4p12
    Ary1D_u4p12_7: category=ARRAY, sw-calibration-access=READ-ONLY, type-emitter=RTE
      element Element: array-size=7, array-size-semantics=FIXED-SIZE, implementation-data-type=u4p12
    Ary1D_u4p12_8: category=ARRAY, sw-calibration-access=READ-ONLY, type-emitter=RTE
      element Element: array-size=8, array-size-semantics=FIXED-SIZE, implementation-data-type=u4p12
    Ary1D_u4p12_9: category=ARRAY, sw-calibration-access=READ-ONLY, type-emitter=RTE
      element Element: array-size=9, array-size-semantics=FIXED-SIZE, implementation-data-type=u4p12
    Ary1D_u5p11_10: category=ARRAY, sw-calibration-access=READ-ONLY, type-emitter=RTE
      element Element: array-size=10, array-size-semantics=FIXED-SIZE, implementation-data-type=u5p11
    Ary1D_u5p11_11: category=ARRAY, sw-calibration-access=READ-ONLY, type-emitter=RTE
      element Element: array-size=11, array-size-semantics=FIXED-SIZE, implementation-data-type=u5p11
    Ary1D_u5p11_12: category=ARRAY, sw-calibration-access=READ-ONLY, type-emitter=RTE
      element Element: array-size=12, array-size-semantics=FIXED-SIZE, implementation-data-type=u5p11
    Ary1D_u5p11_13: category=ARRAY, sw-calibration-access=READ-ONLY, type-emitter=RTE
      element Element: array-size=13, array-size-semantics=FIXED-SIZE, implementation-data-type=u5p11
    Ary1D_u5p11_14: category=ARRAY, sw-calibration-access=READ-ONLY, type-emitter=RTE
      element Element: array-size=14, array-size-semantics=FIXED-SIZE, implementation-data-type=u5p11
    Ary1D_u5p11_16: category=ARRAY, sw-calibration-access=READ-ONLY, type-emitter=RTE
      element Element: array-size=16, array-size-semantics=FIXED-SIZE, implementation-data-type=u5p11
    Ary1D_u5p11_17: category=ARRAY, sw-calibration-access=READ-ONLY, type-emitter=RTE
      element Element: array-size=17, array-size-semantics=FIXED-SIZE, implementation-data-type=u5p11
    Ary1D_u5p11_21: category=ARRAY, sw-calibration-access=READ-ONLY, type-emitter=RTE
      element Element: array-size=21, array-size-semantics=FIXED-SIZE, implementation-data-type=u5p11
    Ary1D_u5p11_5: category=ARRAY, sw-calibration-access=READ-ONLY, type-emitter=RTE
      element Element: array-size=5, array-size-semantics=FIXED-SIZE, implementation-data-type=u5p11
    Ary1D_u5p11_6: category=ARRAY, sw-calibration-access=READ-ONLY, type-emitter=RTE
      element Element: array-size=6, array-size-semantics=FIXED-SIZE, implementation-data-type=u5p11
    Ary1D_u5p11_8: category=ARRAY, sw-calibration-access=READ-ONLY, type-emitter=RTE
      element Element: array-size=8, array-size-semantics=FIXED-SIZE, implementation-data-type=u5p11
    Ary1D_u5p11_9: category=ARRAY, sw-calibration-access=READ-ONLY, type-emitter=RTE
      element Element: array-size=9, array-size-semantics=FIXED-SIZE, implementation-data-type=u5p11
    Ary1D_u6p10_10: category=ARRAY, sw-calibration-access=READ-ONLY, type-emitter=RTE
      element Element: array-size=10, array-size-semantics=FIXED-SIZE, implementation-data-type=u6p10
    Ary1D_u6p10_17: category=ARRAY, sw-calibration-access=READ-ONLY, type-emitter=RTE
      element Element: array-size=17, array-size-semantics=FIXED-SIZE, implementation-data-type=u6p10
    Ary1D_u6p10_20: category=ARRAY, sw-calibration-access=READ-ONLY, type-emitter=RTE
      element Element: array-size=20, array-size-semantics=FIXED-SIZE, implementation-data-type=u6p10
    Ary1D_u6p10_5: category=ARRAY, sw-calibration-access=READ-ONLY, type-emitter=RTE
      element Element: array-size=5, array-size-semantics=FIXED-SIZE, implementation-data-type=u6p10
    Ary1D_u6p10_6: category=ARRAY, sw-calibration-access=READ-ONLY, type-emitter=RTE
      element Element: array-size=6, array-size-semantics=FIXED-SIZE, implementation-data-type=u6p10
    Ary1D_u6p10_9: category=ARRAY, sw-calibration-access=READ-ONLY, type-emitter=RTE
      element Element: array-size=9, array-size-semantics=FIXED-SIZE, implementation-data-type=u6p10
    Ary1D_u7p9_12: category=ARRAY, sw-calibration-access=READ-ONLY, type-emitter=RTE
      element Element: array-size=12, array-size-semantics=FIXED-SIZE, implementation-data-type=u7p9
    Ary1D_u7p9_3: category=ARRAY, sw-calibration-access=READ-ONLY, type-emitter=RTE
      element Element: array-size=3, array-size-semantics=FIXED-SIZE, implementation-data-type=u7p9
    Ary1D_u7p9_4: category=ARRAY, sw-calibration-access=READ-ONLY, type-emitter=RTE
      element Element: array-size=4, array-size-semantics=FIXED-SIZE, implementation-data-type=u7p9
    Ary1D_u7p9_6: category=ARRAY, sw-calibration-access=READ-ONLY, type-emitter=RTE
      element Element: array-size=6, array-size-semantics=FIXED-SIZE, implementation-data-type=u7p9
    Ary1D_u8p8_10: category=ARRAY, sw-calibration-access=READ-ONLY, type-emitter=RTE
      element Element: array-size=10, array-size-semantics=FIXED-SIZE, implementation-data-type=u8p8
    Ary1D_u8p8_11: category=ARRAY, sw-calibration-access=READ-ONLY, type-emitter=RTE
      element Element: array-size=11, array-size-semantics=FIXED-SIZE, implementation-data-type=u8p8
    Ary1D_u8p8_12: category=ARRAY, sw-calibration-access=READ-ONLY, type-emitter=RTE
      element Element: array-size=12, array-size-semantics=FIXED-SIZE, implementation-data-type=u8p8
    Ary1D_u8p8_13: category=ARRAY, sw-calibration-access=READ-ONLY, type-emitter=RTE
      element Element: array-size=13, array-size-semantics=FIXED-SIZE, implementation-data-type=u8p8
    Ary1D_u8p8_14: category=ARRAY, sw-calibration-access=READ-ONLY, type-emitter=RTE
      element Element: array-size=14, array-size-semantics=FIXED-SIZE, implementation-data-type=u8p8
    Ary1D_u8p8_2: category=ARRAY, sw-calibration-access=READ-ONLY, type-emitter=RTE
      element Element: array-size=2, array-size-semantics=FIXED-SIZE, implementation-data-type=u8p8
    Ary1D_u8p8_20: category=ARRAY, sw-calibration-access=READ-ONLY, type-emitter=RTE
      element Element: array-size=20, array-size-semantics=FIXED-SIZE, implementation-data-type=u8p8
    Ary1D_u8p8_3: category=ARRAY, sw-calibration-access=READ-ONLY, type-emitter=RTE
      element Element: array-size=3, array-size-semantics=FIXED-SIZE, implementation-data-type=u8p8
    Ary1D_u8p8_4: category=ARRAY, sw-calibration-access=READ-ONLY, type-emitter=RTE
      element Element: array-size=4, array-size-semantics=FIXED-SIZE, implementation-data-type=u8p8
    Ary1D_u8p8_5: category=ARRAY, sw-calibration-access=READ-ONLY, type-emitter=RTE
      element Element: array-size=5, array-size-semantics=FIXED-SIZE, implementation-data-type=u8p8
    Ary1D_u8p8_6: category=ARRAY, sw-calibration-access=READ-ONLY, type-emitter=RTE
      element Element: array-size=6, array-size-semantics=FIXED-SIZE, implementation-data-type=u8p8
    Ary1D_u8p8_7: category=ARRAY, sw-calibration-access=READ-ONLY, type-emitter=RTE
      element Element: array-size=7, array-size-semantics=FIXED-SIZE, implementation-data-type=u8p8
    Ary1D_u8p8_8: category=ARRAY, sw-calibration-access=READ-ONLY, type-emitter=RTE
      element Element: array-size=8, array-size-semantics=FIXED-SIZE, implementation-data-type=u8p8
    Ary1D_u8p8_9: category=ARRAY, sw-calibration-access=READ-ONLY, type-emitter=RTE
      element Element: array-size=9, array-size-semantics=FIXED-SIZE, implementation-data-type=u8p8
    Ary1D_u9p7_10: category=ARRAY, sw-calibration-access=READ-ONLY, type-emitter=RTE
      element Element: array-size=10, array-size-semantics=FIXED-SIZE, implementation-data-type=u9p7
    Ary1D_u9p7_11: category=ARRAY, sw-calibration-access=READ-ONLY, type-emitter=RTE
      element Element: array-size=11, array-size-semantics=FIXED-SIZE, implementation-data-type=u9p7
    Ary1D_u9p7_12: category=ARRAY, sw-calibration-access=READ-ONLY, type-emitter=RTE
      element Element: array-size=12, array-size-semantics=FIXED-SIZE, implementation-data-type=u9p7
    Ary1D_u9p7_16: category=ARRAY, sw-calibration-access=READ-ONLY, type-emitter=RTE
      element Element: array-size=16, array-size-semantics=FIXED-SIZE, implementation-data-type=u9p7
    Ary1D_u9p7_2: category=ARRAY, sw-calibration-access=READ-ONLY, type-emitter=RTE
      element Element: array-size=2, array-size-semantics=FIXED-SIZE, implementation-data-type=u9p7
    Ary1D_u9p7_3: category=ARRAY, sw-calibration-access=READ-ONLY, type-emitter=RTE
      element Element: array-size=3, array-size-semantics=FIXED-SIZE, implementation-data-type=u9p7
    Ary1D_u9p7_4: category=ARRAY, sw-calibration-access=READ-ONLY, type-emitter=RTE
      element Element: array-size=4, array-size-semantics=FIXED-SIZE, implementation-data-type=u9p7
    Ary1D_u9p7_5: category=ARRAY, sw-calibration-access=READ-ONLY, type-emitter=RTE
      element Element: array-size=5, array-size-semantics=FIXED-SIZE, implementation-data-type=u9p7
    Ary1D_u9p7_6: category=ARRAY, sw-calibration-access=READ-ONLY, type-emitter=RTE
      element Element: array-size=6, array-size-semantics=FIXED-SIZE, implementation-data-type=u9p7
    Ary1D_u9p7_7: category=ARRAY, sw-calibration-access=READ-ONLY, type-emitter=RTE
      element Element: array-size=7, array-size-semantics=FIXED-SIZE, implementation-data-type=u9p7
    Ary1D_u9p7_8: category=ARRAY, sw-calibration-access=READ-ONLY, type-emitter=RTE
      element Element: array-size=8, array-size-semantics=FIXED-SIZE, implementation-data-type=u9p7
    Ary1D_u9p7_9: category=ARRAY, sw-calibration-access=READ-ONLY, type-emitter=RTE
      element Element: array-size=9, array-size-semantics=FIXED-SIZE, implementation-data-type=u9p7
    Ary2D_f32_3_3: category=ARRAY, sw-calibration-access=READ-ONLY, type-emitter=RTE
      element Element: array-size=3, array-size-semantics=FIXED-SIZE, implementation-data-type=Ary1D_f32_3
    Ary2D_f32_4_2: category=ARRAY, sw-calibration-access=READ-ONLY, type-emitter=RTE
      element Element: array-size=4, array-size-semantics=FIXED-SIZE, implementation-data-type=Ary1D_f32_2
    Ary2D_f32_4_5: category=ARRAY, sw-calibration-access=READ-ONLY, type-emitter=RTE
      element Element: array-size=4, array-size-semantics=FIXED-SIZE, implementation-data-type=Ary1D_f32_5
    Ary2D_f32_4_8: category=ARRAY, sw-calibration-access=READ-ONLY, type-emitter=RTE
      element Element: array-size=4, array-size-semantics=FIXED-SIZE, implementation-data-type=Ary1D_f32_8
    Ary2D_f32_5_3: category=ARRAY, sw-calibration-access=READ-ONLY, type-emitter=RTE
      element Element: array-size=5, array-size-semantics=FIXED-SIZE, implementation-data-type=Ary1D_f32_3
    Ary2D_f32_5_4: category=ARRAY, sw-calibration-access=READ-ONLY, type-emitter=RTE
      element Element: array-size=5, array-size-semantics=FIXED-SIZE, implementation-data-type=Ary1D_f32_4
    Ary2D_f32_5_5: category=ARRAY, sw-calibration-access=READ-ONLY, type-emitter=RTE
      element Element: array-size=5, array-size-semantics=FIXED-SIZE, implementation-data-type=Ary1D_f32_5
    Ary2D_f32_8_4: category=ARRAY, sw-calibration-access=READ-ONLY, type-emitter=RTE
      element Element: array-size=8, array-size-semantics=FIXED-SIZE, implementation-data-type=Ary1D_f32_4
    Ary2D_s1p14_10_12: category=ARRAY, sw-calibration-access=READ-ONLY, type-emitter=RTE
      element Element: array-size=10, array-size-semantics=FIXED-SIZE, implementation-data-type=Ary1D_s1p14_12
    Ary2D_s4p11_10_13: category=ARRAY, sw-calibration-access=READ-ONLY, type-emitter=RTE
      element Element: array-size=10, array-size-semantics=FIXED-SIZE, implementation-data-type=Ary1D_s4p11_13
    Ary2D_s4p11_11_8: category=ARRAY, sw-calibration-access=READ-ONLY, type-emitter=RTE
      element Element: array-size=11, array-size-semantics=FIXED-SIZE, implementation-data-type=Ary1D_s4p11_8
    Ary2D_s4p11_12_11: category=ARRAY, sw-calibration-access=READ-ONLY, type-emitter=RTE
      element Element: array-size=12, array-size-semantics=FIXED-SIZE, implementation-data-type=Ary1D_s4p11_11
    Ary2D_s4p11_12_20: category=ARRAY, sw-calibration-access=READ-ONLY, type-emitter=RTE
      element Element: array-size=12, array-size-semantics=FIXED-SIZE, implementation-data-type=Ary1D_s4p11_20
    Ary2D_s4p11_8_11: category=ARRAY, sw-calibration-access=READ-ONLY, type-emitter=RTE
      element Element: array-size=8, array-size-semantics=FIXED-SIZE, implementation-data-type=Ary1D_s4p11_11
    Ary2D_s7p8_11_12: category=ARRAY, sw-calibration-access=READ-ONLY, type-emitter=RTE
      element Element: array-size=11, array-size-semantics=FIXED-SIZE, implementation-data-type=Ary1D_s7p8_12
    Ary2D_s7p8_12_11: category=ARRAY, sw-calibration-access=READ-ONLY, type-emitter=RTE
      element Element: array-size=12, array-size-semantics=FIXED-SIZE, implementation-data-type=Ary1D_s7p8_11
    Ary2D_s7p8_3_5: category=ARRAY, sw-calibration-access=READ-ONLY, type-emitter=RTE
      element Element: array-size=3, array-size-semantics=FIXED-SIZE, implementation-data-type=Ary1D_s7p8_5
    Ary2D_s7p8_3_6: category=ARRAY, sw-calibration-access=READ-ONLY, type-emitter=RTE
      element Element: array-size=3, array-size-semantics=FIXED-SIZE, implementation-data-type=Ary1D_s7p8_6
    Ary2D_s7p8_4_5: category=ARRAY, sw-calibration-access=READ-ONLY, type-emitter=RTE
      element Element: array-size=4, array-size-semantics=FIXED-SIZE, implementation-data-type=Ary1D_s7p8_5
    Ary2D_s7p8_9_5: category=ARRAY, sw-calibration-access=READ-ONLY, type-emitter=RTE
      element Element: array-size=9, array-size-semantics=FIXED-SIZE, implementation-data-type=Ary1D_s7p8_5
    Ary2D_s7p8_9_6: category=ARRAY, sw-calibration-access=READ-ONLY, type-emitter=RTE
      element Element: array-size=9, array-size-semantics=FIXED-SIZE, implementation-data-type=Ary1D_s7p8_6
    Ary2D_u08_2_2: category=ARRAY, sw-calibration-access=READ-ONLY, type-emitter=RTE
      element Element: array-size=2, array-size-semantics=FIXED-SIZE, implementation-data-type=Ary1D_u08_2
    Ary2D_u0p16_20_8: category=ARRAY, sw-calibration-access=READ-ONLY, type-emitter=RTE
      element Element: array-size=20, array-size-semantics=FIXED-SIZE, implementation-data-type=Ary1D_u0p16_8
    Ary2D_u0p16_4_2: category=ARRAY, sw-calibration-access=READ-ONLY, type-emitter=RTE
      element Element: array-size=4, array-size-semantics=FIXED-SIZE, implementation-data-type=Ary1D_u0p16_2
    Ary2D_u10p6_3_7: category=ARRAY, sw-calibration-access=READ-ONLY, type-emitter=RTE
      element Element: array-size=3, array-size-semantics=FIXED-SIZE, implementation-data-type=Ary1D_u10p6_7
    Ary2D_u10p6_8_12: category=ARRAY, sw-calibration-access=READ-ONLY, type-emitter=RTE
      element Element: array-size=8, array-size-semantics=FIXED-SIZE, implementation-data-type=Ary1D_u10p6_12
    Ary2D_u10p6_8_9: category=ARRAY, sw-calibration-access=READ-ONLY, type-emitter=RTE
      element Element: array-size=8, array-size-semantics=FIXED-SIZE, implementation-data-type=Ary1D_u10p6_9
    Ary2D_u11p5_6_5: category=ARRAY, sw-calibration-access=READ-ONLY, type-emitter=RTE
      element Element: array-size=6, array-size-semantics=FIXED-SIZE, implementation-data-type=Ary1D_u11p5_5
    Ary2D_u12p4_12_13: category=ARRAY, sw-calibration-access=READ-ONLY, type-emitter=RTE
      element Element: array-size=12, array-size-semantics=FIXED-SIZE, implementation-data-type=Ary1D_u12p4_13
    Ary2D_u12p4_4_2: category=ARRAY, sw-calibration-access=READ-ONLY, type-emitter=RTE
      element Element: array-size=4, array-size-semantics=FIXED-SIZE, implementation-data-type=Ary1D_u12p4_2
    Ary2D_u12p4_5_4: category=ARRAY, sw-calibration-access=READ-ONLY, type-emitter=RTE
      element Element: array-size=5, array-size-semantics=FIXED-SIZE, implementation-data-type=Ary1D_u12p4_4
    Ary2D_u12p4_8_12: category=ARRAY, sw-calibration-access=READ-ONLY, type-emitter=RTE
      element Element: array-size=8, array-size-semantics=FIXED-SIZE, implementation-data-type=Ary1D_u12p4_12
    Ary2D_u12p4_9_16: category=ARRAY, sw-calibration-access=READ-ONLY, type-emitter=RTE
      element Element: array-size=9, array-size-semantics=FIXED-SIZE, implementation-data-type=Ary1D_u12p4_16
    Ary2D_u15p1_10_24: category=ARRAY, sw-calibration-access=READ-ONLY, type-emitter=RTE
      element Element: array-size=10, array-size-semantics=FIXED-SIZE, implementation-data-type=Ary1D_u15p1_24
    Ary2D_u15p1_12_9: category=ARRAY, sw-calibration-access=READ-ONLY, type-emitter=RTE
      element Element: array-size=12, array-size-semantics=FIXED-SIZE, implementation-data-type=Ary1D_u15p1_9
    Ary2D_u16_3_8: category=ARRAY, sw-calibration-access=READ-ONLY, type-emitter=RTE
      element Element: array-size=3, array-size-semantics=FIXED-SIZE, implementation-data-type=Ary1D_u16p0_8
    Ary2D_u16_8_3: category=ARRAY, sw-calibration-access=READ-ONLY, type-emitter=RTE
      element Element: array-size=8, array-size-semantics=FIXED-SIZE, implementation-data-type=Ary1D_u16_3
    Ary2D_u16p0_2_8: category=ARRAY, sw-calibration-access=READ-ONLY, type-emitter=RTE
      element Element: array-size=2, array-size-semantics=FIXED-SIZE, implementation-data-type=Ary1D_u16p0_8
    Ary2D_u1p15_12_5: category=ARRAY, sw-calibration-access=READ-ONLY, type-emitter=RTE
      element Element: array-size=12, array-size-semantics=FIXED-SIZE, implementation-data-type=Ary1D_u1p15_5
    Ary2D_u1p15_12_9: category=ARRAY, sw-calibration-access=READ-ONLY, type-emitter=RTE
      element Element: array-size=12, array-size-semantics=FIXED-SIZE, implementation-data-type=Ary1D_u1p15_9
    Ary2D_u1p15_5_4: category=ARRAY, sw-calibration-access=READ-ONLY, type-emitter=RTE
      element Element: array-size=5, array-size-semantics=FIXED-SIZE, implementation-data-type=Ary1D_u1p15_4
    Ary2D_u1p15_8_4: category=ARRAY, sw-calibration-access=READ-ONLY, type-emitter=RTE
      element Element: array-size=8, array-size-semantics=FIXED-SIZE, implementation-data-type=Ary1D_u1p15_4
    Ary2D_u2p14_12_5: category=ARRAY, sw-calibration-access=READ-ONLY, type-emitter=RTE
      element Element: array-size=12, array-size-semantics=FIXED-SIZE, implementation-data-type=Ary1D_u2p14_5
    Ary2D_u2p14_5_10: category=ARRAY, sw-calibration-access=READ-ONLY, type-emitter=RTE
      element Element: array-size=5, array-size-semantics=FIXED-SIZE, implementation-data-type=Ary1D_u2p14_10
    Ary2D_u2p14_5_8: category=ARRAY, sw-calibration-access=READ-ONLY, type-emitter=RTE
      element Element: array-size=5, array-size-semantics=FIXED-SIZE, implementation-data-type=Ary1D_u2p14_8
    Ary2D_u2p14_6_5: category=ARRAY, sw-calibration-access=READ-ONLY, type-emitter=RTE
      element Element: array-size=6, array-size-semantics=FIXED-SIZE, implementation-data-type=Ary1D_u2p14_5
    Ary2D_u2p14_6_7: category=ARRAY, sw-calibration-access=READ-ONLY, type-emitter=RTE
      element Element: array-size=6, array-size-semantics=FIXED-SIZE, implementation-data-type=Ary1D_u2p14_7
    Ary2D_u2p14_7_6: category=ARRAY, sw-calibration-access=READ-ONLY, type-emitter=RTE
      element Element: array-size=7, array-size-semantics=FIXED-SIZE, implementation-data-type=Ary1D_u2p14_6
    Ary2D_u2p14_7_8: category=ARRAY, sw-calibration-access=READ-ONLY, type-emitter=RTE
      element Element: array-size=7, array-size-semantics=FIXED-SIZE, implementation-data-type=Ary1D_u2p14_8
    Ary2D_u3p13_12_13: category=ARRAY, sw-calibration-access=READ-ONLY, type-emitter=RTE
      element Element: array-size=12, array-size-semantics=FIXED-SIZE, implementation-data-type=Ary1D_u3p13_13
    Ary2D_u3p13_20_8: category=ARRAY, sw-calibration-access=READ-ONLY, type-emitter=RTE
      element Element: array-size=20, array-size-semantics=FIXED-SIZE, implementation-data-type=Ary1D_u3p13_8
    Ary2D_u4p12_10_24: category=ARRAY, sw-calibration-access=READ-ONLY, type-emitter=RTE
      element Element: array-size=10, array-size-semantics=FIXED-SIZE, implementation-data-type=Ary1D_u4p12_24
    Ary2D_u4p12_12_12: category=ARRAY, sw-calibration-access=READ-ONLY, type-emitter=RTE
      element Element: array-size=12, array-size-semantics=FIXED-SIZE, implementation-data-type=Ary1D_u4p12_12
    Ary2D_u4p12_12_20: category=ARRAY, sw-calibration-access=READ-ONLY, type-emitter=RTE
      element Element: array-size=12, array-size-semantics=FIXED-SIZE, implementation-data-type=Ary1D_u4p12_20
    Ary2D_u4p12_12_5: category=ARRAY, sw-calibration-access=READ-ONLY, type-emitter=RTE
      element Element: array-size=12, array-size-semantics=FIXED-SIZE, implementation-data-type=Ary1D_u4p12_5
    Ary2D_u4p12_12_8: category=ARRAY, sw-calibration-access=READ-ONLY, type-emitter=RTE
      element Element: array-size=12, array-size-semantics=FIXED-SIZE, implementation-data-type=Ary1D_u4p12_8
    Ary2D_u4p12_12_9: category=ARRAY, sw-calibration-access=READ-ONLY, type-emitter=RTE
      element Element: array-size=12, array-size-semantics=FIXED-SIZE, implementation-data-type=Ary1D_u4p12_9
    Ary2D_u4p12_13_3: category=ARRAY, sw-calibration-access=READ-ONLY, type-emitter=RTE
      element Element: array-size=13, array-size-semantics=FIXED-SIZE, implementation-data-type=Ary1D_u4p12_3
    Ary2D_u4p12_3_13: category=ARRAY, sw-calibration-access=READ-ONLY, type-emitter=RTE
      element Element: array-size=3, array-size-semantics=FIXED-SIZE, implementation-data-type=Ary1D_u4p12_13
    Ary2D_u4p12_6_7: category=ARRAY, sw-calibration-access=READ-ONLY, type-emitter=RTE
      element Element: array-size=6, array-size-semantics=FIXED-SIZE, implementation-data-type=Ary1D_u4p12_7
    Ary2D_u5p11_12_13: category=ARRAY, sw-calibration-access=READ-ONLY, type-emitter=RTE
      element Element: array-size=12, array-size-semantics=FIXED-SIZE, implementation-data-type=Ary1D_u5p11_13
    Ary2D_u5p11_12_5: category=ARRAY, sw-calibration-access=READ-ONLY, type-emitter=RTE
      element Element: array-size=12, array-size-semantics=FIXED-SIZE, implementation-data-type=Ary1D_u5p11_5
    Ary2D_u5p11_9_16: category=ARRAY, sw-calibration-access=READ-ONLY, type-emitter=RTE
      element Element: array-size=9, array-size-semantics=FIXED-SIZE, implementation-data-type=Ary1D_u5p11_16
    Ary2D_u5p11_9_9: category=ARRAY, sw-calibration-access=READ-ONLY, type-emitter=RTE
      element Element: array-size=9, array-size-semantics=FIXED-SIZE, implementation-data-type=Ary1D_u5p11_9
    Ary2D_u6p10_12_20: category=ARRAY, sw-calibration-access=READ-ONLY, type-emitter=RTE
      element Element: array-size=12, array-size-semantics=FIXED-SIZE, implementation-data-type=Ary1D_u6p10_20
    Ary2D_u6p10_12_9: category=ARRAY, sw-calibration-access=READ-ONLY, type-emitter=RTE
      element Element: array-size=12, array-size-semantics=FIXED-SIZE, implementation-data-type=Ary1D_u6p10_9
    Ary2D_u6p10_5_9: category=ARRAY, sw-calibration-access=READ-ONLY, type-emitter=RTE
      element Element: array-size=5, array-size-semantics=FIXED-SIZE, implementation-data-type=Ary1D_u6p10_9
    Ary2D_u6p10_8_9: category=ARRAY, sw-calibration-access=READ-ONLY, type-emitter=RTE
      element Element: array-size=8, array-size-semantics=FIXED-SIZE, implementation-data-type=Ary1D_u6p10_9
    Ary2D_u7p9_8_4: category=ARRAY, sw-calibration-access=READ-ONLY, type-emitter=RTE
      element Element: array-size=8, array-size-semantics=FIXED-SIZE, implementation-data-type=Ary1D_u7p9_4
    Ary2D_u7p9_9_4: category=ARRAY, sw-calibration-access=READ-ONLY, type-emitter=RTE
      element Element: array-size=9, array-size-semantics=FIXED-SIZE, implementation-data-type=Ary1D_u7p9_4
    Ary2D_u8p8_12_20: category=ARRAY, sw-calibration-access=READ-ONLY, type-emitter=RTE
      element Element: array-size=12, array-size-semantics=FIXED-SIZE, implementation-data-type=Ary1D_u8p8_20
    Ary2D_u8p8_3_5: category=ARRAY, sw-calibration-access=READ-ONLY, type-emitter=RTE
      element Element: array-size=3, array-size-semantics=FIXED-SIZE, implementation-data-type=Ary1D_u8p8_5
    Ary2D_u8p8_3_6: category=ARRAY, sw-calibration-access=READ-ONLY, type-emitter=RTE
      element Element: array-size=3, array-size-semantics=FIXED-SIZE, implementation-data-type=Ary1D_u8p8_6
    Ary2D_u8p8_5_10: category=ARRAY, sw-calibration-access=READ-ONLY, type-emitter=RTE
      element Element: array-size=5, array-size-semantics=FIXED-SIZE, implementation-data-type=Ary1D_u8p8_10
    Ary2D_u8p8_5_8: category=ARRAY, sw-calibration-access=READ-ONLY, type-emitter=RTE
      element Element: array-size=5, array-size-semantics=FIXED-SIZE, implementation-data-type=Ary1D_u8p8_8
    Ary2D_u8p8_6_5: category=ARRAY, sw-calibration-access=READ-ONLY, type-emitter=RTE
      element Element: array-size=6, array-size-semantics=FIXED-SIZE, implementation-data-type=Ary1D_u8p8_5
    Ary2D_u8p8_9_4: category=ARRAY, sw-calibration-access=READ-ONLY, type-emitter=RTE
      element Element: array-size=9, array-size-semantics=FIXED-SIZE, implementation-data-type=Ary1D_u8p8_4
    Ary2D_u8p8_9_5: category=ARRAY, sw-calibration-access=READ-ONLY, type-emitter=RTE
      element Element: array-size=9, array-size-semantics=FIXED-SIZE, implementation-data-type=Ary1D_u8p8_5
    Ary2D_u8p8_9_6: category=ARRAY, sw-calibration-access=READ-ONLY, type-emitter=RTE
      element Element: array-size=9, array-size-semantics=FIXED-SIZE, implementation-data-type=Ary1D_u8p8_6
    Ary2D_u8p8_9_8: category=ARRAY, sw-calibration-access=READ-ONLY, type-emitter=RTE
      element Element: array-size=9, array-size-semantics=FIXED-SIZE, implementation-data-type=Ary1D_u8p8_8
    Ary2D_u9p7_2_5: category=ARRAY, sw-calibration-access=READ-ONLY, type-emitter=RTE
      element Element: array-size=2, array-size-semantics=FIXED-SIZE, implementation-data-type=Ary1D_u9p7_5
    Ary2D_u9p7_2_8: category=ARRAY, sw-calibration-access=READ-ONLY, type-emitter=RTE
      element Element: array-size=2, array-size-semantics=FIXED-SIZE, implementation-data-type=Ary1D_u9p7_8
    BattSwdVltgCorrlnSts1: compu {0=BSVCS_NOFLT, 1=BSVCS_BATTVLTGSWD2FLT, 2=BSVCS_BATTVLTGSWD1FLT, 3=BSVCS_BATTVLTGFLT, 4=BSVCS_NOCORRLN}, implementation-data-type=ImplementationDataTypes/uint8, type-emitter=RTE
    BattVltgSt1: compu {0=BATTVLTGST_NORMOPER, 1=BATTVLTGST_HIVLTGWARN, 2=BATTVLTGST_HIVLTGCRIT, 3=BATTVLTGST_HIVLTGOFF, 4=BATTVLTGST_LOVLTGWARN, 5=BATTVLTGST_LOVLTGCRIT, 6=BATTVLTGST_LOVLTGOFF}, implementation-data-type=ImplementationDataTypes/uint8, type-emitter=RTE
    BmwDesIninIdxRec1: category=STRUCTURE, sw-calibration-access=READ-ONLY, type-emitter=RTE
      element BmwDesIninIdx: implementation-data-type=ImplementationDataTypes/uint8
      element BmwDesIninIdxWrSts: implementation-data-type=boolean
    BmwDiagcSessionId1: compu {1=BMWDIAGCSESSIONID_DFT, 2=BMWDIAGCSESSIONID_CTRLRPROGM, 3=BMWDIAGCSESSIONID_EXTDDIAGC, 65=BMWDIAGCSESSIONID_VRNTPROGM, 68=BMWDIAGCSESSIONID_REMSWUPD, 79=BMWDIAGCSESSIONID_DEVP, 95=BMWDIAGCSESSIONID_SRVCENTRMOD, 126=BMWDIAGCSESSIONID_NXTRMFG}, implementation-data-type=ImplementationDataTypes/uint8, type-emitter=RTE
    BmwElecEngDrvSts1: compu {0=BMWELECENGDRVSTS_NOELECENGACTV, 1=BMWELECENGDRVSTS_ELECENGACTV, 3=BMWELECENGDRVSTS_INVLD}, implementation-data-type=ImplementationDataTypes/uint8, type-emitter=RTE
    BmwEngDrvSts1: compu {0=BMWENGDRVSTS_ENGSTAND, 1=BMWENGDRVSTS_ENGSTART, 2=BMWENGDRVSTS_ENGRUNNG, 3=BMWENGDRVSTS_ENGOUTL, 13=BMWENGDRVSTS_FCTIFUNAVL, 15=BMWENGDRVSTS_INVLD}, implementation-data-type=ImplementationDataTypes/uint8, type-emitter=RTE
    BmwEngStopCallSts1: compu {0=BMWENGSTOPCALLSTS_NOENGSTOPCALL, 1=BMWENGSTOPCALLSTS_ENGSTOPCALL, 3=BMWENGSTOPCALLSTS_INVLD}, implementation-data-type=ImplementationDataTypes/uint8, type-emitter=RTE
    BmwEpsFctSts1:
      compu {49=BMWEPSFCTSTS_FCTINFALLBACK, 51=BMWEPSFCTSTS_FCTINFALLBACKEMGYFCNENVTLINFLSACTV, 96=BMWEPSFCTSTS_NOTAVIERR, 128=BMWEPSFCTSTS_ININ, 160=BMWEPSFCTSTS_FCTAVIACTV12VEPS, 162=BMWEPSFCTSTS_FCTAVIACTVEMGYFCNENVTLINFLSACTV, 164=BMWEPSFCTSTS_FCTAVIACTV12VEAS, 168=BMWEPSFCTSTS_FCTAVIACTV24VEAS, 176=BMWEPSFCTSTS_FCTTMPINFALLBACK, 178=BMWEPSFCTSTS_FCTTMPINFALLBACKEMGYFCNENVTLINFLSACT, 224=BMWEPSFCTSTS_NOTAVISWDOFF, 255=BMWEPSFCTSTS_INVLD}
      implementation-data-type=ImplementationDataTypes/uint8
      type-emitter=RTE
    BmwFltLampReqSts1: compu {0=BMWFLTLAMPREQSTS_FLTLAMPRSTREQD, 1=BMWFLTLAMPREQSTS_FLTLAMPSETREQD, 3=BMWFLTLAMPREQSTS_INVLD}, implementation-data-type=ImplementationDataTypes/uint8, type-emitter=RTE
    BmwFltLampReqTyp1: compu {627=BMWFLTLAMPREQTYP_GENFLTLAMPREQD, 997=BMWFLTLAMPREQTYP_THERMLIMFLTLAMPREQD, 65534=BMWFLTLAMPREQTYP_NOFLTLAMPREQD, 65535=BMWFLTLAMPREQTYP_INVLD}, implementation-data-type=ImplementationDataTypes/uint16, type-emitter=RTE  # OBSOLETE
    BmwFltLampReqTyp2: compu {0=BMWFLTLAMPREQTYP_NOLAMP, 1=BMWFLTLAMPREQTYP_EPTI_INSPNRLVLAMP, 2=BMWFLTLAMPREQTYP_NORMWARNLAMP, 3=BMWFLTLAMPREQTYP_THERMWARNLAMP}, implementation-data-type=ImplementationDataTypes/uint16, type-emitter=RTE
    BmwMotAgSelnSt1: compu {2=BMWMOTAGSELNST_OFFSCMPD, 4=BMWMOTAGSELNST_SUBVAL, 8=BMWMOTAGSELNST_INI, 10=BMWMOTAGSELNST_TMPCMPD, 12=BMWMOTAGSELNST_OFFSCORRN, 14=BMWMOTAGSELNST_SIGINVLD, 15=BMWMOTAGSELNST_INVLD}, implementation-data-type=ImplementationDataTypes/uint8, type-emitter=RTE
    BmwNearStillVehSpdSts1: compu {12=BMWNEARSTILLVEHSPDSTS_VEHREST, 13=BMWNEARSTILLVEHSPDSTS_VEHNOTREST, 15=BMWNEARSTILLVEHSPDSTS_INVLD}, implementation-data-type=ImplementationDataTypes/uint8, type-emitter=RTE
    BmwOvrlCmdQlfr1: compu {2=BMWOVRLCMDQLFR_IMPLSP, 7=BMWOVRLCMDQLFR_SPNOTAVL, 14=BMWOVRLCMDQLFR_STBDONOTCNVSP, 15=BMWOVRLCMDQLFR_INVLDSIG}, implementation-data-type=ImplementationDataTypes/uint8, type-emitter=RTE
    BmwPwrSplySts1: compu {0=BMWPWRSPLYSTS_NOVLTGDRP, 1=BMWPWRSPLYSTS_VLTGDRPSPLYPAH1, 2=BMWPWRSPLYSTS_VLTGDRPSPLYPAH2, 3=BMWPWRSPLYSTS_PWRSPLY48VOLT, 255=BMWPWRSPLYSTS_INVLD}, implementation-data-type=ImplementationDataTypes/uint8, type-emitter=RTE
    BmwQuadOffsSts1:
      compu {0=BMWQUADOFFSSTS_ALGSLEEP, 1=BMWQUADOFFSSTS_OFFSKWN, 2=BMWQUADOFFSSTS_OFFSBYIDX, 3=BMWQUADOFFSSTS_OFFSBYMDLCOMP, 4=BMWQUADOFFSSTS_OFFSPOSNGBYSTRTSTOP, 5=BMWQUADOFFSSTS_OFFSPOSNGBYSUMCTRLAG, 6=BMWQUADOFFSSTS_OFFSINTEST, 7=BMWQUADOFFSSTS_CORROFFS, 8=BMWQUADOFFSSTS_ININ, 9=BMWQUADOFFSSTS_RSTOFFSKWN, 11=BMWQUADOFFSSTS_OFFSBYMDL, 15=BMWQUADOFFSSTS_INVLD}
      implementation-data-type=ImplementationDataTypes/uint8
      type-emitter=RTE
    BmwRackToVehCentrOffsSts1: compu {0=BMWRACKTOVEHCENTROFFSSTS_RACKTOVEHCENTRINVLD, 1=BMWRACKTOVEHCENTROFFSSTS_RACKTOVEHCENTRLRND, 2=BMWRACKTOVEHCENTROFFSSTS_RACKTOVEHCENTRUNLRND}, implementation-data-type=ImplementationDataTypes/uint8, type-emitter=RTE
    BmwRtIdx1: compu {1=BMWRTIDX_ULTRAHARD, 2=BMWRTIDX_SPTBAL, 3=BMWRTIDX_BAL, 4=BMWRTIDX_SOFT, 13=BMWRTIDX_FCTLIFNOTAVL, 14=BMWRTIDX_FCTRPTERR, 15=BMWRTIDX_INVLD}, implementation-data-type=ImplementationDataTypes/uint8, type-emitter=RTE
    BmwSetVehCentrOffsSts1: compu {0=BMWVEHCENTROFFSSTS_OFFSPRFMD, 1=BMWVEHCENTROFFSSTS_OFFSFAILD, 2=BMWVEHCENTROFFSSTS_OFFSFAILDVALOUTOFRNG}, implementation-data-type=ImplementationDataTypes/uint8, type-emitter=RTE
    BmwStrtStopMsgCmd1: compu {0=BMWSTRTSTOPMSGCMD_STOPCALL, 1=BMWSTRTSTOPMSGCMD_STOPCMD, 2=BMWSTRTSTOPMSGCMD_STRTCALL, 3=BMWSTRTSTOPMSGCMD_STRTCMD}, implementation-data-type=ImplementationDataTypes/uint8, type-emitter=RTE
    BmwTrfcJamAssiDampgStReq1: compu {1=BMWTRFCJAMASSIDAMPGSTREQ_DONOTCNVSPADDLDAMPG, 2=BMWTRFCJAMASSIDAMPGSTREQ_CNVSPADDLDAMPG, 15=BMWTRFCJAMASSIDAMPGSTREQ_INVLDSIG}, implementation-data-type=ImplementationDataTypes/uint8, type-emitter=RTE
    BmwTrfcJamAssiSt1: compu {1=BMWTRFCJAMASSIST_INACTV, 2=BMWTRFCJAMASSIST_ACTV, 15=BMWTRFCJAMASSIST_INVLD}, implementation-data-type=ImplementationDataTypes/uint8, type-emitter=RTE
    BmwVehCdn1: compu {1=BMWVEHCDN_PRKGNBNOK, 2=BMWVEHCDN_PRKGBNOK, 3=BMWVEHCDN_FCTCUSTNOTINFZG, 5=BMWVEHCDN_LVNG, 7=BMWVEHCDN_CHKDIAGCANLS, 8=BMWVEHCDN_DRVRPREPGFOROPER, 10=BMWVEHCDN_DRVG, 12=BMWVEHCDN_DRVRPREPGFOREXITOPER, 15=BMWVEHCDN_INVLD}, implementation-data-type=ImplementationDataTypes/uint8, type-emitter=RTE
    BmwVehCentrOffs1: category=STRUCTURE, sw-calibration-access=READ-ONLY, type-emitter=RTE  # OBSOLETE
      4 x element, all with category=TYPE_REFERENCE:
        BmwRackCentrToVehCentrOffs: implementation-data-type=float32
        VehCentrOffs: implementation-data-type=float32
        LongTermVehCentrCmpl: implementation-data-type=boolean
        BmwQuadRotorOffs: implementation-data-type=sint8
    BmwVehCentrOffsRec1: category=STRUCTURE, sw-calibration-access=READ-ONLY, type-emitter=RTE
      5 x element, all with category=TYPE_REFERENCE:
        BmwRackCentrToVehCentrOffs: implementation-data-type=float32
        VehCentrOffs: implementation-data-type=float32
        LongTermVehCentrCmpl: implementation-data-type=boolean
        BmwQuadRotorOffs: implementation-data-type=sint8
        RackCentrToVehCentrOffsVld: implementation-data-type=boolean
    BmwVehSpdSts1: compu {1=BMWVEHSPDSTS_VLD, 4=BMWVEHSPDSTS_SUBVALSETINUSFLSIGVEHSTANDG, 12=BMWVEHSPDSTS_SUBVALSETINUSFLSIGVEHRUNNG, 14=BMWVEHSPDSTS_SUBVALSETINUSRSIGNOINFO, 15=BMWVEHSPDSTS_INVLD}, implementation-data-type=ImplementationDataTypes/uint8, type-emitter=RTE
    BmwVltgDrpSts1: compu {0=BMWVLTGDRPSTS_NOVLTGDRP, 1=BMWVLTGDRPSTS_STRTVLTGDRPTOMAXVLTGTHD1, 2=BMWVLTGDRPSTS_STRTVLTGDRPTOMAXVLTGTHD2, 13=BMWVLTGDRPSTS_FCTIFUNAVL, 15=BMWVLTGDRPSTS_INVLD}, implementation-data-type=ImplementationDataTypes/uint8, type-emitter=RTE
    CalCopySts1: compu {0=CALCOPYSTS_NOTRDY, 1=CALCOPYSTS_COPYPNDING, 2=CALCOPYSTS_COPYCMPL, 3=CALCOPYSTS_PROCERR}, implementation-data-type=ImplementationDataTypes/uint8, type-emitter=RTE
    CrcHwResvCfg1: compu {0=CRCHWRESVCFG_32BITCRC32BITWIDTH, 1=CRCHWRESVCFG_32BITCRC16BITWIDTH, 2=CRCHWRESVCFG_32BITCRC8BITWIDTH, 3=CRCHWRESVCFG_16BITCRC16BITWIDTH, 4=CRCHWRESVCFG_16BITCRC8BITWIDTH, 5=CRCHWRESVCFG_8BITCRC, 6=CRCHWRESVCFG_8BITCRCH2F}, implementation-data-type=ImplementationDataTypes/uint8, type-emitter=RTE
    CrcHwResvMod1: compu {0=CRCHWRESVMOD_RELS, 1=CRCHWRESVMOD_RESV}, implementation-data-type=ImplementationDataTypes/uint8, type-emitter=RTE
    CrcHwSts1: compu {0=CRCHWSTS_NOTAVL, 1=CRCHWSTS_AVL, 2=CRCHWSTS_BUSY, 3=CRCHWSTS_NOTENAD, 4=CRCHWSTS_RESV, 255=CRCHWSTS_IDXINVLD}, implementation-data-type=ImplementationDataTypes/uint8, type-emitter=RTE
    CrcHwStsRec1: category=STRUCTURE, sw-calibration-access=READ-ONLY, type-emitter=RTE  # OBSOLETE
      element TaskId: implementation-data-type=ImplementationDataTypes/uint16
      element CrcHwSts: implementation-data-type=CrcHwSts1
    CrcHwStsRec2: category=STRUCTURE, sw-calibration-access=READ-ONLY, type-emitter=RTE
      element TaskId: implementation-data-type=uint32
      element CrcHwSts: implementation-data-type=CrcHwSts1
    CurrMeasEolGainCal3PhaRec1: category=STRUCTURE, sw-calibration-access=READ-ONLY, type-emitter=RTE
      element CurrMeasMotCurrEolGainA: implementation-data-type=float32
      element CurrMeasMotCurrEolGainB: implementation-data-type=float32
      element CurrMeasMotCurrEolGainC: implementation-data-type=float32
      symbol props CurrMeasEolGainCal3PhaRec1
    CurrMeasEolGainCalBrdgRec1: category=STRUCTURE, sw-calibration-access=READ-ONLY, type-emitter=RTE
      element CurrMeasMotCurrEolGainA: implementation-data-type=float32
      element CurrMeasMotCurrEolGainB: implementation-data-type=float32
      symbol props CurrMeasEolGainCalBrdgRec1
    CurrMeasEolGainCalRec1: category=STRUCTURE, sw-calibration-access=READ-ONLY, type-emitter=RTE
      6 x element, all with category=TYPE_REFERENCE, implementation-data-type=float32:
        CurrMeasMotCurrEolGainA
        CurrMeasMotCurrEolGainB
        CurrMeasMotCurrEolGainC
        CurrMeasMotCurrEolGainD
        CurrMeasMotCurrEolGainE
        CurrMeasMotCurrEolGainF
      symbol props CurrMeasEolGainCalRec1
    CurrMeasEolOffsCal3PhaRec1: category=STRUCTURE, sw-calibration-access=READ-ONLY, type-emitter=RTE
      7 x element, all with category=TYPE_REFERENCE, implementation-data-type=float32:
        CurrMeasEolOffsHiBrdgVltg
        CurrMeasMotCurrEolOffsDifA
        CurrMeasMotCurrEolOffsDifB
        CurrMeasMotCurrEolOffsDifC
        CurrMeasMotCurrOffsLoAvrgA
        CurrMeasMotCurrOffsLoAvrgB
        CurrMeasMotCurrOffsLoAvrgC
      symbol props CurrMeasEolOffsCal3PhaRec1
    CurrMeasEolOffsCalBrdgRec1: category=STRUCTURE, sw-calibration-access=READ-ONLY, type-emitter=RTE
      5 x element, all with category=TYPE_REFERENCE, implementation-data-type=float32:
        CurrMeasEolOffsHiBrdgVltg
        CurrMeasMotCurrEolOffsDifA
        CurrMeasMotCurrEolOffsDifB
        CurrMeasMotCurrOffsLoAvrgA
        CurrMeasMotCurrOffsLoAvrgB
      symbol props CurrMeasEolOffsCalBrdgRec1
    CurrMeasEolOffsCalRec1: category=STRUCTURE, sw-calibration-access=READ-ONLY, type-emitter=RTE
      13 x element, all with category=TYPE_REFERENCE, implementation-data-type=float32:
        CurrMeasEolOffsHiBrdgVltg
        CurrMeasMotCurrEolOffsDifA
        CurrMeasMotCurrEolOffsDifB
        CurrMeasMotCurrEolOffsDifC
        CurrMeasMotCurrEolOffsDifD
        CurrMeasMotCurrEolOffsDifE
        CurrMeasMotCurrEolOffsDifF
        CurrMeasMotCurrOffsLoAvrgA
        CurrMeasMotCurrOffsLoAvrgB
        CurrMeasMotCurrOffsLoAvrgC
        CurrMeasMotCurrOffsLoAvrgD
        CurrMeasMotCurrOffsLoAvrgE
        CurrMeasMotCurrOffsLoAvrgF
      symbol props CurrMeasEolOffsCalRec1
    CurrMeasEolOffsGainCalRec1: category=STRUCTURE, sw-calibration-access=READ-ONLY, type-emitter=RTE
      6 x element, all with category=TYPE_REFERENCE, implementation-data-type=float32:
        CurrMeasMotCurrOffsZeroAvrgA
        CurrMeasMotCurrOffsZeroAvrgB
        CurrMeasMotCurrOffsZeroAvrgC
        CurrMeasMotCurrEolGainA
        CurrMeasMotCurrEolGainB
        CurrMeasMotCurrEolGainC
      symbol props CurrMeasEolOffsGainCalRec1
    DrvgDynIfSt1: compu {32=DRVGDYNIFST_IFAVLRDYFOROPERWOADDLDAMPG, 33=DRVGDYNIFST_IFACTVADDLDAMPGNOTAVL, 34=DRVGDYNIFST_IFAVLRDYFOROPERADDLDAMPG, 35=DRVGDYNIFST_IFACTVADDLDAMPGAVL, 96=DRVGDYNIFST_SRVNOTAVLERR, 128=DRVGDYNIFST_IFINID, 224=DRVGDYNIFST_SRVNOTAVLSTBPMA, 225=DRVGDYNIFST_SRVNOTAVLSTBEPSSTS, 255=DRVGDYNIFST_INVLDSIG}, implementation-data-type=ImplementationDataTypes/uint8, type-emitter=RTE
    DutyCycExcddDataRec1: category=STRUCTURE, sw-calibration-access=READ-ONLY, type-emitter=RTE
      element ExcddCnt: implementation-data-type=ImplementationDataTypes/uint8
      element IgnCnt: implementation-data-type=ImplementationDataTypes/uint8
      symbol props DutyCycExcddDataRec1
    DutyCycThermProtnFilStValRec1: category=STRUCTURE, sw-calibration-access=READ-ONLY, type-emitter=RTE
      4 x element, all with category=TYPE_REFERENCE, implementation-data-type=ImplementationDataTypes/uint8:
        Fil{3..6}StVal
      symbol props DutyCycThermProtnFilStValRec1
    EgyModSt1: compu {0=EGYMODST_NORM, 1=EGYMODST_PRDN, 2=EGYMODST_TRANSPT, 3=EGYMODST_FLS}, implementation-data-type=ImplementationDataTypes/uint8, type-emitter=RTE
    EOLGainOffs1: category=STRUCTURE, sw-calibration-access=READ-ONLY, type-emitter=RTE
      19 x element, all with category=TYPE_REFERENCE, implementation-data-type=float32:
        CurrMeasEolOffsHiBrdgVltg
        CurrMeasMotCurrEolGainA
        CurrMeasMotCurrEolGainB
        CurrMeasMotCurrEolGainC
        CurrMeasMotCurrEolGainD
        CurrMeasMotCurrEolGainE
        CurrMeasMotCurrEolGainF
        CurrMeasMotCurrEolOffsDifA
        CurrMeasMotCurrEolOffsDifB
        CurrMeasMotCurrEolOffsDifC
        CurrMeasMotCurrEolOffsDifD
        CurrMeasMotCurrEolOffsDifE
        CurrMeasMotCurrEolOffsDifF
        CurrMeasMotCurrOffsLoAvrgA
        CurrMeasMotCurrOffsLoAvrgB
        CurrMeasMotCurrOffsLoAvrgC
        CurrMeasMotCurrOffsLoAvrgD
        CurrMeasMotCurrOffsLoAvrgE
        CurrMeasMotCurrOffsLoAvrgF
      symbol props EOLGainOffs1
    EotNvmDataRec1: category=STRUCTURE, sw-calibration-access=READ-ONLY, type-emitter=RTE
      4 x element, all with category=TYPE_REFERENCE:
        CwEot: implementation-data-type=float32
        CcwEot: implementation-data-type=float32
        CwEotDetd: implementation-data-type=boolean
        CcwEotDetd: implementation-data-type=boolean
    EotSt1: compu {0=EOTST_DISAD, 1=EOTST_NORM, 2=EOTST_ENTR, 3=EOTST_EXIT}, implementation-data-type=ImplementationDataTypes/uint8, type-emitter=RTE
    FilHpRec1: category=STRUCTURE, sw-calibration-access=READ-ONLY, type-emitter=NxtrFil
      element FilLpRec: implementation-data-type=FilLpRec1
      element CorrnFac: implementation-data-type=float32
    FilLpRec1: category=STRUCTURE, sw-calibration-access=READ-ONLY, type-emitter=NxtrFil
      element FilSt: implementation-data-type=float32
      element FilGain: implementation-data-type=float32
      symbol props FilLpRec1
    FilNotchGainRec1: category=STRUCTURE, sw-calibration-access=READ-ONLY, type-emitter=RTE
      5 x element, all with category=TYPE_REFERENCE, implementation-data-type=float32:
        FilGainB{0..2}
        FilGainA1
        FilGainA2
    FilNotchStRec1: category=STRUCTURE, sw-calibration-access=READ-ONLY, type-emitter=RTE
      element FilSt1: implementation-data-type=float32
      element FilSt2: implementation-data-type=float32
    FordEpsLifeCycMod1: compu {0=Norm, 1=Factry, 2=Transpt}, implementation-data-type=ImplementationDataTypes/uint8, type-emitter=RTE
    FordVehWhlDirRaw1: compu {0=FORDVEHWHLDIRRAW_FWD, 1=FORDVEHWHLDIRRAW_BACKW, 2=FORDVEHWHLDIRRAW_UKWN, 3=FORDVEHWHLDIRRAW_FAILD}, implementation-data-type=ImplementationDataTypes/uint8, type-emitter=RTE
    GetSegMod1: compu {0=GETSEGMOD_ADRINFO, 1=GETSEGMOD_STDINFO, 2=GETSEGMOD_ADRMPG}, implementation-data-type=ImplementationDataTypes/uint8, type-emitter=RTE
    GmAutnmsDrvgIfFltRespDi1: compu {0=GMAUTNMSDRVGIFFLTRESPDI_TMPINHBD, 1=GMAUTNMSDRVGIFFLTRESPDI_NORM, 2=GMAUTNMSDRVGIFFLTRESPDI_FAILD}, implementation-data-type=ImplementationDataTypes/uint8, type-emitter=RTE
    GmAutnmsSteerCmdSts1: compu {0=GMAUTNMSSTEERCMDSTS_UKWN, 1=GMAUTNMSSTEERCMDSTS_TMPINHBD, 2=GMAUTNMSSTEERCMDSTS_RDY, 3=GMAUTNMSSTEERCMDSTS_ACTV, 4=GMAUTNMSSTEERCMDSTS_TMPLIMD, 5=GMAUTNMSSTEERCMDSTS_EMGYSTEERPROF, 6=GMAUTNMSSTEERCMDSTS_FAILD}, implementation-data-type=ImplementationDataTypes/uint8, type-emitter=RTE
    GmBackUpSysPwrModAuthentd1: compu {0=GMBACKUPSYSPWRMODAUTHENTD_OFF, 1=GMBACKUPSYSPWRMODAUTHENTD_ACSY, 2=GMBACKUPSYSPWRMODAUTHENTD_RUN, 3=GMBACKUPSYSPWRMODAUTHENTD_PRPN, 4=GMBACKUPSYSPWRMODAUTHENTD_STRTREQ}, implementation-data-type=ImplementationDataTypes/uint8, type-emitter=RTE
    GmDrvrIntvDetnSt1: compu {0=GMDRVRINTVDETNST_ININ, 1=GMDRVRINTVDETNST_TRUE, 2=GMDRVRINTVDETNST_FALSE, 3=GMDRVRINTVDETNST_DISAD}, implementation-data-type=ImplementationDataTypes/uint8, type-emitter=RTE
    GmDualEcuOperSts1: compu {0=GMDUALECUOPERSTS_ININ, 1=GMDUALECUOPERSTS_FAILOPER, 2=GMDUALECUOPERSTS_SNGCTRLR, 3=GMDUALECUOPERSTS_FAILD}, implementation-data-type=ImplementationDataTypes/uint8, type-emitter=RTE
    GmEscSysStsAuthentdSt1: compu {0=GMESCSYSSTSAUTHENTDST_NORMOPER, 1=GMESCSYSSTSAUTHENTDST_FAILD, 2=GMESCSYSSTSAUTHENTDST_INIT, 3=GMESCSYSSTSAUTHENTDST_ENHDOPER, 4=GMESCSYSSTSAUTHENTDST_DRVRDI}, implementation-data-type=ImplementationDataTypes/uint8, type-emitter=RTE
    GmFctDiArbnSts1: compu {0=GMFCTDIARBNSTS_WAIT, 1=GMFCTDIARBNSTS_INPROC, 2=GMFCTDIARBNSTS_PASSD, 3=GMFCTDIARBNSTS_SWBASDMTGTNFAIL, 4=GMFCTDIARBNSTS_TIMEOUTFAIL}, implementation-data-type=ImplementationDataTypes/uint8, type-emitter=RTE
    GmOvrlFeatActvSt1: compu {0=GMOVRLFEATACTVST_NONE, 1=GMOVRLFEATACTVST_ESC, 2=GMOVRLFEATACTVST_APA, 3=GMOVRLFEATACTVST_LKA, 4=GMOVRLFEATACTVST_LCC, 5=GMOVRLFEATACTVST_TRFCJAMASSI, 6=GMOVRLFEATACTVST_HOLF}, implementation-data-type=ImplementationDataTypes/uint8, type-emitter=RTE
    GmOvrlStMgrApaSt1: compu {0=GMOVRLSTMGRAPAST_TMPINHB, 1=GMOVRLSTMGRAPAST_AVLCTRL, 2=GMOVRLSTMGRAPAST_ACTV, 3=GMOVRLSTMGRAPAST_PRMNTFAILD, 4=GMOVRLSTMGRAPAST_MFGDI}, implementation-data-type=ImplementationDataTypes/uint8, type-emitter=RTE
    GmOvrlStMgrHandsOnLaneFolwgSt1: compu {0=GMOVRLSTMGRHANDSONLANEFOLWGST_TMPINHB, 1=GMOVRLSTMGRHANDSONLANEFOLWGST_AVLCTRL, 2=GMOVRLSTMGRHANDSONLANEFOLWGST_ACTV, 3=GMOVRLSTMGRHANDSONLANEFOLWGST_PRMNTFAILD, 4=GMOVRLSTMGRHANDSONLANEFOLWGST_MFGDI}, implementation-data-type=ImplementationDataTypes/uint8, type-emitter=RTE
    GmOvrlStMgrHaptcSt1: compu {0=GMOVRLSTMGRHAPTCST_INACTVNOTPLS, 1=GMOVRLSTMGRHAPTCST_ACTVPLS, 2=GMOVRLSTMGRHAPTCST_WAITAFTPLS, 3=GMOVRLSTMGRHAPTCST_INACTVRDYPLS, 4=GMOVRLSTMGRHAPTCST_DI}, implementation-data-type=ImplementationDataTypes/uint8, type-emitter=RTE
    GmOvrlStMgrTrfcJamAssiSt1: compu {0=GMOVRLSTMGRTRFCJAMASSIST_TMPINHB, 1=GMOVRLSTMGRTRFCJAMASSIST_AVLCTRL, 2=GMOVRLSTMGRTRFCJAMASSIST_ACTV, 3=GMOVRLSTMGRTRFCJAMASSIST_PRMNTFAILD, 4=GMOVRLSTMGRTRFCJAMASSIST_MFGDI}, implementation-data-type=ImplementationDataTypes/uint8, type-emitter=RTE
    GmRxMonrdSig1: compu {0=GMRXMONRDSIG_DISAD, 1=GMRXMONRDSIG_UNINID, 2=GMRXMONRDSIG_UNAVL, 3=GMRXMONRDSIG_AVL}, implementation-data-type=ImplementationDataTypes/uint8, type-emitter=RTE
    GmSecuAcsFlg1:
      compu {0=GMSECUACSFLG_DIAGCCTRLMGRSECULVLLOCKD, 1=GMSECUACSFLG_DIAGCCTRLMGRSECULVL1, 2=GMSECUACSFLG_DIAGCCTRLMGRSECULVL2, 3=GMSECUACSFLG_DIAGCCTRLMGRSECULVL3, 5=GMSECUACSFLG_DIAGCCTRLMGRSECULVL5, 6=GMSECUACSFLG_DIAGCCTRLMGRSECULVL6, 7=GMSECUACSFLG_DIAGCCTRLMGRSECULVL7, 9=GMSECUACSFLG_DIAGCCTRLMGRSECULVL9, 10=GMSECUACSFLG_DIAGCCTRLMGRSECULVL10, 11=GMSECUACSFLG_DIAGCCTRLMGRSECULVL11}
      implementation-data-type=ImplementationDataTypes/uint8
      type-emitter=RTE
    GmSteerAgCtrlDiSt1: compu-method=GmSteerAgCtrlDiSt1, implementation-data-type=ImplementationDataTypes/uint8, type-emitter=RTE
    GmSteerCmdLimrSt1: compu {0=GMSTEERCMDLIMRST_UKWN, 1=GMSTEERCMDLIMRST_NORM, 2=GMSTEERCMDLIMRST_SFTYLIMEXCDD, 3=GMSTEERCMDLIMRST_THERM, 4=GMSTEERCMDLIMRST_VLTG, 5=GMSTEERCMDLIMRST_LSH, 6=GMSTEERCMDLIMRST_FRICLIMD, 7=GMSTEERCMDLIMRST_ECUFLTLIMD}, implementation-data-type=ImplementationDataTypes/uint8, type-emitter=RTE
    GmSteerCmdMsgSrc1: compu {0=GMSTEERCMDMSGSRC_PRIMCTRLR, 1=GMSTEERCMDMSGSRC_RDNTCTRLR, 2=GMSTEERCMDMSGSRC_DUALECUFAILD}, implementation-data-type=ImplementationDataTypes/uint8, type-emitter=RTE
    GmSteerCmdMsgSts1: compu {0=GMSTEERCMDMSGSTS_NORMCOM, 1=GMSTEERCMDMSGSTS_PRIMCOMFAILD, 2=GMSTEERCMDMSGSTS_RDNTCOMFAILD, 3=GMSTEERCMDMSGSTS_DUALECUCOMFAILD}, implementation-data-type=ImplementationDataTypes/uint8, type-emitter=RTE
    GmSteerMod1: compu {0=GMSTEERMOD_BASEPS, 1=GMSTEERMOD_SEMIATNMS, 2=GMSTEERMOD_FULLYATNMS}, implementation-data-type=ImplementationDataTypes/uint8, type-emitter=RTE
    GmSteerPrfmncModReq1: compu {0=GMSTEERPRFMNCMODREQ_NOACTN, 1=GMSTEERPRFMNCMODREQ_NORM, 2=GMSTEERPRFMNCMODREQ_SPT, 3=GMSTEERPRFMNCMODREQ_CMFT, 4=GMSTEERPRFMNCMODREQ_LANE, 5=GMSTEERPRFMNCMODREQ_TOW, 6=GMSTEERPRFMNCMODREQ_CITY, 7=GMSTEERPRFMNCMODREQ_PRFMNCMOD7}, implementation-data-type=ImplementationDataTypes/uint8, type-emitter=RTE
    GmSteerReqArbdFeatAuthentdSt1: compu {0=GMSTEERREQARBDFEATAUTHENTD_CAS, 1=GMSTEERREQARBDFEATAUTHENTD_TRFCJAMASSI, 2=GMSTEERREQARBDFEATAUTHENTD_LCC, 3=GMSTEERREQARBDFEATAUTHENTD_HOLF, 4=GMSTEERREQARBDFEATAUTHENTD_SAA, 5=GMSTEERREQARBDFEATAUTHENTD_LKA, 6=GMSTEERREQARBDFEATAUTHENTD_LCOD, 7=GMSTEERREQARBDFEATAUTHENTD_LCP}, implementation-data-type=ImplementationDataTypes/uint8, type-emitter=RTE
    GmSteerReqStsAuthentdSt1: compu {0=GMSTEERREQSTSAUTHENTDST_UKWN, 1=GMSTEERREQSTSAUTHENTDST_ACTV, 2=GMSTEERREQSTSAUTHENTDST_INACTV}, implementation-data-type=ImplementationDataTypes/uint8, type-emitter=RTE
    GmSysDataCollctnEnaSt1: compu {0=GMSYSDATACOLLCTNENAST_NOTENAD, 1=GMSYSDATACOLLCTNENAST_SERLCOMENAD, 2=GMSYSDATACOLLCTNENAST_ADASENAD, 3=GMSYSDATACOLLCTNENAST_VEHHLTHSTMGRENAD, 4=GMSYSDATACOLLCTNENAST_NTCENAD}, implementation-data-type=ImplementationDataTypes/uint8, type-emitter=RTE
    GmSysPwrMod1: compu {0=GMSYSPWRMOD_OFF, 1=GMSYSPWRMOD_ACSY, 2=GMSYSPWRMOD_RUN, 3=GMSYSPWRMOD_CRK, 4=GMSYSPWRMOD_PRPN}, implementation-data-type=ImplementationDataTypes/uint8, type-emitter=RTE
    GmSysPwrModAuthentd1: compu {0=GMSYSPWRMODAUTHENTD_OFF, 1=GMSYSPWRMODAUTHENTD_ACSY, 2=GMSYSPWRMODAUTHENTD_RUN, 3=GMSYSPWRMODAUTHENTD_STRTREQ, 4=GMSYSPWRMODAUTHENTD_PRPN}, implementation-data-type=ImplementationDataTypes/uint8, type-emitter=RTE
    GmTqArbnEscSt1: compu {0=GMTQARBNESCST_INACTV, 1=GMTQARBNESCST_ACTV, 2=GMTQARBNESCST_TMPLIMD, 3=GMTQARBNESCST_PRMNTFAILD, 4=GMTQARBNESCST_MFGDI}, implementation-data-type=ImplementationDataTypes/uint8, type-emitter=RTE
    GmTqArbnLkaSt1: compu {0=GMTQARBNLKAST_INACTV, 1=GMTQARBNLKAST_ACTV, 2=GMTQARBNLKAST_TMPLIMD, 3=GMTQARBNLKAST_PRMNTFAILD, 4=GMTQARBNLKAST_MFGDI}, implementation-data-type=ImplementationDataTypes/uint8, type-emitter=RTE
    GmTqArbnTrfcJamAssiSt1: compu {0=GMTQARBNTRFCJAMASSIST_INACTV, 1=GMTQARBNTRFCJAMASSIST_ACTV, 2=GMTQARBNTRFCJAMASSIST_TMPLIMD, 3=GMTQARBNTRFCJAMASSIST_PRMNTFAILD, 4=GMTQARBNTRFCJAMASSIST_MFGDI}, implementation-data-type=ImplementationDataTypes/uint8, type-emitter=RTE
    GmTrsmShiftLvrPosnAuthentd1:
      compu {0=GMTRSMSHIFTLVRPOSNAUTHENTD_BTWNRNG, 1=GMTRSMSHIFTLVRPOSNAUTHENTD_PARKRNG, 2=GMTRSMSHIFTLVRPOSNAUTHENTD_RVSRNG, 3=GMTRSMSHIFTLVRPOSNAUTHENTD_NEUTRNG, 4=GMTRSMSHIFTLVRPOSNAUTHENTD_FWDRNGA, 5=GMTRSMSHIFTLVRPOSNAUTHENTD_FWDRNGB, 6=GMTRSMSHIFTLVRPOSNAUTHENTD_FWDRNGC, 7=GMTRSMSHIFTLVRPOSNAUTHENTD_FWDRNGD, 8=GMTRSMSHIFTLVRPOSNAUTHENTD_FWDRNGE, 9=GMTRSMSHIFTLVRPOSNAUTHENTD_FWDRNGF, 10=GMTRSMSHIFTLVRPOSNAUTHENTD_FWDRNGG, 11=GMTRSMSHIFTLVRPOSNAUTHENTD_FWDRNGH, 12=GMTRSMSHIFTLVRPOSNAUTHENTD_FWDRNGI, 13=GMTRSMSHIFTLVRPOSNAUTHENTD_FWDRNGJ, 14=GMTRSMSHIFTLVRPOSNAUTHENTD_LVRPOSNUNKWN}
      implementation-data-type=ImplementationDataTypes/uint8
      type-emitter=RTE
    GmVehHlthMgrSt1: compu {0=GMVEHHLTHMGRST_ININ, 1..5=GMVEHHLTHMGRST_DEGRADEDMOD1..GMVEHHLTHMGRST_DEGRADEDMOD5, 6=GMVEHHLTHMGRST_NORMOPER}, implementation-data-type=ImplementationDataTypes/uint8, type-emitter=RTE
    GmVehModMgrSt1: compu {0=GMVEHMODMGRST_UKWN, 1=GMVEHMODMGRST_MAN, 2=GMVEHMODMGRST_AUTNMSSUPVD, 3=GMVEHMODMGRST_SUPVROVRD, 4=GMVEHMODMGRST_AUTNMSUNSUPVD, 5=GMVEHMODMGRST_FAILD}, implementation-data-type=ImplementationDataTypes/uint8, type-emitter=RTE
    HwAgOffsRec1: category=STRUCTURE, sw-calibration-access=READ-ONLY, type-emitter=RTE
      element OffsTrim: implementation-data-type=float32
      element OffsTrimPrfmdSts: implementation-data-type=boolean
    HwAgSnsrTrimRec1: category=STRUCTURE, sw-calibration-access=READ-ONLY, type-emitter=RTE
      element TrimVal: implementation-data-type=float32
      element TrimPrfmd: implementation-data-type=boolean
    HwAgSnsrTyp1: compu {0=HWAGSNSRTYP_NOSNSR, 1=HWAGSNSRTYP_A1335}, implementation-data-type=ImplementationDataTypes/uint8, type-emitter=RTE
    HwAgTrajCmdSt1: compu {0=HWAGTRAJCMDST_WAIT, 1=HWAGTRAJCMDST_HWAGA, 2=HWAGTRAJCMDST_CONVEL, 3=HWAGTRAJCMDST_HWAGDECEL, 4=HWAGTRAJCMDST_HLD}, implementation-data-type=ImplementationDataTypes/uint16, type-emitter=RTE
    HwTqOffsRec1: category=STRUCTURE, sw-calibration-access=READ-ONLY, type-emitter=RTE
      element OffsTrim: implementation-data-type=float32
      element OffsTrimPrfmdSts: implementation-data-type=boolean
    ImcArbnRxDataSrc1: implementation-data-type=ImcArbnRxDataSrc2, type-emitter=RTE
    ImcArbnRxDataSrc2: implementation-data-type=ImplementationDataTypes/uint8, type-emitter=ImcArbn
    ImcArbnRxExtdSts1: implementation-data-type=ImcArbnRxExtdSts2, type-emitter=RTE
    ImcArbnRxExtdSts2: implementation-data-type=ImplementationDataTypes/uint8, type-emitter=ImcArbn
    ImcArbnRxSts1: compu {0=IMCARBNRXSTS_NODATA, 1=IMCARBNRXSTS_VLD, phys=raw for raw 2}, implementation-data-type=ImplementationDataTypes/uint8, type-emitter=RTE
    IvtrFetFltPha1: compu {0=IVTRFETFLTPHA_NOPHASNGFETFLT, 1=IVTRFETFLTPHA_PHAASNGFETFLT, 2=IVTRFETFLTPHA_PHABSNGFETFLT, 4=IVTRFETFLTPHA_PHACSNGFETFLT}, implementation-data-type=ImplementationDataTypes/uint8, type-emitter=RTE
    IvtrFetFltTyp1: compu {0=IVTRFETFLTTYP_NOFETFLT, 1=IVTRFETFLTTYP_LOWRFETFLT, 2=IVTRFETFLTTYP_UPPRFETFLT, 4=IVTRFETFLTTYP_MPLFETFLT}, implementation-data-type=ImplementationDataTypes/uint8, type-emitter=RTE
    LoaSt1: compu {0=LOAST_NORM, 1=LOAST_LIMD, 2=LOAST_SWBASDMTGTN, 3=LOAST_FADEOUT, 4=LOAST_CTRLDSHTDWNREQD, 5=LOAST_IMDTSHTDWNREQD}, implementation-data-type=ImplementationDataTypes/uint8, type-emitter=RTE
    LrndRackCentrNvmRec1: category=STRUCTURE, sw-calibration-access=READ-ONLY, type-emitter=RTE
      5 x element, all with category=TYPE_REFERENCE:
        TotRackTrvl: implementation-data-type=float32
        RackCentrMotDeg: implementation-data-type=float32
        RackCentrMotRev: implementation-data-type=sint16
        LongTermRackCentrCmpl: implementation-data-type=boolean
        MotAgVld: implementation-data-type=boolean
    MaxHwAgCwAndCcwRec2: category=STRUCTURE, sw-calibration-access=READ-ONLY, type-emitter=RTE
      element HwAgCcwMax: implementation-data-type=float32
      element HwAgCwMax: implementation-data-type=float32
      element HwAgOverTrvlCnt: implementation-data-type=ImplementationDataTypes/uint8
    MfgEnaSt1: compu {0=MFGENAST_PRDNMOD, 1=MFGENAST_MFGMOD, 2=MFGENAST_TESTMOD}, implementation-data-type=ImplementationDataTypes/uint8, type-emitter=RTE
    MotAgEolPrmRec1: category=STRUCTURE, sw-calibration-access=READ-ONLY, type-emitter=RTE
      12 x element, all with category=TYPE_REFERENCE:
        SinOffs: implementation-data-type=u3p13
        CosOffs: implementation-data-type=u3p13
        SinAmpRecpr: implementation-data-type=u3p13
        CosAmpRecpr: implementation-data-type=u3p13
        SinDelta: implementation-data-type=s2p13
        SinHrmncTbl: implementation-data-type=Ary1D_sm6p13_144
        CosHrmncTbl: implementation-data-type=Ary1D_sm6p13_144
        SinGainCorrd: implementation-data-type=u1p15
        CosGainCorrd: implementation-data-type=u1p15
        SinOffsCorrd: implementation-data-type=s2p13
        CosOffsCorrd: implementation-data-type=s2p13
        CosDeltaRecpr: implementation-data-type=u3p13
    MotAgMeasEolPrmRec1: category=STRUCTURE, sw-calibration-access=READ-ONLY, type-emitter=RTE
      5 x element, all with category=TYPE_REFERENCE, implementation-data-type=float32:
        SinOffs
        CosOffs
        SinAmpRecpr
        CosAmpRecpr
        SinDelta
    MotAgRtPrmRec1: category=STRUCTURE, sw-calibration-access=READ-ONLY, type-emitter=RTE
      14 x element, all with category=TYPE_REFERENCE, implementation-data-type=float32:
        SinRtOffs
        SinRtAmpRecpr
        CosRtOffs
        CosRtAmpRecpr
        SinGainCorrd
        CosGainCorrd
        SinOffsCorrd
        CosOffsCorrd
        CosSinNomRatio
        SinCosNomRatio
        RtToNomRatioLoLim
        RtToNomRatioHiLim
        PrevSinRtOffs
        PrevCosRtOffs
    MotAgSnsrCfgSt1: compu {0=MOTAGSNSRCFGST_RSTERR, 1=MOTAGSNSRCFGST_RSTTURNCNTR, 2=MOTAGSNSRCFGST_CMDTRANSPT}, implementation-data-type=ImplementationDataTypes/uint8, type-emitter=RTE
    MotAgSnsrIninSt1: compu {0=MOTAGSNSRININST_MOTAGININDATAREQ, 1=MOTAGSNSRININST_MOTAGININDATAREAD, 2=MOTAGSNSRININST_MOTAGMODREQ, 3=MOTAGSNSRININST_MOTAGCFGCRCCHK, 4=MOTAGSNSRININST_MOTAGCFGSEQFAIL, 5=MOTAGSNSRININST_MOTAGRTDATAREQ}, implementation-data-type=ImplementationDataTypes/uint8, type-emitter=RTE
    MotAgStVariRec1: category=STRUCTURE, sw-calibration-access=READ-ONLY, type-emitter=RTE
      4 x element, all with category=TYPE_REFERENCE, implementation-data-type=float32:
        MotAgSinMax
        MotAgSinMin
        MotAgCosMax
        MotAgCosMin
    MotCurrEolCalSt2: compu {0=MCECS_OFFSCMDSTRT, 1=MCECS_OFFSCMDHI, 2=MCECS_OFFSCMDLO, 3=MCECS_OFFSCMDZERO, 4=MCECS_OFFSCMDEND, 5=MCECS_GAINCMDAD, 6=MCECS_GAINCMDBE, 7=MCECS_GAINCMDCF, 8=MCECS_CMDSAFEST}, implementation-data-type=ImplementationDataTypes/uint8, type-emitter=RTE
    MotPrmNomEolRec3: category=STRUCTURE, sw-calibration-access=READ-ONLY, type-emitter=RTE
      element MotBackEmfConNom: implementation-data-type=float32
      element MotRNom: implementation-data-type=float32
      symbol props MotPrmNomEolRec3
    MotQuad1: compu {1..4=MOTQUAD_QUAD1..MOTQUAD_QUAD4}, implementation-data-type=ImplementationDataTypes/uint8, type-emitter=RTE
    MotRplCoggPrmRec2: category=STRUCTURE, sw-calibration-access=READ-ONLY, type-emitter=RTE
      9 x element, all with category=TYPE_REFERENCE:
        CoggOrder1: implementation-data-type=ImplementationDataTypes/uint16
        CoggOrder1X: implementation-data-type=s1p14
        CoggOrder1Y: implementation-data-type=s1p14
        CoggOrder2: implementation-data-type=ImplementationDataTypes/uint16
        CoggOrder2X: implementation-data-type=s1p14
        CoggOrder2Y: implementation-data-type=s1p14
        CoggOrder3: implementation-data-type=ImplementationDataTypes/uint16
        CoggOrder3X: implementation-data-type=s1p14
        CoggOrder3Y: implementation-data-type=s1p14
    NtcFltInfoRec2: category=STRUCTURE, sw-calibration-access=READ-ONLY, type-emitter=RTE
      element NtcNr: implementation-data-type=NtcNrWithResd1
      element AgiCntr: implementation-data-type=ImplementationDataTypes/uint8
      element Sts: implementation-data-type=ImplementationDataTypes/uint8
    NtcInfoRec4: category=STRUCTURE, sw-calibration-access=READ-ONLY, type-emitter=DiagcMgr
      element NtcStInfo: implementation-data-type=ImplementationDataTypes/uint8
      element Sts: implementation-data-type=ImplementationDataTypes/uint8
      element AgiCntr: implementation-data-type=ImplementationDataTypes/uint8
    NtcNr1: compu {1..511=NTCNR_0X001..NTCNR_0X1FF}, implementation-data-type=ImplementationDataTypes/uint16, type-emitter=RTE
    NtcNrWithResd1: compu {0=NTCNR_RESD, 1..511=NTCNR_0X001..NTCNR_0X1FF}, implementation-data-type=ImplementationDataTypes/uint16, type-emitter=RTE
    NtcSts1: compu {0=NTCSTS_PASSD, 1=NTCSTS_FAILD, 2=NTCSTS_PREPASSD, 3=NTCSTS_PREFAILD}, implementation-data-type=ImplementationDataTypes/uint8, type-emitter=RTE
    PassFailCntrDiagcRec1: category=STRUCTURE, sw-calibration-access=READ-ONLY, type-emitter=RTE
      5 x element, all with category=TYPE_REFERENCE:
        Cntr: implementation-data-type=float32
        Thd: implementation-data-type=float32
        NegStep: implementation-data-type=float32
        PosStep: implementation-data-type=float32
        Sts: implementation-data-type=SigQlfr1
    PhaDiscnctPwmVect1: compu {0=PHADISCNCTPWMVECT_NOCMD, 1=PHADISCNCTPWMVECT_PHAACMD, 2=PHADISCNCTPWMVECT_PHABCMD, 4=PHADISCNCTPWMVECT_PHACCMD}, implementation-data-type=ImplementationDataTypes/uint8, type-emitter=RTE
    PwrDiscnctSts1: compu {0=PWRDISCNCTSTS_WAITFORSTRTA, 1=PWRDISCNCTSTS_VRFYDISCNCTOPEN, 2=PWRDISCNCTSTS_WAITFORSTRTB, 3=PWRDISCNCTSTS_VRFYCLS, 4=PWRDISCNCTSTS_SEQFAIL, 5=PWRDISCNCTSTS_RTDIAGC}, implementation-data-type=ImplementationDataTypes/uint8, type-emitter=RTE
    ReadFltInfoRec1: category=STRUCTURE, sw-calibration-access=READ-ONLY, type-emitter=RTE
      4 x element, all with category=TYPE_REFERENCE:
        NtcNr: implementation-data-type=NtcNrWithResd1
        AgiCntr: implementation-data-type=ImplementationDataTypes/uint8
        Sts: implementation-data-type=ImplementationDataTypes/uint8
        NtcStInfo: implementation-data-type=ImplementationDataTypes/uint8
    s10p5: implementation-data-type=sint16, type-emitter=RTE
    s11p4: implementation-data-type=sint16, type-emitter=RTE
    s14p1: implementation-data-type=sint16, type-emitter=RTE
    s15p0: implementation-data-type=sint16, type-emitter=RTE
    s15p16: implementation-data-type=sint32, type-emitter=RTE
    s18p13: implementation-data-type=sint32, type-emitter=RTE
    s1p14: implementation-data-type=sint16, type-emitter=RTE
    s23pm8: implementation-data-type=sint32, type-emitter=RTE
    s2p13: implementation-data-type=sint16, type-emitter=RTE
    s3p12: implementation-data-type=sint16, type-emitter=RTE
    s4p11: implementation-data-type=sint16, type-emitter=RTE
    s5p10: implementation-data-type=sint16, type-emitter=RTE
    s6p9: implementation-data-type=sint16, type-emitter=RTE
    s7p8: implementation-data-type=sint16, type-emitter=RTE
    s8p7: implementation-data-type=sint16, type-emitter=RTE
    SelnCaseSt1: compu {0=SELNCASEST_FCENTR, 1=SELNCASEST_VEHDYN, 2=SELNCASEST_WHLSPD, 3=SELNCASEST_STORDLSTPOSN, 4=SELNCASEST_CORRDPINIONAG}, implementation-data-type=ImplementationDataTypes/uint8, type-emitter=RTE
    SigQlfr1: compu {0=SIGQLFR_NORES, 1=SIGQLFR_PASSD, 2=SIGQLFR_FAILD}, implementation-data-type=ImplementationDataTypes/uint8, type-emitter=RTE
    sm5p12: implementation-data-type=sint8, type-emitter=RTE
    sm6p13: implementation-data-type=sint8, type-emitter=RTE
    SnpshtDataRec2: category=STRUCTURE, sw-calibration-access=READ-ONLY, type-emitter=RTE
      12 x element, all with category=TYPE_REFERENCE:
        SpclSnpshtData{0..2}: implementation-data-type=uint32
        MicroDiagcData: implementation-data-type=uint32
        IgnCntr: implementation-data-type=uint32
        HwTq: implementation-data-type=s5p10
        MotTq: implementation-data-type=s5p10
        BrdgVltg: implementation-data-type=u6p10
        EcuT: implementation-data-type=s8p7
        NtcNr: implementation-data-type=NtcNrWithResd1
        NtcStInfo: implementation-data-type=ImplementationDataTypes/uint8
        SysSt: implementation-data-type=SysSt1
    SnsrLrndOffsRec1: category=STRUCTURE, sw-calibration-access=READ-ONLY, type-emitter=RTE
      15 x element, all with category=TYPE_REFERENCE:
        HwAgLrndTi: implementation-data-type=float32
        YawRateElpdTi: implementation-data-type=float32
        HwTqLrngCovariMtrx: implementation-data-type=Ary2D_f32_3_3
        HwTqLrngEstimnVect: implementation-data-type=Ary1D_f32_3
        YawRateOffs: implementation-data-type=s6p9
        HwAgOffs: implementation-data-type=s5p10
        HwTqOffs: implementation-data-type=s3p12
        HwAgLrngYawOffsRef: implementation-data-type=s6p9
        HwAgLrngHwAgFilSt: implementation-data-type=s11p4
        HwAgLrngSysTqFilSt: implementation-data-type=s10p5
        HwTqLrngHwAgRef: implementation-data-type=s11p4
        HwTqLrngSampleCntNeg: implementation-data-type=ImplementationDataTypes/uint16
        HwTqLrngSampleCntPos: implementation-data-type=ImplementationDataTypes/uint16
        HwTqLrngSts: implementation-data-type=ImplementationDataTypes/uint8
        YawRateOffsVld: implementation-data-type=boolean
    SteerMod1: compu {0=STEERMOD_BASEPS, 1=STEERMOD_SEMIATNMS, 2=STEERMOD_FULLYATNMS}, implementation-data-type=ImplementationDataTypes/uint8, type-emitter=RTE
    StHlthMonSig3:
      compu {0=STHLTHMONSIG_ECUTFILTD, 1=STHLTHMONSIG_ASSIDUETOVLTG, 2=STHLTHMONSIG_DIGTQSNSRA, 3=STHLTHMONSIG_DIGTQSNSRB, 4=STHLTHMONSIG_DIGTQIDPTSIG, 5=STHLTHMONSIG_DUTYCYC, 6=STHLTHMONSIG_EOTIMPCT, 7=STHLTHMONSIG_MOTPOS, 8=STHLTHMONSIG_MOTPOSABDIFF, 9=STHLTHMONSIG_MOTPOSACDIFF, 10=STHLTHMONSIG_MOTPOSBCDIFF, 11=STHLTHMONSIG_CURRMOTSUMABC, 12=STHLTHMONSIG_CURRMOTSUMDEF, 13=STHLTHMONSIG_MOTPOSPHASEA, 14=STHLTHMONSIG_MOTPOSPHASEB, 15=STHLTHMONSIG_MOTPOSPHASEC, 16=STHLTHMONSIG_MOTPOSPHASED, 17=STHLTHMONSIG_MOTPOSPHASEE, 18=STHLTHMONSIG_MOTPOSPHASEF, 19=STHLTHMONSIG_BITCORRN, 20=STHLTHMONSIG_FRICESTIMN, 21=STHLTHMONSIG_WHLIMBREJCTN}
      implementation-data-type=ImplementationDataTypes/uint8
      type-emitter=RTE
    StHlthMonSig4:
      compu {0=STHLTHMONSIG_ECUTFILTD, 1=STHLTHMONSIG_ASSIDUETOVLTG, 2=STHLTHMONSIG_DIGTQSNSRA, 3=STHLTHMONSIG_DIGTQSNSRB, 4=STHLTHMONSIG_DIGTQIDPTSIG, 5=STHLTHMONSIG_DUTYCYC, 6=STHLTHMONSIG_EOTIMPCT, 7=STHLTHMONSIG_MOTPOS, 8=STHLTHMONSIG_MOTPOSABDIFF, 9=STHLTHMONSIG_MOTPOSACDIFF, 10=STHLTHMONSIG_MOTPOSBCDIFF, 11=STHLTHMONSIG_CURRMOTSUMABC, 12=STHLTHMONSIG_CURRMOTSUMDEF, 13=STHLTHMONSIG_MOTPOSPHASEA, 14=STHLTHMONSIG_MOTPOSPHASEB, 15=STHLTHMONSIG_MOTPOSPHASEC, 16=STHLTHMONSIG_MOTPOSPHASED, 17=STHLTHMONSIG_MOTPOSPHASEE, 18=STHLTHMONSIG_MOTPOSPHASEF, 19=STHLTHMONSIG_BITCORRN, 20=STHLTHMONSIG_FRICESTIMN, 21=STHLTHMONSIG_WHLIMBREJCTN, 22=STHLTHMONSIG_DIGTQSNSRC, 23=STHLTHMONSIG_DIGTQSNSRD}
      implementation-data-type=ImplementationDataTypes/uint8
      type-emitter=RTE
    StordLstPrmRec1: category=STRUCTURE, sw-calibration-access=READ-ONLY, type-emitter=RTE
      element PinionAg: implementation-data-type=float32
      element PinionAgVld: implementation-data-type=boolean
    StordLstPrmRec2: category=STRUCTURE, sw-calibration-access=READ-ONLY, type-emitter=RTE
      element HwAgRel: implementation-data-type=float32
      element Rev: implementation-data-type=sint16
    StrtUpSt1: compu {1=STRTUPST_PWRDISCNCTATESTCMPL, 2=STRTUPST_PWRDISCNCTBTESTCMPL, 3=STRTUPST_TMPLMONININTESTCMPL, 4=STRTUPST_MOTDRVRININCMPL, 5=STRTUPST_CURRMEASWRMININTESTCMPL, 6=STRTUPST_WARMININCMPL, 7=STRTUPST_RUN, 8=STRTUPST_DISABLE}, implementation-data-type=ImplementationDataTypes/uint8, type-emitter=RTE
    StsDrvrActvy1: compu {0=STSDRVRACTVY_NODRVRACTVY, 1=STSDRVRACTVY_DRVRACTVY}, implementation-data-type=ImplementationDataTypes/uint8, type-emitter=RTE
    StsSteerAssi1: compu {0=STSSTEERASSI_OFF, 1=STSSTEERASSI_ON}, implementation-data-type=ImplementationDataTypes/uint8, type-emitter=RTE
    SysFricDataRec1: category=STRUCTURE, sw-calibration-access=READ-ONLY, type-emitter=RTE
      6 x element, all with category=TYPE_REFERENCE:
        FricOffs: implementation-data-type=float32
        BasLineFric: implementation-data-type=Ary1D_f32_4
        VehLrndFric: implementation-data-type=Ary1D_f32_4
        Hys: implementation-data-type=Ary2D_f32_8_4
        RngCntr: implementation-data-type=Ary2D_u16_8_3
        SysFricLrngOperMod: implementation-data-type=SysFricLrngOperMod1
    SysFricLrngOperMod1: compu {0=SYSFRICLRNGOPERMOD_CALIBRATION, 1=SYSFRICLRNGOPERMOD_NORMAL, 2=SYSFRICLRNGOPERMOD_CLEAR, 3=SYSFRICLRNGOPERMOD_IDLE, 4=SYSFRICLRNGOPERMOD_BASELINE}, implementation-data-type=ImplementationDataTypes/uint8, type-emitter=RTE
    SysFricNonLrngDataRec1: category=STRUCTURE, sw-calibration-access=READ-ONLY, type-emitter=RTE
      element EolFric: implementation-data-type=float32
      element EnaFricLrng: implementation-data-type=boolean
      element EnaFricOffsOutp: implementation-data-type=boolean
    SysSt1: compu {0=SYSST_DI, 1=SYSST_OFF, 2=SYSST_ENA, 3=SYSST_WRMININ}, implementation-data-type=ImplementationDataTypes/uint8, type-emitter=RTE
    TFilStValRec1: category=STRUCTURE, sw-calibration-access=READ-ONLY, type-emitter=RTE
      8 x element, all with category=TYPE_REFERENCE, implementation-data-type=float32:
        FilSiLpStVal
        FilMagLpStVal
        FilCuLpStVal
        FilAssisMechLpStVal
        FilSiLLStVal
        FilMagLLStVal
        FilCuLLStVal
        FilAssisMechLLStVal
    TorsBarStEstimdRec1: category=STRUCTURE, sw-calibration-access=READ-ONLY, type-emitter=RTE
      5 x element, all with category=TYPE_REFERENCE, implementation-data-type=float32:
        MotVelEstimd
        TorsBarTqEstimd
        TorsBarRotatmEstimd
        DrvrTqEstimd
        RackTqEstimd
    TrigReg1: compu {85=TRIGREG_MST, 170=TRIGREG_CHKR, 255=TRIGREG_MSTANDCHKR}, implementation-data-type=ImplementationDataTypes/uint8, type-emitter=EcmOutpAndDiagc
    u0p16: implementation-data-type=ImplementationDataTypes/uint16, type-emitter=RTE
    u10p6: implementation-data-type=ImplementationDataTypes/uint16, type-emitter=RTE
    u11p5: implementation-data-type=ImplementationDataTypes/uint16, type-emitter=RTE
    u12p4: implementation-data-type=ImplementationDataTypes/uint16, type-emitter=RTE
    u13p3: implementation-data-type=ImplementationDataTypes/uint16, type-emitter=RTE
    u15p1: implementation-data-type=ImplementationDataTypes/uint16, type-emitter=RTE
    u16p0: implementation-data-type=ImplementationDataTypes/uint16, type-emitter=RTE
    u16p16: implementation-data-type=uint32, type-emitter=RTE
    u1p15: implementation-data-type=ImplementationDataTypes/uint16, type-emitter=RTE
    u2p14: implementation-data-type=ImplementationDataTypes/uint16, type-emitter=RTE
    u3p13: implementation-data-type=ImplementationDataTypes/uint16, type-emitter=RTE
    u4p12: implementation-data-type=ImplementationDataTypes/uint16, type-emitter=RTE
    u5p11: implementation-data-type=ImplementationDataTypes/uint16, type-emitter=RTE
    u6p10: implementation-data-type=ImplementationDataTypes/uint16, type-emitter=RTE
    u7p9: implementation-data-type=ImplementationDataTypes/uint16, type-emitter=RTE
    u8p8: implementation-data-type=ImplementationDataTypes/uint16, type-emitter=RTE
    u9p7: implementation-data-type=ImplementationDataTypes/uint16, type-emitter=RTE
    WhlImbRejctnCmpPeakRec1: category=STRUCTURE, sw-calibration-access=READ-ONLY, type-emitter=RTE
      6 x element, all with category=TYPE_REFERENCE:
        LePeakPrev: implementation-data-type=float32
        RiPeakPrev: implementation-data-type=float32
        MaxCompPerc: implementation-data-type=float32
        ActvCmpBand{1..3}: implementation-data-type=uint32
package /Nexteer/DataTypes/CompuMethods
  compu method GmSteerAgCtrlDiSt1: 0=GMSTEERAGCTRLDIST_EMPTY, 1=GMSTEERAGCTRLDIST_ADVDRVRASSCSYSDI, 2=GMSTEERAGCTRLDIST_TQTHDEXCDD, 3=GMSTEERAGCTRLDIST_VEHSUPVROVRD, 4=GMSTEERAGCTRLDIST_MISSADVDRVRASSCSYSCMD, 5=GMSTEERAGCTRLDIST_INVLDADVDRVRASSCSYSCMD, 6=GMSTEERAGCTRLDIST_VEHMODMGRFAILD, 7=GMSTEERAGCTRLDIST_ECUHWFAILR
  compu method MotCurrEolCalSt1: 1=MCECS_OFFSCMDHI, 2=MCECS_OFFSCMDLO, 3=MCECS_OFFSCMDZERO, 4=MCECS_OFFSCMDEND, 5=MCECS_GAINCMDAD, 6=MCECS_GAINCMDBE, 7=MCECS_GAINCMDCF, 8=MCECS_CMDSAFEST
