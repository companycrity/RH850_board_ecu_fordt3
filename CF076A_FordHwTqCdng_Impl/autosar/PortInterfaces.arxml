AUTOSAR XML (schema 4-0-3)
package /Nexteer/Calibrations
  226 x parameter interface:
    Ary1D_f32_2_CalPortIf1
      parameter data prototype Ary1D: sw-calibration-access=READ-WRITE, type=Ary1D_f32_2
    Ary1D_f32_3_CalPortIf1
      parameter data prototype Ary1D: sw-calibration-access=READ-WRITE, type=Ary1D_f32_3
    Ary1D_f32_4_CalPortIf1
      parameter data prototype Ary1D: sw-calibration-access=READ-WRITE, type=Ary1D_f32_4
    Ary1D_f32_5_CalPortIf1
      parameter data prototype Ary1D: sw-calibration-access=READ-WRITE, type=Ary1D_f32_5
    Ary1D_f32_8_CalPortIf1
      parameter data prototype Ary1D: sw-calibration-access=READ-WRITE, type=Ary1D_f32_8
    Ary1D_logl_2_CalPortIf1
      parameter data prototype Ary1D: sw-calibration-access=READ-WRITE, type=Ary1D_logl_2
    Ary1D_logl_3_CalPortIf1
      parameter data prototype Ary1D: sw-calibration-access=READ-WRITE, type=Ary1D_logl_3
    Ary1D_logl_4_CalPortIf1
      parameter data prototype Ary1D: sw-calibration-access=READ-WRITE, type=Ary1D_logl_4_01
    Ary1D_s10p5_8_CalPortIf1
      parameter data prototype Ary1D: sw-calibration-access=READ-WRITE, type=Ary1D_s10p5_8
    Ary1D_s11p4_11_CalPortIf1
      parameter data prototype Ary1D: sw-calibration-access=READ-WRITE, type=Ary1D_s11p4_11
    Ary1D_s11p4_14_CalPortIf1
      parameter data prototype Ary1D: sw-calibration-access=READ-WRITE, type=Ary1D_s11p4_14
    Ary1D_s11p4_5_CalPortIf1
      parameter data prototype Ary1D: sw-calibration-access=READ-WRITE, type=Ary1D_s11p4_5
    Ary1D_s14p1_8_CalPortIf1
      parameter data prototype Ary1D: sw-calibration-access=READ-WRITE, type=Ary1D_s14p1_8
    Ary1D_s15p0_21_CalPortIf1
      parameter data prototype Ary1D: sw-calibration-access=READ-WRITE, type=Ary1D_s15p0_21
    Ary1D_s15p0_4_CalPortIf1
      parameter data prototype Ary1D: sw-calibration-access=READ-WRITE, type=Ary1D_s15p0_4
    Ary1D_s16_22_CalPortIf1
      parameter data prototype Ary1D: sw-calibration-access=READ-WRITE, type=Ary1D_s16_22
    Ary1D_s2p13_21_CalPortIf1
      parameter data prototype Ary1D: sw-calibration-access=READ-WRITE, type=Ary1D_s2p13_21
    Ary1D_s4p11_12_CalPortIf1
      parameter data prototype Ary1D: sw-calibration-access=READ-WRITE, type=Ary1D_s4p11_12
    Ary1D_s4p11_20_CalPortIf1
      parameter data prototype Ary1D: sw-calibration-access=READ-WRITE, type=Ary1D_s4p11_20
    Ary1D_s4p11_4_CalPortIf1
      parameter data prototype Ary1D: sw-calibration-access=READ-WRITE, type=Ary1D_s4p11_4
    Ary1D_s4p11_5_CalPortIf1
      parameter data prototype Ary1D: sw-calibration-access=READ-WRITE, type=Ary1D_s4p11_5
    Ary1D_s7p8_20_CalPortIf1
      parameter data prototype Ary1D: sw-calibration-access=READ-WRITE, type=Ary1D_s7p8_20
    Ary1D_s8p7_12_CalPortIf1
      parameter data prototype Ary1D: sw-calibration-access=READ-WRITE, type=Ary1D_s8p7_12
    Ary1D_s8p7_14_CalPortIf1
      parameter data prototype Ary1D: sw-calibration-access=READ-WRITE, type=Ary1D_s8p7_14
    Ary1D_s8p7_21_CalPortIf1
      parameter data prototype Ary1D: sw-calibration-access=READ-WRITE, type=Ary1D_s8p7_21
    Ary1D_s8p7_3_CalPortIf1
      parameter data prototype Ary1D: sw-calibration-access=READ-WRITE, type=Ary1D_s8p7_3
    Ary1D_u08_22_CalPortIf1
      parameter data prototype Ary1D: sw-calibration-access=READ-WRITE, type=Ary1D_u08_22
    Ary1D_u0p16_10_CalPortIf1
      parameter data prototype Ary1D: sw-calibration-access=READ-WRITE, type=Ary1D_u0p16_10
    Ary1D_u0p16_3_CalPortIf1
      parameter data prototype Ary1D: sw-calibration-access=READ-WRITE, type=Ary1D_u0p16_3
    Ary1D_u10p6_10_CalPortIf1
      parameter data prototype Ary1D: sw-calibration-access=READ-WRITE, type=Ary1D_u10p6_10
    Ary1D_u10p6_13_CalPortIf1
      parameter data prototype Ary1D: sw-calibration-access=READ-WRITE, type=Ary1D_u10p6_13
    Ary1D_u10p6_2_CalPortIf1
      parameter data prototype Ary1D: sw-calibration-access=READ-WRITE, type=Ary1D_u10p6_2
    Ary1D_u10p6_3_CalPortIf1
      parameter data prototype Ary1D: sw-calibration-access=READ-WRITE, type=Ary1D_u10p6_3
    Ary1D_u10p6_4_CalPortIf1
      parameter data prototype Ary1D: sw-calibration-access=READ-WRITE, type=Ary1D_u10p6_4
    Ary1D_u10p6_5_CalPortIf1
      parameter data prototype Ary1D: sw-calibration-access=READ-WRITE, type=Ary1D_u10p6_5
    Ary1D_u10p6_7_CalPortIf1
      parameter data prototype Ary1D: sw-calibration-access=READ-WRITE, type=Ary1D_u10p6_7
    Ary1D_u10p6_8_CalPortIf1
      parameter data prototype Ary1D: sw-calibration-access=READ-WRITE, type=Ary1D_u10p6_8
    Ary1D_u11p5_10_CalPortIf1
      parameter data prototype Ary1D: sw-calibration-access=READ-WRITE, type=Ary1D_u11p5_10
    Ary1D_u11p5_11_CalPortIf1
      parameter data prototype Ary1D: sw-calibration-access=READ-WRITE, type=Ary1D_u11p5_11
    Ary1D_u11p5_12_CalPortIf1
      parameter data prototype Ary1D: sw-calibration-access=READ-WRITE, type=Ary1D_u11p5_12
    Ary1D_u11p5_13_CalPortIf1
      parameter data prototype Ary1D: sw-calibration-access=READ-WRITE, type=Ary1D_u11p5_13
    Ary1D_u11p5_4_CalPortIf1
      parameter data prototype Ary1D: sw-calibration-access=READ-WRITE, type=Ary1D_u11p5_4
    Ary1D_u11p5_5_CalPortIf1
      parameter data prototype Ary1D: sw-calibration-access=READ-WRITE, type=Ary1D_u11p5_5
    Ary1D_u11p5_6_CalPortIf1
      parameter data prototype Ary1D: sw-calibration-access=READ-WRITE, type=Ary1D_u11p5_6
    Ary1D_u11p5_8_CalPortIf1
      parameter data prototype Ary1D: sw-calibration-access=READ-WRITE, type=Ary1D_u11p5_8
    Ary1D_u11p5_9_CalPortIf1
      parameter data prototype Ary1D: sw-calibration-access=READ-WRITE, type=Ary1D_u11p5_9
    Ary1D_u12p4_12_CalPortIf1
      parameter data prototype Ary1D: sw-calibration-access=READ-WRITE, type=Ary1D_u12p4_12
    Ary1D_u12p4_2_CalPortIf1
      parameter data prototype Ary1D: sw-calibration-access=READ-WRITE, type=Ary1D_u12p4_2
    Ary1D_u12p4_4_CalPortIf1
      parameter data prototype Ary1D: sw-calibration-access=READ-WRITE, type=Ary1D_u12p4_4
    Ary1D_u12p4_7_CalPortIf1
      parameter data prototype Ary1D: sw-calibration-access=READ-WRITE, type=Ary1D_u12p4_7
    Ary1D_u12p4_9_CalPortIf1
      parameter data prototype Ary1D: sw-calibration-access=READ-WRITE, type=Ary1D_u12p4_9
    Ary1D_u13p3_2_CalPortIf1
      parameter data prototype Ary1D: sw-calibration-access=READ-WRITE, type=Ary1D_u13p3_2
    Ary1D_u13p3_4_CalPortIf1
      parameter data prototype Ary1D: sw-calibration-access=READ-WRITE, type=Ary1D_u13p3_4
    Ary1D_u13p3_6_CalPortIf1
      parameter data prototype Ary1D: sw-calibration-access=READ-WRITE, type=Ary1D_u13p3_6
    Ary1D_u15p1_12_CalPortIf1
      parameter data prototype Ary1D: sw-calibration-access=READ-WRITE, type=Ary1D_u15p1_12
    Ary1D_u15p1_4_CalPortIf1
      parameter data prototype Ary1D: sw-calibration-access=READ-WRITE, type=Ary1D_u15p1_4
    Ary1D_u16_3_CalPortIf1
      parameter data prototype Ary1D: sw-calibration-access=READ-WRITE, type=Ary1D_u16_3
    Ary1D_u16_512_CalPortIf1
      parameter data prototype Ary1D: sw-calibration-access=READ-WRITE, type=Ary1D_u16_512
    Ary1D_u16p0_2_CalPortIf1
      parameter data prototype Ary1D: sw-calibration-access=READ-WRITE, type=Ary1D_u16p0_2
    Ary1D_u16p0_20_CalPortIf1
      parameter data prototype Ary1D: sw-calibration-access=READ-WRITE, type=Ary1D_u16p0_20
    Ary1D_u16p0_22_CalPortIf1
      parameter data prototype Ary1D: sw-calibration-access=READ-WRITE, type=Ary1D_u16p0_22
    Ary1D_u16p0_8_CalPortIf1
      parameter data prototype Ary1D: sw-calibration-access=READ-WRITE, type=Ary1D_u16p0_8
    Ary1D_u1p15_10_CalPortIf1
      parameter data prototype Ary1D: sw-calibration-access=READ-WRITE, type=Ary1D_u1p15_10
    Ary1D_u1p15_11_CalPortIf1
      parameter data prototype Ary1D: sw-calibration-access=READ-WRITE, type=Ary1D_u1p15_11
    Ary1D_u1p15_12_CalPortIf1
      parameter data prototype Ary1D: sw-calibration-access=READ-WRITE, type=Ary1D_u1p15_12
    Ary1D_u1p15_2_CalPortIf1
      parameter data prototype Ary1D: sw-calibration-access=READ-WRITE, type=Ary1D_u1p15_2
    Ary1D_u1p15_21_CalPortIf1
      parameter data prototype Ary1D: sw-calibration-access=READ-WRITE, type=Ary1D_u1p15_21
    Ary1D_u1p15_4_CalPortIf1
      parameter data prototype Ary1D: sw-calibration-access=READ-WRITE, type=Ary1D_u1p15_4
    Ary1D_u1p15_5_CalPortIf1
      parameter data prototype Ary1D: sw-calibration-access=READ-WRITE, type=Ary1D_u1p15_5
    Ary1D_u1p15_6_CalPortIf1
      parameter data prototype Ary1D: sw-calibration-access=READ-WRITE, type=Ary1D_u1p15_6
    Ary1D_u1p15_9_CalPortIf1
      parameter data prototype Ary1D: sw-calibration-access=READ-WRITE, type=Ary1D_u1p15_9
    Ary1D_u2p14_10_CalPortIf1
      parameter data prototype Ary1D: sw-calibration-access=READ-WRITE, type=Ary1D_u2p14_10
    Ary1D_u2p14_11_CalPortIf1
      parameter data prototype Ary1D: sw-calibration-access=READ-WRITE, type=Ary1D_u2p14_11
    Ary1D_u2p14_12_CalPortIf1
      parameter data prototype Ary1D: sw-calibration-access=READ-WRITE, type=Ary1D_u2p14_12
    Ary1D_u2p14_16_CalPortIf1
      parameter data prototype Ary1D: sw-calibration-access=READ-WRITE, type=Ary1D_u2p14_16
    Ary1D_u2p14_2_CalPortIf1
      parameter data prototype Ary1D: sw-calibration-access=READ-WRITE, type=Ary1D_u2p14_2
    Ary1D_u2p14_3_CalPortIf1
      parameter data prototype Ary1D: sw-calibration-access=READ-WRITE, type=Ary1D_u2p14_3
    Ary1D_u2p14_4_CalPortIf1
      parameter data prototype Ary1D: sw-calibration-access=READ-WRITE, type=Ary1D_u2p14_4
    Ary1D_u2p14_5_CalPortIf1
      parameter data prototype Ary1D: sw-calibration-access=READ-WRITE, type=Ary1D_u2p14_5
    Ary1D_u2p14_6_CalPortIf1
      parameter data prototype Ary1D: sw-calibration-access=READ-WRITE, type=Ary1D_u2p14_6
    Ary1D_u2p14_7_CalPortIf1
      parameter data prototype Ary1D: sw-calibration-access=READ-WRITE, type=Ary1D_u2p14_7
    Ary1D_u2p14_8_CalPortIf1
      parameter data prototype Ary1D: sw-calibration-access=READ-WRITE, type=Ary1D_u2p14_8
    Ary1D_u2p14_9_CalPortIf1
      parameter data prototype Ary1D: sw-calibration-access=READ-WRITE, type=Ary1D_u2p14_9
    Ary1D_u32_512_CalPortIf1
      parameter data prototype Ary1D: sw-calibration-access=READ-WRITE, type=Ary1D_u32_512
    Ary1D_u3p13_10_CalPortIf1
      parameter data prototype Ary1D: sw-calibration-access=READ-WRITE, type=Ary1D_u3p13_10
    Ary1D_u3p13_5_CalPortIf1
      parameter data prototype Ary1D: sw-calibration-access=READ-WRITE, type=Ary1D_u3p13_5
    Ary1D_u4p12_10_CalPortIf1
      parameter data prototype Ary1D: sw-calibration-access=READ-WRITE, type=Ary1D_u4p12_10
    Ary1D_u4p12_11_CalPortIf1
      parameter data prototype Ary1D: sw-calibration-access=READ-WRITE, type=Ary1D_u4p12_11
    Ary1D_u4p12_12_CalPortIf1
      parameter data prototype Ary1D: sw-calibration-access=READ-WRITE, type=Ary1D_u4p12_12
    Ary1D_u4p12_14_CalPortIf1
      parameter data prototype Ary1D: sw-calibration-access=READ-WRITE, type=Ary1D_u4p12_14
    Ary1D_u4p12_2_CalPortIf1
      parameter data prototype Ary1D: sw-calibration-access=READ-WRITE, type=Ary1D_u4p12_2
    Ary1D_u4p12_21_CalPortIf1
      parameter data prototype Ary1D: sw-calibration-access=READ-WRITE, type=Ary1D_u4p12_21
    Ary1D_u4p12_4_CalPortIf1
      parameter data prototype Ary1D: sw-calibration-access=READ-WRITE, type=Ary1D_u4p12_4
    Ary1D_u4p12_5_CalPortIf1
      parameter data prototype Ary1D: sw-calibration-access=READ-WRITE, type=Ary1D_u4p12_5
    Ary1D_u4p12_6_CalPortIf1
      parameter data prototype Ary1D: sw-calibration-access=READ-WRITE, type=Ary1D_u4p12_6
    Ary1D_u4p12_8_CalPortIf1
      parameter data prototype Ary1D: sw-calibration-access=READ-WRITE, type=Ary1D_u4p12_8
    Ary1D_u5p11_10_CalPortIf1
      parameter data prototype Ary1D: sw-calibration-access=READ-WRITE, type=Ary1D_u5p11_10
    Ary1D_u5p11_11_CalPortIf1
      parameter data prototype Ary1D: sw-calibration-access=READ-WRITE, type=Ary1D_u5p11_11
    Ary1D_u5p11_14_CalPortIf1
      parameter data prototype Ary1D: sw-calibration-access=READ-WRITE, type=Ary1D_u5p11_14
    Ary1D_u5p11_17_CalPortIf1
      parameter data prototype Ary1D: sw-calibration-access=READ-WRITE, type=Ary1D_u5p11_17
    Ary1D_u5p11_21_CalPortIf1
      parameter data prototype Ary1D: sw-calibration-access=READ-WRITE, type=Ary1D_u5p11_21
    Ary1D_u5p11_5_CalPortIf1
      parameter data prototype Ary1D: sw-calibration-access=READ-WRITE, type=Ary1D_u5p11_5
    Ary1D_u5p11_6_CalPortIf1
      parameter data prototype Ary1D: sw-calibration-access=READ-WRITE, type=Ary1D_u5p11_6
    Ary1D_u5p11_8_CalPortIf1
      parameter data prototype Ary1D: sw-calibration-access=READ-WRITE, type=Ary1D_u5p11_8
    Ary1D_u6p10_10_CalPortIf1
      parameter data prototype Ary1D: sw-calibration-access=READ-WRITE, type=Ary1D_u6p10_10
    Ary1D_u6p10_17_CalPortIf1
      parameter data prototype Ary1D: sw-calibration-access=READ-WRITE, type=Ary1D_u6p10_17
    Ary1D_u6p10_5_CalPortIf1
      parameter data prototype Ary1D: sw-calibration-access=READ-WRITE, type=Ary1D_u6p10_5
    Ary1D_u6p10_6_CalPortIf1
      parameter data prototype Ary1D: sw-calibration-access=READ-WRITE, type=Ary1D_u6p10_6
    Ary1D_u6p10_9_CalPortIf1
      parameter data prototype Ary1D: sw-calibration-access=READ-WRITE, type=Ary1D_u6p10_9
    Ary1D_u7p9_12_CalPortIf1
      parameter data prototype Ary1D: sw-calibration-access=READ-WRITE, type=Ary1D_u7p9_12
    Ary1D_u7p9_3_CalPortIf1
      parameter data prototype Ary1D: sw-calibration-access=READ-WRITE, type=Ary1D_u7p9_3
    Ary1D_u7p9_6_CalPortIf1
      parameter data prototype Ary1D: sw-calibration-access=READ-WRITE, type=Ary1D_u7p9_6
    Ary1D_u8p8_10_CalPortIf1
      parameter data prototype Ary1D: sw-calibration-access=READ-WRITE, type=Ary1D_u8p8_10
    Ary1D_u8p8_11_CalPortIf1
      parameter data prototype Ary1D: sw-calibration-access=READ-WRITE, type=Ary1D_u8p8_11
    Ary1D_u8p8_12_CalPortIf1
      parameter data prototype Ary1D: sw-calibration-access=READ-WRITE, type=Ary1D_u8p8_12
    Ary1D_u8p8_14_CalPortIf1
      parameter data prototype Ary1D: sw-calibration-access=READ-WRITE, type=Ary1D_u8p8_14
    Ary1D_u8p8_2_CalPortIf1
      parameter data prototype Ary1D: sw-calibration-access=READ-WRITE, type=Ary1D_u8p8_2
    Ary1D_u8p8_20_CalPortIf1
      parameter data prototype Ary1D: sw-calibration-access=READ-WRITE, type=Ary1D_u8p8_20
    Ary1D_u8p8_3_CalPortIf1
      parameter data prototype Ary1D: sw-calibration-access=READ-WRITE, type=Ary1D_u8p8_3
    Ary1D_u8p8_4_CalPortIf1
      parameter data prototype Ary1D: sw-calibration-access=READ-WRITE, type=Ary1D_u8p8_4
    Ary1D_u8p8_5_CalPortIf1
      parameter data prototype Ary1D: sw-calibration-access=READ-WRITE, type=Ary1D_u8p8_5
    Ary1D_u8p8_6_CalPortIf1
      parameter data prototype Ary1D: sw-calibration-access=READ-WRITE, type=Ary1D_u8p8_6
    Ary1D_u8p8_7_CalPortIf1
      parameter data prototype Ary1D: sw-calibration-access=READ-WRITE, type=Ary1D_u8p8_7
    Ary1D_u8p8_8_CalPortIf1
      parameter data prototype Ary1D: sw-calibration-access=READ-WRITE, type=Ary1D_u8p8_8
    Ary1D_u8p8_9_CalPortIf1
      parameter data prototype Ary1D: sw-calibration-access=READ-WRITE, type=Ary1D_u8p8_9
    Ary1D_u9p7_10_CalPortIf1
      parameter data prototype Ary1D: sw-calibration-access=READ-WRITE, type=Ary1D_u9p7_10
    Ary1D_u9p7_11_CalPortIf1
      parameter data prototype Ary1D: sw-calibration-access=READ-WRITE, type=Ary1D_u9p7_11
    Ary1D_u9p7_12_CalPortIf1
      parameter data prototype Ary1D: sw-calibration-access=READ-WRITE, type=Ary1D_u9p7_12
    Ary1D_u9p7_16_CalPortIf1
      parameter data prototype Ary1D: sw-calibration-access=READ-WRITE, type=Ary1D_u9p7_16
    Ary1D_u9p7_2_CalPortIf1
      parameter data prototype Ary1D: sw-calibration-access=READ-WRITE, type=Ary1D_u9p7_2
    Ary1D_u9p7_3_CalPortIf1
      parameter data prototype Ary1D: sw-calibration-access=READ-WRITE, type=Ary1D_u9p7_3
    Ary1D_u9p7_4_CalPortIf1
      parameter data prototype Ary1D: sw-calibration-access=READ-WRITE, type=Ary1D_u9p7_4
    Ary1D_u9p7_5_CalPortIf1
      parameter data prototype Ary1D: sw-calibration-access=READ-WRITE, type=Ary1D_u9p7_5
    Ary1D_u9p7_6_CalPortIf1
      parameter data prototype Ary1D: sw-calibration-access=READ-WRITE, type=Ary1D_u9p7_6
    Ary1D_u9p7_7_CalPortIf1
      parameter data prototype Ary1D: sw-calibration-access=READ-WRITE, type=Ary1D_u9p7_7
    Ary1D_u9p7_8_CalPortIf1
      parameter data prototype Ary1D: sw-calibration-access=READ-WRITE, type=Ary1D_u9p7_8
    Ary1D_u9p7_9_CalPortIf1
      parameter data prototype Ary1D: sw-calibration-access=READ-WRITE, type=Ary1D_u9p7_9
    Ary2D_f32_4_2_CalPortIf1
      parameter data prototype Ary2D: sw-calibration-access=READ-WRITE, type=Ary2D_f32_4_2
    Ary2D_f32_4_5_CalPortIf1
      parameter data prototype Ary2D: sw-calibration-access=READ-WRITE, type=Ary2D_f32_4_5
    Ary2D_f32_5_3_CalPortIf1
      parameter data prototype Ary2D: sw-calibration-access=READ-WRITE, type=Ary2D_f32_5_3
    Ary2D_f32_5_4_CalPortIf1
      parameter data prototype Ary2D: sw-calibration-access=READ-WRITE, type=Ary2D_f32_5_4
    Ary2D_f32_5_5_CalPortIf1
      parameter data prototype Ary2D: sw-calibration-access=READ-WRITE, type=Ary2D_f32_5_5
    Ary2D_f32_8_4_CalPortIf1
      parameter data prototype Ary2D: sw-calibration-access=READ-WRITE, type=Ary2D_f32_8_4
    Ary2D_s1p14_10_12_CalPortIf1
      parameter data prototype Ary2D: sw-calibration-access=READ-WRITE, type=Ary2D_s1p14_10_12
    Ary2D_s4p11_10_13_CalPortIf1
      parameter data prototype Ary2D: sw-calibration-access=READ-WRITE, type=Ary2D_s4p11_10_13
    Ary2D_s4p11_11_8_CalPortIf1
      parameter data prototype Ary2D: sw-calibration-access=READ-WRITE, type=Ary2D_s4p11_11_8
    Ary2D_s4p11_12_11_CalPortIf1
      parameter data prototype Ary2D: sw-calibration-access=READ-WRITE, type=Ary2D_s4p11_12_11
    Ary2D_s4p11_12_20_CalPortIf1
      parameter data prototype Ary2D: sw-calibration-access=READ-WRITE, type=Ary2D_s4p11_12_20
    Ary2D_s4p11_8_11_CalPortIf1
      parameter data prototype Ary2D: sw-calibration-access=READ-WRITE, type=Ary2D_s4p11_8_11
    Ary2D_s7p8_11_12_CalPortIf1
      parameter data prototype Ary2D: sw-calibration-access=READ-WRITE, type=Ary2D_s7p8_11_12
    Ary2D_s7p8_12_11_CalPortIf1
      parameter data prototype Ary2D: sw-calibration-access=READ-WRITE, type=Ary2D_s7p8_12_11
    Ary2D_s7p8_3_5_CalPortIf1
      parameter data prototype Ary2D: sw-calibration-access=READ-WRITE, type=Ary2D_s7p8_3_5
    Ary2D_s7p8_3_6_CalPortIf1
      parameter data prototype Ary2D: sw-calibration-access=READ-WRITE, type=Ary2D_s7p8_3_6
    Ary2D_s7p8_4_5_CalPortIf1
      parameter data prototype Ary2D: sw-calibration-access=READ-WRITE, type=Ary2D_s7p8_4_5
    Ary2D_s7p8_9_5_CalPortIf1
      parameter data prototype Ary2D: sw-calibration-access=READ-WRITE, type=Ary2D_s7p8_9_5
    Ary2D_s7p8_9_6_CalPortIf1
      parameter data prototype Ary2D: sw-calibration-access=READ-WRITE, type=Ary2D_s7p8_9_6
    Ary2D_u0p16_20_8_CalPortIf1
      parameter data prototype Ary2D: sw-calibration-access=READ-WRITE, type=Ary2D_u0p16_20_8
    Ary2D_u0p16_4_2_CalPortIf1
      parameter data prototype Ary2D: sw-calibration-access=READ-WRITE, type=Ary2D_u0p16_4_2
    Ary2D_u10p6_3_7_CalPortIf1
      parameter data prototype Ary2D: sw-calibration-access=READ-WRITE, type=Ary2D_u10p6_3_7
    Ary2D_u10p6_8_12_CalPortIf1
      parameter data prototype Ary2D: sw-calibration-access=READ-WRITE, type=Ary2D_u10p6_8_12
    Ary2D_u10p6_8_9_CalPortIf1
      parameter data prototype Ary2D: sw-calibration-access=READ-WRITE, type=Ary2D_u10p6_8_9
    Ary2D_u11p5_6_5_CalPortIf1
      parameter data prototype Ary2D: sw-calibration-access=READ-WRITE, type=Ary2D_u11p5_6_5
    Ary2D_u12p4_12_13_CalPortIf1
      parameter data prototype Ary2D: sw-calibration-access=READ-WRITE, type=Ary2D_u12p4_12_13
    Ary2D_u12p4_4_2_CalPortIf1
      parameter data prototype Ary2D: sw-calibration-access=READ-WRITE, type=Ary2D_u12p4_4_2
    Ary2D_u12p4_5_4_CalPortIf1
      parameter data prototype Ary2D: sw-calibration-access=READ-WRITE, type=Ary2D_u12p4_5_4
    Ary2D_u12p4_8_12_CalPortIf1
      parameter data prototype Ary2D: sw-calibration-access=READ-WRITE, type=Ary2D_u12p4_8_12
    Ary2D_u12p4_9_16_CalPortIf1
      parameter data prototype Ary2D: sw-calibration-access=READ-WRITE, type=Ary2D_u12p4_9_16
    Ary2D_u15p1_10_24_CalPortIf1
      parameter data prototype Ary2D: sw-calibration-access=READ-WRITE, type=Ary2D_u15p1_10_24
    Ary2D_u15p1_12_9_CalPortIf1
      parameter data prototype Ary2D: sw-calibration-access=READ-WRITE, type=Ary2D_u15p1_12_9
    Ary2D_u16_8_3_CalPortIf1
      parameter data prototype Ary2D: sw-calibration-access=READ-WRITE, type=Ary2D_u16_8_3
    Ary2D_u16p0_2_8_CalPortIf1
      parameter data prototype Ary2D: sw-calibration-access=READ-WRITE, type=Ary2D_u16p0_2_8
    Ary2D_u1p15_12_5_CalPortIf1
      parameter data prototype Ary2D: sw-calibration-access=READ-WRITE, type=Ary2D_u1p15_12_5
    Ary2D_u1p15_12_9_CalPortIf1
      parameter data prototype Ary2D: sw-calibration-access=READ-WRITE, type=Ary2D_u1p15_12_9
    Ary2D_u1p15_5_4_CalPortIf1
      parameter data prototype Ary2D: sw-calibration-access=READ-WRITE, type=Ary2D_u1p15_5_4
    Ary2D_u1p15_8_4_CalPortIf1
      parameter data prototype Ary2D: sw-calibration-access=READ-WRITE, type=Ary2D_u1p15_8_4
    Ary2D_u2p14_12_5_CalPortIf1
      parameter data prototype Ary2D: sw-calibration-access=READ-WRITE, type=Ary2D_u2p14_12_5
    Ary2D_u2p14_5_10_CalPortIf1
      parameter data prototype Ary2D: sw-calibration-access=READ-WRITE, type=Ary2D_u2p14_5_10
    Ary2D_u2p14_5_8_CalPortIf1
      parameter data prototype Ary2D: sw-calibration-access=READ-WRITE, type=Ary2D_u2p14_5_8
    Ary2D_u2p14_6_5_CalPortIf1
      parameter data prototype Ary2D: sw-calibration-access=READ-WRITE, type=Ary2D_u2p14_6_5
    Ary2D_u2p14_6_7_CalPortIf1
      parameter data prototype Ary2D: sw-calibration-access=READ-WRITE, type=Ary2D_u2p14_6_7
    Ary2D_u2p14_7_8_CalPortIf1
      parameter data prototype Ary2D: sw-calibration-access=READ-WRITE, type=Ary2D_u2p14_7_8
    Ary2D_u3p13_12_13_CalPortIf1
      parameter data prototype Ary2D: sw-calibration-access=READ-WRITE, type=Ary2D_u3p13_12_13
    Ary2D_u3p13_20_8_CalPortIf1
      parameter data prototype Ary2D: sw-calibration-access=READ-WRITE, type=Ary2D_u3p13_20_8
    Ary2D_u4p12_10_24_CalPortIf1
      parameter data prototype Ary2D: sw-calibration-access=READ-WRITE, type=Ary2D_u4p12_10_24
    Ary2D_u4p12_12_12_CalPortIf1
      parameter data prototype Ary2D: sw-calibration-access=READ-WRITE, type=Ary2D_u4p12_12_12
    Ary2D_u4p12_12_20_CalPortIf1
      parameter data prototype Ary2D: sw-calibration-access=READ-WRITE, type=Ary2D_u4p12_12_20
    Ary2D_u4p12_12_5_CalPortIf1
      parameter data prototype Ary2D: sw-calibration-access=READ-WRITE, type=Ary2D_u4p12_12_5
    Ary2D_u4p12_12_8_CalPortIf1
      parameter data prototype Ary2D: sw-calibration-access=READ-WRITE, type=Ary2D_u4p12_12_8
    Ary2D_u4p12_12_9_CalPortIf1
      parameter data prototype Ary2D: sw-calibration-access=READ-WRITE, type=Ary2D_u4p12_12_9
    Ary2D_u4p12_13_3_CalPortIf1
      parameter data prototype Ary2D: sw-calibration-access=READ-WRITE, type=Ary2D_u4p12_13_3
    Ary2D_u4p12_3_13_CalPortIf1
      parameter data prototype Ary2D: sw-calibration-access=READ-WRITE, type=Ary2D_u4p12_3_13
    Ary2D_u5p11_12_13_CalPortIf1
      parameter data prototype Ary2D: sw-calibration-access=READ-WRITE, type=Ary2D_u5p11_12_13
    Ary2D_u5p11_12_5_CalPortIf1
      parameter data prototype Ary2D: sw-calibration-access=READ-WRITE, type=Ary2D_u5p11_12_5
    Ary2D_u5p11_9_16_CalPortIf1
      parameter data prototype Ary2D: sw-calibration-access=READ-WRITE, type=Ary2D_u5p11_9_16
    Ary2D_u5p11_9_9_CalPortIf1
      parameter data prototype Ary2D: sw-calibration-access=READ-WRITE, type=Ary2D_u5p11_9_9
    Ary2D_u6p10_12_20_CalPortIf1
      parameter data prototype Ary2D: sw-calibration-access=READ-WRITE, type=Ary2D_u6p10_12_20
    Ary2D_u6p10_12_9_CalPortIf1
      parameter data prototype Ary2D: sw-calibration-access=READ-WRITE, type=Ary2D_u6p10_12_9
    Ary2D_u6p10_5_9_CalPortIf1
      parameter data prototype Ary2D: sw-calibration-access=READ-WRITE, type=Ary2D_u6p10_5_9
    Ary2D_u6p10_8_9_CalPortIf1
      parameter data prototype Ary2D: sw-calibration-access=READ-WRITE, type=Ary2D_u6p10_8_9
    Ary2D_u7p9_9_4_CalPortIf1
      parameter data prototype Ary2D: sw-calibration-access=READ-WRITE, type=Ary2D_u7p9_9_4
    Ary2D_u8p8_12_20_CalPortIf1
      parameter data prototype Ary2D: sw-calibration-access=READ-WRITE, type=Ary2D_u8p8_12_20
    Ary2D_u8p8_3_5_CalPortIf1
      parameter data prototype Ary2D: sw-calibration-access=READ-WRITE, type=Ary2D_u8p8_3_5
    Ary2D_u8p8_3_6_CalPortIf1
      parameter data prototype Ary2D: sw-calibration-access=READ-WRITE, type=Ary2D_u8p8_3_6
    Ary2D_u8p8_5_10_CalPortIf1
      parameter data prototype Ary2D: sw-calibration-access=READ-WRITE, type=Ary2D_u8p8_5_10
    Ary2D_u8p8_5_8_CalPortIf1
      parameter data prototype Ary2D: sw-calibration-access=READ-WRITE, type=Ary2D_u8p8_5_8
    Ary2D_u8p8_6_5_CalPortIf1
      parameter data prototype Ary2D: sw-calibration-access=READ-WRITE, type=Ary2D_u8p8_6_5
    Ary2D_u8p8_9_4_CalPortIf1
      parameter data prototype Ary2D: sw-calibration-access=READ-WRITE, type=Ary2D_u8p8_9_4
    Ary2D_u8p8_9_5_CalPortIf1
      parameter data prototype Ary2D: sw-calibration-access=READ-WRITE, type=Ary2D_u8p8_9_5
    Ary2D_u8p8_9_6_CalPortIf1
      parameter data prototype Ary2D: sw-calibration-access=READ-WRITE, type=Ary2D_u8p8_9_6
    Ary2D_u8p8_9_8_CalPortIf1
      parameter data prototype Ary2D: sw-calibration-access=READ-WRITE, type=Ary2D_u8p8_9_8
    Ary2D_u9p7_2_5_CalPortIf1
      parameter data prototype Ary2D: sw-calibration-access=READ-WRITE, type=Ary2D_u9p7_2_5
    Ary2D_u9p7_2_8_CalPortIf1
      parameter data prototype Ary2D: sw-calibration-access=READ-WRITE, type=Ary2D_u9p7_2_8
    boolean_CalPortIf1
      parameter data prototype Logl: sw-calibration-access=READ-WRITE, type=boolean
    FilNotchGainRec1_CalPortIf1
      parameter data prototype Rec: sw-calibration-access=READ-WRITE, type=FilNotchGainRec1
    float32_CalPortIf1
      parameter data prototype Val: sw-calibration-access=READ-WRITE, type=float32
    s18p13_CalPortIf1
      parameter data prototype Val: sw-calibration-access=READ-WRITE, type=s18p13
    sint16_CalPortIf1
      parameter data prototype Val: sw-calibration-access=READ-WRITE, type=sint16
    sint8_CalPortIf1
      parameter data prototype Val: sw-calibration-access=READ-WRITE, type=sint8
    u0p16_CalPortIf1
      parameter data prototype Val: sw-calibration-access=READ-WRITE, type=u0p16
    u10p6_CalPortIf1
      parameter data prototype Val: sw-calibration-access=READ-WRITE, type=u10p6
    u16p0_CalPortIf1
      parameter data prototype Val: sw-calibration-access=READ-WRITE, type=u16p0
    u2p14_CalPortIf1
      parameter data prototype Val: sw-calibration-access=READ-WRITE, type=u2p14
    u9p7_CalPortIf1
      parameter data prototype Val: sw-calibration-access=READ-WRITE, type=u9p7
    uint16_CalPortIf1
      parameter data prototype Val: sw-calibration-access=READ-WRITE, type=uint16
    uint32_CalPortIf1
      parameter data prototype Val: sw-calibration-access=READ-WRITE, type=uint32
    uint8_CalPortIf1
      parameter data prototype Val: sw-calibration-access=READ-WRITE, type=uint8
package /Nexteer/PortInterfaces
  210 x client server interface:
    Adc1CfgAndUseAdc1EnaCnvn_PortIf1
      operation Oper
    Adc1CfgAndUseAdc1EnaCnvn1_PortIf1
      operation Oper
    Adcf1EnaCnvn_PortIf1
      operation Oper
    AdcScanGroupCfg_PortIf1
      operation Oper
        arg StrtPtr_Arg: type=uint8, direction=IN, server-argument-impl-policy=USE-ARGUMENT-TYPE
        arg EndPtr_Arg: type=uint8, direction=IN, server-argument-impl-policy=USE-ARGUMENT-TYPE
    ApplSMBusOffBgn_PortIf1
      operation Oper: possible-error=ApplSMBusOffBgn_PortIf1/E_NOT_OK
        arg CanCh_Arg: type=boolean, direction=IN, server-argument-impl-policy=USE-ARGUMENT-TYPE
        arg ApplSMBusOffBgn_Arg: type=boolean, direction=OUT, server-argument-impl-policy=USE-ARGUMENT-TYPE
      error E_NOT_OK: error-code=1
    ApplSMBusOffEnd_PortIf1
      operation Oper: possible-error=ApplSMBusOffEnd_PortIf1/E_NOT_OK
        arg CanCh_Arg: type=boolean, direction=IN, server-argument-impl-policy=USE-ARGUMENT-TYPE
        arg ApplSMBusOffEnd_Arg: type=boolean, direction=OUT, server-argument-impl-policy=USE-ARGUMENT-TYPE
      error E_NOT_OK: error-code=1
    Calc16BitCrc_u08_PortIf1
      operation Oper: possible-error=Calc16BitCrc_u08_PortIf1/E_NOT_OK
        5 x arg, all with server-argument-impl-policy=USE-ARGUMENT-TYPE:
          DataPtr_Arg: type=uint8, direction=INOUT
          Len_Arg: type=uint32, direction=IN
          StrtVal_Arg: type=uint16, direction=IN
          FirstCall_Arg: type=boolean, direction=IN
          CalcCrcRes_Arg: type=uint16, direction=OUT
      error E_NOT_OK: error-code=1
    Calc16BitCrc_u16_PortIf1
      operation Oper: possible-error=Calc16BitCrc_u16_PortIf1/E_NOT_OK
        5 x arg, all with server-argument-impl-policy=USE-ARGUMENT-TYPE:
          DataPtr_Arg: type=uint16, direction=INOUT
          Len_Arg: type=uint32, direction=IN
          StrtVal_Arg: type=uint16, direction=IN
          FirstCall_Arg: type=boolean, direction=IN
          CalcCrcRes_Arg: type=uint16, direction=OUT
      error E_NOT_OK: error-code=1
    Calc32BitCrc_u08_PortIf1
      operation Oper: possible-error=Calc32BitCrc_u08_PortIf1/E_NOT_OK
        5 x arg, all with server-argument-impl-policy=USE-ARGUMENT-TYPE:
          DataPtr_Arg: type=uint8, direction=INOUT
          Len_Arg: type=uint32, direction=IN
          StrtVal_Arg: type=uint32, direction=IN
          FirstCall_Arg: type=boolean, direction=IN
          CalcCrcRes_Arg: type=uint32, direction=OUT
      error E_NOT_OK: error-code=1
    Calc32BitCrc_u16_PortIf1
      operation Oper: possible-error=Calc32BitCrc_u16_PortIf1/E_NOT_OK
        5 x arg, all with server-argument-impl-policy=USE-ARGUMENT-TYPE:
          DataPtr_Arg: type=uint16, direction=INOUT
          Len_Arg: type=uint32, direction=IN
          StrtVal_Arg: type=uint32, direction=IN
          FirstCall_Arg: type=boolean, direction=IN
          CalcCrcRes_Arg: type=uint32, direction=OUT
      error E_NOT_OK: error-code=1
    Calc32BitCrc_u32_PortIf1
      operation Oper: possible-error=Calc32BitCrc_u32_PortIf1/E_NOT_OK
        5 x arg, all with server-argument-impl-policy=USE-ARGUMENT-TYPE:
          DataPtr_Arg: type=uint32, direction=INOUT
          Len_Arg: type=uint32, direction=IN
          StrtVal_Arg: type=uint32, direction=IN
          FirstCall_Arg: type=boolean, direction=IN
          CalcCrcRes_Arg: type=uint32, direction=OUT
      error E_NOT_OK: error-code=1
    Calc8BitCrc_PortIf1
      operation Oper: possible-error=Calc8BitCrc_PortIf1/E_NOT_OK
        5 x arg, all with server-argument-impl-policy=USE-ARGUMENT-TYPE:
          DataPtr_Arg: type=uint8, direction=INOUT
          Len_Arg: type=uint32, direction=IN
          StrtVal_Arg: type=uint8, direction=IN
          FirstCall_Arg: type=boolean, direction=IN
          CalcCrcRes_Arg: type=uint8, direction=OUT
      error E_NOT_OK: error-code=1
    ChkForStrtUpTest_PortIf1
      operation Oper
        arg ExecStrtUpTest_Arg: type=boolean, direction=OUT, server-argument-impl-policy=USE-ARGUMENT-TYPE
    ClrAllDiagc_PortIf1
      operation Oper
    ClrBmwRackCentrToVehCentrOffs_PortIf1
      operation Oper
    ClrErrInjReg_PortIf1
      operation Oper
    ClrFricLrngOperMod_PortIf1
      operation Oper
    ClrHwAgTrimVal_PortIf1
      operation Oper
    ClrLtchCntrData_PortIf1
      operation Oper
    ClrSigStcHlthData_PortIf1
      operation Oper
        arg ClrTar_Arg: type=boolean, direction=IN, server-argument-impl-policy=USE-ARGUMENT-TYPE
    ClrSnpshtData_PortIf1
      operation Oper
    ClrVehCentrPosn_PortIf1
      operation Oper
    CnvSnpshtData_f32_PortIf1
      operation Oper
        arg SnpshtDataCnvd_Arg: type=uint32, direction=OUT, server-argument-impl-policy=USE-ARGUMENT-TYPE
        arg SnpshtData_Arg: type=float32, direction=IN, server-argument-impl-policy=USE-ARGUMENT-TYPE
    CnvSnpshtData_logl_PortIf1
      operation Oper
        arg SnpshtDataCnvd_Arg: type=uint32, direction=OUT, server-argument-impl-policy=USE-ARGUMENT-TYPE
        arg SnpshtData_Arg: type=boolean, direction=IN, server-argument-impl-policy=USE-ARGUMENT-TYPE
    CnvSnpshtData_s08_PortIf1
      operation Oper
        arg SnpshtDataCnvd_Arg: type=uint32, direction=OUT, server-argument-impl-policy=USE-ARGUMENT-TYPE
        arg SnpshtData_Arg: type=sint8, direction=IN, server-argument-impl-policy=USE-ARGUMENT-TYPE
    CnvSnpshtData_s16_PortIf1
      operation Oper
        arg SnpshtDataCnvd_Arg: type=uint32, direction=OUT, server-argument-impl-policy=USE-ARGUMENT-TYPE
        arg SnpshtData_Arg: type=sint16, direction=IN, server-argument-impl-policy=USE-ARGUMENT-TYPE
    CnvSnpshtData_s32_PortIf1
      operation Oper
        arg SnpshtDataCnvd_Arg: type=uint32, direction=OUT, server-argument-impl-policy=USE-ARGUMENT-TYPE
        arg SnpshtData_Arg: type=sint32, direction=IN, server-argument-impl-policy=USE-ARGUMENT-TYPE
    CnvSnpshtData_u08_PortIf1
      operation Oper
        arg SnpshtDataCnvd_Arg: type=uint32, direction=OUT, server-argument-impl-policy=USE-ARGUMENT-TYPE
        arg SnpshtData_Arg: type=uint8, direction=IN, server-argument-impl-policy=USE-ARGUMENT-TYPE
    CnvSnpshtData_u16_PortIf1
      operation Oper
        arg SnpshtDataCnvd_Arg: type=uint32, direction=OUT, server-argument-impl-policy=USE-ARGUMENT-TYPE
        arg SnpshtData_Arg: type=uint16, direction=IN, server-argument-impl-policy=USE-ARGUMENT-TYPE
    CopyCalPageReq_PortIf1
      operation Oper: possible-error=CopyCalPageReq_PortIf1/E_NOT_OK
        arg Seg_Arg: type=uint8, direction=IN, server-argument-impl-policy=USE-ARGUMENT-TYPE
      error E_NOT_OK: error-code=1
    CtrlErrOut_PortIf1
      operation Oper
        arg PinSt_Arg: type=boolean, direction=IN, server-argument-impl-policy=USE-ARGUMENT-TYPE
        arg TrigReg_Arg: type=TrigReg1, direction=IN, server-argument-impl-policy=USE-ARGUMENT-TYPE
    CurrMeasEolGainReq_PortIf1
      operation Oper
    CurrMeasEolGainStReq_PortIf1
      operation Oper
        arg CurrMeasEolGainSt_Arg: type=uint8, direction=OUT, server-argument-impl-policy=USE-ARGUMENT-TYPE
    CurrMeasEolOffsReq_PortIf1
      operation Oper
    CurrMeasEolOffsStReq_PortIf1
      operation Oper
        arg CurrMeasEolOffsSt_Arg: type=uint8, direction=OUT, server-argument-impl-policy=USE-ARGUMENT-TYPE
    CurrMeasGainReadReq_PortIf2
      operation Oper
        arg CurrMeasMotCurrGainA_Arg: type=float32, direction=OUT, server-argument-impl-policy=USE-ARGUMENT-TYPE
        arg CurrMeasMotCurrGainB_Arg: type=float32, direction=OUT, server-argument-impl-policy=USE-ARGUMENT-TYPE
        arg CurrMeasMotCurrGainC_Arg: type=float32, direction=OUT, server-argument-impl-policy=USE-ARGUMENT-TYPE
    CurrMeasGainReadReqBrdg_PortIf1
      operation Oper
        arg CurrMeasMotCurrGainA_Arg: type=float32, direction=OUT, server-argument-impl-policy=USE-ARGUMENT-TYPE
        arg CurrMeasMotCurrGainB_Arg: type=float32, direction=OUT, server-argument-impl-policy=USE-ARGUMENT-TYPE
    CurrMeasGainReadReqSngIvtr_PortIf1
      operation Oper
        arg CurrMeasMotCurrGainA_Arg: type=float32, direction=OUT, server-argument-impl-policy=USE-ARGUMENT-TYPE
        arg CurrMeasMotCurrGainB_Arg: type=float32, direction=OUT, server-argument-impl-policy=USE-ARGUMENT-TYPE
        arg CurrMeasMotCurrGainC_Arg: type=float32, direction=OUT, server-argument-impl-policy=USE-ARGUMENT-TYPE
    CurrMeasGainWrReq_PortIf3
      operation Oper
        4 x arg, all with server-argument-impl-policy=USE-ARGUMENT-TYPE:
          CurrMeasMotCurrGainA_Arg: type=float32, direction=IN
          CurrMeasMotCurrGainB_Arg: type=float32, direction=IN
          CurrMeasMotCurrGainC_Arg: type=float32, direction=IN
          CurrMeasGainWrReqSts_Arg: type=uint8, direction=OUT
    CurrMeasGainWrReqBrdg_PortIf1
      operation Oper
        arg CurrMeasMotCurrGainA_Arg: type=float32, direction=IN, server-argument-impl-policy=USE-ARGUMENT-TYPE
        arg CurrMeasMotCurrGainB_Arg: type=float32, direction=IN, server-argument-impl-policy=USE-ARGUMENT-TYPE
        arg CurrMeasGainWrReqSts_Arg: type=uint8, direction=OUT, server-argument-impl-policy=USE-ARGUMENT-TYPE
    CurrMeasGainWrReqSngIvtr_PortIf1
      operation Oper
        4 x arg, all with server-argument-impl-policy=USE-ARGUMENT-TYPE:
          CurrMeasMotCurrGainA_Arg: type=float32, direction=IN
          CurrMeasMotCurrGainB_Arg: type=float32, direction=IN
          CurrMeasMotCurrGainC_Arg: type=float32, direction=IN
          CurrMeasGainWrReqSts_Arg: type=uint8, direction=OUT
    CurrMeasOffsReadReq_PortIf3
      operation Oper
        arg MotCurrOffsZeroAvrgA_Arg: type=float32, direction=OUT, server-argument-impl-policy=USE-ARGUMENT-TYPE
        arg MotCurrOffsZeroAvrgB_Arg: type=float32, direction=OUT, server-argument-impl-policy=USE-ARGUMENT-TYPE
        arg MotCurrOffsZeroAvrgC_Arg: type=float32, direction=OUT, server-argument-impl-policy=USE-ARGUMENT-TYPE
    CurrMeasOffsReadReqBrdg_PortIf1
      operation Oper
        5 x arg, all with type=float32, direction=OUT, server-argument-impl-policy=USE-ARGUMENT-TYPE:
          CurrMeasEolOffsHiBrdgVltg_Arg
          CurrMeasMotCurrOffsDifA_Arg
          CurrMeasMotCurrOffsDifB_Arg
          CurrMeasMotCurrOffsLoAvrgA_Arg
          CurrMeasMotCurrOffsLoAvrgB_Arg
    CurrMeasOffsReadReqSngIvtr_PortIf1
      operation Oper
        7 x arg, all with type=float32, direction=OUT, server-argument-impl-policy=USE-ARGUMENT-TYPE:
          CurrMeasEolOffsHiBrdgVltg_Arg
          CurrMeasMotCurrOffsDifA_Arg
          CurrMeasMotCurrOffsDifB_Arg
          CurrMeasMotCurrOffsDifC_Arg
          CurrMeasMotCurrOffsLoAvrgA_Arg
          CurrMeasMotCurrOffsLoAvrgB_Arg
          CurrMeasMotCurrOffsLoAvrgC_Arg
    CurrMeasOffsWrReq_PortIf4
      operation Oper
        arg MotCurrOffsZeroAvrgA_Arg: type=float32, direction=IN, server-argument-impl-policy=USE-ARGUMENT-TYPE
        arg MotCurrOffsZeroAvrgB_Arg: type=float32, direction=IN, server-argument-impl-policy=USE-ARGUMENT-TYPE
        arg MotCurrOffsZeroAvrgC_Arg: type=float32, direction=IN, server-argument-impl-policy=USE-ARGUMENT-TYPE
    CurrMeasOffsWrReqBrdg_PortIf1
      operation Oper
        6 x arg, all with server-argument-impl-policy=USE-ARGUMENT-TYPE:
          CurrMeasEolOffsHiBrdgVltg_Arg: type=float32, direction=IN
          CurrMeasMotCurrOffsDifA_Arg: type=float32, direction=IN
          CurrMeasMotCurrOffsDifB_Arg: type=float32, direction=IN
          CurrMeasMotCurrOffsLoAvrgA_Arg: type=float32, direction=IN
          CurrMeasMotCurrOffsLoAvrgB_Arg: type=float32, direction=IN
          CurrMeasOffsWrReqSts_Arg: type=uint8, direction=OUT
    CurrMeasOffsWrReqSngIvtr_PortIf1
      operation Oper
        8 x arg, all with server-argument-impl-policy=USE-ARGUMENT-TYPE:
          CurrMeasEolOffsHiBrdgVltg_Arg: type=float32, direction=IN
          CurrMeasMotCurrOffsDifA_Arg: type=float32, direction=IN
          CurrMeasMotCurrOffsDifB_Arg: type=float32, direction=IN
          CurrMeasMotCurrOffsDifC_Arg: type=float32, direction=IN
          CurrMeasMotCurrOffsLoAvrgA_Arg: type=float32, direction=IN
          CurrMeasMotCurrOffsLoAvrgB_Arg: type=float32, direction=IN
          CurrMeasMotCurrOffsLoAvrgC_Arg: type=float32, direction=IN
          CurrMeasOffsWrReqSts_Arg: type=uint8, direction=OUT
    DmaEna2MilliSecToMotCtrlTrf_PortIf1
      operation Oper
    DmaEna2MilliSecToMotCtrlTrf1_PortIf1
      operation Oper
    DmaEna2msToMotCtrlTrf_PortIf1
      operation Oper
    DmaWaitForMotCtrlTo2MilliSecTrf_PortIf1
      operation Oper: possible-error=DmaWaitForMotCtrlTo2MilliSecTrf_PortIf1/E_NOT_OK
      error E_NOT_OK: error-code=1
    DmaWaitForMotCtrlTo2MilliSecTrf1_PortIf1
      operation Oper: possible-error=DmaWaitForMotCtrlTo2MilliSecTrf1_PortIf1/E_NOT_OK
      error E_NOT_OK: error-code=1
    DmaWaitForMotCtrlTo2msTrf_PortIf1
      operation Oper: possible-error=DmaWaitForMotCtrlTo2msTrf_PortIf1/E_NOT_OK
      error E_NOT_OK: error-code=1
    FltInj_f32_PortIf1
      operation Oper
        arg SigPah_Arg: type=float32, direction=INOUT, server-argument-impl-policy=USE-ARGUMENT-TYPE
        arg LocnKey_Arg: type=uint16, direction=IN, server-argument-impl-policy=USE-ARGUMENT-TYPE
    FltInj_logl_PortIf1
      operation Oper
        arg SigPah_Arg: type=boolean, direction=INOUT, server-argument-impl-policy=USE-ARGUMENT-TYPE
        arg LocnKey_Arg: type=uint16, direction=IN, server-argument-impl-policy=USE-ARGUMENT-TYPE
    FltInj_u08_PortIf1
      operation Oper
        arg SigPah_Arg: type=uint8, direction=INOUT, server-argument-impl-policy=USE-ARGUMENT-TYPE
        arg LocnKey_Arg: type=uint16, direction=IN, server-argument-impl-policy=USE-ARGUMENT-TYPE
    FltInj_u0p16_PortIf1
      operation Oper
        arg SigPah_Arg: type=u0p16, direction=INOUT, server-argument-impl-policy=USE-ARGUMENT-TYPE
        arg LocnKey_Arg: type=uint16, direction=IN, server-argument-impl-policy=USE-ARGUMENT-TYPE
    FSnsrlsHwCentr_PortIf1
      operation Oper
    GetCalPageReq_PortIf1
      operation Oper
        4 x arg, all with type=uint8, server-argument-impl-policy=USE-ARGUMENT-TYPE:
          Seg_Arg: direction=IN
          Mod_Arg: direction=IN
          Page_Arg: direction=INOUT
          Rtn_Arg: direction=OUT
    GetCtrlPrm_PortIf1
      operation Oper
        7 x arg, all with type=float32, direction=OUT, server-argument-impl-policy=USE-ARGUMENT-TYPE:
          MotVelCtrlPropGain_Arg
          MotVelCtrlIntgtrGain_Arg
          MotVelCtrlDerivtvGain_Arg
          MotVelCtrlAntiWdupLim_Arg
          MotVelCtrlAntiWdupGain_Arg
          MotVelCtrlDerivtvLpFilTiCon_Arg
          MotVelCtrlTqCmdLim_Arg
    GetFricData_PortIf3
      operation Oper
        5 x arg, all with direction=OUT, server-argument-impl-policy=USE-ARGUMENT-TYPE:
          FricOffs_Arg: type=float32
          BasLineFric_Arg: type=Ary1D_f32_4
          VehLrndFric_Arg: type=Ary1D_f32_4
          Hys_Arg: type=Ary2D_f32_8_4
          RngCntr_Arg: type=Ary2D_u16_8_3
    GetFricLrngData_PortIf1
      operation Oper
        4 x arg, all with direction=OUT, server-argument-impl-policy=USE-ARGUMENT-TYPE:
          FricLrngEna_Arg: type=boolean
          FricLrngOffsOutpEna_Arg: type=boolean
          FricLrngOperMod_Arg: type=SysFricLrngOperMod1
          EolFric_Arg: type=float32
    GetFricOffsOutpDi_PortIf1
      operation Oper
        arg FricOffsOutpDi_Arg: type=boolean, direction=OUT, server-argument-impl-policy=USE-ARGUMENT-TYPE
    GetGearIdn_PortIf1
      operation Oper
        arg GearIdn_Arg: type=uint8, direction=OUT, server-argument-impl-policy=USE-ARGUMENT-TYPE
    GetGmLoaIgnCntr_PortIf1
      operation Oper
        arg GmLoaIgnCntr_Arg: type=uint16, direction=OUT, server-argument-impl-policy=USE-ARGUMENT-TYPE
    GetGmSteerAgCtrlDiHist_PortIf1
      operation Oper
        arg GmSteerAgCtrlDiHist_Arg: type=Ary1D_GmSteerAgCtrlDiSt1_7, direction=OUT, server-argument-impl-policy=USE-ARGUMENT-TYPE
    GetGpio_PortIf1
      operation Oper: possible-error=GetGpio_PortIf1/E_NOT_OK
        arg PinSt_Arg: type=boolean, direction=OUT, server-argument-impl-policy=USE-ARGUMENT-TYPE
      error E_NOT_OK: error-code=1
    GetHwAgOffs_PortIf1
      operation Oper
        arg HwAgOffs_Arg: type=float32, direction=OUT, server-argument-impl-policy=USE-ARGUMENT-TYPE
        arg HwAgLrngStRst_Arg: type=boolean, direction=OUT, server-argument-impl-policy=USE-ARGUMENT-TYPE
    GetHwAgOverTrvlCnt_PortIf2
      operation Oper
        arg HwAgOverTrvlCnt_Arg: type=uint8, direction=OUT, server-argument-impl-policy=USE-ARGUMENT-TYPE
    GetHwAgTrimVal_PortIf2
      operation Oper
        arg HwAgTrimVal_Arg: type=float32, direction=OUT, server-argument-impl-policy=USE-ARGUMENT-TYPE
        arg HwAgTrimPrfmd_Arg: type=boolean, direction=OUT, server-argument-impl-policy=USE-ARGUMENT-TYPE
    GetHwTqOffs_PortIf1
      operation Oper
        arg HwTqOffs_Arg: type=float32, direction=OUT, server-argument-impl-policy=USE-ARGUMENT-TYPE
        arg HwTqLrngStRst_Arg: type=boolean, direction=OUT, server-argument-impl-policy=USE-ARGUMENT-TYPE
    GetMcuDiagcSpplData_PortIf1
      operation Oper
        arg McuDiagcData1_Arg: type=uint32, direction=OUT, server-argument-impl-policy=USE-ARGUMENT-TYPE
    GetMotAgMecl_PortIf1
      operation Oper
        arg MotAgMecl_Arg: type=u0p16, direction=OUT, server-argument-impl-policy=USE-ARGUMENT-TYPE
    GetMotCoggCmdPrm_PortIf1
      operation Oper
        arg MotCoggCmdY_Arg: type=Ary1D_s1p14_128, direction=OUT, server-argument-impl-policy=USE-ARGUMENT-TYPE
        arg Idx_Arg: type=uint8, direction=IN, server-argument-impl-policy=USE-ARGUMENT-TYPE
    GetMotPrmNomEol_PortIf1
      operation Oper
        arg MotBackEmfConNom_Arg: type=float32, direction=OUT, server-argument-impl-policy=USE-ARGUMENT-TYPE
        arg MotRNom_Arg: type=float32, direction=OUT, server-argument-impl-policy=USE-ARGUMENT-TYPE
    GetMotRplCoggPrm_PortIf1
      operation Oper
        9 x arg, all with direction=OUT, server-argument-impl-policy=USE-ARGUMENT-TYPE:
          CoggOrder1_Arg: type=uint16
          CoggOrder1X_Arg: type=s1p14
          CoggOrder1Y_Arg: type=s1p14
          CoggOrder2_Arg: type=uint16
          CoggOrder2X_Arg: type=s1p14
          CoggOrder2Y_Arg: type=s1p14
          CoggOrder3_Arg: type=uint16
          CoggOrder3X_Arg: type=s1p14
          CoggOrder3Y_Arg: type=s1p14
    GetMotTqCmdSca_PortIf1
      operation Oper
        arg MotTqCmdSca_Arg: type=float32, direction=OUT, server-argument-impl-policy=USE-ARGUMENT-TYPE
    GetNtcActv1_PortIf1
      operation Oper: possible-error=GetNtcActv1_PortIf1/E_NOT_OK
        arg NtcNr: type=NtcNr1, direction=IN, server-argument-impl-policy=USE-ARGUMENT-TYPE
        arg NtcActv: type=boolean, direction=OUT, server-argument-impl-policy=USE-ARGUMENT-TYPE
      error E_NOT_OK: error-code=1
    GetNtcQlfrSts_PortIf1
      operation Oper: possible-error=GetNtcQlfrSts_PortIf1/E_NOT_OK
        arg NtcNr_Arg: type=NtcNr1, direction=IN, server-argument-impl-policy=USE-ARGUMENT-TYPE
        arg NtcQlfr_Arg: type=SigQlfr1, direction=OUT, server-argument-impl-policy=USE-ARGUMENT-TYPE
      error E_NOT_OK: error-code=1
    GetNtcQlfrSts1_PortIf1  # OBSOLETE
      operation Oper: possible-error=GetNtcQlfrSts1_PortIf1/E_NOT_OK
        arg NtcNr: type=NtcNr1, direction=IN, server-argument-impl-policy=USE-ARGUMENT-TYPE
        arg NtcQlfr: type=SigQlfr1, direction=OUT, server-argument-impl-policy=USE-ARGUMENT-TYPE
      error E_NOT_OK: error-code=1
    GetNtcSts1_PortIf1
      operation Oper: possible-error=GetNtcSts1_PortIf1/E_NOT_OK
        arg NtcNr: type=NtcNr1, direction=IN, server-argument-impl-policy=USE-ARGUMENT-TYPE
        arg NtcInfoSts: type=uint8, direction=OUT, server-argument-impl-policy=USE-ARGUMENT-TYPE
      error E_NOT_OK: error-code=1
    GetPullCmpPrm_PortIf1
      operation Oper
        4 x arg, all with direction=OUT, server-argument-impl-policy=USE-ARGUMENT-TYPE:
          PullCmpCmdTot_Arg: type=float32
          PullCmpShoTerm_Arg: type=float32
          PullCmpLongTerm_Arg: type=float32
          LrngEnad_Arg: type=boolean
    GetRefTmr100MicroSec32bit_PortIf1
      operation Oper
        arg RefTmr_Arg: type=uint32, direction=OUT, server-argument-impl-policy=USE-ARGUMENT-TYPE
    GetRefTmr1MicroSec32bit_PortIf1
      operation Oper
        arg RefTmr_Arg: type=uint32, direction=OUT, server-argument-impl-policy=USE-ARGUMENT-TYPE
    GetSegInfoReq_PortIf2
      operation Oper
        7 x arg, all with server-argument-impl-policy=USE-ARGUMENT-TYPE:
          Mod_Arg: type=GetSegMod1, direction=IN
          Seg_Arg: type=uint8, direction=IN
          SegInfo_Arg: type=uint8, direction=IN
          MpgIdx_Arg: type=uint8, direction=IN
          Resp_Arg: type=uint8, direction=INOUT
          RespLen_Arg: type=uint8, direction=INOUT
          Rtn_Arg: type=uint8, direction=OUT
    GetSigImcData_f32_PortIf1
      operation Oper: possible-error=GetSigImcData_f32_PortIf1/E_NOT_OK
        arg SigId_Arg: type=uint16, direction=IN, server-argument-impl-policy=USE-ARGUMENT-TYPE
        arg Data_Arg: type=float32, direction=OUT, server-argument-impl-policy=USE-ARGUMENT-TYPE
        arg Sts_Arg: type=ImcArbnRxSts1, direction=OUT, server-argument-impl-policy=USE-ARGUMENT-TYPE
      error E_NOT_OK: error-code=1
    GetSigImcData_logl_PortIf1
      operation Oper: possible-error=GetSigImcData_logl_PortIf1/E_NOT_OK
        arg SigId_Arg: type=uint16, direction=IN, server-argument-impl-policy=USE-ARGUMENT-TYPE
        arg Data_Arg: type=boolean, direction=OUT, server-argument-impl-policy=USE-ARGUMENT-TYPE
        arg Sts_Arg: type=ImcArbnRxSts1, direction=OUT, server-argument-impl-policy=USE-ARGUMENT-TYPE
      error E_NOT_OK: error-code=1
    GetSigImcData_s08_PortIf1
      operation Oper: possible-error=GetSigImcData_s08_PortIf1/E_NOT_OK
        arg SigId_Arg: type=uint16, direction=IN, server-argument-impl-policy=USE-ARGUMENT-TYPE
        arg Data_Arg: type=sint8, direction=OUT, server-argument-impl-policy=USE-ARGUMENT-TYPE
        arg Sts_Arg: type=ImcArbnRxSts1, direction=OUT, server-argument-impl-policy=USE-ARGUMENT-TYPE
      error E_NOT_OK: error-code=1
    GetSigImcData_s16_PortIf1
      operation Oper: possible-error=GetSigImcData_s16_PortIf1/E_NOT_OK
        arg SigId_Arg: type=uint16, direction=IN, server-argument-impl-policy=USE-ARGUMENT-TYPE
        arg Data_Arg: type=sint16, direction=OUT, server-argument-impl-policy=USE-ARGUMENT-TYPE
        arg Sts_Arg: type=ImcArbnRxSts1, direction=OUT, server-argument-impl-policy=USE-ARGUMENT-TYPE
      error E_NOT_OK: error-code=1
    GetSigImcData_s32_PortIf1
      operation Oper: possible-error=GetSigImcData_s32_PortIf1/E_NOT_OK
        arg SigId_Arg: type=uint16, direction=IN, server-argument-impl-policy=USE-ARGUMENT-TYPE
        arg Data_Arg: type=sint32, direction=OUT, server-argument-impl-policy=USE-ARGUMENT-TYPE
        arg Sts_Arg: type=ImcArbnRxSts1, direction=OUT, server-argument-impl-policy=USE-ARGUMENT-TYPE
      error E_NOT_OK: error-code=1
    GetSigImcData_u08_PortIf1
      operation Oper: possible-error=GetSigImcData_u08_PortIf1/E_NOT_OK
        arg SigId_Arg: type=uint16, direction=IN, server-argument-impl-policy=USE-ARGUMENT-TYPE
        arg Data_Arg: type=uint8, direction=OUT, server-argument-impl-policy=USE-ARGUMENT-TYPE
        arg Sts_Arg: type=ImcArbnRxSts1, direction=OUT, server-argument-impl-policy=USE-ARGUMENT-TYPE
      error E_NOT_OK: error-code=1
    GetSigImcData_u16_PortIf1
      operation Oper: possible-error=GetSigImcData_u16_PortIf1/E_NOT_OK
        arg SigId_Arg: type=uint16, direction=IN, server-argument-impl-policy=USE-ARGUMENT-TYPE
        arg Data_Arg: type=uint16, direction=OUT, server-argument-impl-policy=USE-ARGUMENT-TYPE
        arg Sts_Arg: type=ImcArbnRxSts1, direction=OUT, server-argument-impl-policy=USE-ARGUMENT-TYPE
      error E_NOT_OK: error-code=1
    GetSigImcData_u32_PortIf1
      operation Oper: possible-error=GetSigImcData_u32_PortIf1/E_NOT_OK
        arg SigId_Arg: type=uint16, direction=IN, server-argument-impl-policy=USE-ARGUMENT-TYPE
        arg Data_Arg: type=uint32, direction=OUT, server-argument-impl-policy=USE-ARGUMENT-TYPE
        arg Sts_Arg: type=ImcArbnRxSts1, direction=OUT, server-argument-impl-policy=USE-ARGUMENT-TYPE
      error E_NOT_OK: error-code=1
    GetSigImcDataExtdSts_f32_PortIf1
      operation Oper: possible-error=GetSigImcDataExtdSts_f32_PortIf1/E_NOT_OK
        4 x arg, all with server-argument-impl-policy=USE-ARGUMENT-TYPE:
          SigId_Arg: type=uint16, direction=IN
          Data_Arg: type=float32, direction=OUT
          Sts_Arg: type=ImcArbnRxExtdSts1, direction=OUT
          DataSrc_Arg: type=ImcArbnRxDataSrc1, direction=OUT
      error E_NOT_OK: error-code=1
    GetSigImcDataExtdSts_logl_PortIf1
      operation Oper: possible-error=GetSigImcDataExtdSts_logl_PortIf1/E_NOT_OK
        4 x arg, all with server-argument-impl-policy=USE-ARGUMENT-TYPE:
          SigId_Arg: type=uint16, direction=IN
          Data_Arg: type=boolean, direction=OUT
          Sts_Arg: type=ImcArbnRxExtdSts1, direction=OUT
          DataSrc_Arg: type=ImcArbnRxDataSrc1, direction=OUT
      error E_NOT_OK: error-code=1
    GetSigImcDataExtdSts_s08_PortIf1
      operation Oper: possible-error=GetSigImcDataExtdSts_s08_PortIf1/E_NOT_OK
        4 x arg, all with server-argument-impl-policy=USE-ARGUMENT-TYPE:
          SigId_Arg: type=uint16, direction=IN
          Data_Arg: type=sint8, direction=OUT
          Sts_Arg: type=ImcArbnRxExtdSts1, direction=OUT
          DataSrc_Arg: type=ImcArbnRxDataSrc1, direction=OUT
      error E_NOT_OK: error-code=1
    GetSigImcDataExtdSts_s16_PortIf1
      operation Oper: possible-error=GetSigImcDataExtdSts_s16_PortIf1/E_NOT_OK
        4 x arg, all with server-argument-impl-policy=USE-ARGUMENT-TYPE:
          SigId_Arg: type=uint16, direction=IN
          Data_Arg: type=sint16, direction=OUT
          Sts_Arg: type=ImcArbnRxExtdSts1, direction=OUT
          DataSrc_Arg: type=ImcArbnRxDataSrc1, direction=OUT
      error E_NOT_OK: error-code=1
    GetSigImcDataExtdSts_s32_PortIf1
      operation Oper: possible-error=GetSigImcDataExtdSts_s32_PortIf1/E_NOT_OK
        4 x arg, all with server-argument-impl-policy=USE-ARGUMENT-TYPE:
          SigId_Arg: type=uint16, direction=IN
          Data_Arg: type=sint32, direction=OUT
          Sts_Arg: type=ImcArbnRxExtdSts1, direction=OUT
          DataSrc_Arg: type=ImcArbnRxDataSrc1, direction=OUT
      error E_NOT_OK: error-code=1
    GetSigImcDataExtdSts_u08_PortIf1
      operation Oper: possible-error=GetSigImcDataExtdSts_u08_PortIf1/E_NOT_OK
        4 x arg, all with server-argument-impl-policy=USE-ARGUMENT-TYPE:
          SigId_Arg: type=uint16, direction=IN
          Data_Arg: type=uint8, direction=OUT
          Sts_Arg: type=ImcArbnRxExtdSts1, direction=OUT
          DataSrc_Arg: type=ImcArbnRxDataSrc1, direction=OUT
      error E_NOT_OK: error-code=1
    GetSigImcDataExtdSts_u16_PortIf1
      operation Oper: possible-error=GetSigImcDataExtdSts_u16_PortIf1/E_NOT_OK
        4 x arg, all with server-argument-impl-policy=USE-ARGUMENT-TYPE:
          SigId_Arg: type=uint16, direction=IN
          Data_Arg: type=uint16, direction=OUT
          Sts_Arg: type=ImcArbnRxExtdSts1, direction=OUT
          DataSrc_Arg: type=ImcArbnRxDataSrc1, direction=OUT
      error E_NOT_OK: error-code=1
    GetSigImcDataExtdSts_u32_PortIf1
      operation Oper: possible-error=GetSigImcDataExtdSts_u32_PortIf1/E_NOT_OK
        4 x arg, all with server-argument-impl-policy=USE-ARGUMENT-TYPE:
          SigId_Arg: type=uint16, direction=IN
          Data_Arg: type=uint32, direction=OUT
          Sts_Arg: type=ImcArbnRxExtdSts1, direction=OUT
          DataSrc_Arg: type=ImcArbnRxDataSrc1, direction=OUT
      error E_NOT_OK: error-code=1
    GetSigStcHlthData_PortIf3
      operation Oper: possible-error=GetSigStcHlthData_PortIf3/E_NOT_OK
        arg SigId_Arg: type=StHlthMonSig3, direction=IN, server-argument-impl-policy=USE-ARGUMENT-TYPE
        arg BufPtr_Arg: type=uint32, direction=OUT, server-argument-impl-policy=USE-ARGUMENT-TYPE
      error E_NOT_OK: error-code=1
    GetSigStcHlthData_PortIf4
      operation Oper: possible-error=GetSigStcHlthData_PortIf4/E_NOT_OK
        arg SigId_Arg: type=StHlthMonSig4, direction=IN, server-argument-impl-policy=USE-ARGUMENT-TYPE
        arg BufPtr_Arg: type=uint32, direction=OUT, server-argument-impl-policy=USE-ARGUMENT-TYPE
      error E_NOT_OK: error-code=1
    GetTiSpan100MicroSec32bit_PortIf1
      operation Oper
        arg RefTmr_Arg: type=uint32, direction=IN, server-argument-impl-policy=USE-ARGUMENT-TYPE
        arg TiSpan_Arg: type=uint32, direction=OUT, server-argument-impl-policy=USE-ARGUMENT-TYPE
    GetTiSpan1MicroSec32bit_PortIf1
      operation Oper
        arg RefTmr_Arg: type=uint32, direction=IN, server-argument-impl-policy=USE-ARGUMENT-TYPE
        arg TiSpan_Arg: type=uint32, direction=OUT, server-argument-impl-policy=USE-ARGUMENT-TYPE
    GetTxRateGroup_PortIf1
      operation Oper: possible-error=GetTxRateGroup_PortIf1/E_NOT_OK
        arg RateGroup_Arg: type=uint8, direction=IN, server-argument-impl-policy=USE-ARGUMENT-TYPE
        arg Buf_Arg: type=uint8, direction=OUT, server-argument-impl-policy=USE-ARGUMENT-TYPE
      error E_NOT_OK: error-code=1
    GetTxSigGroup_PortIf1
      operation Oper: possible-error=GetTxSigGroup_PortIf1/E_NOT_OK
        arg SigGroupId_Arg: type=uint8, direction=IN, server-argument-impl-policy=USE-ARGUMENT-TYPE
        arg Buf_Arg: type=uint8, direction=OUT, server-argument-impl-policy=USE-ARGUMENT-TYPE
      error E_NOT_OK: error-code=1
    GetYawRateOffs_PortIf1
      operation Oper
        arg VehYawRateOffs_Arg: type=float32, direction=OUT, server-argument-impl-policy=USE-ARGUMENT-TYPE
        arg VehYawRateLrngStRst_Arg: type=boolean, direction=OUT, server-argument-impl-policy=USE-ARGUMENT-TYPE
    GmFctDiReq_PortIf1
      operation Oper
    GtmGetSentData_PortIf1  # OBSOLETE
      operation Oper: possible-error=GtmGetSentData_PortIf1/E_NOT_OK
        arg BufStrtAdr_Arg: type=uint32, direction=INOUT, server-argument-impl-policy=USE-ARGUMENT-TYPE
      error E_NOT_OK: error-code=1
    GtmGetSentData_PortIf2
      operation Oper: possible-error=GtmGetSentData_PortIf2/E_NOT_OK
        arg BufStrt_Arg: type=uint32, direction=OUT, server-argument-impl-policy=USE-ARGUMENT-TYPE
      error E_NOT_OK: error-code=1
    HwAgAutTrim_PortIf1
      operation Oper
    HwAgClrLtch_PortIf1
      operation Oper
    HwAgClrTrim_PortIf1
      operation Oper
    HwAgReadTrim_PortIf1
      operation Oper
        arg HwAgReadTrimData_Arg: type=float32, direction=OUT, server-argument-impl-policy=USE-ARGUMENT-TYPE
    HwAgTrimPrfmdSts_PortIf1
      operation Oper
        arg HwAgOffsTrimPrfmdStsData_Arg: type=boolean, direction=OUT, server-argument-impl-policy=USE-ARGUMENT-TYPE
    HwAgWrTrim_PortIf1
      operation Oper
        arg HwAgWrOffsTrimData_Arg: type=float32, direction=IN, server-argument-impl-policy=USE-ARGUMENT-TYPE
    HwTqClrSnsrSca_PortIf1
      operation Oper
    HwTqMeasHwTqAutTrim_PortIf1
      operation Oper
    HwTqMeasHwTqClrTrim_PortIf1
      operation Oper
    HwTqMeasHwTqReadTrim_PortIf1
      operation Oper
        arg HwTqReadTrimData_Arg: type=float32, direction=OUT, server-argument-impl-policy=USE-ARGUMENT-TYPE
    HwTqMeasHwTqTrimPrfmdSts_PortIf1
      operation Oper
        arg HwTqOffsTrimPrfmdStsData_Arg: type=boolean, direction=OUT, server-argument-impl-policy=USE-ARGUMENT-TYPE
    HwTqMeasHwTqWrTrim_PortIf1
      operation Oper
        arg HwTqWrOffsTrimData_Arg: type=float32, direction=IN, server-argument-impl-policy=USE-ARGUMENT-TYPE
    HwTqReadSnsrSca_PortIf2
      operation Oper
        arg HwTqReadScaData_Arg: type=float32, direction=OUT, server-argument-impl-policy=USE-ARGUMENT-TYPE
    HwTqSnsrScaPrfmdSts_PortIf1
      operation Oper
        arg HwTqScaPrfmdStsData_Arg: type=boolean, direction=OUT, server-argument-impl-policy=USE-ARGUMENT-TYPE
    HwTqWrSnsrSca_PortIf1
      operation Oper
        arg HwTqScaVal_Arg: type=float32, direction=IN, server-argument-impl-policy=USE-ARGUMENT-TYPE
    InitFricLrngTbl_PortIf1
      operation Oper
    MCalReadVrfyFailFltInfo_PortIf1
      operation Oper
        arg PrphlId_Arg: type=uint8, direction=IN, server-argument-impl-policy=USE-ARGUMENT-TYPE
        arg ErrId_Arg: type=uint16, direction=IN, server-argument-impl-policy=USE-ARGUMENT-TYPE
    MeasTrigStrt_PortIf1
      operation Oper
    MotAg0MeasMotAg0CorrnTblClr1_PortIf1
      operation Oper
    MotAg0SnsrCfgDmaStrt_PortIf2
      operation Oper: possible-error=MotAg0SnsrCfgDmaStrt_PortIf2/E_NOT_OK
      error E_NOT_OK: error-code=1
    MotAg1MeasMotAg1CorrnTblClr1_PortIf1
      operation Oper
    MotAgCmpBackEmfRead_PortIf1
      operation Oper
        arg MotAgBackEmfRead_Arg: type=u0p16, direction=OUT, server-argument-impl-policy=USE-ARGUMENT-TYPE
    MotAgCmpBackEmfWr_PortIf1
      operation Oper
        arg MotAgCmpBackEmfWrData_Arg: type=u0p16, direction=IN, server-argument-impl-policy=USE-ARGUMENT-TYPE
    MotAgEolPrmRead_PortIf1
      operation Oper
        arg MotAgEolPrmData_Arg: type=MotAgEolPrmRec1, direction=OUT, server-argument-impl-policy=USE-ARGUMENT-TYPE
    MotAgEolPrmWr_PortIf1
      operation Oper
        arg MotAgEolPrmData_Arg: type=MotAgEolPrmRec1, direction=IN, server-argument-impl-policy=USE-ARGUMENT-TYPE
    MotAgMeasEolPrmRead_PortIf2
      operation Oper
        arg MotAgEolPrmRead_Arg: type=MotAgMeasEolPrmRec1, direction=OUT, server-argument-impl-policy=USE-ARGUMENT-TYPE
    MotAgMeasEolPrmWr_PortIf2
      operation Oper
        arg MotAgSinCosEolCalData_Arg: type=MotAgMeasEolPrmRec1, direction=IN, server-argument-impl-policy=USE-ARGUMENT-TYPE
    MotAgMeasMotAgCoeffTblRead_PortIf1
      operation Oper
        arg MotAgCoeffTbl_Arg: type=Ary1D_f32_26, direction=OUT, server-argument-impl-policy=USE-ARGUMENT-TYPE
    MotAgMeasMotAgCoeffTblWr_PortIf1
      operation Oper
        arg MotAgCoeffTbl_Arg: type=Ary1D_f32_26, direction=IN, server-argument-impl-policy=USE-ARGUMENT-TYPE
    OnlineTunRamAdrMpg_PortIf1
      operation Oper: possible-error=OnlineTunRamAdrMpg_PortIf1/E_NOT_OK
        arg ReqAdr_Arg: type=uint32, direction=IN, server-argument-impl-policy=USE-ARGUMENT-TYPE
        arg CorrdAdr_Arg: type=uint32, direction=INOUT, server-argument-impl-policy=USE-ARGUMENT-TYPE
        arg ReqTyp_Arg: type=AdrMpgReqTyp1, direction=IN, server-argument-impl-policy=USE-ARGUMENT-TYPE
      error E_NOT_OK: error-code=1
    PartNrCustMfgEnaCntr_PortIf1
      operation Oper
        arg PartNrCustMfgEnaCnt_Arg: type=uint8, direction=OUT, server-argument-impl-policy=USE-ARGUMENT-TYPE
    PolarityCfgRead_PortIf1
      operation Oper: possible-error=PolarityCfgRead_PortIf1/E_NOT_OK
        arg PolarityCfgSaved_Arg: type=uint32, direction=OUT, server-argument-impl-policy=USE-ARGUMENT-TYPE
      error E_NOT_OK: error-code=1
    PolarityCfgWr_PortIf1
      operation Oper: possible-error=PolarityCfgWr_PortIf1/E_NOT_OK
        arg PolarityCfgSaved_Arg: type=uint32, direction=IN, server-argument-impl-policy=USE-ARGUMENT-TYPE
      error E_NOT_OK: error-code=1
    PrphlVltgMonrStrtUpTestFlt_PortIf1
      operation Oper
    PwrTurnOffCtrl_PortIf1
      operation Oper
        arg PinSt_Arg: type=boolean, direction=IN, server-argument-impl-policy=USE-ARGUMENT-TYPE
    ReadErrInjReg_PortIf1
      operation Oper
        arg ErrId_Arg: type=uint32, direction=OUT, server-argument-impl-policy=USE-ARGUMENT-TYPE
    ReadLtchCntrData_PortIf1
      operation Oper
        arg ReadLtchCntrAry_Arg: type=Ary1D_u08_20, direction=OUT, server-argument-impl-policy=USE-ARGUMENT-TYPE
    ReadNtcFltAry_PortIf1
      operation Oper
        arg DiagcMgrReadFltInfo_Arg: type=Ary1D_ReadFltInfoRec1_20, direction=OUT, server-argument-impl-policy=USE-ARGUMENT-TYPE
    ReadNtcInfoAndDebCntr_PortIf1
      operation Oper
        arg NtcNr_Arg: type=NtcNr1, direction=IN, server-argument-impl-policy=USE-ARGUMENT-TYPE
        arg NtcInfo_Arg: type=NtcInfoRec4, direction=OUT, server-argument-impl-policy=USE-ARGUMENT-TYPE
        arg DebCntr_Arg: type=sint16, direction=OUT, server-argument-impl-policy=USE-ARGUMENT-TYPE
    ReadSnpshtData_PortIf2
      operation Oper
        arg ReadSnpshtDataAry_Arg: type=Ary1D_SnpshtDataRec2_8, direction=OUT, server-argument-impl-policy=USE-ARGUMENT-TYPE
    ResvCrcHwUnit_PortIf1  # OBSOLETE
      operation Oper: possible-error=ResvCrcHwUnit_PortIf1/E_NOT_OK
        6 x arg, all with server-argument-impl-policy=USE-ARGUMENT-TYPE:
          Mod_Arg: type=CrcHwResvMod1, direction=IN
          CrcCfg_Arg: type=CrcHwResvCfg1, direction=IN
          CrcHwInRegAdr_Arg: type=uint32, direction=OUT
          CrcHwOutRegAdr_Arg: type=uint32, direction=OUT
          StrtVal_Arg: type=uint32, direction=IN
          ResvKey_Arg: type=uint16, direction=INOUT
      error E_NOT_OK: error-code=1
    ResvCrcHwUnit_PortIf2
      operation Oper: possible-error=ResvCrcHwUnit_PortIf2/E_NOT_OK
        6 x arg, all with server-argument-impl-policy=USE-ARGUMENT-TYPE:
          Mod_Arg: type=CrcHwResvMod1, direction=IN
          CrcCfg_Arg: type=CrcHwResvCfg1, direction=IN
          CrcHwInRegAdr_Arg: type=uint32, direction=OUT
          CrcHwOutRegAdr_Arg: type=uint32, direction=OUT
          StrtVal_Arg: type=uint32, direction=IN
          ResvKey_Arg: type=uint32, direction=INOUT
      error E_NOT_OK: error-code=1
    RstHwAgOverTrvlCnt_PortIf1
      operation Oper
    RstHwTq_PortIf1
      operation Oper
    RstMaxHwAgCwAndCcw_PortIf1
      operation Oper
    RstPullCmp_PortIf1
      operation Oper
    RstRackCentrMotAg_PortIf1
      operation Oper
    RstRackCentrMotRev_PortIf1
      operation Oper
    RstSnsrlsHwCentr_PortIf1
      operation Oper
    RstYawAndAg_PortIf1
      operation Oper
    RtCalChgReq_PortIf1
      operation Oper: possible-error=RtCalChgReq_PortIf1/E_NOT_OK
      error E_NOT_OK: error-code=1
    RtnMaxHwAgCwAndCcw_PortIf1
      operation Oper
        arg HwAgCcwMax_Arg: type=float32, direction=OUT, server-argument-impl-policy=USE-ARGUMENT-TYPE
        arg HwAgCwMax_Arg: type=float32, direction=OUT, server-argument-impl-policy=USE-ARGUMENT-TYPE
    SerlComInpProxyGmLanIdRd_PortIf1
      operation Oper
        arg GmLanId_Arg: type=Ary1D_u08_12, direction=OUT, server-argument-impl-policy=USE-ARGUMENT-TYPE
    SerlComRstEot_PortIf1
      operation Oper
    SetCalPageReq_PortIf1
      operation Oper
        arg Seg_Arg: type=uint8, direction=IN, server-argument-impl-policy=USE-ARGUMENT-TYPE
        arg Mod_Arg: type=uint8, direction=IN, server-argument-impl-policy=USE-ARGUMENT-TYPE
        arg Page_Arg: type=uint8, direction=IN, server-argument-impl-policy=USE-ARGUMENT-TYPE
    SetCtrlPrm_PortIf1
      operation Oper
        7 x arg, all with type=float32, direction=IN, server-argument-impl-policy=USE-ARGUMENT-TYPE:
          MotVelCtrlPropGain_Arg
          MotVelCtrlIntgtrGain_Arg
          MotVelCtrlDerivtvGain_Arg
          MotVelCtrlAntiWdupLim_Arg
          MotVelCtrlAntiWdupGain_Arg
          MotVelCtrlDerivtvLpFilTiCon_Arg
          MotVelCtrlTqCmdLim_Arg
    SetFctGpio_PortIf1
      operation Oper: possible-error=SetFctGpio_PortIf1/E_NOT_OK
      error E_NOT_OK: error-code=1
    SetFctPeriph_PortIf1
      operation Oper: possible-error=SetFctPeriph_PortIf1/E_NOT_OK
      error E_NOT_OK: error-code=1
    SetFricData_PortIf3
      operation Oper
        5 x arg, all with direction=IN, server-argument-impl-policy=USE-ARGUMENT-TYPE:
          FricOffs_Arg: type=float32
          BasLineFric_Arg: type=Ary1D_f32_4
          VehLrndFric_Arg: type=Ary1D_f32_4
          Hys_Arg: type=Ary2D_f32_8_4
          RngCntr_Arg: type=Ary2D_u16_8_3
    SetFricLrngData_PortIf1
      operation Oper
        4 x arg, all with direction=IN, server-argument-impl-policy=USE-ARGUMENT-TYPE:
          FricLrngEna_Arg: type=boolean
          FricLrngOffsOutpEna_Arg: type=boolean
          FricLrngOperMod_Arg: type=SysFricLrngOperMod1
          EolFric_Arg: type=float32
    SetFricOffsOutpDi_PortIf1
      operation Oper
        arg FricOffsOutpDi_Arg: type=boolean, direction=IN, server-argument-impl-policy=USE-ARGUMENT-TYPE
    SetGmLoaIgnCntr_PortIf1
      operation Oper
        arg GmLoaIgnCntr_Arg: type=uint16, direction=IN, server-argument-impl-policy=USE-ARGUMENT-TYPE
    SetGpio_PortIf1
      operation Oper: possible-error=SetGpio_PortIf1/E_NOT_OK
        arg PinSt_Arg: type=boolean, direction=IN, server-argument-impl-policy=USE-ARGUMENT-TYPE
      error E_NOT_OK: error-code=1
    SetHwAgOffs_PortIf1
      operation Oper
        arg HwAgOffs_Arg: type=float32, direction=IN, server-argument-impl-policy=USE-ARGUMENT-TYPE
        arg HwAgLrngStRst_Arg: type=boolean, direction=IN, server-argument-impl-policy=USE-ARGUMENT-TYPE
    SetHwAgOverTrvlCnt_PortIf2
      operation Oper
        arg HwAgOverTrvlCnt_Arg: type=uint8, direction=IN, server-argument-impl-policy=USE-ARGUMENT-TYPE
    SetHwAgTrimVal_PortIf2
      operation Oper
        arg HwAgTrimVal_Arg: type=float32, direction=IN, server-argument-impl-policy=USE-ARGUMENT-TYPE
        arg HwAgTrimPrfmd_Arg: type=boolean, direction=IN, server-argument-impl-policy=USE-ARGUMENT-TYPE
    SetHwTqOffs_PortIf1
      operation Oper
        arg HwTqOffs_Arg: type=float32, direction=IN, server-argument-impl-policy=USE-ARGUMENT-TYPE
        arg HwTqLrngStRst_Arg: type=boolean, direction=IN, server-argument-impl-policy=USE-ARGUMENT-TYPE
    SetInpPrm_PortIf1
      operation Oper
        arg TarVel_Arg: type=float32, direction=IN, server-argument-impl-policy=USE-ARGUMENT-TYPE
        arg TarA_Arg: type=float32, direction=IN, server-argument-impl-policy=USE-ARGUMENT-TYPE
    SetManTqCmd_PortIf1
      operation Oper: possible-error=SetManTqCmd_PortIf1/E_NOT_OK
        arg ManTqCmd_Arg: type=float32, direction=IN, server-argument-impl-policy=USE-ARGUMENT-TYPE
        arg ManTqCmdEna_Arg: type=boolean, direction=IN, server-argument-impl-policy=USE-ARGUMENT-TYPE
      error E_NOT_OK: error-code=1
    SetMotCoggCmdPrm_PortIf1
      operation Oper
        arg MotCoggCmdY_Arg: type=Ary1D_s1p14_128, direction=IN, server-argument-impl-policy=USE-ARGUMENT-TYPE
        arg Idx_Arg: type=uint8, direction=IN, server-argument-impl-policy=USE-ARGUMENT-TYPE
    SetMotPrmNomEol_PortIf1
      operation Oper
        arg MotBackEmfConNom_Arg: type=float32, direction=IN, server-argument-impl-policy=USE-ARGUMENT-TYPE
        arg MotRNom_Arg: type=float32, direction=IN, server-argument-impl-policy=USE-ARGUMENT-TYPE
    SetMotRplCoggPrm_PortIf1
      operation Oper
        9 x arg, all with direction=IN, server-argument-impl-policy=USE-ARGUMENT-TYPE:
          CoggOrder1_Arg: type=uint16
          CoggOrder1X_Arg: type=s1p14
          CoggOrder1Y_Arg: type=s1p14
          CoggOrder2_Arg: type=uint16
          CoggOrder2X_Arg: type=s1p14
          CoggOrder2Y_Arg: type=s1p14
          CoggOrder3_Arg: type=uint16
          CoggOrder3X_Arg: type=s1p14
          CoggOrder3Y_Arg: type=s1p14
    SetMotTqCmdSca_PortIf1
      operation Oper
        arg MotTqCmdSca_Arg: type=float32, direction=IN, server-argument-impl-policy=USE-ARGUMENT-TYPE
    SetNtcSts_PortIf1
      operation Oper: possible-error=SetNtcSts_PortIf1/E_NOT_OK
        4 x arg, all with direction=IN, server-argument-impl-policy=USE-ARGUMENT-TYPE:
          NtcNr_Arg: type=NtcNr1
          NtcStInfo_Arg: type=uint8
          NtcSts_Arg: type=NtcSts1
          DebStep_Arg: type=uint16
      error E_NOT_OK: error-code=1
    SetNtcStsAndSnpshtData_PortIf1
      operation Oper: possible-error=SetNtcStsAndSnpshtData_PortIf1/E_NOT_OK
        7 x arg, all with direction=IN, server-argument-impl-policy=USE-ARGUMENT-TYPE:
          NtcNr_Arg: type=NtcNr1
          NtcStInfo_Arg: type=uint8
          NtcSts_Arg: type=NtcSts1
          DebStep_Arg: type=uint16
          SpclSnpshtData{0..2}_Arg: type=uint32
      error E_NOT_OK: error-code=1
    SetPullCmpLongTerm_PortIf1
      operation Oper
        arg PullCmpLongTerm_Arg: type=float32, direction=IN, server-argument-impl-policy=USE-ARGUMENT-TYPE
    SetPullCmpShoTerm_PortIf1
      operation Oper
        arg PullCmpShoTerm_Arg: type=float32, direction=IN, server-argument-impl-policy=USE-ARGUMENT-TYPE
    SetRxSigGroup_PortIf1
      operation Oper: possible-error=SetRxSigGroup_PortIf1/E_NOT_OK
        arg SigGroup_Arg: type=uint8, direction=IN, server-argument-impl-policy=USE-ARGUMENT-TYPE
        arg DataSrc_Arg: type=ImcArbnRxDataSrc1, direction=IN, server-argument-impl-policy=USE-ARGUMENT-TYPE
        arg Buf_Arg: type=Ary1D_u08_8, direction=IN, server-argument-impl-policy=USE-ARGUMENT-TYPE
      error E_NOT_OK: error-code=1
    SetTrajTarPrm_PortIf1
      operation Oper
        arg HwAgTrajGennHwAgTar_Arg: type=float32, direction=IN, server-argument-impl-policy=USE-ARGUMENT-TYPE
        arg HwAgTrajGennHwVelTar_Arg: type=float32, direction=IN, server-argument-impl-policy=USE-ARGUMENT-TYPE
        arg HwAgTrajGennHwATar_Arg: type=float32, direction=IN, server-argument-impl-policy=USE-ARGUMENT-TYPE
    SetVehCentrPosn_PortIf1
      operation Oper
        arg BmwSetVehCentrOffsSts_Arg: type=BmwSetVehCentrOffsSts1, direction=OUT, server-argument-impl-policy=USE-ARGUMENT-TYPE
    SetYawRateOffs_PortIf1
      operation Oper
        arg VehYawRateOffs_Arg: type=float32, direction=IN, server-argument-impl-policy=USE-ARGUMENT-TYPE
        arg VehYawRateLrngStRst_Arg: type=boolean, direction=IN, server-argument-impl-policy=USE-ARGUMENT-TYPE
    StHlthStcPwrDwn_PortIf1
      operation Oper
    StopCtrl_PortIf1
      operation Oper
        arg MotVelCtrlVelSlewRate_Arg: type=float32, direction=IN, server-argument-impl-policy=USE-ARGUMENT-TYPE
    StrtCtrl_PortIf1
      operation Oper
        arg MotVelCtrlMotVelTar_Arg: type=float32, direction=IN, server-argument-impl-policy=USE-ARGUMENT-TYPE
        arg MotVelCtrlVelSlewRate_Arg: type=float32, direction=IN, server-argument-impl-policy=USE-ARGUMENT-TYPE
    StrtErrInjCntr_PortIf1
      operation Oper
    SwCalGetPrm_PortIf1
      operation Oper
        11 x arg, all with direction=OUT, server-argument-impl-policy=USE-ARGUMENT-TYPE:
          BoostModlnIdx_Arg: type=float32
          HldModlnIdx_Arg: type=float32
          CoolDwnModlnIdx_Arg: type=float32
          Ramp{1..3}Ti_Arg: type=uint8
          BoostTi_Arg: type=uint8
          HldTi_Arg: type=uint16
          CoolDwnTi_Arg: type=uint16
          PosnStepSize_Arg: type=u0p16
          ElecRevCnt_Arg: type=uint8
    SwCalSetPrm_PortIf1
      operation Oper: possible-error=SwCalSetPrm_PortIf1/E_NOT_OK
        11 x arg, all with direction=IN, server-argument-impl-policy=USE-ARGUMENT-TYPE:
          BoostModlnIdx_Arg: type=float32
          HldModlnIdx_Arg: type=float32
          CoolDwnModlnIdx_Arg: type=float32
          Ramp{1..3}Ti_Arg: type=uint8
          BoostTi_Arg: type=uint8
          HldTi_Arg: type=uint16
          CoolDwnTi_Arg: type=uint16
          PosnStepSize_Arg: type=u0p16
          ElecRevCnt_Arg: type=uint8
      error E_NOT_OK: error-code=1
    SwCalStop_PortIf1
      operation Oper
    SwCalStrt_PortIf1
      operation Oper
    SwCalStsCallBack_PortIf1
      operation Oper
        arg ElecRev_Arg: type=uint8, direction=IN, server-argument-impl-policy=USE-ARGUMENT-TYPE
        arg PosIdx_Arg: type=uint16, direction=IN, server-argument-impl-policy=USE-ARGUMENT-TYPE
        arg SnsrData_Arg: type=Ary1D_u16_12, direction=IN, server-argument-impl-policy=USE-ARGUMENT-TYPE
    TrigGmSysDataCollctnEntry_PortIf1
      operation Oper
        arg GmSysDataCollctnEna_Arg: type=GmSysDataCollctnEnaSt1, direction=IN, server-argument-impl-policy=USE-ARGUMENT-TYPE
    TunVrntRead_PortIf1
      operation Oper: possible-error=TunVrntRead_PortIf1/E_NOT_OK
        arg BmwDesIninIdx_Arg: type=uint8, direction=OUT, server-argument-impl-policy=USE-ARGUMENT-TYPE
      error E_NOT_OK: error-code=1
    TunVrntWr_PortIf1
      operation Oper: possible-error=TunVrntWr_PortIf1/E_NOT_OK
        arg BmwDesIninIdx_Arg: type=uint8, direction=IN, server-argument-impl-policy=USE-ARGUMENT-TYPE
      error E_NOT_OK: error-code=1
    UpdErrInjReg_PortIf1
      operation Oper
        arg NtcNr_Arg: type=uint16, direction=IN, server-argument-impl-policy=USE-ARGUMENT-TYPE
        arg NtcStInfo_Arg: type=uint8, direction=IN, server-argument-impl-policy=USE-ARGUMENT-TYPE
        arg ErrInjNr_Arg: type=uint8, direction=IN, server-argument-impl-policy=USE-ARGUMENT-TYPE
    UpdHwAgTrimVal_PortIf1
      operation Oper
        arg UpdHwAgTrimValSrvResp_Arg: type=uint8, direction=OUT, server-argument-impl-policy=USE-ARGUMENT-TYPE
    UpdRawSig_PortIf3
      operation Oper
        arg SigId_Arg: type=StHlthMonSig3, direction=IN, server-argument-impl-policy=USE-ARGUMENT-TYPE
    UpdRawSig_PortIf4
      operation Oper
        arg SigId_Arg: type=StHlthMonSig4, direction=IN, server-argument-impl-policy=USE-ARGUMENT-TYPE
    UpdStHlthStcData_PortIf1
      operation Oper
        arg TaskId_Arg: type=uint8, direction=IN, server-argument-impl-policy=USE-ARGUMENT-TYPE
    XcpCalChgReq_PortIf1
      operation Oper: possible-error=XcpCalChgReq_PortIf1/E_NOT_OK
      error E_NOT_OK: error-code=1
  95 x sender receiver interface:
    ActvGroup_PortIf1: invalidation-policy{data-element=ActvGroup_PortIf1/Val, handle-invalid=DONT-INVALIDATE}
      data Val: type=uint8
    Ary1D_f32_8_PortIf1: invalidation-policy{data-element=Ary1D_f32_8_PortIf1/Ary1D, handle-invalid=DONT-INVALIDATE}
      data Ary1D: sw-calibration-access=READ-ONLY, type=Ary1D_f32_8
    Ary1D_u08_17_PortIf1: invalidation-policy{data-element=Ary1D_u08_17_PortIf1/Ary1D, handle-invalid=DONT-INVALIDATE}
      data Ary1D: sw-calibration-access=READ-ONLY, type=Ary1D_u08_17
    Ary1D_u08_5_PortIf1: invalidation-policy{data-element=Ary1D_u08_5_PortIf1/Ary1D, handle-invalid=DONT-INVALIDATE}
      data Ary1D: sw-calibration-access=READ-ONLY, type=Ary1D_u08_5
    Ary1D_u08_8_PortIf1: invalidation-policy{data-element=Ary1D_u08_8_PortIf1/Ary1D, handle-invalid=DONT-INVALIDATE}
      data Ary1D: sw-calibration-access=READ-ONLY, type=Ary1D_u08_8
    Ary1D_u0p16_8_PortIf1: invalidation-policy{data-element=Ary1D_u0p16_8_PortIf1/Ary1D, handle-invalid=DONT-INVALIDATE}
      data Ary1D: sw-calibration-access=READ-ONLY, type=Ary1D_u0p16_8
    Ary1D_u32_4_PortIf1: invalidation-policy{data-element=Ary1D_u32_4_PortIf1/Ary1D, handle-invalid=DONT-INVALIDATE}
      data Ary1D: sw-calibration-access=READ-ONLY, type=Ary1D_u32_4
    Ary1D_u32_8_PortIf1: invalidation-policy{data-element=Ary1D_u32_8_PortIf1/Ary1D, handle-invalid=DONT-INVALIDATE}
      data Ary1D: sw-calibration-access=READ-ONLY, type=Ary1D_u32_8
    BattSwdVltgCorrlnSts1_PortIf1: invalidation-policy{data-element=BattSwdVltgCorrlnSts1_PortIf1/Val, handle-invalid=DONT-INVALIDATE}
      data Val: sw-calibration-access=READ-ONLY, type=BattSwdVltgCorrlnSts1
    BattVltgSt1_PortIf1: invalidation-policy{data-element=BattVltgSt1_PortIf1/Val, handle-invalid=DONT-INVALIDATE}
      data Val: sw-calibration-access=READ-ONLY, type=BattVltgSt1
    BmwDiagcSessionId1_PortIf1: invalidation-policy{data-element=BmwDiagcSessionId1_PortIf1/Val, handle-invalid=DONT-INVALIDATE}
      data Val: sw-calibration-access=READ-ONLY, type=BmwDiagcSessionId1
    BmwElecEngDrvSts1_PortIf1: invalidation-policy{data-element=BmwElecEngDrvSts1_PortIf1/Val, handle-invalid=DONT-INVALIDATE}
      data Val: sw-calibration-access=READ-ONLY, type=BmwElecEngDrvSts1
    BmwEngDrvSts1_PortIf1: invalidation-policy{data-element=BmwEngDrvSts1_PortIf1/Val, handle-invalid=DONT-INVALIDATE}
      data Val: sw-calibration-access=READ-ONLY, type=BmwEngDrvSts1
    BmwEngStopCallSts1_PortIf1: invalidation-policy{data-element=BmwEngStopCallSts1_PortIf1/Val, handle-invalid=DONT-INVALIDATE}
      data Val: sw-calibration-access=READ-ONLY, type=BmwEngStopCallSts1
    BmwEpsFctSts1_PortIf1: invalidation-policy{data-element=BmwEpsFctSts1_PortIf1/Val, handle-invalid=DONT-INVALIDATE}
      data Val: sw-calibration-access=READ-ONLY, type=BmwEpsFctSts1
    BmwFltLampReqSts1_PortIf1: invalidation-policy{data-element=BmwFltLampReqSts1_PortIf1/Val, handle-invalid=DONT-INVALIDATE}
      data Val: sw-calibration-access=READ-ONLY, type=BmwFltLampReqSts1
    BmwMotAgSelnSt1_PortIf1: invalidation-policy{data-element=BmwMotAgSelnSt1_PortIf1/Val, handle-invalid=DONT-INVALIDATE}
      data Val: sw-calibration-access=READ-ONLY, type=BmwMotAgSelnSt1
    BmwNearStillVehSpdSts1_PortIf1: invalidation-policy{data-element=BmwNearStillVehSpdSts1_PortIf1/Val, handle-invalid=DONT-INVALIDATE}
      data Val: sw-calibration-access=READ-ONLY, type=BmwNearStillVehSpdSts1
    BmwOvrlCmdQlfr1_PortIf1: invalidation-policy{data-element=BmwOvrlCmdQlfr1_PortIf1/Val, handle-invalid=DONT-INVALIDATE}
      data Val: sw-calibration-access=READ-ONLY, type=BmwOvrlCmdQlfr1
    BmwPwrSplySts1_PortIf1: invalidation-policy{data-element=BmwPwrSplySts1_PortIf1/Val, handle-invalid=DONT-INVALIDATE}
      data Val: sw-calibration-access=READ-ONLY, type=BmwPwrSplySts1
    BmwQuadOffsSts1_PortIf1: invalidation-policy{data-element=BmwQuadOffsSts1_PortIf1/Val, handle-invalid=DONT-INVALIDATE}
      data Val: sw-calibration-access=READ-ONLY, type=BmwQuadOffsSts1
    BmwRtIdx1_PortIf1: invalidation-policy{data-element=BmwRtIdx1_PortIf1/Val, handle-invalid=DONT-INVALIDATE}
      data Val: sw-calibration-access=READ-ONLY, type=BmwRtIdx1
    BmwStrtStopMsgCmd1_PortIf1: invalidation-policy{data-element=BmwStrtStopMsgCmd1_PortIf1/Val, handle-invalid=DONT-INVALIDATE}
      data Val: sw-calibration-access=READ-ONLY, type=BmwStrtStopMsgCmd1
    BmwTrfcJamAssiDampgStReq1_PortIf1: invalidation-policy{data-element=BmwTrfcJamAssiDampgStReq1_PortIf1/Val, handle-invalid=DONT-INVALIDATE}
      data Val: sw-calibration-access=READ-ONLY, type=BmwTrfcJamAssiDampgStReq1
    BmwTrfcJamAssiSt1_PortIf1: invalidation-policy{data-element=BmwTrfcJamAssiSt1_PortIf1/Val, handle-invalid=DONT-INVALIDATE}
      data Val: sw-calibration-access=READ-ONLY, type=BmwTrfcJamAssiSt1
    BmwVehSpdSts1_PortIf1: invalidation-policy{data-element=BmwVehSpdSts1_PortIf1/Val, handle-invalid=DONT-INVALIDATE}
      data Val: sw-calibration-access=READ-ONLY, type=BmwVehSpdSts1
    BmwVltgDrpSts1_PortIf1: invalidation-policy{data-element=BmwVltgDrpSts1_PortIf1/Val, handle-invalid=DONT-INVALIDATE}
      data Val: sw-calibration-access=READ-ONLY, type=BmwVltgDrpSts1
    boolean_PortIf1: invalidation-policy{data-element=Logl, handle-invalid=DONT-INVALIDATE}
      data Logl: sw-calibration-access=READ-ONLY, type=boolean
    CalCopySts_PortIf1: invalidation-policy{data-element=CalCopySts_PortIf1/Val, handle-invalid=DONT-INVALIDATE}
      data Val: type=CalCopySts1
    DrvgDynIfSt1_PortIf1: invalidation-policy{data-element=DrvgDynIfSt1_PortIf1/Val, handle-invalid=DONT-INVALIDATE}
      data Val: sw-calibration-access=READ-ONLY, type=DrvgDynIfSt1
    EgyModSt1_PortIf1: invalidation-policy{data-element=EgyModSt1_PortIf1/Val, handle-invalid=DONT-INVALIDATE}
      data Val: sw-calibration-access=READ-ONLY, type=EgyModSt1
    EotSt1_PortIf1: invalidation-policy{data-element=EotSt1_PortIf1/Val, handle-invalid=DONT-INVALIDATE}
      data Val: sw-calibration-access=READ-ONLY, type=EotSt1
    float32_PortIf1: invalidation-policy{data-element=float32_PortIf1/Val, handle-invalid=DONT-INVALIDATE}
      data Val: sw-calibration-access=READ-ONLY, type=float32
    FordVehWhlDirRaw1_PortIf1: invalidation-policy{data-element=FordVehWhlDirRaw1_PortIf1/Val, handle-invalid=DONT-INVALIDATE}
      data Val: type=FordVehWhlDirRaw1
    GmAutnmsDrvgIfFltRespDi_PortIf1: invalidation-policy{data-element=GmAutnmsDrvgIfFltRespDi_PortIf1/Val, handle-invalid=DONT-INVALIDATE}
      data Val: sw-calibration-access=READ-ONLY, type=GmAutnmsDrvgIfFltRespDi1
    GmAutnmsSteerCmdSts_PortIf1: invalidation-policy{data-element=GmAutnmsSteerCmdSts_PortIf1/Val, handle-invalid=DONT-INVALIDATE}
      data Val: sw-calibration-access=READ-ONLY, type=GmAutnmsSteerCmdSts1
    GmBackUpSysPwrModAuthentd1_PortIf1: invalidation-policy{data-element=GmBackUpSysPwrModAuthentd1_PortIf1/Val, handle-invalid=DONT-INVALIDATE}
      data Val: sw-calibration-access=READ-ONLY, type=GmBackUpSysPwrModAuthentd1
    GmDrvrIntvDetnSt_PortIf1: invalidation-policy{data-element=GmDrvrIntvDetnSt_PortIf1/Val, handle-invalid=DONT-INVALIDATE}
      data Val: sw-calibration-access=READ-ONLY, type=GmDrvrIntvDetnSt1
    GmDualEcuOperSts_PortIf1: invalidation-policy{data-element=GmDualEcuOperSts_PortIf1/Val, handle-invalid=DONT-INVALIDATE}
      data Val: sw-calibration-access=READ-ONLY, type=GmDualEcuOperSts1
    GmEscSysStsAuthentdSt1_PortIf1: invalidation-policy{data-element=GmEscSysStsAuthentdSt1_PortIf1/Val, handle-invalid=DONT-INVALIDATE}
      data Val: sw-calibration-access=READ-ONLY, type=GmEscSysStsAuthentdSt1
    GmFctDiArbnSts_PortIf1: invalidation-policy{data-element=GmFctDiArbnSts_PortIf1/Val, handle-invalid=DONT-INVALIDATE}
      data Val: sw-calibration-access=READ-ONLY, type=GmFctDiArbnSts1
    GmOvrlFeatActvSt1_PortIf1: invalidation-policy{data-element=GmOvrlFeatActvSt1_PortIf1/Val, handle-invalid=DONT-INVALIDATE}
      data Val: sw-calibration-access=READ-ONLY, type=GmOvrlFeatActvSt1
    GmOvrlStMgrApaSt1_PortIf1: invalidation-policy{data-element=GmOvrlStMgrApaSt1_PortIf1/Val, handle-invalid=DONT-INVALIDATE}
      data Val: sw-calibration-access=READ-ONLY, type=GmOvrlStMgrApaSt1
    GmOvrlStMgrHandsOnLaneFolwgSt1_PortIf1: invalidation-policy{data-element=GmOvrlStMgrHandsOnLaneFolwgSt1_PortIf1/Val, handle-invalid=DONT-INVALIDATE}
      data Val: sw-calibration-access=READ-ONLY, type=GmOvrlStMgrHandsOnLaneFolwgSt1
    GmOvrlStMgrHaptcSt1_PortIf1: invalidation-policy{data-element=GmOvrlStMgrHaptcSt1_PortIf1/Val, handle-invalid=DONT-INVALIDATE}
      data Val: sw-calibration-access=READ-ONLY, type=GmOvrlStMgrHaptcSt1
    GmOvrlStMgrTrfcJamAssiSt1_PortIf1: invalidation-policy{data-element=GmOvrlStMgrTrfcJamAssiSt1_PortIf1/Val, handle-invalid=DONT-INVALIDATE}
      data Val: sw-calibration-access=READ-ONLY, type=GmOvrlStMgrTrfcJamAssiSt1
    GmRxMonrdSig1_PortIf1: invalidation-policy{data-element=GmRxMonrdSig1_PortIf1/Val, handle-invalid=DONT-INVALIDATE}
      data Val: sw-calibration-access=READ-ONLY, type=GmRxMonrdSig1
    GmSecuAcsFlg1_PortIf1: invalidation-policy{data-element=GmSecuAcsFlg1_PortIf1/Val, handle-invalid=DONT-INVALIDATE}
      data Val: sw-calibration-access=READ-ONLY, type=GmSecuAcsFlg1
    GmSteerCmdLimrSt_PortIf1: invalidation-policy{data-element=GmSteerCmdLimrSt_PortIf1/Val, handle-invalid=DONT-INVALIDATE}
      data Val: sw-calibration-access=READ-ONLY, type=GmSteerCmdLimrSt1
    GmSteerCmdMsgSrc1_PortIf1: invalidation-policy{data-element=GmSteerCmdMsgSrc1_PortIf1/Val, handle-invalid=DONT-INVALIDATE}
      data Val: sw-calibration-access=READ-ONLY, type=GmSteerCmdMsgSrc1
    GmSteerCmdMsgSts_PortIf1: invalidation-policy{data-element=GmSteerCmdMsgSts_PortIf1/Val, handle-invalid=DONT-INVALIDATE}
      data Val: sw-calibration-access=READ-ONLY, type=GmSteerCmdMsgSts1
    GmSteerReqArbdFeatAuthentdSt1_PortIf1: invalidation-policy{data-element=GmSteerReqArbdFeatAuthentdSt1_PortIf1/Val, handle-invalid=DONT-INVALIDATE}
      data Val: sw-calibration-access=READ-ONLY, type=GmSteerReqArbdFeatAuthentdSt1
    GmSteerReqStsAuthentdSt1_PortIf1: invalidation-policy{data-element=GmSteerReqStsAuthentdSt1_PortIf1/Val, handle-invalid=DONT-INVALIDATE}
      data Val: sw-calibration-access=READ-ONLY, type=GmSteerReqStsAuthentdSt1
    GmSysPwrMod1_PortIf1: invalidation-policy{data-element=GmSysPwrMod1_PortIf1/Val, handle-invalid=DONT-INVALIDATE}
      data Val: sw-calibration-access=READ-ONLY, type=GmSysPwrMod1
    GmSysPwrModAuthentd1_PortIf1: invalidation-policy{data-element=GmSysPwrModAuthentd1_PortIf1/Val, handle-invalid=DONT-INVALIDATE}
      data Val: sw-calibration-access=READ-ONLY, type=GmSysPwrModAuthentd1
    GmTqArbnEscSt1_PortIf1: invalidation-policy{data-element=GmTqArbnEscSt1_PortIf1/Val, handle-invalid=DONT-INVALIDATE}
      data Val: sw-calibration-access=READ-ONLY, type=GmTqArbnEscSt1
    GmTqArbnLkaSt1_PortIf1: invalidation-policy{data-element=GmTqArbnLkaSt1_PortIf1/Val, handle-invalid=DONT-INVALIDATE}
      data Val: sw-calibration-access=READ-ONLY, type=GmTqArbnLkaSt1
    GmTqArbnTrfcJamAssiSt1_PortIf1: invalidation-policy{data-element=GmTqArbnTrfcJamAssiSt1_PortIf1/Val, handle-invalid=DONT-INVALIDATE}
      data Val: sw-calibration-access=READ-ONLY, type=GmTqArbnTrfcJamAssiSt1
    GmTrsmShiftLvrPosnAuthentd1_PortIf1: invalidation-policy{data-element=GmTrsmShiftLvrPosnAuthentd1_PortIf1/Val, handle-invalid=DONT-INVALIDATE}
      data Val: sw-calibration-access=READ-ONLY, type=GmTrsmShiftLvrPosnAuthentd1
    GmVehHlthMgrSt1_PortIf1: invalidation-policy{data-element=GmVehHlthMgrSt1_PortIf1/Val, handle-invalid=DONT-INVALIDATE}
      data Val: sw-calibration-access=READ-ONLY, type=GmVehHlthMgrSt1
    GmVehModMgrSt_PortIf1: invalidation-policy{data-element=GmVehModMgrSt_PortIf1/Val, handle-invalid=DONT-INVALIDATE}
      data Val: sw-calibration-access=READ-ONLY, type=GmVehModMgrSt1
    HwAg1SnsrTyp_PortIf1: invalidation-policy{data-element=HwAg1SnsrTyp_PortIf1/Val, handle-invalid=DONT-INVALIDATE}  # OBSOLETE
      data Val: sw-calibration-access=READ-ONLY, type=HwAgSnsrTyp1
    HwAgSnsrTyp1_PortIf1: invalidation-policy{data-element=HwAgSnsrTyp1_PortIf1/Val, handle-invalid=DONT-INVALIDATE}
      data Val: sw-calibration-access=READ-ONLY, type=HwAgSnsrTyp1
    ImcArbnRxSts1_PortIf1: invalidation-policy{data-element=ImcArbnRxSts1_PortIf1/Val, handle-invalid=DONT-INVALIDATE}
      data Val: sw-calibration-access=READ-ONLY, type=ImcArbnRxSts1
    IvtrFetFltPha1_PortIf1: invalidation-policy{data-element=IvtrFetFltPha1_PortIf1/Val, handle-invalid=DONT-INVALIDATE}
      data Val: sw-calibration-access=READ-ONLY, type=IvtrFetFltPha1
    IvtrFetFltTyp1_PortIf1: invalidation-policy{data-element=IvtrFetFltTyp1_PortIf1/Val, handle-invalid=DONT-INVALIDATE}
      data Val: sw-calibration-access=READ-ONLY, type=IvtrFetFltTyp1
    LoaSt1_PortIf1: invalidation-policy{data-element=LoaSt1_PortIf1/Val, handle-invalid=DONT-INVALIDATE}
      data Val: sw-calibration-access=READ-ONLY, type=LoaSt1
    MfgEnaSt1_PortIf1: invalidation-policy{data-element=MfgEnaSt1_PortIf1/Val, handle-invalid=DONT-INVALIDATE}
      data Val: type=MfgEnaSt1
    MotAgSnsrCfgSt1_PortIf1: invalidation-policy{data-element=MotAgSnsrCfgSt1_PortIf1/Val, handle-invalid=DONT-INVALIDATE}
      data Val: sw-calibration-access=READ-ONLY, type=MotAgSnsrCfgSt1
    MotAgSnsrIninSt1_PortIf1: invalidation-policy{data-element=MotAgSnsrIninSt1_PortIf1/Val, handle-invalid=DONT-INVALIDATE}
      data Val: sw-calibration-access=READ-ONLY, type=MotAgSnsrIninSt1
    MotCurrEolCalSt2_PortIf1: invalidation-policy{data-element=MotCurrEolCalSt2_PortIf1/Val, handle-invalid=DONT-INVALIDATE}
      data Val: sw-calibration-access=READ-ONLY, type=MotCurrEolCalSt2
    MotQuad1_PortIf1: invalidation-policy{data-element=MotQuad1_PortIf1/Val, handle-invalid=DONT-INVALIDATE}
      data Val: sw-calibration-access=READ-ONLY, type=MotQuad1
    PhaDiscnctPwmVect1_PortIf1: invalidation-policy{data-element=PhaDiscnctPwmVect1_PortIf1/Val, handle-invalid=DONT-INVALIDATE}
      data Val: type=PhaDiscnctPwmVect1
    s15p16_PortIf1: invalidation-policy{data-element=s15p16_PortIf1/Val, handle-invalid=DONT-INVALIDATE}
      data Val: sw-calibration-access=READ-ONLY, type=s15p16
    s18p13_PortIf1: invalidation-policy{data-element=s18p13_PortIf1/Val, handle-invalid=DONT-INVALIDATE}
      data Val: sw-calibration-access=READ-ONLY, type=s18p13
    s23pm8_PortIf1: invalidation-policy{data-element=s23pm8_PortIf1/Val, handle-invalid=DONT-INVALIDATE}
      data Val: sw-calibration-access=READ-ONLY, type=s23pm8
    s5p10: invalidation-policy{data-element=s5p10/Val, handle-invalid=DONT-INVALIDATE}
      data Val: sw-calibration-access=READ-ONLY, type=s5p10
    s8p7: invalidation-policy{data-element=s8p7/Val, handle-invalid=DONT-INVALIDATE}
      data Val: sw-calibration-access=READ-ONLY, type=s8p7
    SelnCaseSt1_PortIf1: invalidation-policy{data-element=SelnCaseSt1_PortIf1/Val, handle-invalid=DONT-INVALIDATE}
      data Val: sw-calibration-access=READ-ONLY, type=SelnCaseSt1
    SigQlfr1_PortIf1: invalidation-policy{data-element=SigQlfr1_PortIf1/Val, handle-invalid=DONT-INVALIDATE}
      data Val: sw-calibration-access=READ-ONLY, type=SigQlfr1
    sint16_PortIf1: invalidation-policy{data-element=sint16_PortIf1/Val, handle-invalid=DONT-INVALIDATE}
      data Val: sw-calibration-access=READ-ONLY, type=sint16
    sint32_PortIf1: invalidation-policy{data-element=sint32_PortIf1/Val, handle-invalid=DONT-INVALIDATE}
      data Val: sw-calibration-access=READ-ONLY, type=sint32
    sint8_PortIf1: invalidation-policy{data-element=sint8_PortIf1/Val, handle-invalid=DONT-INVALIDATE}
      data Val: sw-calibration-access=READ-ONLY, type=sint8
    SteerMod1_PortIf1: invalidation-policy{data-element=SteerMod1_PortIf1/Val, handle-invalid=DONT-INVALIDATE}
      data Val: sw-calibration-access=READ-ONLY, type=SteerMod1
    SteerPrfmncModReq_PortIf1: invalidation-policy{data-element=SteerPrfmncModReq_PortIf1/Val, handle-invalid=DONT-INVALIDATE}
      data Val: sw-calibration-access=READ-ONLY, type=GmSteerPrfmncModReq1
    StrtUpSt1_PortIf1: invalidation-policy{data-element=StrtUpSt1_PortIf1/Val, handle-invalid=DONT-INVALIDATE}
      data Val: sw-calibration-access=READ-ONLY, type=StrtUpSt1
    StsDrvrActvy1_PortIf1: invalidation-policy{data-element=StsDrvrActvy1_PortIf1/Val, handle-invalid=DONT-INVALIDATE}
      data Val: sw-calibration-access=READ-ONLY, type=StsDrvrActvy1
    StsSteerAssi1_PortIf1: invalidation-policy{data-element=StsSteerAssi1_PortIf1/Val, handle-invalid=DONT-INVALIDATE}
      data Val: sw-calibration-access=READ-ONLY, type=StsSteerAssi1
    SysSt1_PortIf1: invalidation-policy{data-element=SysSt1_PortIf1/Val, handle-invalid=DONT-INVALIDATE}
      data Val: sw-calibration-access=READ-ONLY, type=SysSt1
    TorsBarStEstimdRec1_PortIf1: invalidation-policy{data-element=Rec, handle-invalid=DONT-INVALIDATE}
      data Rec: sw-calibration-access=READ-ONLY, type=TorsBarStEstimdRec1
    u0p16_PortIf1: invalidation-policy{data-element=u0p16_PortIf1/Val, handle-invalid=DONT-INVALIDATE}
      data Val: sw-calibration-access=READ-ONLY, type=u0p16
    u16p0_PortIf1: invalidation-policy{data-element=u16p0_PortIf1/Val, handle-invalid=DONT-INVALIDATE}
      data Val: sw-calibration-access=READ-ONLY, type=u16p0
    uint16_PortIf1: invalidation-policy{data-element=uint16_PortIf1/Val, handle-invalid=DONT-INVALIDATE}
      data Val: sw-calibration-access=READ-ONLY, type=uint16
    uint32_PortIf1: invalidation-policy{data-element=uint32_PortIf1/Val, handle-invalid=DONT-INVALIDATE}
      data Val: sw-calibration-access=READ-ONLY, type=uint32
    uint8_PortIf1: invalidation-policy{data-element=uint8_PortIf1/Val, handle-invalid=DONT-INVALIDATE}
      data Val: sw-calibration-access=READ-ONLY, type=uint8
package /PortInterfaces
  client server interface CmnMfgSrvIfImdtTx_PortIf1
    operation Oper
      arg CmnMfgSrvDataBufPtr_Arg: type=Ary1D_u08_CmnMfgSrvIf, direction=IN, server-argument-impl-policy=USE-ARGUMENT-TYPE
      arg CmnMfgSrvDataLen_Arg: type=uint16, direction=IN, server-argument-impl-policy=USE-ARGUMENT-TYPE
  client server interface CmnMfgSrvMaiFct_PortIf1
    operation Oper
      7 x arg, all with server-argument-impl-policy=USE-ARGUMENT-TYPE:
        CmnMfgSrvSrvId_Arg: type=uint8, direction=IN
        CmnMfgSrvSubFct_Arg: type=uint8, direction=IN
        CmnMfgSrvPrmId_Arg: type=uint16, direction=IN
        CmnMfgSrvDataBufPtr_Arg: type=uint8, direction=INOUT
        CmnMfgSrvReqLen_Arg: type=uint16, direction=IN
        CmnMfgSrvRespLen_Arg: type=uint16, direction=OUT
        CmnMfgSrvRespCod_Arg: type=uint8, direction=OUT
  sender receiver interface BmwFltLampReqTyp1_PortIf1: invalidation-policy{data-element=BmwFltLampReqTyp1_PortIf1/Val, handle-invalid=DONT-INVALIDATE}  # OBSOLETE
    data Val: type=BmwFltLampReqTyp1
  sender receiver interface BmwFltLampReqTyp2_PortIf1: invalidation-policy{data-element=BmwFltLampReqTyp2_PortIf1/Val, handle-invalid=DONT-INVALIDATE}
    data Val: type=BmwFltLampReqTyp2
  sender receiver interface BmwVehCdn1_PortIf1: invalidation-policy{data-element=BmwVehCdn1_PortIf1/Val, handle-invalid=DONT-INVALIDATE}
    data Val: type=BmwVehCdn1
