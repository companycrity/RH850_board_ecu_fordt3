AUTOSAR XML (schema 4-0-3)
standard types defined: float32, uint8, float32_DataConstr, uint8_DataConstr, boolean, uint16
package /DataType/Unit
  5 x unit, all with factor-si-to-unit=1, offset-si-to-unit=0:
    U_Amps: display-name=Amps
    U_kmYh: display-name=km/h
    U_Nm: display-name=Nm
    U_SED: display-name=SED
    U_Volts: display-name=Volts
package /Ford/DataTypes
  16 x impl type, all with category=VALUE, sw-calibration-access=READ-ONLY:
    Ford_DrvSte_Tq_Actl: base-type=DataType/uint8, compu {254=CxFE_Unknown, 255=CxFF_Invalid, phys=raw*0.0625-8 for raw 0..255; unit Nm} "Source signal range: [0,253]"
    Ford_DrvSteActv_B_Stat: base-type=boolean, compu {phys=raw for raw 0..1, 0=Cx0_Inactive, 1=Cx1_Active; unit SED}
    Ford_EPAS_Failure: base-type=DataType/uint8, compu {phys=raw for raw 0..3, 0=Cx0_EPAS_OK_NO_MESSAGE, 1=Cx1_POWER_STRG_ASSIST_FAULT, 2=Cx2_SERVICE_POWER_STEERING, 3=Cx3_SERVICE_POWER_STEERING_NOW; unit SED}, range raw 0..3
    Ford_SAPPAngleControlStat1: base-type=DataType/uint8, compu {phys=raw for raw 0..3, 0=Cx0_Closed, 1=Cx1_Open, 2=Cx2_Active, 3=Cx3_Fault; unit SED}, range raw 0..3
    Ford_SAPPAngleControlStat2: base-type=boolean, compu {phys=raw for raw 0..1, 0=Cx0_NoRel_ExtSteeringAngleReqx, 1=Cx1_Rel_ExtSteeringAngleReqx; unit SED}
    Ford_SAPPAngleControlStat3: base-type=boolean, compu {phys=raw for raw 0..1, 0=Cx0_ExternalSigContentOKforEAC, 1=Cx1_EARactiveNoReverseEngage; unit SED}
    Ford_SAPPAngleControlStat4: base-type=boolean, compu {phys=raw for raw 0..1, 0=Cx0_ExternalSigContentOKforEAC, 1=Cx1_SpeedLimitExceededEAROn; unit SED}
    Ford_SAPPAngleControlStat5: base-type=boolean, compu {phys=raw for raw 0..1, 0=Cx0_ExternalSigContentOKforEAC, 1=Cx1_StrgColTorqueExceed_EAROn; unit SED}
    Ford_SAPPAngleControlStat6: base-type=boolean, compu {phys=raw for raw 0..1, 0=Cx0_RequestedAngleCanBeReached, 1=Cx1_RequestedAngleNotReached; unit SED}
    Ford_SteeringColumnTorque: base-type=DataType/uint8, compu {254=CxFE_Unknown, 255=CxFF_Invalid, phys=raw*0.0625-8 for raw 0..255; unit Nm} "Source signal range: [0,253]"
    Ford_SteMdule_D_Stat: base-type=DataType/uint8, compu {phys=raw for raw 0..7, 0=Cx0_EPAS_Initialization, 1=Cx1_Normal_Op_Limited_Assist, 2=Cx2_Normal_Op_Full_Assist, 3=Cx3_EPAS_Shutdown, 4=Cx4_System_Failure, 5=Cx5_EPAS_Failure2, 6=Cx6_EPAS_Failure3, 7=Cx7_NotUsed; unit SED}, range raw 0..7
    Ford_SteMdule_I_Est: base-type=uint16, compu {4095=CxFFF_Invalid, phys=raw*0.05-64 for raw 0..4095; unit Amps} "Source signal range: [0,4094]", range raw 0..4095
    Ford_SteMdule_U_Meas: base-type=DataType/uint8, compu {255=CxFF_Invalid, phys=raw*0.05+6 for raw 0..255; unit Volts} "Source signal range: [0,254]"
    Ford_TrlrHitchLamp_D_Rqst: base-type=boolean, compu {phys=raw for raw 0..1, 0=Cx0_Off, 1=Cx1_On; unit SED}
    Ford_Veh_V_RqMxTrlrAid: base-type=DataType/uint8, compu {phys=raw*0.1 for raw 0..255; unit km/h}
    Ford_VehVTrlrAid_B_Rq: base-type=boolean, compu {phys=raw for raw 0..1, 0=Cx0_NoRequest, 1=Cx1_Request; unit SED}
