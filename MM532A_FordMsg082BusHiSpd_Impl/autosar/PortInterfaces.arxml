AUTOSAR XML (schema 4-0-3)
package /Ford/PortInterfaces
  16 x sender receiver interface:
    Ford_DrvSte_Tq_Actl: invalidation-policy{data-element=Ford_DrvSte_Tq_Actl, handle-invalid=DONT-INVALIDATE}
      data Ford_DrvSte_Tq_Actl: sw-calibration-access=READ-ONLY, type=Ford_DrvSte_Tq_Actl
    Ford_DrvSteActv_B_Stat: invalidation-policy{data-element=Ford_DrvSteActv_B_Stat, handle-invalid=DONT-INVALIDATE}
      data Ford_DrvSteActv_B_Stat: sw-calibration-access=READ-ONLY, type=Ford_DrvSteActv_B_Stat
    Ford_EPAS_Failure: invalidation-policy{data-element=Ford_EPAS_Failure, handle-invalid=DONT-INVALIDATE}
      data Ford_EPAS_Failure: sw-calibration-access=READ-ONLY, type=Ford_EPAS_Failure
    Ford_SAPPAngleControlStat1: invalidation-policy{data-element=Ford_SAPPAngleControlStat1, handle-invalid=DONT-INVALIDATE}
      data Ford_SAPPAngleControlStat1: sw-calibration-access=READ-ONLY, type=Ford_SAPPAngleControlStat1
    Ford_SAPPAngleControlStat2: invalidation-policy{data-element=Ford_SAPPAngleControlStat2, handle-invalid=DONT-INVALIDATE}
      data Ford_SAPPAngleControlStat2: sw-calibration-access=READ-ONLY, type=Ford_SAPPAngleControlStat2
    Ford_SAPPAngleControlStat3: invalidation-policy{data-element=Ford_SAPPAngleControlStat3, handle-invalid=DONT-INVALIDATE}
      data Ford_SAPPAngleControlStat3: sw-calibration-access=READ-ONLY, type=Ford_SAPPAngleControlStat3
    Ford_SAPPAngleControlStat4: invalidation-policy{data-element=Ford_SAPPAngleControlStat4, handle-invalid=DONT-INVALIDATE}
      data Ford_SAPPAngleControlStat4: sw-calibration-access=READ-ONLY, type=Ford_SAPPAngleControlStat4
    Ford_SAPPAngleControlStat5: invalidation-policy{data-element=Ford_SAPPAngleControlStat5, handle-invalid=DONT-INVALIDATE}
      data Ford_SAPPAngleControlStat5: sw-calibration-access=READ-ONLY, type=Ford_SAPPAngleControlStat5
    Ford_SAPPAngleControlStat6: invalidation-policy{data-element=Ford_SAPPAngleControlStat6, handle-invalid=DONT-INVALIDATE}
      data Ford_SAPPAngleControlStat6: sw-calibration-access=READ-ONLY, type=Ford_SAPPAngleControlStat6
    Ford_SteeringColumnTorque: invalidation-policy{data-element=Ford_SteeringColumnTorque, handle-invalid=DONT-INVALIDATE}
      data Ford_SteeringColumnTorque: sw-calibration-access=READ-ONLY, type=Ford_SteeringColumnTorque
    Ford_SteMdule_D_Stat: invalidation-policy{data-element=Ford_SteMdule_D_Stat, handle-invalid=DONT-INVALIDATE}
      data Ford_SteMdule_D_Stat: sw-calibration-access=READ-ONLY, type=Ford_SteMdule_D_Stat
    Ford_SteMdule_I_Est: invalidation-policy{data-element=Ford_SteMdule_I_Est, handle-invalid=DONT-INVALIDATE}
      data Ford_SteMdule_I_Est: sw-calibration-access=READ-ONLY, type=Ford_SteMdule_I_Est
    Ford_SteMdule_U_Meas: invalidation-policy{data-element=Ford_SteMdule_U_Meas, handle-invalid=DONT-INVALIDATE}
      data Ford_SteMdule_U_Meas: sw-calibration-access=READ-ONLY, type=Ford_SteMdule_U_Meas
    Ford_TrlrHitchLamp_D_Rqst: invalidation-policy{data-element=Ford_TrlrHitchLamp_D_Rqst, handle-invalid=DONT-INVALIDATE}
      data Ford_TrlrHitchLamp_D_Rqst: sw-calibration-access=READ-ONLY, type=Ford_TrlrHitchLamp_D_Rqst
    Ford_Veh_V_RqMxTrlrAid: invalidation-policy{data-element=Ford_Veh_V_RqMxTrlrAid, handle-invalid=DONT-INVALIDATE}
      data Ford_Veh_V_RqMxTrlrAid: sw-calibration-access=READ-ONLY, type=Ford_Veh_V_RqMxTrlrAid
    Ford_VehVTrlrAid_B_Rq: invalidation-policy{data-element=Ford_VehVTrlrAid_B_Rq, handle-invalid=DONT-INVALIDATE}
      data Ford_VehVTrlrAid_B_Rq: sw-calibration-access=READ-ONLY, type=Ford_VehVTrlrAid_B_Rq
package /Nexteer/PortInterfaces
  sender receiver interface float32_PortIf1: invalidation-policy{data-element=float32_PortIf1/Val, handle-invalid=DONT-INVALIDATE}
    data Val: sw-calibration-access=READ-ONLY, type=float32
  sender receiver interface uint8_PortIf1: invalidation-policy{data-element=uint8_PortIf1/Val, handle-invalid=DONT-INVALIDATE}
    data Val: sw-calibration-access=READ-ONLY, type=uint8
