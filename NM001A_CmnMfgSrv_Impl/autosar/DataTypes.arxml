AUTOSAR XML (schema 4-0-3)
standard types defined: boolean, float32, sint16, sint32, sint8, uint16, uint32, uint8, boolean_CompuMethod, boolean_DataConstr, float32_DataConstr, sint16_DataConstr, sint32_DataConstr, sint8_DataConstr, uint16_DataConstr, uint32_DataConstr, uint8_DataConstr, Boolean, dtRef_const_VOID, dtRef_VOID
package /DataTypes
  impl type Ary1D_u16_16: category=ARRAY, sw-calibration-access=READ-ONLY, type-emitter=RTE
    element Element: array-size=16, array-size-semantics=FIXED-SIZE, implementation-data-type=PlatformTypes/uint16
  impl type Ary1D_u8_20: category=ARRAY, sw-calibration-access=READ-ONLY, type-emitter=RTE
    element Element: array-size=20, array-size-semantics=FIXED-SIZE, implementation-data-type=PlatformTypes/uint8
  impl type Ary1D_u8_8: category=ARRAY, sw-calibration-access=READ-ONLY, type-emitter=RTE
    element Element: array-size=8, array-size-semantics=FIXED-SIZE, implementation-data-type=PlatformTypes/uint8
package /Nexteer/DataTypeMappingSets
  data type mapping set Nexteer
    data-type-maps:
      application-data-type=A{1..5}, implementation-data-type=PlatformTypes/float32
      application-data-type=Ag1, implementation-data-type=PlatformTypes/float32
      application-data-type=Ag{10..17}, implementation-data-type=PlatformTypes/float32
      application-data-type=Ag18, implementation-data-type=u12p4
      application-data-type=Ag19, implementation-data-type=PlatformTypes/float32
      application-data-type=Ag2, implementation-data-type=PlatformTypes/float32
      application-data-type=Ag3, implementation-data-type=PlatformTypes/float32
      application-data-type=Ag4, implementation-data-type=s2p13
      application-data-type=Ag5, implementation-data-type=u0p16
      application-data-type=Ag6, implementation-data-type=s18p13
      application-data-type=Ag7, implementation-data-type=s18p13
      application-data-type=Ag8, implementation-data-type=s15p16
      application-data-type=Ag9, implementation-data-type=u0p16
      application-data-type=AgAry1D1, implementation-data-type=Ary1D_s2p13_1024
      application-data-type=AgAry1D2, implementation-data-type=Ary1D_u0p16_8
      application-data-type=AgAry1D3, implementation-data-type=Ary1D_s2p13_1025
      application-data-type=AgAry1D4, implementation-data-type=Ary1D_f32_8
      application-data-type=AgAry1D5, implementation-data-type=Ary1D_u12p4_16
      application-data-type=AgAry2D1, implementation-data-type=Ary2D_u12p4_9_16
      application-data-type=Cnt1, implementation-data-type=PlatformTypes/uint8
      application-data-type=Cnt10, implementation-data-type=PlatformTypes/uint16
      application-data-type=Cnt11, implementation-data-type=PlatformTypes/uint16
      application-data-type=Cnt{12..14}, implementation-data-type=PlatformTypes/uint8
      application-data-type=Cnt15, implementation-data-type=PlatformTypes/uint32
      application-data-type=Cnt16, implementation-data-type=PlatformTypes/uint16
      application-data-type=Cnt17, implementation-data-type=PlatformTypes/uint32
      application-data-type=Cnt18, implementation-data-type=PlatformTypes/uint8
      application-data-type=Cnt19, implementation-data-type=PlatformTypes/uint8
      application-data-type=Cnt2, implementation-data-type=PlatformTypes/sint8
      application-data-type=Cnt20, implementation-data-type=PlatformTypes/sint16
      application-data-type=Cnt21, implementation-data-type=PlatformTypes/uint8
      application-data-type=Cnt22, implementation-data-type=PlatformTypes/uint8
      application-data-type=Cnt23, implementation-data-type=u16p0
      application-data-type=Cnt24, implementation-data-type=PlatformTypes/uint8
      application-data-type=Cnt25, implementation-data-type=PlatformTypes/uint8
      application-data-type=Cnt26, implementation-data-type=u16p0
      application-data-type=Cnt{27..29}, implementation-data-type=PlatformTypes/uint8
      application-data-type=Cnt3, implementation-data-type=PlatformTypes/uint16
      application-data-type=Cnt30, implementation-data-type=PlatformTypes/uint8
      application-data-type=Cnt31, implementation-data-type=PlatformTypes/uint16
      application-data-type=Cnt32, implementation-data-type=PlatformTypes/float32
      application-data-type=Cnt33, implementation-data-type=PlatformTypes/uint8
      application-data-type=Cnt34, implementation-data-type=PlatformTypes/float32
      application-data-type=Cnt35, implementation-data-type=PlatformTypes/sint16
      application-data-type=Cnt4, implementation-data-type=PlatformTypes/uint16
      application-data-type=Cnt5, implementation-data-type=PlatformTypes/uint16
      application-data-type=Cnt6, implementation-data-type=PlatformTypes/uint8
      application-data-type=Cnt7, implementation-data-type=PlatformTypes/uint8
      application-data-type=Cnt8, implementation-data-type=PlatformTypes/uint32
      application-data-type=Cnt9, implementation-data-type=PlatformTypes/uint16
      application-data-type=CntAry1D1, implementation-data-type=Ary1D_u16p0_2
      application-data-type=CntAry1D2, implementation-data-type=Ary1D_u32_8
      application-data-type=CntAry1D3, implementation-data-type=Ary1D_u16_257
      application-data-type=CntAry1D4, implementation-data-type=Ary1D_u16p0_2
      application-data-type=CntAry1D5, implementation-data-type=Ary1D_u8_22
      application-data-type=CntAry1D6, implementation-data-type=Ary1D_s16_22
      application-data-type=Curr{1..7}, implementation-data-type=PlatformTypes/float32
      application-data-type=Curr8, implementation-data-type=u9p7
      application-data-type=Curr9, implementation-data-type=PlatformTypes/float32
      application-data-type=CurrAry1D1, implementation-data-type=Ary1D_u9p7_16
      application-data-type=CurrAry1D2, implementation-data-type=Ary1D_u9p7_6
      application-data-type=CurrAry1D3, implementation-data-type=Ary1D_u9p7_7
      application-data-type=CurrSqd1, implementation-data-type=PlatformTypes/float32
      application-data-type=Frq1, implementation-data-type=PlatformTypes/float32
      application-data-type=Frq10, implementation-data-type=PlatformTypes/float32
      application-data-type=Frq2, implementation-data-type=PlatformTypes/float32
      application-data-type=Frq3, implementation-data-type=u10p6
      application-data-type=Frq4, implementation-data-type=u10p6
      application-data-type=Frq5, implementation-data-type=u9p7
      application-data-type=Frq6, implementation-data-type=u9p7
      application-data-type=Frq{7..9}, implementation-data-type=PlatformTypes/float32
      application-data-type=FrqAry1D1, implementation-data-type=Ary1D_u10p6_4
      application-data-type=FrqAry1D2, implementation-data-type=Ary1D_u10p6_4
      application-data-type=FrqAry1D3, implementation-data-type=Ary1D_u9p7_4
      application-data-type=FrqAry1D4, implementation-data-type=Ary1D_u9p7_4
      application-data-type=Gain{1..8}, implementation-data-type=PlatformTypes/float32
      application-data-type=HwAgOffsRecAppl1, implementation-data-type=HwAgOffsRec1
      application-data-type=Indu1, implementation-data-type=PlatformTypes/float32
      application-data-type=Indu2, implementation-data-type=PlatformTypes/float32
      application-data-type=Logl1, implementation-data-type=PlatformTypes/boolean
      application-data-type=MotCon1, implementation-data-type=PlatformTypes/float32
      application-data-type=MotPrmNomEolRecAppl2, implementation-data-type=MotPrmNomEolRec2
      application-data-type=MotPrmNomEolRecAppl3, implementation-data-type=MotPrmNomEolRec3
      application-data-type=R{1..8}, implementation-data-type=PlatformTypes/float32
      application-data-type=Rate1, implementation-data-type=PlatformTypes/float32
      application-data-type=Rate10, implementation-data-type=PlatformTypes/float32
      application-data-type=Rate{2..9}, implementation-data-type=PlatformTypes/float32
      application-data-type=Spd1, implementation-data-type=PlatformTypes/float32
      application-data-type=Spd2, implementation-data-type=u9p7
      application-data-type=Spd3, implementation-data-type=PlatformTypes/float32
      application-data-type=Spd4, implementation-data-type=PlatformTypes/float32
      application-data-type=SpdAry1D1, implementation-data-type=Ary1D_u9p7_12
      application-data-type=SpdAry1D2, implementation-data-type=Ary1D_u9p7_9
      application-data-type=T{1..5}, implementation-data-type=PlatformTypes/float32
      application-data-type=T6, implementation-data-type=s11p4
      application-data-type=T7, implementation-data-type=s8p7
      application-data-type=T8, implementation-data-type=PlatformTypes/float32
      application-data-type=TAry1D1, implementation-data-type=Ary1D_s11p4_14
      application-data-type=TAry1D2, implementation-data-type=Ary1D_s8p7_14
      application-data-type=Ti1, implementation-data-type=PlatformTypes/uint32
      application-data-type=Ti{10..12}, implementation-data-type=PlatformTypes/float32
      application-data-type=Ti{2..6}, implementation-data-type=PlatformTypes/uint32
      application-data-type=Ti7, implementation-data-type=PlatformTypes/float32
      application-data-type=Ti8, implementation-data-type=PlatformTypes/float32
      application-data-type=Ti9, implementation-data-type=PlatformTypes/uint32
      application-data-type=Tq1, implementation-data-type=PlatformTypes/float32
      application-data-type=Tq10, implementation-data-type=PlatformTypes/float32
      application-data-type=Tq11, implementation-data-type=s4p11
      application-data-type=Tq12, implementation-data-type=u5p11
      application-data-type=Tq13, implementation-data-type=u4p12
      application-data-type=Tq14, implementation-data-type=u5p11
      application-data-type=Tq{15..19}, implementation-data-type=PlatformTypes/float32
      application-data-type=Tq2, implementation-data-type=PlatformTypes/float32
      application-data-type=Tq3, implementation-data-type=PlatformTypes/float32
      application-data-type=Tq4, implementation-data-type=u5p11
      application-data-type=Tq5, implementation-data-type=s4p11
      application-data-type=Tq6, implementation-data-type=u8p8
      application-data-type=Tq7, implementation-data-type=u5p11
      application-data-type=Tq8, implementation-data-type=PlatformTypes/float32
      application-data-type=Tq9, implementation-data-type=PlatformTypes/float32
      application-data-type=TqAry1D1, implementation-data-type=Ary1D_s4p11_20
      application-data-type=TqAry1D10, implementation-data-type=Ary1D_u4p12_12
      application-data-type=TqAry1D11, implementation-data-type=Ary1D_u5p11_13
      application-data-type=TqAry1D2, implementation-data-type=Ary1D_u8p8_20
      application-data-type=TqAry1D3, implementation-data-type=Ary1D_u5p11_5
      application-data-type=TqAry1D4, implementation-data-type=Ary1D_s4p11_20
      application-data-type=TqAry1D5, implementation-data-type=Ary1D_u5p11_5
      application-data-type=TqAry1D6, implementation-data-type=Ary1D_u4p12_11
      application-data-type=TqAry1D7, implementation-data-type=Ary1D_u5p11_16
      application-data-type=TqAry1D8, implementation-data-type=Ary1D_u8p8_8
      application-data-type=TqAry1D9, implementation-data-type=Ary1D_u8p8_2
      application-data-type=TqAry2D1, implementation-data-type=Ary2D_s4p11_12_20
      application-data-type=TqAry2D2, implementation-data-type=Ary2D_u8p8_12_20
      application-data-type=TqAry2D3, implementation-data-type=Ary2D_u5p11_12_5
      application-data-type=TqAry2D4, implementation-data-type=Ary2D_s4p11_12_20
      application-data-type=TqAry2D5, implementation-data-type=Ary2D_u5p11_12_5
      application-data-type=TqAry2D6, implementation-data-type=Ary2D_u5p11_9_16
      application-data-type=TqAry2D7, implementation-data-type=Ary2D_u8p8_9_8
      application-data-type=TqAry2D8, implementation-data-type=Ary2D_u5p11_12_13
      application-data-type=Uls1, implementation-data-type=PlatformTypes/float32
      application-data-type=Uls10, implementation-data-type=PlatformTypes/float32
      application-data-type=Uls11, implementation-data-type=u2p14
      application-data-type=Uls{12..14}, implementation-data-type=PlatformTypes/float32
      application-data-type=Uls15, implementation-data-type=u1p15
      application-data-type=Uls16, implementation-data-type=PlatformTypes/float32
      application-data-type=Uls17, implementation-data-type=u8p8
      application-data-type=Uls18, implementation-data-type=u9p7
      application-data-type=Uls19, implementation-data-type=u8p8
      application-data-type=Uls2, implementation-data-type=PlatformTypes/float32
      application-data-type=Uls20, implementation-data-type=u4p12
      application-data-type=Uls21, implementation-data-type=PlatformTypes/float32
      application-data-type=Uls22, implementation-data-type=PlatformTypes/float32
      application-data-type=Uls23, implementation-data-type=u8p8
      application-data-type=Uls24, implementation-data-type=PlatformTypes/uint8
      application-data-type=Uls3, implementation-data-type=PlatformTypes/sint8
      application-data-type=Uls4, implementation-data-type=u2p14
      application-data-type=Uls{5..9}, implementation-data-type=PlatformTypes/float32
      application-data-type=UlsAry1D1, implementation-data-type=Ary1D_u2p14_5
      application-data-type=UlsAry1D10, implementation-data-type=Ary1D_u8p8_4
      application-data-type=UlsAry1D11, implementation-data-type=Ary1D_u8p8_14
      application-data-type=UlsAry1D12, implementation-data-type=Ary1D_u1p15_2
      application-data-type=UlsAry1D13, implementation-data-type=Ary1D_u4p12_12
      application-data-type=UlsAry1D14, implementation-data-type=Ary1D_u4p12_14
      application-data-type=UlsAry1D15, implementation-data-type=Ary1D_u8p8_14
      application-data-type=UlsAry1D2, implementation-data-type=Ary1D_u2p14_2
      application-data-type=UlsAry1D3, implementation-data-type=Ary1D_u2p14_16
      application-data-type=UlsAry1D4, implementation-data-type=Ary1D_u2p14_6
      application-data-type=UlsAry1D5, implementation-data-type=Ary1D_u1p15_11
      application-data-type=UlsAry1D6, implementation-data-type=Ary1D_f32_8
      application-data-type=UlsAry1D7, implementation-data-type=Ary1D_u8p8_4
      application-data-type=UlsAry1D8, implementation-data-type=Ary1D_u9p7_4
      application-data-type=UlsAry1D9, implementation-data-type=Ary1D_u8p8_8
      application-data-type=UlsAry2D1, implementation-data-type=Ary2D_u2p14_12_5
      application-data-type=UlsAry2D2, implementation-data-type=Ary2D_u2p14_7_6
      application-data-type=UlsAry2D3, implementation-data-type=Ary2D_u8p8_9_8
      application-data-type=UlsAry2D4, implementation-data-type=Ary2D_u8p8_9_4
      application-data-type=Vel{1..3}, implementation-data-type=PlatformTypes/float32
      application-data-type=Vel4, implementation-data-type=u11p5
      application-data-type=Vel5, implementation-data-type=PlatformTypes/float32
      application-data-type=Vel6, implementation-data-type=u7p9
      application-data-type=Vel7, implementation-data-type=u12p4
      application-data-type=Vel8, implementation-data-type=PlatformTypes/float32
      application-data-type=Vel9, implementation-data-type=PlatformTypes/float32
      application-data-type=VelAry1D1, implementation-data-type=Ary1D_u11p5_4
      application-data-type=VelAry1D2, implementation-data-type=Ary1D_u11p5_11
      application-data-type=VelAry1D3, implementation-data-type=Ary1D_u11p5_10
      application-data-type=VelAry1D4, implementation-data-type=Ary1D_u7p9_4
      application-data-type=VelAry1D5, implementation-data-type=Ary1D_u12p4_13
      application-data-type=VelAry2D1, implementation-data-type=Ary2D_u7p9_8_4
      application-data-type=VelAry2D2, implementation-data-type=Ary2D_u7p9_9_4
      application-data-type=VelAry2D3, implementation-data-type=Ary2D_u12p4_12_13
      application-data-type=Volt1, implementation-data-type=PlatformTypes/float32
      application-data-type=Volt{10..17}, implementation-data-type=PlatformTypes/float32
      application-data-type=Volt18, implementation-data-type=u3p13
      application-data-type=Volt{2..9}, implementation-data-type=PlatformTypes/float32
      application-data-type=VoltAry1D1, implementation-data-type=Ary1D_u3p13_10
      application-data-type=VoltGain1, implementation-data-type=PlatformTypes/float32
      application-data-type=VoltTi1, implementation-data-type=PlatformTypes/uint32
      application-data-type=VoltTi2, implementation-data-type=PlatformTypes/uint32
package /Nexteer/DataTypes
  70 x application array data type, all with category=ARRAY, sw-calibration-access=READ-ONLY:
    AgAry1D1
      element Element: category=VALUE, type=Ag4, array-size-semantics=FIXED-SIZE, max-number-of-elements=1024
    AgAry1D2
      element Element: category=VALUE, type=Ag5, array-size-semantics=FIXED-SIZE, max-number-of-elements=8
    AgAry1D3
      element Element: category=VALUE, type=Ag4, array-size-semantics=FIXED-SIZE, max-number-of-elements=1025
    AgAry1D4
      element Element: category=VALUE, type=Ag14, array-size-semantics=FIXED-SIZE, max-number-of-elements=8
    AgAry1D5
      element Element: category=VALUE, type=Ag18, array-size-semantics=FIXED-SIZE, max-number-of-elements=16
    AgAry2D1
      element Element: category=ARRAY, type=AgAry1D5, array-size-semantics=FIXED-SIZE, max-number-of-elements=9
    CntAry1D1
      element Element: category=VALUE, type=Cnt23, array-size-semantics=FIXED-SIZE, max-number-of-elements=2
    CntAry1D2
      element Element: category=VALUE, type=Cnt15, array-size-semantics=FIXED-SIZE, max-number-of-elements=8
    CntAry1D3
      element Element: category=VALUE, type=Cnt16, array-size-semantics=FIXED-SIZE, max-number-of-elements=257
    CntAry1D4
      element Element: category=VALUE, type=Cnt26, array-size-semantics=FIXED-SIZE, max-number-of-elements=2
    CntAry1D5
      element Element: category=VALUE, type=Cnt19, array-size-semantics=FIXED-SIZE, max-number-of-elements=22
    CntAry1D6
      element Element: category=VALUE, type=Cnt35, array-size-semantics=FIXED-SIZE, max-number-of-elements=22
    CurrAry1D1
      element Element: category=VALUE, type=Curr8, array-size-semantics=FIXED-SIZE, max-number-of-elements=16
    CurrAry1D2
      element Element: category=VALUE, type=Curr8, array-size-semantics=FIXED-SIZE, max-number-of-elements=6
    CurrAry1D3
      element Element: category=VALUE, type=Curr8, array-size-semantics=FIXED-SIZE, max-number-of-elements=7
    FrqAry1D1
      element Element: category=VALUE, type=Frq3, array-size-semantics=FIXED-SIZE, max-number-of-elements=4
    FrqAry1D2
      element Element: category=VALUE, type=Frq4, array-size-semantics=FIXED-SIZE, max-number-of-elements=4
    FrqAry1D3
      element Element: category=VALUE, type=Frq5, array-size-semantics=FIXED-SIZE, max-number-of-elements=4
    FrqAry1D4
      element Element: category=VALUE, type=Frq6, array-size-semantics=FIXED-SIZE, max-number-of-elements=4
    SpdAry1D1
      element Element: category=VALUE, type=Spd2, array-size-semantics=FIXED-SIZE, max-number-of-elements=12
    SpdAry1D2
      element Element: category=VALUE, type=Spd2, array-size-semantics=FIXED-SIZE, max-number-of-elements=9
    TAry1D1
      element Element: category=VALUE, type=T6, array-size-semantics=FIXED-SIZE, max-number-of-elements=14
    TAry1D2
      element Element: category=VALUE, type=T7, array-size-semantics=FIXED-SIZE, max-number-of-elements=14
    TqAry1D1
      element Element: category=VALUE, type=Tq5, array-size-semantics=FIXED-SIZE, max-number-of-elements=20
    TqAry1D10
      element Element: category=VALUE, type=Tq13, array-size-semantics=FIXED-SIZE, max-number-of-elements=12
    TqAry1D11
      element Element: category=VALUE, type=Tq12, array-size-semantics=FIXED-SIZE, max-number-of-elements=13
    TqAry1D2
      element Element: category=VALUE, type=Tq6, array-size-semantics=FIXED-SIZE, max-number-of-elements=20
    TqAry1D3
      element Element: category=VALUE, type=Tq7, array-size-semantics=FIXED-SIZE, max-number-of-elements=5
    TqAry1D4
      element Element: category=VALUE, type=Tq11, array-size-semantics=FIXED-SIZE, max-number-of-elements=20
    TqAry1D5
      element Element: category=VALUE, type=Tq12, array-size-semantics=FIXED-SIZE, max-number-of-elements=5
    TqAry1D6
      element Element: category=VALUE, type=Tq13, array-size-semantics=FIXED-SIZE, max-number-of-elements=11
    TqAry1D7
      element Element: category=VALUE, type=Tq14, array-size-semantics=FIXED-SIZE, max-number-of-elements=16
    TqAry1D8
      element Element: category=VALUE, type=Tq6, array-size-semantics=FIXED-SIZE, max-number-of-elements=8
    TqAry1D9
      element Element: category=VALUE, type=Tq6, array-size-semantics=FIXED-SIZE, max-number-of-elements=2
    TqAry2D1
      element Element: category=ARRAY, type=TqAry1D1, array-size-semantics=FIXED-SIZE, max-number-of-elements=12
    TqAry2D2
      element Element: category=ARRAY, type=TqAry1D2, array-size-semantics=FIXED-SIZE, max-number-of-elements=12
    TqAry2D3
      element Element: category=ARRAY, type=TqAry1D3, array-size-semantics=FIXED-SIZE, max-number-of-elements=12
    TqAry2D4
      element Element: category=ARRAY, type=TqAry1D4, array-size-semantics=FIXED-SIZE, max-number-of-elements=12
    TqAry2D5
      element Element: category=ARRAY, type=TqAry1D5, array-size-semantics=FIXED-SIZE, max-number-of-elements=12
    TqAry2D6
      element Element: category=ARRAY, type=TqAry1D7, array-size-semantics=FIXED-SIZE, max-number-of-elements=9
    TqAry2D7
      element Element: category=ARRAY, type=TqAry1D8, array-size-semantics=FIXED-SIZE, max-number-of-elements=9
    TqAry2D8
      element Element: category=ARRAY, type=TqAry1D11, array-size-semantics=FIXED-SIZE, max-number-of-elements=12
    UlsAry1D1
      element Element: category=VALUE, type=Uls4, array-size-semantics=FIXED-SIZE, max-number-of-elements=5
    UlsAry1D10
      element Element: category=VALUE, type=Uls19, array-size-semantics=FIXED-SIZE, max-number-of-elements=4
    UlsAry1D11
      element Element: category=VALUE, type=Uls17, array-size-semantics=FIXED-SIZE, max-number-of-elements=14
    UlsAry1D12
      element Element: category=VALUE, type=Uls15, array-size-semantics=FIXED-SIZE, max-number-of-elements=2
    UlsAry1D13
      element Element: category=VALUE, type=Uls20, array-size-semantics=FIXED-SIZE, max-number-of-elements=12
    UlsAry1D14
      element Element: category=VALUE, type=Uls20, array-size-semantics=FIXED-SIZE, max-number-of-elements=14
    UlsAry1D15
      element Element: category=VALUE, type=Uls23, array-size-semantics=FIXED-SIZE, max-number-of-elements=14
    UlsAry1D2
      element Element: category=VALUE, type=Uls4, array-size-semantics=FIXED-SIZE, max-number-of-elements=2
    UlsAry1D3
      element Element: category=VALUE, type=Uls11, array-size-semantics=FIXED-SIZE, max-number-of-elements=16
    UlsAry1D4
      element Element: category=VALUE, type=Uls11, array-size-semantics=FIXED-SIZE, max-number-of-elements=6
    UlsAry1D5
      element Element: category=VALUE, type=Uls15, array-size-semantics=FIXED-SIZE, max-number-of-elements=11
    UlsAry1D6
      element Element: category=VALUE, type=Uls12, array-size-semantics=FIXED-SIZE, max-number-of-elements=8
    UlsAry1D7
      element Element: category=VALUE, type=Uls17, array-size-semantics=FIXED-SIZE, max-number-of-elements=4
    UlsAry1D8
      element Element: category=VALUE, type=Uls18, array-size-semantics=FIXED-SIZE, max-number-of-elements=4
    UlsAry1D9
      element Element: category=VALUE, type=Uls17, array-size-semantics=FIXED-SIZE, max-number-of-elements=8
    UlsAry2D1
      element Element: category=ARRAY, type=UlsAry1D1, array-size-semantics=FIXED-SIZE, max-number-of-elements=12
    UlsAry2D2
      element Element: category=ARRAY, type=UlsAry1D4, array-size-semantics=FIXED-SIZE, max-number-of-elements=7
    UlsAry2D3
      element Element: category=ARRAY, type=UlsAry1D9, array-size-semantics=FIXED-SIZE, max-number-of-elements=9
    UlsAry2D4
      element Element: category=ARRAY, type=UlsAry1D10, array-size-semantics=FIXED-SIZE, max-number-of-elements=9
    VelAry1D1
      element Element: category=VALUE, type=Vel4, array-size-semantics=FIXED-SIZE, max-number-of-elements=4
    VelAry1D2
      element Element: category=VALUE, type=Vel4, array-size-semantics=FIXED-SIZE, max-number-of-elements=11
    VelAry1D3
      element Element: category=VALUE, type=Vel4, array-size-semantics=FIXED-SIZE, max-number-of-elements=10
    VelAry1D4
      element Element: category=VALUE, type=Vel6, array-size-semantics=FIXED-SIZE, max-number-of-elements=4
    VelAry1D5
      element Element: category=VALUE, type=Vel7, array-size-semantics=FIXED-SIZE, max-number-of-elements=13
    VelAry2D1
      element Element: category=ARRAY, type=VelAry1D4, array-size-semantics=FIXED-SIZE, max-number-of-elements=8
    VelAry2D2
      element Element: category=ARRAY, type=VelAry1D4, array-size-semantics=FIXED-SIZE, max-number-of-elements=9
    VelAry2D3
      element Element: category=ARRAY, type=VelAry1D5, array-size-semantics=FIXED-SIZE, max-number-of-elements=12
    VoltAry1D1
      element Element: category=VALUE, type=Volt18, array-size-semantics=FIXED-SIZE, max-number-of-elements=10
  206 x app type, all with sw-calibration-access=READ-ONLY:
    A1: category=VALUE, range phys -10..10, unit=m/s^2
    A2: category=VALUE, range phys -180..180, unit=m/s^2
    A3: category=VALUE, range phys -50..50, unit=kph/s
    A4: category=VALUE, range phys 0.1..10, unit=m/s^2
    A5: category=VALUE, range phys 0.1..10, unit=kph/s
    Ag1: category=VALUE, range phys 0..6.25, unit=MotDeg
    Ag10: category=VALUE, range phys 0..6.2832, unit=MotRad
    Ag11: category=VALUE, range phys 10..40, unit=MotDeg/HwDeg
    Ag12: category=VALUE, range phys -1.62..1.62, unit=MotRad
    Ag13: category=VALUE, range phys 0.001..0.1, unit=MotRad
    Ag14: category=VALUE, range phys -3.1415927..3.1415927, unit=MotRad
    Ag15: category=VALUE, range phys -1440..1440, unit=HwDeg
    Ag16: category=VALUE, range phys 0..20, unit=HwDeg
    Ag17: category=VALUE, range phys 0..1440, unit=HwDeg
    Ag18: category=VALUE, compu {phys=raw*16; unit FixdPt}, range phys 0..1440, unit=HwDeg
    Ag19: category=VALUE, range phys -900..900, unit=HwDeg
    Ag2: category=VALUE, range phys -11796480..11796480, unit=MotDeg
    Ag3: category=VALUE, range phys 0..0.999, unit=MotRevElec
    Ag4: category=VALUE, compu {raw=phys*8192; unit FixdPt}, range phys -0.05555555556..0.05555555556, unit=MotRev
    Ag5: category=VALUE, compu {raw=phys*65536; unit FixdPt}, range phys 0..0.9999847412, unit=MotRev
    Ag6: category=VALUE, compu {raw=phys*8192; unit FixdPt}, range phys 0..6.25, unit=MotDeg
    Ag7: category=VALUE, compu {raw=phys*8192; unit FixdPt}, range phys -262144..262143.9998, unit=MotDeg
    Ag8: category=VALUE, compu {raw=phys*65536; unit FixdPt}, range phys -32768..32767.999984741, unit=MotRev
    Ag9: category=VALUE, compu {raw=phys*65536; unit FixdPt}, range phys 0..0.9999847412, unit=MotRevElec
    Cnt1: category=VALUE, range phys 1..4, unit=Cnt
    Cnt10: category=VALUE, range phys 1..10000, unit=Cnt
    Cnt11: category=VALUE, range phys 0..10000, unit=Cnt
    Cnt12: category=VALUE, range phys 0..3, unit=Cnt
    Cnt13: category=VALUE, range phys 0..3, unit=Cnt
    Cnt14: category=VALUE, range phys 2..12, unit=Cnt
    Cnt15: category=VALUE, range phys 0..4294967295, unit=Cnt
    Cnt16: category=VALUE, range phys 0..65535, unit=Cnt
    Cnt17: category=VALUE, range phys 0..67108863, unit=Cnt
    Cnt18: category=VALUE, range phys 0..31, unit=Cnt
    Cnt19: category=VALUE, range phys 0..255, unit=Cnt
    Cnt2: category=VALUE, range phys -1..1, unit=Cnt
    Cnt20: category=VALUE, range phys -512..511, unit=Cnt
    Cnt21: category=VALUE, range phys 1..3, unit=Cnt
    Cnt22: category=VALUE, range phys 0..7, unit=Cnt
    Cnt23: category=VALUE, range phys 0..100, unit=Cnt
    Cnt24: category=VALUE, range phys 0..42, unit=Cnt
    Cnt25: category=VALUE, range phys 0..2, unit=Cnt
    Cnt26: category=VALUE, range phys 0..200, unit=Cnt
    Cnt27: category=VALUE, range phys 0..8, unit=Cnt
    Cnt28: category=VALUE, range phys 1..5, unit=Cnt
    Cnt29: category=VALUE, range phys 1..20, unit=Cnt
    Cnt3: category=VALUE, range phys 0..1, unit=Cnt
    Cnt30: category=VALUE, range phys 0..20, unit=Cnt
    Cnt31: category=VALUE, range phys 0..4095, unit=Cnt
    Cnt32: category=VALUE, range phys 0..360, unit=Cnt
    Cnt33: category=VALUE, range phys 0..22, unit=Cnt
    Cnt34: category=VALUE, range phys -900..900, unit=Cnt
    Cnt35: category=VALUE, range phys -500..500, unit=Cnt
    Cnt4: category=VALUE, range phys 0..31, unit=Cnt
    Cnt5: category=VALUE, range phys 0..32767, unit=Cnt
    Cnt6: category=VALUE, range phys 0..63, unit=Cnt
    Cnt7: category=VALUE, range phys 20..160, unit=Cnt
    Cnt8: category=VALUE, range phys 0..1800, unit=Cnt
    Cnt9: category=VALUE, range phys 1..1000, unit=Cnt
    Curr1: category=VALUE, range phys -145..145, unit=Amp
    Curr2: category=VALUE, range phys 0..50, unit=Amp
    Curr3: category=VALUE, range phys 10..100, unit=Amp
    Curr4: category=VALUE, range phys -450..450, unit=Amp
    Curr5: category=VALUE, range phys -1000..1000, unit=Amp
    Curr6: category=VALUE, range phys 0..200, unit=Amp
    Curr7: category=VALUE, range phys -200..200, unit=Amp
    Curr8: category=VALUE, compu {raw=phys*128; unit FixdPt}, range phys 0..200, unit=Amp
    Curr9: category=VALUE, range phys 0.01..20, unit=Amp
    CurrSqd1: category=VALUE, range phys 0..40000, unit=Amp^2
    Frq1: category=VALUE, range phys 0.1..10, unit=Hz
    Frq10: category=VALUE, range phys 1..100, unit=Hz
    Frq2: category=VALUE, range phys 1..200, unit=Hz
    Frq3: category=VALUE, compu {raw=phys*64; unit FixdPt}, range phys 0..750, unit=Hz
    Frq4: category=VALUE, compu {raw=phys*64; unit FixdPt}, range phys 0..1000, unit=Hz
    Frq5: category=VALUE, compu {raw=phys*128; unit FixdPt}, range phys 0..500, unit=Hz
    Frq6: category=VALUE, compu {raw=phys*128; unit FixdPt}, range phys 0..400, unit=Hz
    Frq7: category=VALUE, range phys 5..100, unit=Hz
    Frq8: category=VALUE, range phys 5..31.25, unit=Hz
    Frq9: category=VALUE, range phys 0.0039..100, unit=Hz
    Gain1: category=VALUE, range phys 0..200, unit=degC/Volt
    Gain2: category=VALUE, range phys 70..76, unit=Amp/V
    Gain3: category=VALUE, range phys 56..60, unit=Amp/V
    Gain4: category=VALUE, range phys 0..76, unit=Amp/V
    Gain5: category=VALUE, range phys 0..0.006, unit=ohm/degC
    Gain6: category=VALUE, range phys -0.0015..0, unit=V/MotRad/S/degC
    Gain7: category=VALUE, range phys 0..0.0045, unit=ohm/degC
    Gain8: category=VALUE, range phys 0..0.1, unit=MotNm/MotRad/S
    Indu1: category=VALUE, range phys 3e-05..0.00041, unit=H
    Indu2: category=VALUE, range phys 0..0.0023, unit=H
    Logl1: category=BOOLEAN, range phys 0..1
    MotCon1: category=VALUE, range phys 0.025..0.075, unit=V/MotRad/Sec
    R1: category=VALUE, range phys 0..0.2, unit=ohm
    R2: category=VALUE, range phys 0..45, unit=ohm
    R3: category=VALUE, range phys 0..2.25, unit=ohm
    R4: category=VALUE, range phys 0..3.6, unit=ohm
    R5: category=VALUE, range phys 0.005..0.125, unit=ohm
    R6: category=VALUE, range phys 0.005..0.12565, unit=ohm
    R7: category=VALUE, range phys -0.5..0.5, unit=ohm
    R8: category=VALUE, range phys 0..0.1, unit=ohm
    Rate1: category=VALUE, range phys 0.1..500, unit=Uls/S
    Rate10: category=VALUE, range phys 1..1200, unit=VehDeg/S^2
    Rate2: category=VALUE, range phys 0..500, unit=Uls/S
    Rate3: category=VALUE, range phys 0..1000, unit=Uls/S
    Rate4: category=VALUE, range phys 0.1..10, unit=Uls/S
    Rate5: category=VALUE, range phys -120..120, unit=VehDeg/S
    Rate6: category=VALUE, range phys 0.1..400, unit=m/s^2
    Rate7: category=VALUE, range phys 0.1..500, unit=kph/s^2
    Rate8: category=VALUE, range phys 1..50, unit=kph/s
    Rate9: category=VALUE, range phys 0.1..120, unit=VehDeg/S
    Spd1: category=VALUE, range phys 0..511, unit=kph
    Spd2: category=VALUE, compu {raw=phys*128; unit FixdPt}, range phys 0..511, unit=kph
    Spd3: category=VALUE, range phys 0..255, unit=kph
    Spd4: category=VALUE, range phys 0.1..511, unit=kph
    T1: category=VALUE, range phys -50..150, unit=degC
    T2: category=VALUE, range phys -50..200, unit=degC
    T3: category=VALUE, range phys -50..300, unit=degC
    T4: category=VALUE, range phys -100..150, unit=degC
    T5: category=VALUE, range phys -40..150, unit=degC
    T6: category=VALUE, compu {phys=raw*16; unit FixdPt}, range phys -50..150, unit=degC
    T7: category=VALUE, compu {raw=phys*128; unit FixdPt}, range phys -50..150, unit=degC
    T8: category=VALUE, range phys 0..10, unit=degC
    Ti1: category=VALUE, range phys 0..25000, unit=nS
    Ti10: category=VALUE, range phys 0..0.0002, unit=sec
    Ti11: category=VALUE, range phys 9.1e-05..0.000143, unit=sec
    Ti12: category=VALUE, range phys 0..0.05, unit=sec
    Ti2: category=VALUE, range phys 1..1000, unit=nS
    Ti3: category=VALUE, range phys 0..71429, unit=nS
    Ti4: category=VALUE, range phys 55555..71429, unit=nS
    Ti5: category=VALUE, range phys 6666..8572, unit=nS
    Ti6: category=VALUE, range phys 0..30000, unit=nS
    Ti7: category=VALUE, range phys 0..4295, unit=uS
    Ti8: category=VALUE, range phys 0..71429, unit=nS
    Ti9: category=VALUE, range phys 0..4294967295, unit=nS
    Tq1: category=VALUE, range phys -8.8..8.8, unit=MotNm
    Tq10: category=VALUE, range phys 0..8.8, unit=MotNm
    Tq11: category=VALUE, compu {raw=phys*2048; unit FixdPt}, range phys -1..15.99, unit=MotNm
    Tq12: category=VALUE, compu {raw=phys*2048; unit FixdPt}, range phys 0..8.8, unit=MotNm
    Tq13: category=VALUE, compu {phys=raw*4096; unit FixdPt}, range phys 0..8.8, unit=MotNm
    Tq14: category=VALUE, compu {raw=phys*2048; unit FixdPt}, range phys 0..0.5, unit=MotNm
    Tq15: category=VALUE, range phys 0..0.3, unit=MotNm
    Tq16: category=VALUE, range phys 0..64, unit=HwNm
    Tq17: category=VALUE, range phys 0..63, unit=HwNm
    Tq18: category=VALUE, range phys 0..10, unit=HwNm
    Tq19: category=VALUE, range phys 0..1799, unit=HwNm
    Tq2: category=VALUE, range phys -10..10, unit=HwNm
    Tq3: category=VALUE, range phys 0..8.8, unit=HwNm
    Tq4: category=VALUE, compu {raw=phys*2048; unit FixdPt}, range phys 0..8, unit=MotNm
    Tq5: category=VALUE, compu {raw=phys*2048; unit FixdPt}, range phys -10..10, unit=MotNm
    Tq6: category=VALUE, compu {raw=phys*256; unit FixdPt}, range phys 0..10, unit=HwNm
    Tq7: category=VALUE, compu {raw=phys*2048; unit FixdPt}, range phys 0..1.1, unit=MotNm
    Tq8: category=VALUE, range phys -3..3, unit=MotNm
    Tq9: category=VALUE, range phys -8..8, unit=MotNm
    Uls1: category=VALUE, range phys 0.5..1, unit=Uls
    Uls10: category=VALUE, range phys 0..20, unit=Uls
    Uls11: category=VALUE, compu {raw=phys*16384; unit FixdPt}, range phys 0..2, unit=Uls
    Uls12: category=VALUE, range phys -1..1, unit=Uls
    Uls13: category=VALUE, range phys -100..100, unit=Uls
    Uls14: category=VALUE, range phys 1..2, unit=Uls
    Uls15: category=VALUE, compu {phys=raw*32768; unit FixdPt}, range phys 0..1, unit=Uls
    Uls16: category=VALUE, range phys 0.1..10, unit=Uls
    Uls17: category=VALUE, compu {raw=phys*256; unit FixdPt}, range phys 0..1, unit=Uls
    Uls18: category=VALUE, compu {raw=phys*128; unit FixdPt}, range phys 0..1, unit=Uls
    Uls19: category=VALUE, compu {raw=phys*256; unit FixdPt}, range phys 0..2.5, unit=Uls
    Uls2: category=VALUE, range phys 0..1, unit=Uls
    Uls20: category=VALUE, compu {phys=raw*4096; unit FixdPt}, range phys 0..10, unit=Uls
    Uls21: category=VALUE, range phys 0..2, unit=Uls
    Uls22: category=VALUE, range phys 0..10, unit=Uls
    Uls23: category=VALUE, compu {raw=phys*256; unit FixdPt}, range phys 0..1, unit=Uls
    Uls24: category=VALUE, range phys 0..255, unit=Uls
    Uls3: category=VALUE, range phys -1..1, unit=Uls
    Uls4: category=VALUE, compu {raw=phys*16384; unit FixdPt}, range phys 0..1, unit=Uls
    Uls5: category=VALUE, range phys -1000000000..1000000000, unit=Uls
    Uls6: category=VALUE, range phys 0..200, unit=Uls
    Uls7: category=VALUE, range phys -25..25, unit=Uls
    Uls8: category=VALUE, range phys -200..200, unit=Uls
    Uls9: category=VALUE, range phys 0.98..1, unit=Uls
    Vel1: category=VALUE, range phys -1350..1350, unit=MotRad/s
    Vel2: category=VALUE, range phys 0..1350, unit=MotRad/s
    Vel3: category=VALUE, range phys -42..42, unit=HwRad/s
    Vel4: category=VALUE, compu {raw=phys*32; unit FixdPt}, range phys 0..1350, unit=MotRad/s
    Vel5: category=VALUE, range phys 0..0.5, unit=HwDeg/s
    Vel6: category=VALUE, compu {phys=raw*512; unit FixdPt}, range phys 0..42, unit=HwRad/s
    Vel7: category=VALUE, compu {phys=raw*16; unit FixdPt}, range phys 0..1350, unit=MotRad/s
    Vel8: category=VALUE, range phys 0..128, unit=MotRad/s
    Vel9: category=VALUE, range phys 0..127, unit=MotRad/s
    Volt1: category=VALUE, range phys 6..26.5, unit=V
    Volt10: category=VALUE, range phys 2.5..4.8, unit=V
    Volt11: category=VALUE, range phys 0.3..2.5, unit=V
    Volt12: category=VALUE, range phys 2.5..3, unit=V
    Volt13: category=VALUE, range phys 2..2.5, unit=V
    Volt14: category=VALUE, range phys 0..4800, unit=V
    Volt15: category=VALUE, range phys 0..48000, unit=V
    Volt16: category=VALUE, range phys 0..1, unit=V
    Volt17: category=VALUE, range phys -26.5..26.5, unit=V
    Volt18: category=VALUE, compu {raw=phys*8192; unit FixdPt}, range phys 0..5, unit=V
    Volt2: category=VALUE, range phys 6..16, unit=V
    Volt3: category=VALUE, range phys 0..5, unit=V
    Volt4: category=VALUE, range phys 0..26.5, unit=V
    Volt5: category=VALUE, range phys 0..16, unit=V
    Volt6: category=VALUE, range phys 0..40, unit=V
    Volt7: category=VALUE, range phys 0.3..4.8, unit=V
    Volt8: category=VALUE, range phys 2.8..3, unit=V
    Volt9: category=VALUE, range phys 2..2.3, unit=V
    VoltGain1: category=VALUE, range phys -1..1, unit=VoltPerVoltNanoSec
    VoltTi1: category=VALUE, range phys 0..1040000, unit=VnS
    VoltTi2: category=VALUE, range phys 233330..1325008, unit=VnS
  application record data type HwAgOffsRecAppl1: category=STRUCTURE, sw-calibration-access=READ-ONLY
    application record element OffsTrim: category=VALUE, type=Ag19
    application record element OffsTrimPrfmdSts: category=BOOLEAN, type=Logl1
  application record data type MotPrmNomEolRecAppl2: category=STRUCTURE, sw-calibration-access=READ-ONLY
    application record element MotKeNom: category=VALUE, type=MotCon1
    application record element MotRNom: category=VALUE, type=R6
  application record data type MotPrmNomEolRecAppl3: category=STRUCTURE, sw-calibration-access=READ-ONLY
    application record element MotBackEmfConNom: category=VALUE, type=MotCon1
    application record element MotRNom: category=VALUE, type=R6
  112 x impl type:
    Ary1D_f32_26: category=ARRAY, sw-calibration-access=READ-ONLY, type-emitter=RTE
      element Element: array-size=26, array-size-semantics=FIXED-SIZE, implementation-data-type=ImplementationDataTypes/float32
    Ary1D_f32_4: category=ARRAY, sw-calibration-access=READ-ONLY, type-emitter=RTE
      element Element: array-size=4, array-size-semantics=FIXED-SIZE, implementation-data-type=ImplementationDataTypes/float32
    Ary1D_f32_8: category=ARRAY, sw-calibration-access=READ-ONLY, type-emitter=RTE
      element Element: array-size=8, array-size-semantics=FIXED-SIZE, implementation-data-type=ImplementationDataTypes/float32
    Ary1D_ReadFltInfoRec1_20: category=ARRAY, sw-calibration-access=READ-ONLY, type-emitter=RTE
      element Element: array-size=20, array-size-semantics=FIXED-SIZE, implementation-data-type=ReadFltInfoRec1
    Ary1D_s11p4_14: category=ARRAY, sw-calibration-access=READ-ONLY, type-emitter=RTE
      element Element: array-size=14, array-size-semantics=FIXED-SIZE, implementation-data-type=s11p4
    Ary1D_s16_22: category=ARRAY, sw-calibration-access=READ-ONLY, type-emitter=RTE
      element Element: array-size=22, array-size-semantics=FIXED-SIZE, implementation-data-type=ImplementationDataTypes/sint16
    Ary1D_s1p14_128: category=ARRAY, sw-calibration-access=READ-ONLY, type-emitter=RTE
      element Element: array-size=128, array-size-semantics=FIXED-SIZE, implementation-data-type=s1p14
    Ary1D_s2p13_1024: category=ARRAY, sw-calibration-access=READ-ONLY, type-emitter=RTE
      element Element: array-size=1024, array-size-semantics=FIXED-SIZE, implementation-data-type=s2p13
    Ary1D_s2p13_1025: category=ARRAY, sw-calibration-access=READ-ONLY, type-emitter=RTE
      element Element: array-size=1025, array-size-semantics=FIXED-SIZE, implementation-data-type=s2p13
    Ary1D_s4p11_20: category=ARRAY, sw-calibration-access=READ-ONLY, type-emitter=RTE
      element Element: array-size=20, array-size-semantics=FIXED-SIZE, implementation-data-type=s4p11
    Ary1D_s8p7_14: category=ARRAY, sw-calibration-access=READ-ONLY, type-emitter=RTE
      element Element: array-size=14, array-size-semantics=FIXED-SIZE, implementation-data-type=s8p7
    Ary1D_sm6p13_144: category=ARRAY, sw-calibration-access=READ-ONLY, type-emitter=RTE
      element Element: array-size=144, array-size-semantics=FIXED-SIZE, implementation-data-type=sm6p13
    Ary1D_SnpshtDataRec1_8: category=ARRAY, sw-calibration-access=READ-ONLY, type-emitter=RTE
      element Element: array-size=8, array-size-semantics=FIXED-SIZE, implementation-data-type=SnpshtDataRec1
    Ary1D_SnpshtDataRec2_8: category=ARRAY, sw-calibration-access=READ-ONLY, type-emitter=RTE
      element Element: array-size=8, array-size-semantics=FIXED-SIZE, implementation-data-type=SnpshtDataRec2
    Ary1D_u08_20: category=ARRAY, sw-calibration-access=READ-ONLY, type-emitter=RTE
      element Element: array-size=20, array-size-semantics=FIXED-SIZE, implementation-data-type=ImplementationDataTypes/uint8
    Ary1D_u0p16_8: category=ARRAY, sw-calibration-access=READ-ONLY, type-emitter=RTE
      element Element: array-size=8, array-size-semantics=FIXED-SIZE, implementation-data-type=u0p16
    Ary1D_u10p6_4: category=ARRAY, sw-calibration-access=READ-ONLY, type-emitter=RTE
      element Element: array-size=4, array-size-semantics=FIXED-SIZE, implementation-data-type=u10p6
    Ary1D_u11p5_10: category=ARRAY, sw-calibration-access=READ-ONLY, type-emitter=RTE
      element Element: array-size=10, array-size-semantics=FIXED-SIZE, implementation-data-type=u11p5
    Ary1D_u11p5_11: category=ARRAY, sw-calibration-access=READ-ONLY, type-emitter=RTE
      element Element: array-size=11, array-size-semantics=FIXED-SIZE, implementation-data-type=u11p5
    Ary1D_u11p5_4: category=ARRAY, sw-calibration-access=READ-ONLY, type-emitter=RTE
      element Element: array-size=4, array-size-semantics=FIXED-SIZE, implementation-data-type=u11p5
    Ary1D_u12p4_13: category=ARRAY, sw-calibration-access=READ-ONLY, type-emitter=RTE
      element Element: array-size=13, array-size-semantics=FIXED-SIZE, implementation-data-type=u12p4
    Ary1D_u12p4_16: category=ARRAY, sw-calibration-access=READ-ONLY, type-emitter=RTE
      element Element: array-size=16, array-size-semantics=FIXED-SIZE, implementation-data-type=u12p4
    Ary1D_u16_12: category=ARRAY, sw-calibration-access=READ-ONLY, type-emitter=RTE
      element Element: array-size=12, array-size-semantics=FIXED-SIZE, implementation-data-type=ImplementationDataTypes/uint16
    Ary1D_u16_257: category=ARRAY, sw-calibration-access=READ-ONLY, type-emitter=RTE
      element Element: array-size=257, array-size-semantics=FIXED-SIZE, implementation-data-type=ImplementationDataTypes/uint16
    Ary1D_u16_3: category=ARRAY, sw-calibration-access=READ-ONLY, type-emitter=RTE
      element Element: array-size=3, array-size-semantics=FIXED-SIZE, implementation-data-type=ImplementationDataTypes/uint16
    Ary1D_u16p0_2: category=ARRAY, sw-calibration-access=READ-ONLY, type-emitter=RTE
      element Element: array-size=2, array-size-semantics=FIXED-SIZE, implementation-data-type=u16p0
    Ary1D_u1p15_11: category=ARRAY, sw-calibration-access=READ-ONLY, type-emitter=RTE
      element Element: array-size=11, array-size-semantics=FIXED-SIZE, implementation-data-type=u1p15
    Ary1D_u1p15_2: category=ARRAY, sw-calibration-access=READ-ONLY, type-emitter=RTE
      element Element: array-size=2, array-size-semantics=FIXED-SIZE, implementation-data-type=u1p15
    Ary1D_u2p14_16: category=ARRAY, sw-calibration-access=READ-ONLY, type-emitter=RTE
      element Element: array-size=16, array-size-semantics=FIXED-SIZE, implementation-data-type=u2p14
    Ary1D_u2p14_2: category=ARRAY, sw-calibration-access=READ-ONLY, type-emitter=RTE
      element Element: array-size=2, array-size-semantics=FIXED-SIZE, implementation-data-type=u2p14
    Ary1D_u2p14_5: category=ARRAY, sw-calibration-access=READ-ONLY, type-emitter=RTE
      element Element: array-size=5, array-size-semantics=FIXED-SIZE, implementation-data-type=u2p14
    Ary1D_u2p14_6: category=ARRAY, sw-calibration-access=READ-ONLY, type-emitter=RTE
      element Element: array-size=6, array-size-semantics=FIXED-SIZE, implementation-data-type=u2p14
    Ary1D_u32_2: category=ARRAY, sw-calibration-access=READ-ONLY, type-emitter=RTE
      element Element: array-size=2, array-size-semantics=FIXED-SIZE, implementation-data-type=ImplementationDataTypes/uint32
    Ary1D_u32_8: category=ARRAY, sw-calibration-access=READ-ONLY, type-emitter=RTE
      element Element: array-size=8, array-size-semantics=FIXED-SIZE, implementation-data-type=ImplementationDataTypes/uint32
    Ary1D_u3p13_10: category=ARRAY, sw-calibration-access=READ-ONLY, type-emitter=RTE
      element Element: array-size=10, array-size-semantics=FIXED-SIZE, implementation-data-type=u3p13
    Ary1D_u4p12_11: category=ARRAY, sw-calibration-access=READ-ONLY, type-emitter=RTE
      element Element: array-size=11, array-size-semantics=FIXED-SIZE, implementation-data-type=u4p12
    Ary1D_u4p12_12: category=ARRAY, sw-calibration-access=READ-ONLY, type-emitter=RTE
      element Element: array-size=12, array-size-semantics=FIXED-SIZE, implementation-data-type=u4p12
    Ary1D_u4p12_14: category=ARRAY, sw-calibration-access=READ-ONLY, type-emitter=RTE
      element Element: array-size=14, array-size-semantics=FIXED-SIZE, implementation-data-type=u4p12
    Ary1D_u5p11_13: category=ARRAY, sw-calibration-access=READ-ONLY, type-emitter=RTE
      element Element: array-size=13, array-size-semantics=FIXED-SIZE, implementation-data-type=u5p11
    Ary1D_u5p11_16: category=ARRAY, sw-calibration-access=READ-ONLY, type-emitter=RTE
      element Element: array-size=16, array-size-semantics=FIXED-SIZE, implementation-data-type=u5p11
    Ary1D_u5p11_5: category=ARRAY, sw-calibration-access=READ-ONLY, type-emitter=RTE
      element Element: array-size=5, array-size-semantics=FIXED-SIZE, implementation-data-type=u5p11
    Ary1D_u7p9_4: category=ARRAY, sw-calibration-access=READ-ONLY, type-emitter=RTE
      element Element: array-size=4, array-size-semantics=FIXED-SIZE, implementation-data-type=u7p9
    Ary1D_u8_10: category=ARRAY, sw-calibration-access=READ-ONLY, type-emitter=RTE
      element Element: array-size=10, array-size-semantics=FIXED-SIZE, implementation-data-type=PlatformTypes/uint8
    Ary1D_u8_16: category=ARRAY, sw-calibration-access=READ-ONLY, type-emitter=RTE
      element Element: array-size=16, array-size-semantics=FIXED-SIZE, implementation-data-type=PlatformTypes/uint8
    Ary1D_u8_20: category=ARRAY, sw-calibration-access=READ-ONLY, type-emitter=RTE
      element Element: array-size=20, array-size-semantics=FIXED-SIZE, implementation-data-type=PlatformTypes/uint8
    Ary1D_u8_22: category=ARRAY, sw-calibration-access=READ-ONLY, type-emitter=RTE
      element Element: array-size=22, array-size-semantics=FIXED-SIZE, implementation-data-type=PlatformTypes/uint8
    Ary1D_u8_48: category=ARRAY, sw-calibration-access=READ-ONLY, type-emitter=RTE
      element Element: array-size=48, array-size-semantics=FIXED-SIZE, implementation-data-type=PlatformTypes/uint8
    Ary1D_u8_6: category=ARRAY, sw-calibration-access=READ-ONLY, type-emitter=RTE
      element Element: array-size=6, array-size-semantics=FIXED-SIZE, implementation-data-type=PlatformTypes/uint8
    Ary1D_u8_CmnMfgSrvIf: category=ARRAY, type-emitter=CmnMfgSrvIf
      element Element: array-size=65535, array-size-semantics=FIXED-SIZE, implementation-data-type=PlatformTypes/uint8
    Ary1D_u8p8_14: category=ARRAY, sw-calibration-access=READ-ONLY, type-emitter=RTE
      element Element: array-size=14, array-size-semantics=FIXED-SIZE, implementation-data-type=u8p8
    Ary1D_u8p8_2: category=ARRAY, sw-calibration-access=READ-ONLY, type-emitter=RTE
      element Element: array-size=2, array-size-semantics=FIXED-SIZE, implementation-data-type=u8p8
    Ary1D_u8p8_20: category=ARRAY, sw-calibration-access=READ-ONLY, type-emitter=RTE
      element Element: array-size=20, array-size-semantics=FIXED-SIZE, implementation-data-type=u8p8
    Ary1D_u8p8_4: category=ARRAY, sw-calibration-access=READ-ONLY, type-emitter=RTE
      element Element: array-size=4, array-size-semantics=FIXED-SIZE, implementation-data-type=u8p8
    Ary1D_u8p8_8: category=ARRAY, sw-calibration-access=READ-ONLY, type-emitter=RTE
      element Element: array-size=8, array-size-semantics=FIXED-SIZE, implementation-data-type=u8p8
    Ary1D_u9p7_12: category=ARRAY, sw-calibration-access=READ-ONLY, type-emitter=RTE
      element Element: array-size=12, array-size-semantics=FIXED-SIZE, implementation-data-type=u9p7
    Ary1D_u9p7_16: category=ARRAY, sw-calibration-access=READ-ONLY, type-emitter=RTE
      element Element: array-size=16, array-size-semantics=FIXED-SIZE, implementation-data-type=u9p7
    Ary1D_u9p7_4: category=ARRAY, sw-calibration-access=READ-ONLY, type-emitter=RTE
      element Element: array-size=4, array-size-semantics=FIXED-SIZE, implementation-data-type=u9p7
    Ary1D_u9p7_6: category=ARRAY, sw-calibration-access=READ-ONLY, type-emitter=RTE
      element Element: array-size=6, array-size-semantics=FIXED-SIZE, implementation-data-type=u9p7
    Ary1D_u9p7_7: category=ARRAY, sw-calibration-access=READ-ONLY, type-emitter=RTE
      element Element: array-size=7, array-size-semantics=FIXED-SIZE, implementation-data-type=u9p7
    Ary1D_u9p7_9: category=ARRAY, sw-calibration-access=READ-ONLY, type-emitter=RTE
      element Element: array-size=9, array-size-semantics=FIXED-SIZE, implementation-data-type=u9p7
    Ary2D_f32_8_4: category=ARRAY, sw-calibration-access=READ-ONLY, type-emitter=RTE
      element Element: array-size=8, array-size-semantics=FIXED-SIZE, implementation-data-type=Ary1D_f32_4
    Ary2D_s4p11_12_20: category=ARRAY, sw-calibration-access=READ-ONLY, type-emitter=RTE
      element Element: array-size=12, array-size-semantics=FIXED-SIZE, implementation-data-type=Ary1D_s4p11_20
    Ary2D_u12p4_12_13: category=ARRAY, sw-calibration-access=READ-ONLY, type-emitter=RTE
      element Element: array-size=12, array-size-semantics=FIXED-SIZE, implementation-data-type=Ary1D_u12p4_13
    Ary2D_u12p4_9_16: category=ARRAY, sw-calibration-access=READ-ONLY, type-emitter=RTE
      element Element: array-size=9, array-size-semantics=FIXED-SIZE, implementation-data-type=Ary1D_u12p4_16
    Ary2D_u16_8_3: category=ARRAY, sw-calibration-access=READ-ONLY, type-emitter=RTE
      element Element: array-size=8, array-size-semantics=FIXED-SIZE, implementation-data-type=Ary1D_u16_3
    Ary2D_u2p14_12_5: category=ARRAY, sw-calibration-access=READ-ONLY, type-emitter=RTE
      element Element: array-size=12, array-size-semantics=FIXED-SIZE, implementation-data-type=Ary1D_u2p14_5
    Ary2D_u2p14_7_6: category=ARRAY, sw-calibration-access=READ-ONLY, type-emitter=RTE
      element Element: array-size=7, array-size-semantics=FIXED-SIZE, implementation-data-type=Ary1D_u2p14_6
    Ary2D_u5p11_12_13: category=ARRAY, sw-calibration-access=READ-ONLY, type-emitter=RTE
      element Element: array-size=12, array-size-semantics=FIXED-SIZE, implementation-data-type=Ary1D_u5p11_13
    Ary2D_u5p11_12_5: category=ARRAY, sw-calibration-access=READ-ONLY, type-emitter=RTE
      element Element: array-size=12, array-size-semantics=FIXED-SIZE, implementation-data-type=Ary1D_u5p11_5
    Ary2D_u5p11_9_16: category=ARRAY, sw-calibration-access=READ-ONLY, type-emitter=RTE
      element Element: array-size=9, array-size-semantics=FIXED-SIZE, implementation-data-type=Ary1D_u5p11_16
    Ary2D_u7p9_8_4: category=ARRAY, sw-calibration-access=READ-ONLY, type-emitter=RTE
      element Element: array-size=8, array-size-semantics=FIXED-SIZE, implementation-data-type=Ary1D_u7p9_4
    Ary2D_u7p9_9_4: category=ARRAY, sw-calibration-access=READ-ONLY, type-emitter=RTE
      element Element: array-size=9, array-size-semantics=FIXED-SIZE, implementation-data-type=Ary1D_u7p9_4
    Ary2D_u8p8_12_20: category=ARRAY, sw-calibration-access=READ-ONLY, type-emitter=RTE
      element Element: array-size=12, array-size-semantics=FIXED-SIZE, implementation-data-type=Ary1D_u8p8_20
    Ary2D_u8p8_9_4: category=ARRAY, sw-calibration-access=READ-ONLY, type-emitter=RTE
      element Element: array-size=9, array-size-semantics=FIXED-SIZE, implementation-data-type=Ary1D_u8p8_4
    Ary2D_u8p8_9_8: category=ARRAY, sw-calibration-access=READ-ONLY, type-emitter=RTE
      element Element: array-size=9, array-size-semantics=FIXED-SIZE, implementation-data-type=Ary1D_u8p8_8
    HwAgOffsRec1: category=STRUCTURE, sw-calibration-access=READ-ONLY, type-emitter=RTE
      element OffsTrim: implementation-data-type=ImplementationDataTypes/float32
      element OffsTrimPrfmdSts: implementation-data-type=ImplementationDataTypes/boolean
    MfgEnaSt1: compu {0=MFGENAST_PRDNMOD, 1=MFGENAST_MFGMOD, 2=MFGENAST_TESTMOD}, implementation-data-type=ImplementationDataTypes/uint8, type-emitter=RTE
    MotAgEolPrmRec1: category=STRUCTURE, sw-calibration-access=READ-ONLY, type-emitter=RTE
      12 x element, all with category=TYPE_REFERENCE:
        SinOffs: implementation-data-type=u3p13
        CosOffs: implementation-data-type=u3p13
        SinAmpRecpr: implementation-data-type=u3p13
        CosAmpRecpr: implementation-data-type=u3p13
        SinDelta: implementation-data-type=s2p13
        SinHrmncTbl: implementation-data-type=Ary1D_sm6p13_144
        CosHrmncTbl: implementation-data-type=Ary1D_sm6p13_144
        SinGainCorrd: implementation-data-type=u1p15
        CosGainCorrd: implementation-data-type=u1p15
        SinOffsCorrd: implementation-data-type=s2p13
        CosOffsCorrd: implementation-data-type=s2p13
        CosDeltaRecpr: implementation-data-type=u3p13
    MotAgMeasEolPrmRec1: category=STRUCTURE, sw-calibration-access=READ-ONLY, type-emitter=RTE
      5 x element, all with category=TYPE_REFERENCE, implementation-data-type=ImplementationDataTypes/float32:
        SinOffs
        CosOffs
        SinAmpRecpr
        CosAmpRecpr
        SinDelta
    MotPrmNomEolRec2: category=STRUCTURE, sw-calibration-access=READ-ONLY, type-emitter=RTE
      element MotKeNom: implementation-data-type=PlatformTypes/float32
      element MotRNom: implementation-data-type=PlatformTypes/float32
      symbol props MotPrmNomEolRec2
    MotPrmNomEolRec3: category=STRUCTURE, sw-calibration-access=READ-ONLY, type-emitter=RTE
      element MotBackEmfConNom: implementation-data-type=ImplementationDataTypes/float32
      element MotRNom: implementation-data-type=ImplementationDataTypes/float32
      symbol props MotPrmNomEolRec3
    NtcInfoRec4: category=STRUCTURE, sw-calibration-access=READ-ONLY, type-emitter=DiagcMgr
      element NtcStInfo: implementation-data-type=ImplementationDataTypes/uint8
      element Sts: implementation-data-type=ImplementationDataTypes/uint8
      element AgiCntr: implementation-data-type=ImplementationDataTypes/uint8
    NtcNr1: compu {1..511=NTCNR_0X001..NTCNR_0X1FF}, implementation-data-type=ImplementationDataTypes/uint16, type-emitter=RTE
    NtcNrWithResd1: compu {0=NTCNR_RESD, 1..511=NTCNR_0X001..NTCNR_0X1FF}, implementation-data-type=ImplementationDataTypes/uint16, type-emitter=RTE
    ReadFltInfoRec1: category=STRUCTURE, sw-calibration-access=READ-ONLY, type-emitter=RTE
      4 x element, all with category=TYPE_REFERENCE:
        NtcNr: implementation-data-type=NtcNrWithResd1
        AgiCntr: implementation-data-type=ImplementationDataTypes/uint8
        Sts: implementation-data-type=ImplementationDataTypes/uint8
        NtcStInfo: implementation-data-type=ImplementationDataTypes/uint8
    s11p4: implementation-data-type=ImplementationDataTypes/sint16, type-emitter=RTE
    s15p16: implementation-data-type=sint32, type-emitter=RTE
    s18p13: implementation-data-type=sint32, type-emitter=RTE
    s1p14: implementation-data-type=ImplementationDataTypes/sint16, type-emitter=RTE
    s2p13: implementation-data-type=ImplementationDataTypes/sint16, type-emitter=RTE
    s4p11: implementation-data-type=ImplementationDataTypes/sint16, type-emitter=RTE
    s5p10: implementation-data-type=ImplementationDataTypes/sint16, type-emitter=RTE
    s8p7: implementation-data-type=ImplementationDataTypes/sint16, type-emitter=RTE
    sm6p13: implementation-data-type=ImplementationDataTypes/sint8, type-emitter=RTE
    SnpshtDataRec1: category=STRUCTURE, sw-calibration-access=READ-ONLY, type-emitter=RTE
      10 x element, all with category=TYPE_REFERENCE:
        MicroDiagcData: implementation-data-type=PlatformTypes/uint32
        HwTq: implementation-data-type=s5p10
        MotTq: implementation-data-type=s5p10
        IgnCntr: implementation-data-type=PlatformTypes/uint32
        BrdgVltg: implementation-data-type=u6p10
        EcuT: implementation-data-type=s8p7
        NtcNr: implementation-data-type=PlatformTypes/uint16
        NtcStInfo: implementation-data-type=PlatformTypes/uint8
        SysSt: implementation-data-type=SysSt1
        VehSpd: implementation-data-type=u9p7
    SnpshtDataRec2: category=STRUCTURE, sw-calibration-access=READ-ONLY, type-emitter=RTE
      12 x element, all with category=TYPE_REFERENCE:
        SpclSnpshtData{0..2}: implementation-data-type=ImplementationDataTypes/uint32
        MicroDiagcData: implementation-data-type=ImplementationDataTypes/uint32
        IgnCntr: implementation-data-type=ImplementationDataTypes/uint32
        HwTq: implementation-data-type=s5p10
        MotTq: implementation-data-type=s5p10
        BrdgVltg: implementation-data-type=u6p10
        EcuT: implementation-data-type=s8p7
        NtcNr: implementation-data-type=NtcNrWithResd1
        NtcStInfo: implementation-data-type=ImplementationDataTypes/uint8
        SysSt: implementation-data-type=SysSt1
    SysFricLrngOperMod1: compu {0=SYSFRICLRNGOPERMOD_CALIBRATION, 1=SYSFRICLRNGOPERMOD_NORMAL, 2=SYSFRICLRNGOPERMOD_CLEAR, 3=SYSFRICLRNGOPERMOD_IDLE, 4=SYSFRICLRNGOPERMOD_BASELINE}, implementation-data-type=ImplementationDataTypes/uint8, type-emitter=RTE
    SysSt1: compu {0=SYSST_DI, 1=SYSST_OFF, 2=SYSST_ENA, 3=SYSST_WRMININ}, implementation-data-type=ImplementationDataTypes/uint8, type-emitter=RTE
    u0p16: implementation-data-type=ImplementationDataTypes/uint16, type-emitter=RTE
    u10p6: implementation-data-type=ImplementationDataTypes/uint16, type-emitter=RTE
    u11p5: implementation-data-type=ImplementationDataTypes/uint16, type-emitter=RTE
    u12p4: implementation-data-type=ImplementationDataTypes/uint16, type-emitter=RTE
    u16p0: implementation-data-type=ImplementationDataTypes/uint16, type-emitter=RTE
    u1p15: implementation-data-type=ImplementationDataTypes/uint16, type-emitter=RTE
    u2p14: implementation-data-type=ImplementationDataTypes/uint16, type-emitter=RTE
    u3p13: implementation-data-type=ImplementationDataTypes/uint16, type-emitter=RTE
    u4p12: implementation-data-type=ImplementationDataTypes/uint16, type-emitter=RTE
    u5p11: implementation-data-type=ImplementationDataTypes/uint16, type-emitter=RTE
    u6p10: implementation-data-type=ImplementationDataTypes/uint16, type-emitter=RTE
    u7p9: implementation-data-type=ImplementationDataTypes/uint16, type-emitter=RTE
    u8p8: implementation-data-type=ImplementationDataTypes/uint16, type-emitter=RTE
    u9p7: implementation-data-type=ImplementationDataTypes/uint16, type-emitter=RTE
package /Nexteer/NvMProxy_swc/DataTypes
  impl type NvM_RequestResultType: category=VALUE, base-type=NvM_RequestResultType, compu {0=NVM_REQ_OK, 1=NVM_REQ_NOT_OK, 2=NVM_REQ_PENDING, 3=NVM_REQ_INTEGRITY_FAILED, 4=NVM_REQ_BLOCK_SKIPPED, 5=NVM_REQ_NV_INVALIDATED, 6=NVM_REQ_CANCELED, 7=NVM_REQ_REDUNDANCY_FAILED, 8=NVM_REQ_RESTORED_FROM_ROM}
package /Nexteer/NvMProxy_swc/DataTypes/BaseTypes
  base type NvM_RequestResultType: category=FIXED_LENGTH, base-type-size=8, base-type-encoding=NONE, native-declaration=uint8
package /Nexteer/Units
  39 x unit, all with factor-si-to-unit=1, offset-si-to-unit=0:
    Ampr: display-name=Amp
    AmprPerVolt: display-name=Amp/V
    AmprSqd: display-name=Amp^2
    Cnt: display-name=Cnt
    DegCgrd: display-name=degC
    DegCgrdPerVolt: display-name=degC/Volt
    FixdPt
    Henry: display-name=H
    HwDeg: display-name=HwDeg
    HwDegPerSec: display-name=HwDeg/s
    HwNwtMtr: display-name=HwNm
    HwRadPerSec: display-name=HwRad/s
    Hz: display-name=Hz
    Kph: display-name=kph
    KphPerSec: display-name=kph/s
    KphPerSecSqd: display-name=kph/s^2
    MicroSec: display-name=uS
    MotDeg: display-name=MotDeg
    MotDegPerHwDeg: display-name=MotDeg/HwDeg
    MotNwtMtr: display-name=MotNm
    MotNwtMtrPerMotRadPerSec: display-name=MotNm/MotRad/S
    MotRad: display-name=MotRad
    MotRadPerSec: display-name=MotRad/s
    MotRev: display-name=MotRev
    MotRevElec: display-name=MotRevElec
    MtrPerSecSqd: display-name=m/s^2
    NanoSec: display-name=nS
    Ohm: display-name=ohm
    OhmPerDegCgrd: display-name=ohm/degC
    Sec: display-name=sec
    Uls: display-name=Uls
    UlsPerSec: display-name=Uls/S
    VehDegPerSec: display-name=VehDeg/S
    VehDegPerSecSqd: display-name=VehDeg/S^2
    Volt: display-name=V
    VoltNanoSec: display-name=VnS
    VoltPerMotRadPerSec: display-name=V/MotRad/Sec
    VoltPerMotRadPerSecPerDegCgrd: display-name=V/MotRad/S/degC
    VoltPerVoltNanoSec
