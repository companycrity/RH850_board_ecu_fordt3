AUTOSAR XML (schema 4-0-3)
package /ActiveEcuC
  module config SyncCrc: implementation-config-variant=VARIANT-PRE-COMPILE, module-description=SyncCrc_Impl
    SyncCrcCommon: AutosarWrapperEnable=STD_OFF, DeviceType=P1M-C, ReservedCRCHardwareUnits=0, CrcOsApplicationReference=Appl10
