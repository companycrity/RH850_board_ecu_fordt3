AUTOSAR XML (schema 4-0-3)
standard types defined: float32_DataConstr, float64_DataConstr, sint16_DataConstr, sint32_DataConstr, sint8_DataConstr, uint16_DataConstr, uint32_DataConstr, uint8_DataConstr, boolean, float32, float64, sint16, sint32, sint8, uint16, uint32, uint8
package /Nexteer/DataTypes
  5 x impl type, all with type-emitter=RTE:
    Ary1D_CrcHwStsRec2_8: category=ARRAY, sw-calibration-access=READ-ONLY
      element Element: array-size=8, array-size-semantics=FIXED-SIZE, implementation-data-type=CrcHwStsRec2
    CrcHwResvCfg1: compu {0=CRCHWRESVCFG_32BITCRC32BITWIDTH, 1=CRCHWRESVCFG_32BITCRC16BITWIDTH, 2=CRCHWRESVCFG_32BITCRC8BITWIDTH, 3=CRCHWRESVCFG_16BITCRC16BITWIDTH, 4=CRCHWRESVCFG_16BITCRC8BITWIDTH, 5=CRCHWRESVCFG_8BITCRC, 6=CRCHWRESVCFG_8BITCRCH2F}, implementation-data-type=uint8
    CrcHwResvMod1: compu {0=CRCHWRESVMOD_RELS, 1=CRCHWRESVMOD_RESV}, implementation-data-type=uint8
    CrcHwSts1: compu {0=CRCHWSTS_NOTAVL, 1=CRCHWSTS_AVL, 2=CRCHWSTS_BUSY, 3=CRCHWSTS_NOTENAD, 4=CRCHWSTS_RESV, 255=CRCHWSTS_IDXINVLD}, implementation-data-type=uint8
    CrcHwStsRec2: category=STRUCTURE, sw-calibration-access=READ-ONLY
      element TaskId: implementation-data-type=uint32
      element CrcHwSts: implementation-data-type=CrcHwSts1
