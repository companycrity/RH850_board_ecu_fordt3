AUTOSAR XML (schema 4-0-3)
# COPYRIGHT
# Copyright (c) 2016 by Vector Informatik GmbH. All rights reserved.
# This software is copyright protected and proprietary to Vector Informatik GmbH.
# Vector Informatik GmbH grants to you only those rights as set out in the license conditions.
package /MICROSAR
  module config Com_Pre: definition=Com
    ComGeneral: ComAdvancedIPduCallouts=1
  module config Com_Rec: definition=Com, implementation-config-variant=VARIANT-PRE-COMPILE
    ComConfig
    ComGeneral: ComConfigurationUseDet=0, ComRetryFailedTransmitRequests=1, ComVersionInfoApi=1
  module config Com_Rec_Class2: definition=Com
    ComConfig
      ComIPdu
        ComTxIPdu: ComTxIPduUnusedAreasDefault=0
  module config Com_Rec_Class4: definition=Com
    ComConfig
      ComSignal: ComSignalEndianness=BIG_ENDIAN
  module config Com_Rec_Class5: definition=Com
    ComConfig
      ComSignalGroup
        ComGroupSignal: ComSignalEndianness=BIG_ENDIAN
