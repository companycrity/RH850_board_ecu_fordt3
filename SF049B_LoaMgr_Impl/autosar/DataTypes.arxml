AUTOSAR XML (schema 4-0-3)
standard types defined: boolean, float32, uint16, uint8, boolean_CompuMethod, boolean_DataConstr, float32_DataConstr, uint16_DataConstr, uint8_DataConstr
package /Nexteer/DataTypes
  5 x impl type, all with category=TYPE_REFERENCE, type-emitter=RTE:
    IvtrFetFltTyp1: compu {0=IVTRFETFLTTYP_NOFETFLT, 1=IVTRFETFLTTYP_LOWRFETFLT, 2=IVTRFETFLTTYP_UPPRFETFLT, 4=IVTRFETFLTTYP_MPLFETFLT}, implementation-data-type=uint8
    LoaSt1: compu {0=LOAST_NORM, 1=LOAST_LIMD, 2=LOAST_SWBASDMTGTN, 3=LOAST_FADEOUT, 4=LOAST_CTRLDSHTDWNREQD, 5=LOAST_IMDTSHTDWNREQD}, implementation-data-type=uint8
    NtcNr1: compu {1..511=NTCNR_0X001..NTCNR_0X1FF}, implementation-data-type=uint16
    NtcSts1: compu {0=NTCSTS_PASSD, 1=NTCSTS_FAILD, 2=NTCSTS_PREPASSD, 3=NTCSTS_PREFAILD}, implementation-data-type=uint8
    SteerMod1: compu {0=STEERMOD_BASEPS, 1=STEERMOD_SEMIATNMS, 2=STEERMOD_FULLYATNMS}, implementation-data-type=uint8
