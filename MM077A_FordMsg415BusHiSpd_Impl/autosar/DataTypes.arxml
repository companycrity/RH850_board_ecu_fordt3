AUTOSAR XML (schema 4-0-3)
standard types defined: boolean, float32, uint16, uint32, uint8, boolean_CompuMethod, boolean_DataConstr, float32_DataConstr, uint16_DataConstr, uint32_DataConstr, uint8_DataConstr
package /DataType/Unit
  unit U_kph: display-name=kph, factor-si-to-unit=1, offset-si-to-unit=0
  unit U_SED: display-name=SED, factor-si-to-unit=1, offset-si-to-unit=0
  unit Unitless: display-name=Unitless, factor-si-to-unit=1, offset-si-to-unit=0
package /Ford/DataTypes
  5 x impl type, all with category=VALUE, sw-calibration-access=READ-ONLY:
    Ford_LsmcBrkDecel_D_Stat: base-type=DataType/uint8, compu {phys=raw for raw 0..7, 0=Cx0_Off, 1=Cx1_On, 2=Cx2_FaultExt, 3=Cx3_FaultDegraded, 4=Cx4_Denied, 5=Cx5_NotUsed_1, 6=Cx6_NotUsed_2, 7=Cx7_NotUsed_3; unit SED}, range raw 0..7
    Ford_Veh_V_ActlBrk: base-type=DataType/uint16, compu {phys=raw*0.01 for raw 0..65535; unit kph}
    Ford_VehVActlBrk_D_Qf: base-type=DataType/uint8, compu {phys=raw for raw 0..3, 0=Cx0_Faulty, 1=Cx1_No_Data_Exists, 2=Cx2_Not_Within_Specifications, 3=Cx3_OK; unit SED}, range raw 0..3
    Ford_VehVActlBrk_No_Cnt: base-type=DataType/uint8, compu {phys=raw for raw 0..15; unit Unitless}, range raw 0..15
    Ford_VehVActlBrk_No_Cs: base-type=DataType/uint8, compu {phys=raw for raw 0..255; unit Unitless}
package /Nexteer/DataTypes
  impl type NtcNr1: compu {1..511=NTCNR_0X001..NTCNR_0X1FF}, implementation-data-type=uint16, type-emitter=RTE
  impl type NtcSts1: compu {0=NTCSTS_PASSD, 1=NTCSTS_FAILD, 2=NTCSTS_PREPASSD, 3=NTCSTS_PREFAILD}, implementation-data-type=uint8, type-emitter=RTE
