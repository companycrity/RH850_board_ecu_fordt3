AUTOSAR XML (schema 4-0-3)
package /Ford/PortInterfaces
  5 x sender receiver interface:
    Ford_LsmcBrkDecel_D_Stat: invalidation-policy{data-element=Ford_LsmcBrkDecel_D_Stat, handle-invalid=DONT-INVALIDATE}
      data Ford_LsmcBrkDecel_D_Stat: sw-calibration-access=READ-ONLY, type=Ford_LsmcBrkDecel_D_Stat
    Ford_Veh_V_ActlBrk: invalidation-policy{data-element=Ford_Veh_V_ActlBrk, handle-invalid=DONT-INVALIDATE}
      data Ford_Veh_V_ActlBrk: sw-calibration-access=READ-ONLY, type=Ford_Veh_V_ActlBrk
    Ford_VehVActlBrk_D_Qf: invalidation-policy{data-element=Ford_VehVActlBrk_D_Qf, handle-invalid=DONT-INVALIDATE}
      data Ford_VehVActlBrk_D_Qf: sw-calibration-access=READ-ONLY, type=Ford_VehVActlBrk_D_Qf
    Ford_VehVActlBrk_No_Cnt: invalidation-policy{data-element=Ford_VehVActlBrk_No_Cnt, handle-invalid=DONT-INVALIDATE}
      data Ford_VehVActlBrk_No_Cnt: sw-calibration-access=READ-ONLY, type=Ford_VehVActlBrk_No_Cnt
    Ford_VehVActlBrk_No_Cs: invalidation-policy{data-element=Ford_VehVActlBrk_No_Cs, handle-invalid=DONT-INVALIDATE}
      data Ford_VehVActlBrk_No_Cs: sw-calibration-access=READ-ONLY, type=Ford_VehVActlBrk_No_Cs
package /Nexteer/Calibrations
  parameter interface uint16_CalPortIf1
    parameter data prototype Val: sw-calibration-access=READ-WRITE, type=uint16
package /Nexteer/PortInterfaces
  client server interface GetRefTmr100MicroSec32bit_PortIf1
    operation Oper
      arg RefTmr_Arg: type=uint32, direction=OUT, server-argument-impl-policy=USE-ARGUMENT-TYPE
  client server interface GetTiSpan100MicroSec32bit_PortIf1
    operation Oper
      arg RefTmr_Arg: type=uint32, direction=IN, server-argument-impl-policy=USE-ARGUMENT-TYPE
      arg TiSpan_Arg: type=uint32, direction=OUT, server-argument-impl-policy=USE-ARGUMENT-TYPE
  client server interface SetNtcSts_PortIf1
    operation Oper: possible-error=E_NOT_OK
      4 x arg, all with direction=IN, server-argument-impl-policy=USE-ARGUMENT-TYPE:
        NtcNr_Arg: type=NtcNr1
        NtcStInfo_Arg: type=uint8
        NtcSts_Arg: type=NtcSts1
        DebStep_Arg: type=uint16
    error E_NOT_OK: error-code=1
  4 x sender receiver interface:
    boolean_PortIf1: invalidation-policy{data-element=Logl, handle-invalid=DONT-INVALIDATE}
      data Logl: sw-calibration-access=READ-ONLY, type=boolean
    float32_PortIf1: invalidation-policy{data-element=float32_PortIf1/Val, handle-invalid=DONT-INVALIDATE}
      data Val: sw-calibration-access=READ-ONLY, type=float32
    uint16_PortIf1: invalidation-policy{data-element=uint16_PortIf1/Val, handle-invalid=DONT-INVALIDATE}
      data Val: sw-calibration-access=READ-ONLY, type=uint16
    uint8_PortIf1: invalidation-policy{data-element=uint8_PortIf1/Val, handle-invalid=DONT-INVALIDATE}
      data Val: sw-calibration-access=READ-ONLY, type=uint8
