AUTOSAR XML (schema 4-0-3)
standard types defined: boolean, float32, sint8, uint16, uint32, uint8, boolean_CompuMethod, boolean_DataConstr, float32_DataConstr, sint8_DataConstr, uint16_DataConstr, uint32_DataConstr, uint8_DataConstr
package /Nexteer/DataTypes
  impl type Ary1D_u0p16_8: category=ARRAY, sw-calibration-access=READ-ONLY, type-emitter=RTE
    element Element: array-size=8, array-size-semantics=FIXED-SIZE, implementation-data-type=u0p16
  impl type Ary1D_u32_8: category=ARRAY, sw-calibration-access=READ-ONLY, type-emitter=RTE
    element Element: array-size=8, array-size-semantics=FIXED-SIZE, implementation-data-type=uint32
  impl type u0p16: implementation-data-type=uint16, type-emitter=RTE
