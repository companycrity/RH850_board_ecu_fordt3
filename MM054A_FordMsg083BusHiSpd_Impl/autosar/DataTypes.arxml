AUTOSAR XML (schema 4-0-3)
standard types defined: boolean, uint16, uint32, uint8, boolean_CompuMethod, boolean_DataConstr, uint16_DataConstr, uint32_DataConstr, uint8_DataConstr
package /DataType/Unit
  unit U_SED: display-name=SED, factor-si-to-unit=1, offset-si-to-unit=0
package /Ford/DataTypes
  impl type Ford_TurnLghtSwtch_D_Stat: category=VALUE, base-type=DataType/uint8, sw-calibration-access=READ-ONLY, compu {phys=raw for raw 0..3, 0=Cx0_Off, 1=Cx1_Left, 2=Cx2_Right, 3=Cx3_Unused_Treat_As_Off; unit SED}, range raw 0..3
package /Nexteer/DataTypes
  impl type NtcNr1: compu {1..511=NTCNR_0X001..NTCNR_0X1FF}, implementation-data-type=uint16, type-emitter=RTE
  impl type NtcSts1: compu {0=NTCSTS_PASSD, 1=NTCSTS_FAILD, 2=NTCSTS_PREPASSD, 3=NTCSTS_PREFAILD}, implementation-data-type=uint8, type-emitter=RTE
